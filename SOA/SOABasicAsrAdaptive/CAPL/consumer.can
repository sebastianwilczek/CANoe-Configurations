/*@!Encoding:1252*/

/* 
   Consumer side CAPL application model for service 'Calculator'
   This model calls a method and prints the result
   Additionally, the value of the event 'State' is printed
*/



// Call method 'Add' of service 'Calculator' when key 'c' is pressed 
on key 'c'
{
  CommunicationObjects::Calculator[Consumer,Provider].Divide.CallAsync(3,0);
}

// Toggle subscription for Event 'State' upon panel switch button is pressed
on sysvar ConsumerPanel::SubscribeStateEvent
{
  if (@ConsumerPanel::SubscribeStateEvent == 2)
  {
    CommunicationObjects::Calculator.consumerSide[Consumer,Provider].State.AbstractRequestEvent();
  }
  else
  {
    CommunicationObjects::Calculator.consumerSide[Consumer,Provider].State.AbstractReleaseEvent();
  }
}
// This handler is called when the return value of method 'Add' of service 'Calculator' is received
on fctReturned CommunicationObjects::Calculator[Consumer,Provider].Divide
{
  write("Result of Add method: %f", this.result); // Print result in the Write Window of CANoe
}

// This handler is called when the value of the event 'State' changed
on value_change CommunicationObjects::Calculator.consumerSide[Consumer,Provider].State
{
  write("State event received. AddCount: %d, SubstractCount: %d, MultiplyCount: %d, DivideCount: %d", 
         $CommunicationObjects::Calculator.consumerSide[Consumer,Provider].State.AddCount,
         $CommunicationObjects::Calculator.consumerSide[Consumer,Provider].State.SubstractCount,
         $CommunicationObjects::Calculator.consumerSide[Consumer,Provider].State.MultiplyCount,
         $CommunicationObjects::Calculator.consumerSide[Consumer,Provider].State.DivideCount);
}


