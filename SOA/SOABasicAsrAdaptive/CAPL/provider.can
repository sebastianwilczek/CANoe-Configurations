/*@!Encoding:1252*/

/* 
   Provider side CAPL application model for service 'Calculator'
   This model implements all methods and events of the service
*/

variables
{
  msTimer stateEventTimer; // Timer for event transmission
  int gAddCount;           // Number of add operations
  int gSubstractCount;     // Number of substract operations
  int gMultiplyCount;      // Number of multiply operations
  int gDivideCount;        // Number of divide operations
}


on start
{
  // Set timer to cyclic interval of 1000 milliseconds
  setTimerCyclic(stateEventTimer, 1000);
}

on timer stateEventTimer
{
  // Update state event. This will also trigger the transmission of the event
  $CommunicationObjects::Calculator[Provider].State.AddCount = gAddCount;
  $CommunicationObjects::Calculator[Provider].State.SubstractCount = gSubstractCount;
  $CommunicationObjects::Calculator[Provider].State.MultiplyCount = gMultiplyCount;
  $CommunicationObjects::Calculator[Provider].State.DivideCount = gDivideCount;
}

// Implementation for method 'Add'
on fctCalled CommunicationObjects::Calculator[Provider].Add
{
  this.result = this.operand1 + this.operand2; // Calculate result
  gAddCount++;                                 // Update counter
  this.ReturnCall();                           // Return result
}

// Implementation for method 'Substract'
on fctCalled CommunicationObjects::Calculator[Provider].Substract
{
  this.result = this.operand1 - this.operand2;
  gSubstractCount++;
  this.ReturnCall();
}

// Implementation for method 'Multiply'
on fctCalled CommunicationObjects::Calculator[Provider].Multiply
{
  this.result = this.operand1 * this.operand2;
  gMultiplyCount++;
  this.ReturnCall();
}

// Implementation for method 'Divide'
on fctCalled CommunicationObjects::Calculator[Provider].Divide
{
  // Prevent division by zero
  if (this.operand2 != 0.0)
  {
    this.result = this.operand1 / this.operand2;
  }
  else
  {
	if (this.operand1 > 0.0)
	{
		this.result = atodbl("INF");
	}
	else if (this.operand1 < 0.0)
	{
		this.result = atodbl("-INF");
	}
	else
	{
		this.result = atodbl("NaN");
	}
  }
  gDivideCount++;
  this.ReturnCall();
}