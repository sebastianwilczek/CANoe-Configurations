/*@!Encoding:1252*/
includes
{
#include "TurnIndicator_Include.cin"
}

variables
{
  int gResetLeftIndicator = kINDICATOR_RESETED; 
}

on linFrame LeftTurn
{
  if (this.Left_TurnIndication == kOn && kINDICATOR_INACTIVE == @LIN::RightIndicatorState && kINDICATOR_INACTIVE == @LIN::WarningIndicatorState)
  {
    @LIN::LeftIndicatorState = kINDICATOR_ACTIVE;

    if (kMAXINDICATORMESSAGES == gIndicatorCounter)
    {

      if ($Left_TurnIndicator_State == kOn ) 
      {
        $Left_TurnIndicator_State = kOff;
      }
      else
      {
        $Left_TurnIndicator_State = kOn;
      }

      gIndicatorCounter = 0; 
    }
     
    gResetLeftIndicator = kINDICATOR_RESET;
    ++gIndicatorCounter;  
  }
  else if (this.Left_TurnIndication == kOff && kINDICATOR_INACTIVE == @LIN::WarningIndicatorState && kINDICATOR_RESET == gResetLeftIndicator)
  {
    @LIN::LeftIndicatorState = kINDICATOR_INACTIVE;
    $Left_TurnIndicator_State = kOff;
    gIndicatorCounter = kMAXINDICATORMESSAGES;
    gResetLeftIndicator = kINDICATOR_RESETED;
  }
}

