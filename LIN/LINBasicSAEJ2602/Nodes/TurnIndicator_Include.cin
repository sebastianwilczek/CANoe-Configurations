/*@!Encoding:1252*/
variables
{
  const int kMAXINDICATORMESSAGES    = 10;
  const int kOn                      = 1;
  const int kOff                     = 0;
  const int kINDICATOR_ACTIVE        = 1;
  const int kINDICATOR_INACTIVE      = 0;
  const int kINDICATOR_RESETED       = 0;
  const int kINDICATOR_RESET         = 1;

  int       gIndicatorCounter        = 0;
  int       gWarningIndicatorCounter = 0;
  int       gResetWarnIndicator      = 0;
}

on linFrame WarningLight
{
  if (this.WarningLightIndication == kOn)
  {
    @LIN::WarningIndicatorState = kINDICATOR_ACTIVE;

    if (kMAXINDICATORMESSAGES == gWarningIndicatorCounter)
    {

      if ($Left_TurnIndicator_State == kOn ) 
      {
        $Left_TurnIndicator_State = kOff;
        $Right_TurnIndicator_State = kOff;
      }
      else
      {
        $Left_TurnIndicator_State = kOn;
        $Right_TurnIndicator_State = kOn;
      }

      gWarningIndicatorCounter = 0; 
    }
     
    gResetWarnIndicator = kINDICATOR_RESET;
    ++gWarningIndicatorCounter;
  }
  else if (this.WarningLightIndication == kOff && kINDICATOR_RESET == gResetWarnIndicator)
  {
    @LIN::WarningIndicatorState = kINDICATOR_INACTIVE;

    if (kINDICATOR_INACTIVE == @LIN::RightIndicatorState)
    {
      $Right_TurnIndicator_State = kOff;
    }

    if (kINDICATOR_INACTIVE == @LIN::LeftIndicatorState)
    {
      $Left_TurnIndicator_State = kOff;
    }
    
    gResetWarnIndicator = kINDICATOR_RESETED;
    gWarningIndicatorCounter = 0; 
  }
}

