/* Description: LIN Description file created using Vector's LIN File Editor */
/* Created: 20.09.2005 */
/* Author: Vector Informatik GmbH */
/* Version: 1.0 */
/* Project: KWPSim-Demo-Configuration */

// Global Definitions
LIN_description_file;
LIN_protocol_version = "2.2";
LIN_language_version = "2.2";
LIN_speed = 19.2 kbps; // baudrate (1.0-20.0)
// End of Global Definitions

Nodes // Nodes Definition
{
  Master:
    LINMaster, // master node name
    1 ms, // time base (real)
    0.1 ms; // jitter (real)

  Slaves:
    FrontLeftDoor, RearLeftDoor; // slave node names

} // End of Nodes Definition

Signals // Signals Definition
{
  // Scalar Signal

     FrontLeftDoorSignal:
    8,
    0,
    FrontLeftDoor,
    LINMaster;

    FrontLeftDoorErrSig:
      1,
    0,
    FrontLeftDoor,
    LINMaster;

   RearLeftDoorSignal:
    8,
    0,
    RearLeftDoor,
    LINMaster;

   RearLeftDoorErrSig:
      1,
    0,
    RearLeftDoor,
    LINMaster;

  // End of Scalar Signal
} // End of Signals Definition

Diagnostic_signals // Diagnostic Signals Definition (optional)
{
  // MasterReq Reserved Signals
  MasterReqB0: 8, 0; // signal name: signal size, signal offset;
  MasterReqB1: 8, 0;
  MasterReqB2: 8, 0;
  MasterReqB3: 8, 0;
  MasterReqB4: 8, 0;
  MasterReqB5: 8, 0;
  MasterReqB6: 8, 0;
  MasterReqB7: 8, 0;
        // End of MasterReq Reserved Signals

  // SlaveResp Reserved Signals
  SlaveRespB0: 8, 0; // signal name: signal size, signal offset;
  SlaveRespB1: 8, 0;
  SlaveRespB2: 8, 0;
  SlaveRespB3: 8, 0;
  SlaveRespB4: 8, 0;
  SlaveRespB5: 8, 0;
  SlaveRespB6: 8, 0;
  SlaveRespB7: 8, 0;
  // End of SlaveResp Reserved Signals

} // End of Diagnostic Signals Definition

Frames // Unconditional Frames Definition
{
     FrontLeftDoorMessage: // frame name
    1, // frame id (0-59 or 62)
    FrontLeftDoor, // publisher node
    2 // frame size in bytes (1-8)
    {
      // list of signals carried by this frame
      FrontLeftDoorSignal, 0; // signal name with LSB offset in bits
      FrontLeftDoorErrSig, 8;
    }

     RearLeftDoorMessage: // frame name
    2, // frame id (0-59 or 62)
    RearLeftDoor, // publisher node
    2 // frame size in bytes (1-8)
    {
      // list of signals carried by this frame
      RearLeftDoorSignal, 0; // signal name with LSB offset in bits
      RearLeftDoorErrSig, 8;
    }

} // End of Unconditional Frames Definition

Diagnostic_frames // Diagnostic Frame Definition (optional)
{
  MasterReq: 60 // reserved frame name and frame identifier
  {
    MasterReqB0, 0; // diagnostic signal name, signal offset
    MasterReqB1, 8;
    MasterReqB2, 16;
    MasterReqB3, 24;
    MasterReqB4, 32;
    MasterReqB5, 40;
    MasterReqB6, 48;
    MasterReqB7, 56;
  }

  SlaveResp: 61 // reserved frame name and frame identifier
  {
    SlaveRespB0, 0; // diagnostic signal name, signal offset
    SlaveRespB1, 8;
    SlaveRespB2, 16;
    SlaveRespB3, 24;
    SlaveRespB4, 32;
    SlaveRespB5, 40;
    SlaveRespB6, 48;
    SlaveRespB7, 56;
  }
} // End of Diagnostic Frame Definition

Node_attributes // Node Attributes Definition
{
    FrontLeftDoor // node name
  {
    LIN_protocol = "2.2";
    configured_NAD = 7; // initial NAD of node (1-126)
    product_id =
      0x001e, // supplier_id (0-0x7FFE)
      2, // function_id (0-0xFFFE)
      0; // variant (0-0xFF)
    response_error = FrontLeftDoorErrSig; // name of 1 bit error signal
    P2_min = 51 ms; // min. time (real) between MasterReq and SlaveResp
    ST_min = 2 ms; // min. time (real) between consecutive SlaveResps
        N_As_timeout = 1001 ms;
        N_Cr_timeout = 1002 ms;
    configurable_frames
    {
      // list of configurable frames
      FrontLeftDoorMessage; // frame name with message id (0-0xFFFE)
    }
  } // End of Node Attribut

    RearLeftDoor // node name
  {
    LIN_protocol = "2.2";
    configured_NAD = 8; // initial NAD of node (1-126)
    product_id =
      0x001e, // supplier_id (0-0x7FFE)
      3, // function_id (0-0xFFFE)
      0; // variant (0-0xFF)
    response_error = RearLeftDoorErrSig; // name of 1 bit error signal
    P2_min = 51 ms; // min. time (real) between MasterReq and SlaveResp
    ST_min = 2 ms; // min. time (real) between consecutive SlaveResps
        N_As_timeout = 1001 ms;
        N_Cr_timeout = 1002 ms;
    configurable_frames
    {
      // list of configurable frames
      RearLeftDoorMessage; // frame name with message id (0-0xFFFE)
    }
  } // End of Node Attribut

} // End of Node Attributes Definition

Schedule_tables {
 MasterReq_Table {
    MasterReq delay 10 ms ;
  }
 SlaveResp_Table {
    SlaveResp delay 10 ms ;
  }
 Diagnostic {
    MasterReq delay 10 ms ;
    SlaveResp delay 10 ms ;
  }
 Initialisation {
    AssignFrameId { FrontLeftDoor, FrontLeftDoorMessage } delay 10 ms ;
  }
 Send {
    FrontLeftDoorMessage delay 5 ms ;
    RearLeftDoorMessage delay 5 ms ;
  }
}
