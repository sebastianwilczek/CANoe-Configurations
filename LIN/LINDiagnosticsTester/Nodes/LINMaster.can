/*@!Encoding:1252*/
variables
{
  long gNodeAddress;
}

on sysvar sysvar::LINDiagnostics::FunctionalTesterPresent
{
  diagRequest TesterPresent_Send req;
  
  if (@this == 1)
  {
    diagSendFunctional(req);
  }
}

on start
{
  DiagsetTarget("Door");
}

on diagResponse SerialNumber_Read
{
  write ("Received Response: Serial Number Read");
}



