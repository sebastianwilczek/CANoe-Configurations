// Description: LIN Description file created using Vector's DaVinci Network Designer

// Created: 07 Sep 2007 15:12:10

// Author: Vector Informatik GmbH

// Version: 0.1

LIN_description_file;
LIN_protocol_version = "2.2";
LIN_language_version = "2.2";
LIN_speed = 19.2 kbps;

Nodes {
  Master: LINMaster, 10 ms, 0.1 ms ;
  Slaves: LinSlave ;
}

Signals {
  Ramp: 8, 0, LINMaster, LinSlave ;
  constant_Signal: 8, 0, LINMaster, LinSlave ;
  Sine: 8, 0, LINMaster, LinSlave ;
  error: 1, 0, LinSlave, LINMaster ;
}

Frames {
  LinExtra: 34, LINMaster, 1 {
    constant_Signal, 0 ;
  }
  LinMsg1: 48, LINMaster, 2 {
    Sine, 0 ;
    Ramp, 8 ;
  }
  LinMsg2: 38, LINMaster, 1 {
    constant_Signal, 0 ;
  }
  LinStatus: 39, LinSlave, 1 {
    error, 0 ;
  }
}

Node_attributes {
  LinSlave{
    LIN_protocol = "2.2" ;
    configured_NAD = 0x5 ;
    initial_NAD = 0x5 ;
    product_id = 0x1e, 0x2, 1 ;
    response_error = error ;
    P2_min = 50 ms ;
    ST_min = 0 ms ;
    configurable_frames {
      LinMsg1;
    LinMsg2;
    LinExtra;
    LinStatus;
    }
  }
}

Schedule_tables {
 Main_table {
    LinMsg1 delay 30 ms ;
    LinMsg2 delay 30 ms ;
  LinStatus delay 30 ms ;
  }
 Extra_Table {
    LinExtra delay 10 ms ;
  LinStatus delay 10 ms ;
  }
}

Signal_encoding_types {
  constant_Signal_Sig_Type {
    physical_value, 0, 255, 1, 0 ;
  }
  Sine_Sig_Type {
    physical_value, 0, 255, 1, 0 ;
  }
  StandardPhys_Sig_Type {
    physical_value, 0, 0, 1, 0 ;
  }
}

Signal_representation {
  Sine_Sig_Type: Sine ;
  StandardPhys_Sig_Type: Ramp ;
  constant_Signal_Sig_Type: constant_Signal ;
}
