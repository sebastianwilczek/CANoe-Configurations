/*@@var:*/
variables
{ 
  dword mNewPage;  //sink identifier
}
/*@@end*/

/*@@startStart:Start:*/
on start
{
  //Create a new page at the write window
  mNewPage = writeCreate("Instructions");

  //get information about the scheduler mode in the write window
  writeLineEx(mNewPage,2,"The interactive generator can be used to:");
  writeLineEx(mNewPage,2,"- change the response data (LinMsg1,LinMsg2)");
  writeLineEx(mNewPage,2,"- send a msg header (LinExtra)");
  writeLineEx(mNewPage,2,"For detailed information see \nthe configuration comment or online help.");
  writeLineEx(mNewPage,2,"\nPush the \"now\" button to send an additional header!");
}
/*@@end*/

