variables
{
  const int kCLOSE = 0x00;
  const int kOPEN  = 0x01;
}

on sysvar sysvar::RemoteKey::KeyClose
{
  if(@sysvar::Door::OpenDoorLeft)  return;

  if(@sysvar::RemoteKey::KeyClose) 
  {
   $RCR_01::RCR_CentralLockingSystem = kCLOSE;
   SetControlForeColor("Exterior Console", "StaticTextCentralLockingWarning", MakeRGB(255,0,0));
   SetControlForeColor("Door Opener", "StaticTextControl1", MakeRGB(255,0,0));
   SetControlForeColor("Interior Console", "StaticTextControl3", MakeRGB(255,0,0));
  }
}

on sysvar sysvar::RemoteKey::KeyOpen
{
  if(@sysvar::RemoteKey::KeyOpen) 
  {
    linSendWakeup();
    $RCR_01::RCR_CentralLockingSystem = kOPEN;
    SetControlForeColor("Exterior Console", "StaticTextCentralLockingWarning", MakeRGB(0,192,0));
    SetControlForeColor("Door Opener", "StaticTextControl1", MakeRGB(0,192,0));
    SetControlForeColor("Interior Console", "StaticTextControl3", MakeRGB(0,192,0));
  }
}

on sysvar sysvar::RemoteKey::KeyPassenger
{
  if((@sysvar::RemoteKey::KeyPassenger == 1 || @sysvar::RemoteKey::KeyPassenger == 2) &&  $RCR_01::RCR_CentralLockingSystem == kOPEN)  
    $RCR_01::RCR_Passanger = @sysvar::RemoteKey::KeyPassenger;
}

