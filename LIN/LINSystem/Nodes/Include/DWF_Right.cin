/*@!Encoding:1252*/
variables
{
  const long kINACTIVE = 0x00;
  const long kACTIVE   = 0x01;
  const long kDOWN     = 0x00;
  const long kHALT     = 0x01;
  const long kUP       = 0x02;
  const long kMINUS    = -1;
  const long kPLUS    = +1;

  msTimer tWinMovment;
  const long gWIN_SPEED = 100;  // in ms
  
  long gDirection     = 0;
  long gTimerIsActive = kINACTIVE;
}

on timer tWinMovment
{
  if(gTimerIsActive)
  {
    if(gDirection == -1 && $DWFR_01::DWFR_WinPos != 0  ||  gDirection == +1 && $DWFR_01::DWFR_WinPos != 16)
      $DWFR_01::DWFR_WinPos = $DWFR_01::DWFR_WinPos + gDirection;
  
    cancelTimer(this);
    SetTimer(this,gWIN_SPEED);

    if(gDirection == -1 && $DWFR_01::DWFR_WinPos <= 0  ||  gDirection == +1 && $DWFR_01::DWFR_WinPos >= 16)
    {
        $Door::GWI_01::GWI_FrontWindowsRight = 1;
    }

  }
}

Start_WindowsMovment (int winDir)
{
  gTimerIsActive = kACTIVE;
  gDirection = winDir;
  cancelTimer(tWinMovment);
  SetTimer(tWinMovment,gWIN_SPEED);
}

Stop_WindowsMovment ()
{
  gDirection = 0;
  gTimerIsActive = kINACTIVE;
  CancelTimer(tWinMovment);
}

WindowsMovement ()
{
  if(gTimerIsActive == kINACTIVE) 
  {
    if($GWI_01::GWI_FrontWindowsRight == kDOWN)    Start_WindowsMovment(kMINUS);
    else if($GWI_01::GWI_FrontWindowsRight == kUP) Start_WindowsMovment(kPLUS);
  }
  if($GWI_01::GWI_FrontWindowsRight == kHALT)  Stop_WindowsMovment(); 
}

on linFrame GWI_01
{
  if(this.MsgChannel == kLIN_CHANNEL)  WindowsMovement(); 
}

