/*@!Encoding:1252*/
includes
{
  #include "Include\ExtLightRight.CIN"
}

variables
{
}

on linFrame GWE_01
{
  if(this.MsgChannel == kLIN_CHANNEL)
  {
    $ExteriorLight::DLRRight_01::DLRR_LightStatus = GetLightStatus(); 
  }
}

