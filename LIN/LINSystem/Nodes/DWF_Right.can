/*@@includes:*/
includes
{
  #include "Include\DWF_Right.cin"
}
/*@@end*/

/*@@var:*/
variables
{
  const int kLIN_CHANNEL = 2;
}
/*@@end*/

