variables
{
  const long kUNLOCKED  = 0x01;
  const long kLOCKED    = 0x00;
  const long kOPEN      = 0x01;
  const long kCLOSE     = 0x00;
  const long kACTIVE    = 0x01;
  const long kINACTIVE  = 0x00;

  msTimer tFadeBrightnessUP;
  msTimer tFadeBrightnessDOWN;
  
  const long kBRIGHTNESS_RATE   = 50;
  const long kWAIT_TO_DOWN_LESS = 2000;  // in ms
  const long kWAIT_TO_DOWN_MORE = 5000;  // in ms

  long kUpIsActive    = 0;
  long kDownIsActive  = 0;
}

on signal GWI_CentralLockingSystem
{
  if(this == kUNLOCKED)
  {
    if(!kUpIsActive)
    { 
      kUpIsActive   = kACTIVE;
      kDownIsActive = kINACTIVE;
      cancelTimer(tFadeBrightnessUP);
      setTimer(tFadeBrightnessUP,kBRIGHTNESS_RATE);
    }
  }
  else if(this == kLOCKED)
  {
    if(!kDownIsActive)
    { 
      kDownIsActive = kACTIVE;
      kUpIsActive   = kINACTIVE;
      cancelTimer(tFadeBrightnessDOWN);
      setTimer(tFadeBrightnessDOWN,kBRIGHTNESS_RATE);  
    }
  }
}

on signal GWI_DoorState
{
  if(this == kOPEN)
  {
    if(!kUpIsActive)
    { 
      kUpIsActive   = kACTIVE;
      kDownIsActive = kINACTIVE;
      cancelTimer(tFadeBrightnessUP);
      setTimer(tFadeBrightnessUP,kBRIGHTNESS_RATE);
    }
  }
  else if(this == kCLOSE)
  {
    if(!kDownIsActive)
    { 
      kDownIsActive = kACTIVE;
      kUpIsActive   = kINACTIVE;
      cancelTimer(tFadeBrightnessDOWN);
      setTimer(tFadeBrightnessDOWN,kWAIT_TO_DOWN_LESS);  
    }
  }
}

on timer tFadeBrightnessDOWN
{
  if($RUF_01::RUF_Brightness > 0 && $GWI_DoorState == kCLOSE)
  {
    SetBrightness(-1);
    cancelTimer(this);
    SetTimer(this,kBRIGHTNESS_RATE);
  }
}

on timer tFadeBrightnessUP
{
  if($RUF_01::RUF_Brightness < 60)
  {
    SetBrightness(+1);
    cancelTimer(this);
    SetTimer(this,kBRIGHTNESS_RATE);
  }
  if($RUF_01::RUF_Brightness == 60)
  {
    kUpIsActive = kINACTIVE;
    cancelTimer(tFadeBrightnessDOWN);
    SetTimer(tFadeBrightnessDOWN,kWAIT_TO_DOWN_MORE);
  }
}

SetBrightness(int value)
{
  $RUF_01::RUF_Brightness = $RUF_01::RUF_Brightness + value;
}


