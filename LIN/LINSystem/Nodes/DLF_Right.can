/*@!Encoding:1252*/
includes
{
  #include "Include\ExtLightRight.cin"
}

variables
{
}

on linFrame GWE_01
{
  if(this.MsgChannel == kLIN_CHANNEL)
  {
    $ExteriorLight::DLFRight_01::DLFR_LightStatus = GetLightStatus(); 
  }
}

