/*@!Encoding:1252*/
includes
{
  #include "Include\ExtLightLeft.CIN"
}

variables
{
}

on linFrame GWE_01
{
  if(this.MsgChannel == kLIN_CHANNEL)
  {
    $ExteriorLight::DLFLeft_01::DLFL_LightStatus = GetLightStatus(); 
  }
}

