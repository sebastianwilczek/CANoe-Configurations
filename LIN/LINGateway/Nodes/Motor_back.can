/*@!Encoding:1252*/
variables
{
  const int kACTIVE   = 1;
  const int kDEACTIVE = 0;

  int gDriveToStorePos = 1;

  //declare global variables
  int gCurrentPosition, gDriverID;

  //data for different stored saetpositions
  int gStoredPosition[4] = {18, 16 , 20, 25};
}

on linFrame Seatsetting
{
  if(gDriveToStorePos == kACTIVE) return;

  //shift the seat position
  @LIN::Seatback_forward_Dsp = this.Seatback_forward;
  @LIN::Seatback_back_Dsp = this.Seatback_back;

  if (gCurrentPosition > 16 && this.Seatback_forward)
  {
    gCurrentPosition = gCurrentPosition - 1;
    @LIN::Seatback_Dsp = gCurrentPosition;
  }
  if (gCurrentPosition < 25 && this.Seatback_back)
  {
    gCurrentPosition = gCurrentPosition + 1;
    @LIN::Seatback_Dsp = gCurrentPosition;
  }
}

on start
{
  gCurrentPosition=16;
}

on linFrame Seatposition
{
  //call function to get the stored seat position
  SetSeatposition(this.Driver);
}

SetSeatposition(int actDriver)
{
  if(gDriverID != actDriver)  
  {
    gDriveToStorePos = kACTIVE;
    gDriverID = actDriver;
  }
  if(gDriveToStorePos == kACTIVE)
  {
    //get the stored seat position
    if (gCurrentPosition < gStoredPosition[gDriverID])
    {
      gCurrentPosition = gCurrentPosition + 1;
      @LIN::Seatback_Dsp = gCurrentPosition;
    }
    if (gCurrentPosition > gStoredPosition[gDriverID])
    {
      gCurrentPosition = gCurrentPosition - 1;
      @LIN::Seatback_Dsp = gCurrentPosition;
    }
    if(gCurrentPosition == gStoredPosition[gDriverID]) gDriveToStorePos = kDEACTIVE;
  }
}

on linFrame StoreSeatposition
{
  //store the current seat position
  if(this.Storeposition)  gStoredPosition[gDriverID] = gCurrentPosition;
}

