/*@!Encoding:1252*/
variables
{
}

on sysvar CAN::LoggingControl
{
  if(@this == 1) startLogging();
  else  stopLogging();
}

