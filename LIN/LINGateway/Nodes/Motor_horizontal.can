/*@!Encoding:1252*/
variables
{
  const int kACTIVE   = 1;
  const int kDEACTIVE = 0;

  //declare global variables
  int gCurrentPosition, gDriverID;
  
  //data for different stored saetpositions
  int gStoredPosition[4] = {7, 5 , 5, 4};
  int gDriveToStorePos = 1;
}

on linFrame Seatsetting
{
  if(gDriveToStorePos == kACTIVE) return;

   //shift the seat position
   @LIN::Seat_forward_Dsp = this.Seat_forward;
   @LIN::Seat_back_Dsp = this.Seat_back;

   if (gCurrentPosition < 7 && this.Seat_back)
   {
      gCurrentPosition = gCurrentPosition + 1;
      @LIN::Seathorizontal_Dsp = gCurrentPosition;
   }
  
   if (gCurrentPosition > 0 && this.Seat_forward)
   {
      gCurrentPosition = gCurrentPosition - 1;
      @LIN::Seathorizontal_Dsp = gCurrentPosition;
   }
}

on linFrame Seatposition
{
   //call function to get the stored seat position
   SetSeatposition(this.Driver);
}

SetSeatposition(int actDriver)
{
  if(gDriverID != actDriver)  
  {
    gDriveToStorePos = kACTIVE;
    gDriverID = actDriver;
  }
   
  if(gDriveToStorePos == kACTIVE)
  {   
    //get the stored seat position
    if (gCurrentPosition < gStoredPosition[gDriverID])
    {
      gCurrentPosition = gCurrentPosition + 1;
      @LIN::Seathorizontal_Dsp = gCurrentPosition;
    }
    if (gCurrentPosition > gStoredPosition[gDriverID])
    {
      gCurrentPosition = gCurrentPosition - 1;
      @LIN::Seathorizontal_Dsp = gCurrentPosition;
    }
    if(gCurrentPosition == gStoredPosition[gDriverID]) gDriveToStorePos = kDEACTIVE;
  }
}

on linFrame StoreSeatposition
{
   //store the current seat position
   if(this.Storeposition)
      gStoredPosition[gDriverID] = gCurrentPosition;
}

