/*@!Encoding:1252*/
variables
{
  const int kACTIVE   = 1;
  const int kDEACTIVE = 0;

  int gDriveToStorePos = 1;

  //declare global variables
  int gCurrentPosition, gDriverID;

  //data for different stored saetpositions
  int gStoredPosition[4] = {29, 27 , 28, 29};
}

on linFrame Seatsetting
{
  if(gDriveToStorePos == kACTIVE) return;

  //shift the seat position
  @LIN::Head_up_Dsp = this.Head_up;
  @LIN::Head_down_Dsp = this.Head_down;

  if(gCurrentPosition < 29 && this.Head_up)
  {
    gCurrentPosition = gCurrentPosition + 1;
    @LIN::Head_Dsp = gCurrentPosition;
  }
  if(gCurrentPosition > 26 && this.Head_down)
  {
    gCurrentPosition = gCurrentPosition - 1;
    @LIN::Head_Dsp = gCurrentPosition;
  }
}

on linFrame Seatposition
{
  //call function to get the stored seat position
  SetSeatposition(this.Driver);
}

on linFrame StoreSeatposition
{
  //store the current seat position
  if(this.Storeposition)  gStoredPosition[gDriverID] = gCurrentPosition;
}

SetSeatposition(int actDriver)
{
  if(gDriverID != actDriver)  
  {
    gDriveToStorePos = kACTIVE;
    gDriverID = actDriver;
  }

  if(gDriveToStorePos == kACTIVE)
  {
    //get the stored seat position
    if (gCurrentPosition < gStoredPosition[gDriverID])
    {
      gCurrentPosition = gCurrentPosition + 1;
      @LIN::Head_Dsp = gCurrentPosition;
    }
    if (gCurrentPosition > gStoredPosition[gDriverID])
    {
      gCurrentPosition = gCurrentPosition - 1;
      @LIN::Head_Dsp = gCurrentPosition;
    }
    if(gCurrentPosition == gStoredPosition[gDriverID]) gDriveToStorePos = kDEACTIVE;
  }
}

on start
{
  gCurrentPosition = 26;
}

