/*@!Encoding:1252*/
variables
{
  //declare millisecond Timer
  msTimer tHeating;
}

on linFrame Seatheating
{
  if(this.Heating != 0) 
  {
    @LIN::Seatheating_LEDDsp = 1;
    @LIN::Seatheating_Dsp = this.Heating;
    cancelTimer(tHeating);
    setTimer(tHeating, 1000);
  }
}

on timer tHeating
{
  @LIN::Seatheating_LEDDsp = 0;
  @LIN::Seatheating_Dsp = 0;
}

