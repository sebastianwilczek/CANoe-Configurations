/*@!Encoding:1252*/
variables
{
  //declare LIN frame
  linFrame Seatsensor msgSeatsensor;
}

on sysvar LIN::SeatSensor
{
  msgSeatsensor.Seatsensor = @this;
  output(msgSeatsensor);
}

