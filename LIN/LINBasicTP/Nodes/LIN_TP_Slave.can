/*@!Encoding:1252*/
variables
{
  char gECU[15] = "FrontLeftDoor";
  long gNodeAddress;
}

on start
{
  gNodeAddress = 7;
  write("Node Adress: %d", gNodeAddress);
}

on sysvar sysvar::LINTP::NAD
{
  gNodeAddress = @this;
  LINtp_SetNAD(gNodeAddress);
  write("Changed Node Adress to: %d", gNodeAddress);
}

/********************** DIAGNOTICS LAYER ******************/

on diagRequest DefaultSession_Start
{
  diagResponse this resp;

  DiagSendResponse( resp);
}

on diagRequest ExtendedSession_Start
{
  diagResponse this resp;

  DiagSendResponse( resp);
}

on diagRequest ProgrammingSession_Start
{
  diagResponse this resp;

  DiagSendResponse( resp);
}

on diagRequest EcuIdentification_Read
{
  diagResponse this resp;

  DiagSendResponse( resp);
}

on diagRequest DoorStatus_Set
{
  diagResponse this resp;

  DiagSendResponse( resp);
}

on diagRequest DoorStatus_Read
{
  diagResponse this resp;

  DiagSendResponse( resp);
}

on diagRequest SerialNumber_Read
{
  diagResponse this resp;

  DiagSendResponse( resp);
}

on diagRequest WindowLifterSpeed_Read
{
  diagResponse this resp;

  DiagSendResponse( resp);
}

on diagRequest TesterPresent
{
  diagResponse this resp;

  DiagSendResponse( resp);
}

/*********************** CAPL CALLBACK INTERFACE ******************/

_Diag_DataRequest(byte data[], DWORD count, long furtherSegments) 
{
  /* The diagnostics layer transports data via a 
     CAPL callback interface. */

  byte val1;

  writeDbgLevel(1,"%s: _Diag_DataReq", gECU);

  if( elcount( data) >= 2)  val1 = data[1];
  else  val1 = 0;

  writeDbgLevel(1,"%s: Send %d bytes: %02x %02x ...", gECU, elcount( data), data[0], val1);
  LINtp_DataReq(data, count, gNodeAddress);
  writeDbgLevel(1,"%s: Done.", gECU);
}


_Diag_SetChannelParameters() 
{
  gNodeAddress = diagGetCommParameter("CANoe.AddrExt");
  write( "%s: _Diag_SetChannelParameters: node address is %d", gECU, gNodeAddress);
}

/*********************** LIN TP Layer ******************/

LINtp_DataInd(long count, dword nad)
{
  /* This function returns the number of data received */

  byte rxBuffer[4096];

  writeDbgLevel(1, "%s: LINtp_DataInd", gECU);
  writeDbgLevel(1, "%s: LINtp_DataInd(%d, 0x%x)", gECU, count, nad);

  LINtp_GetRxData(rxBuffer, count);

  //LINtp_DataReq(rxBuffer, count, gNodeAddress);
  Diag_DataInd( rxBuffer, count, gNodeAddress);
}

LINtp_ErrorInd(int error)
{
}

LINtp_DataCon(long count)
{
  write("Data Confirmation");
}




