/*@@var:*/
variables
{
}
/*@@end*/

/*@@preStart:PreStart:*/
on preStart
{
  LinDeactivateResps();
}
/*@@end*/

