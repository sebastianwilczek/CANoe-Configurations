/*@!Encoding:1252*/
variables
{
  long gNodeAddress = 1;
  char gECU[10] = "Motor1";
}

on preStart
{
  LinDeactivateResps();
}

// LIN CAPL Callback Implmentation

_Diag_DataRequest( byte data[], dword count, long flag)
{
  LINtp_DataReq(data, count, 0);
  write("%s: ***_Diag_DataRequest", gECU);
}

_Diag_SetChannelParameters()
{
  gNodeAddress = diagGetCommParameter("CANoe.AddrExt");
}

_Diag_SetupChannelReq()
{
  Diag_SetupChannelCon();
}

LINtp_DataInd(long count)
{
  BYTE data[4095];

  LINtp_GetRxData(data, count);

  Diag_DataInd(data, count, 0);
  write("%s: ***LINtp_DataInd", gECU);
}

LINtp_ErrorInd()
{
  write("%s: ***LINtp_ErrorInd", gECU);
}

