/*@@var:*/
variables
{
  const dword wrCAPLSink = 1;
  const dword wrSYSSink = 0;
  const dword wrInfo = 1;
  const dword wrError = 3;

}
/*@@end*/

/*@@startStart:Start:*/
on start
{
  if (IsSimulated()) // don't activate tests when running in simulated mode
  {
    WriteLineEx(wrCAPLSink, wrError
      , "This demo cannot run in simulated mode!");     
    stop();
  }
}
/*@@end*/

