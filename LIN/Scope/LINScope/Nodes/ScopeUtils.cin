/*@!Encoding:1252*/


variables
{
  long mResult;
}

int CheckStatusInternal(long status, char text[])
{
 if(status <= 0)
 {
   testStepFail(testStepName, " Internal error in %s, return code = %d", text, status);
   return 0;
 }
 return 1;
}

int DoScopeConnect()
{
  mResult = scopeConnect();
  if(!CheckStatusInternal(mResult, "scopeConnect"))return 0; 
  if(mResult==2) return 1;  //already connected
  
  mResult =testWaitForScopeEvent(eScopeConnected, 8000);
  if(!CheckStatusInternal(mResult, "scopeConnect"))return 0; 
  return 1;
}

int DoScopeTrigger()
{
  mResult = scopeTriggerNow();
  if(!CheckStatusInternal(mResult, "scopeTriggerNow")) return 0;

  // wait till action done
  mResult =(testWaitForScopeEvent(eScopeTriggered, 50000));
  if(!CheckStatusInternal(mResult, "scopeTriggerNow")) return 0;

  return 1; 
}

int DoScopeDisconnect()
{
  mResult = scopeDisconnect();
  if(!CheckStatusInternal(mResult, "scopeDisconnect")) return 0;

  mResult =testWaitForScopeEvent(eScopeDisconnected, 8000);
  if(!CheckStatusInternal(mResult, "scopeDisconnect")) return 0;

  return 1;
}



