/*@!Encoding:1252*/
includes
{
  
}

variables
{
  
}

export void AddEngineerInfoToReport(char title[], char value[])
{
  testReportAddEngineerInfo(title, value);
}

export void AddSUTInfoToReport(char title[], char value[])
{
  testReportAddSUTInfo(title, value);
}
