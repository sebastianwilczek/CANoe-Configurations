/*@@includes:*/
includes
{
  #include "MostDefs.cin"
}
/*@@end*/

/*@@var:*/
variables
{
  // MOST node address of AudioDiskPlayer
  word gADPDeviceAdr = 0x101;

  // InstanceId of SUT
  int gADPInstance;

  // Update of environment variables to display values in graphics window
  msTimer tUpdateGraphic;
  long  gUpdateGraphicCycle=500;
  dword gCheckId;
  long  gTimeout = 200;
}
/*@@end*/

/*@@testcase:TC_PropertyProtocolCheck():*/
// This test case demonstrates the usage of the property protocol error check. 
// It observes the property 'AudioDiskPlayer.TrackPosition' and calls the specified 
// callback function, in case the property doesn't respond in time. You can use the 
// error injection panel to provoke a check violation. 
// --------------------------------------------------------------------------------
testcase TC_PropertyProtocolCheck()
{
  int i;
  dword checkId;
  
  TestCaseTitle ("PropertyProtocolCheck", "Demonstration of check for MostPropertyProtocolError.");
  TestCaseDescription("Use error injection panel to block response of 'AudioDiskPlayer.TrackPosition' function.");

  TestStep("1", "Setup check to observe property 'AudioDiskPlayer.TrackPosition'.");

  ChkConfig_SetPrecision(3); // milliseconds
  
  checkId = ChkStart_MostPropertyProtocolError("AudioDiskPlayer.TrackPosition", gADPInstance, gTimeout, "CallbackPropertyProtocolError"); 
  gCheckId=checkId; // Store id for cyclic refreshing of signal in graphic window
  setTimer(tUpdateGraphic,gUpdateGraphicCycle);

  TestStep("2", "Start playback of CD.");
 
  TestSendMostAMSMessage(gADPDeviceAdr, "AudioDiskPlayer.DeckStatus.Set(Play)", gADPInstance);

  TestStep("3", "Generate a sequence of 'TrackPosition' requests for 20s");
  
  for(i = 0; i < 20; ++i)
  {
    TestSendMostAMSMessage(gADPDeviceAdr, "AudioDiskPlayer.TrackPosition.Set(1)", gADPInstance);

    TestWaitForTimeout(100);

    TestSendMostAMSMessage(gADPDeviceAdr, "AudioDiskPlayer.TrackPosition.Increment(1)", gADPInstance);

    TestWaitForTimeout(100);

    TestSendMostAMSMessage(gADPDeviceAdr, "AudioDiskPlayer.TrackPosition.Decrement(1)", gADPInstance);

    TestWaitForTimeout(100);

    TestSendMostAMSMessage(gADPDeviceAdr, "AudioDiskPlayer.TrackPosition.SetGet(2)", gADPInstance);

    TestWaitForTimeout(100);

    TestSendMostAMSMessage(gADPDeviceAdr, "AudioDiskPlayer.TrackPosition.Decrement(1)", gADPInstance);

    TestWaitForTimeout(100);

    TestSendMostAMSMessage(gADPDeviceAdr, "AudioDiskPlayer.TrackPosition.Increment(1)", gADPInstance);

    TestWaitForTimeout(100);

    TestSendMostAMSMessage(gADPDeviceAdr, "AudioDiskPlayer.TrackPosition.SetGet(1)", gADPInstance);

    TestWaitForTimeout(100);

    TestSendMostAMSMessage(gADPDeviceAdr, "AudioDiskPlayer.TrackPosition.Increment(1)", gADPInstance);

    TestWaitForTimeout(100);

    TestSendMostAMSMessage(gADPDeviceAdr, "AudioDiskPlayer.TrackPosition.Decrement(1)", gADPInstance);

    TestWaitForTimeout(100);

    TestSendMostAMSMessage(gADPDeviceAdr, "AudioDiskPlayer.TrackPosition.SetGet(2)", gADPInstance);

    TestWaitForTimeout(100);

  }

  TestStep("4", "PropertyProtocolError-Check has evaluated the following results for 'TrackPosition':");

  WritePropertyProtErrStatistics(checkId);

  TestWaitForTimeout(200);

  cancelTimer(tUpdateGraphic);
  ChkControl_Stop(checkId);
  
}
/*@@end*/

/*@@mainTest:MainTest():*/
void MainTest()
{
  word checkId_NetState;
  word checkId_ShortUnlock;

  // Set test module title and detailed infos for test report.
  TestModuleTitle ("TM_PropertyProtocol - Evaluation of 'AudioDiskPlayer.TrackPosition' property response");
  SetReportInfos();

  gADPInstance = GetADPInstance(); // get the first available instance of the AudioDiskPlayer

  // Setup checks to ensure test execution under stable conditions  

  // This check triggers a violation, if the ring transits from ConfigOk to NetInterfaceInit state
  checkId_NetState = ChkStart_MostNetState(kNetStateConfigOk, kNetStateNetInterfaceInit);
  TestAddConstraint(checkId_NetState);

  // This check triggers a violation as soon as a ShortUnlock event occurrs
  checkId_ShortUnlock = ChkStart_MostShortUnlock();
  TestAddConstraint(checkId_ShortUnlock);

  TC_PropertyProtocolCheck();

  // Cleanup checks after test case execution
  TestRemoveConstraint(checkId_NetState);
  ChkControl_Destroy(checkId_ShortUnlock);

}
/*@@end*/

/*@@caplFunc:WritePropertyProtErrStatistics(int):*///function
WritePropertyProtErrStatistics (int checkId)
{
  long numRequests; 
  long numTimedoutRequests;
  long avResponseTime;
  long maxResponseTime;
  long minResponseTime;
  long avIntervall; 
  char buffer[1024];

  // create statistic report
  numRequests         = ChkQuery_NumRequests(checkId); 
  numTimedoutRequests = ChkQuery_NumTimedoutRequests(checkId); 
  avResponseTime      = ChkQuery_StatAvResponseTime(checkId);
  maxResponseTime     = ChkQuery_StatMaxValidResponseTime(checkId);
  minResponseTime     = ChkQuery_StatMinResponseTime(checkId);

  snprintf(buffer, 1024, "Number of requests           = %d", numRequests);
  Write(buffer);
  TestStep("", buffer);
  snprintf(buffer, 1024, "Number of timedout requests  = %d", numTimedoutRequests);
  Write(buffer);
  TestStep("", buffer);
  snprintf(buffer, 1024, "Average valid  response time = %d ms", avResponseTime);
  Write(buffer);
  TestStep("", buffer);
  snprintf(buffer, 1024, "Maximum valid response time  = %d ms", maxResponseTime);
  Write(buffer);
  TestStep("", buffer);
  snprintf(buffer, 1024, "Minimum response time        = %d ms", minResponseTime);
  Write(buffer);
  TestStep("", buffer);
}
/*@@end*/

/*@@caplFunc:CallbackPropertyProtocolError(dword):*///callback
CallbackPropertyProtocolError(dword checkId)
{
  TestStepFail("Check-Error", "Check failed. The observed property didn't response in time.");

  @sysvar::TM::Check_AvRespTime     = ChkQuery_StatAvResponseTime(checkId);
  @sysvar::TM::Check_NumReq         = ChkQuery_NumRequests(checkId);  
  @sysvar::TM::Check_NumTimedoutReq = ChkQuery_NumTimedoutRequests(checkId);
}
/*@@end*/

/*@@caplFunc:GetADPInstance():*///function
// returns a instance number of the AudioDiskPlayer (0x31)
int GetADPInstance ()
{
  int i; 
  gADPInstance = 1 ; // default value
  for(i = 0; i < MostAsRgGetSize(kBusRegistry); i++)
  {
    if(MostAsRgGetFBlockID(kBusRegistry, i) == 0x31) 
    {
      return MostAsrgGetInstID(kBusRegistry, i) ;
    }
  }
  return 0;
}
/*@@end*/

/*@@caplFunc:SetReportInfos():*///function
// Determine info about test engineer, test setup etc.
// and write info into report. A text that describes the
// test module is written into the report, too.

void SetReportInfos ()
{
  TestModuleDescription ("This test module demonstrates the usage of several");
  TestModuleDescription ("MOST specific checks to evaluate the response behaviour");
  TestModuleDescription ("of the 'TrackPosition' function of 'AudioDiskPlayer'.");

  TestReportAddEngineerInfo ("Name", "not available");
  TestReportAddEngineerInfo ("Company", "not available");

  TestReportAddSetupInfo ("CANoe Configuration", "MOSTTester");
  TestReportAddSetupInfo ("Creator", "Vector Informatik GmbH, Stuttgart");
  TestReportAddSetupInfo ("Version and Date", "3.0 from 2006-10-10");

  TestReportAddSUTInfo ("Device Name", "MOST AudioDiskPlayer");
}
/*@@end*/

/*@@timer:tUpdateGraphic:*/
on timer tUpdateGraphic
{
  @sysvar::TM::Check_AvRespTime     = ChkQuery_StatAvResponseTime(gCheckId);
  @sysvar::TM::Check_NumReq         = ChkQuery_NumRequests(gCheckId);
  @sysvar::TM::Check_NumTimedoutReq = ChkQuery_NumTimedoutRequests(gCheckId);  

  setTimer(tUpdateGraphic,gUpdateGraphicCycle);
}
/*@@end*/

