/*@@var:*/
variables
{
  // This file defines constants of the Function Catalog
  // applied in the simulation example.
  // Note:
  // The function set of the simulation's FBlocks does not
  // fully match the official FBlock's function set.


  // NetBlock
  const byte kFB_NB = 0x01;
  const word kFct_NB_FBlockIDs              = 0x000;
  const word kFct_NB_DeviceInfo             = 0x001;
  const word kFct_NB_NodePositionAddress    = 0x002;
  const word kFct_NB_NodeAddress            = 0x003;
  const word kFct_NB_GroupAddress           = 0x004;
  const word kFct_NB_PermissionToWake       = 0x005;
  const word kFct_NB_ShutDown               = 0x006;
  const word kFct_NB_RetryParameters        = 0x007;
  const word kFct_NB_Sampling_Frequency     = 0x008;
  const word kFct_NB_Version                = 0x010;
  const word kFct_NB_SourceHandles          = 0x100;
  const word kFct_NB_Notification           = 0x401;
  const word kFct_NB_NotificationCheck      = 0x402;
  const word kFct_NB_Boundary               = 0xA03;

  // NetworkMaster
  const byte kFB_NWM = 0x02;
  const word kFct_NWM_FktIDs                 = 0x000;
  const word kFct_NWM_Version                = 0x010;
  const word kFct_NWM_Configuration          = 0xA00;
  const word kFct_NWM_CentralRegistry        = 0xA01;
  const word kFct_NWM_SaveConfiguration      = 0xA02;
  const word kFct_NWM_Boundary               = 0xA03;

  // ConnectionMaster
  const byte kFB_CM = 0x03;
  const word kFct_CM_FktIDs                 = 0x000;
  const word kFct_CM_Notification           = 0x001;
  const word kFct_CM_NotificationCheck      = 0x002;
  const word kFct_CM_BuildSyncConnection    = 0x200;
  const word kFct_CM_RemoveSyncConnection   = 0x201;
  const word kFct_CM_SyncConnectionTable    = 0x400;
  const word kFct_CM_AvailableChannels      = 0x401;

  // PowerMaster
  const byte kFB_PM = 0x04;

  // AudioAmplifier
  const byte kFB_AA = 0x22;
  const word kFct_AA_FktIDs                 = 0x000;
  const word kFct_AA_Notification           = 0x001;
  const word kFct_AA_NotificationCheck      = 0x002;
  const word kFct_AA_SinkInfo               = 0x110;
  const word kFct_AA_Connect                = 0x111;
  const word kFct_AA_DisConnect             = 0x112;
  const word kFct_AA_Mute                   = 0x113;
  const word kFct_AA_SinkName               = 0x114;
  const word kFct_AA_ConnectTo              = 0x115;
  const word kFct_AA_SyncDataInfo           = 0x116;
  const word kFct_AA_Balance                = 0x200;
  const word kFct_AA_Bass                   = 0x202;
  const word kFct_AA_Treble                 = 0x203;
  const word kFct_AA_Fader                  = 0x204;
  const word kFct_AA_Volume                 = 0x400;

  // AudioDiskPlayer
  const byte kFB_ADP = 0x31;
  const word kFct_ADP_FktIDs                 = 0x000;
  const word kFct_ADP_Notification           = 0x001;
  const word kFct_ADP_NotificationCheck      = 0x002;
  const word kFct_ADP_SourceInfo             = 0x100;
  const word kFct_ADP_Allocate               = 0x101;
  const word kFct_ADP_DeAllocate             = 0x102;
  const word kFct_ADP_SourceActivity         = 0x103;
  const word kFct_ADP_SourceName             = 0x104;
  const word kFct_ADP_SyncDataInfo           = 0x116;
  const word kFct_ADP_DeckStatus             = 0x200;
  const word kFct_ADP_TimePosition           = 0x201;
  const word kFct_ADP_TrackPosition          = 0x202;
  const word kFct_ADP_FramePosition          = 0x203;
  const word kFct_ADP_MagazineStatus         = 0x410;
  const word kFct_ADP_ActiveDisk             = 0x412;
  const word kFct_ADP_MediaInfo              = 0x413;
  const word kFct_ADP_AudioDiskInfo          = 0x420;
  const word kFct_ADP_DeckEvent              = 0x430;
  const word kFct_ADP_MediaEvent             = 0x431;
  const word kFct_ADP_Random                 = 0x450;
  const word kFct_ADP_Scan                   = 0x451;
  const word kFct_ADP_PeakLevel              = 0xF00;

  // AmFmTuner
  const byte kFB_AFT = 0x40;
  const word kFct_AFT_FktIDs                 = 0x000;
  const word kFct_AFT_Notification           = 0x001;
  const word kFct_AFT_NotificationCheck      = 0x002;
  const word kFct_AFT_SourceInfo             = 0x100;
  const word kFct_AFT_Allocate               = 0x101;
  const word kFct_AFT_DeAllocate             = 0x102;
  const word kFct_AFT_SourceActivity         = 0x103;
  const word kFct_AFT_SourceName             = 0x104;
  const word kFct_AFT_ATStationInfo          = 0x201;
  const word kFct_AFT_ATPI                   = 0x205;
  const word kFct_AFT_ATPresetList1          = 0x401;
  const word kFct_AFT_Radiotext              = 0x45A;
  const word kFct_AFT_PeakLevel              = 0xF00;

  // VectorPhoneBook
  const byte kFB_VPB = 0x51;
  const word kFct_VPB_FktIDs                 = 0x000;
  const word kFct_VPB_Notification           = 0x001;
  const word kFct_VPB_NotificationCheck      = 0x002;
  const word kFct_VPB_Phonebook              = 0x400;

  // Navigation
  const byte kFB_Nav = 0x52;
  const word kFct_Nav_FktIDs                 = 0x000;
  const word kFct_Nav_Notification           = 0x001;
  const word kFct_Nav_NotificationCheck      = 0x002;
  const word kFct_Nav_CalculateRoute         = 0xE00;
  const word kFct_Nav_Waypoints              = 0xE01;
  const word kFct_Nav_CurrentPosition        = 0xE02;
  const word kFct_Nav_Image                  = 0xE03;

  // Gateway
  const byte kFB_Gateway = 0xC9;
  const word kFct_Gateway_FktIDs                 = 0x000;
  const word kFct_Gateway_Notification           = 0x001;
  const word kFct_Gateway_NotificationCheck      = 0x002;
  const word kFct_Gateway_CANEvent               = 0xC09;

  // VectorSystemManager
  const byte kFB_VSM = 0xD0;
  const word kFct_VSM_FktIDs                 = 0x000;
  const word kFct_VSM_Notification           = 0x001;
  const word kFct_VSM_NotificationCheck      = 0x002;
  const word kFct_VSM_SwitchAudioSource      = 0xD00;
  const word kFct_VSM_CurrentAudioSource     = 0xD01;
  const word kFct_VSM_AvailableAudioSources  = 0xD05;

}
/*@@end*/

