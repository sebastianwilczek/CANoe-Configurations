/*@@var:*/
variables
{
  ////////////////////////////////////////////////////////////
  // Include file for MOST High Protocol Nodelayer DLL
  ////////////////////////////////////////////////////////////

  // Transport modes
  const int cTransportMode_Control = 1;
  const int cTransportMode_Packet = 2;

  // Acknowledge modes
  const long cAckMode_Frame = 0; 
  const long cAckMode_Block = 1;

  // Frames per block 
  const int cMaxNOfFrames_Control = 15;
  const int cMaxNOfFrames_Packet = 255;

  // Size of frames
  const int cMaxUsrDataSize_Control = 11;
  const int cMaxUsrDataSize_PacketMin = 0x28;
  const int cMaxUsrDataSize_PacketMax = 1516; // 1006 for MOST25/50
  const int cDefaultUsrDataSize_Packet = 1006;

  // SegIDs of blocks
  const long cSegID_Single = 0;
  const long cSegID_First  = 1;
  const long cSegID_Middle = 2;
  const long cSegID_Last   = 3;

  // Timeout and reasons for hold connection
  long cTimeoutHold = 700; // ms
  const int cTxHoldEnd   = 0x83 ;  // receiver has sent all data
  const int cTxHoldEvent = 0x84 ;  // sender services other connection
  const int cRxHoldEvent = 0x81 ;  // receiver services other connection

  // Port states
  const int cPortState_Inactive = 0; // sender or receiver inactive 
  const int cPortState_Transmit = 1; // sender or receiver currently transmits data
  const int cPortState_Ready    = 2; // sender waits for more data from the application to be transmitted 
  const int cPortState_End      = 3; // sender currently ends the connection 

  // MH_... API return values
  const int cAPIResult_Termination     = -5;
  const int cAPIResult_NotApplied      = -4;
  const int cAPIResult_InvalidParam    = -3;
  const int cAPIResult_Connection      = -2;
  const int cAPIResult_InvalidHandle   = -1;
  const int cAPIResult_Ok              = 0;

  // specical return value of fault injection processíng
  const long cFIRetValDataFrame =  0;

  // values for reason in MH_RxBufferFinished callback
  const int cReasonRxBuff_Full      = 0;
  const int cReasonRxBuff_Packet    = 1;
  const int cReasonRxBuff_Terminate = 2;

  // High Protocol commands
  const byte cHighCmdFrameAck    = 0xFA;
  const byte cHighCmdReqCon      = 0xCA;
  const byte cHighCmdStartCon    = 0xF2;
  const byte cHighCmdReady       = 0xFD;
  const byte cHighCmdHoldRx      = 0xFE;
  const byte cHighCmdHoldTx      = 0xF1;
  const byte cHighCmdEndRx       = 0xFC;
  const byte cHighCmdEndTx       = 0xF3;
  const byte cHighCmdFrmReq      = 0xFB;
  const byte cHighCmdMultiFrmReq = 0xFF;
  const byte cHighCmdAdjust      = 0xF0;

  // string constants for High Protocol command and frame names
  char cMsgNameDataFrame[32]    = "DATA FRAME";
  char cMsgNameZeroFrame[32]    = "0-FRAME";
  char cMsgNameFrameAck[32]     = "FRAME ACK";
  char cMsgNameReqCon[32]       = "REQUEST CONNECTION";
  char cMsgNameStartCon[32]     = "START CONNECTION";
  char cMsgNameReady[32]        = "READY FOR DATA";
  char cMsgNameHoldRx[32]       = "HOLD CONNECTION RX";
  char cMsgNameHoldTx[32]       = "HOLD CONNECTION TX";
  char cMsgNameEndRx[32]        = "END CONNECTION RX";
  char cMsgNameEndTx[32]        = "END CONNECTION TX";
  char cMsgNameFrmReq[32]       = "REQUEST";
  char cMsgNameMultiFrmReq[32]  = "MULTIPLE FRAMES REQUEST";
  char cMsgNameAdjust[32]       = "ADJUST RATE";
}
/*@@end*/

