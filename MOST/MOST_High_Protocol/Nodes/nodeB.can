/*@@includes:*/
includes
{
#include "MOST_MHP.cin"
}
/*@@end*/

/*@@var:*/
variables {

  char gECU[10] = "Node_B";

  // set this flag to 0 if you want minimum output to the write window
  int gDebugLevel= 5;

  dword gTxPortHandle;  // port handle for DSO instance (sender)
  dword gRxPortHandle;  // port handle for DSI instance (receiver)

  // DSO buffer 
  const long cTxSize = 131072;
  byte gTxDataBuffer[cTxSize];

  // DSI buffer
  const long cRxSize = 65536;
  byte gRxDataBuffer[cRxSize];
  long gRxBufferPos = 0;

  // Address of own DSI: FBlockID.InstID.FctID.OpType
  dword gMyFBlockID;
  dword gMyInstID;
  dword gMyFktID;
  dword gMyOpTypeID;

  // Address of destination DSI: FBlockID.InstID.FctID.OpType + Device adr.
  dword gDestFBlockID;
  dword gDestInstID;
  dword gDestFktID;
  dword gDestOpTypeID;

  dword gDestDev; 
  
  // dummy must be used for PutValue(EnvSendData_2,..)
  byte gClearData[10];

  // Timer for hold of connection
  mstimer gTimerRxHold; 

  // constants for error identification
  const int cSender = 0;
  const int cReceiver = 1;

  const long cDefaultAir = 5000;
  const long cDefaultPrio = 1;

  long gDefaultPacketSize = cDefaultUsrDataSize_Packet;
  long gDefaultNOfFrames = cRxSize / cDefaultUsrDataSize_Packet;
  byte gAppendToFile;
}
/*@@end*/

/*@@startStart:Start:*/
on start
{
  long myDevAdr; 
  int fktID, nOfFrames, isStreaming, isBlockAck;

  setWriteDbgLevel(gDebugLevel);
  writeDbgLevel(1,"DebugLevel: %d", gDebugLevel);
  ResetTxCounters();
  ResetRxCounters();
  
  @sysvar::RxSysVar::IsStream_2 = 0;
  @sysvar::TxSysVar::IsStream_2 = 0;
  @sysvar::TxSysVar::FrameSize_2 = gDefaultPacketSize;
  @sysvar::RxSysVar::FrameSize_2 = gDefaultPacketSize;
  @sysvar::NOfFramesPerBl_2 = gDefaultNOfFrames;

  /////////////////////////////////////////////////////////////////////////
  // Get receiver address from panel and register it for appliction node
  gMyFBlockID = @sysvar::RxSysVar::FBlockID_2; 
  gMyInstID   = @sysvar::RxSysVar::InstID_2;
  gMyFktID    = @sysvar::RxSysVar::FktID_2; 
  gMyOpTypeID = @sysvar::RxSysVar::OpType_2;  
  MostApRegisterEx(gMyFBlockID, gMyInstID);
}
/*@@end*/

/*@@sysvarChange:ClearData_2:*/
on sysvar ClearData_2
{
  if (@this)
  {
    sysSetVariableData(sysvar::ReceiveData_2, gClearData, 0);
    ResetRxCounters();
  }
}
/*@@end*/

/*@@sysvarChange:FillData_2:*/
on sysvar FillData_2
{
  long txCount,i;
  long destDev;

  // No action if button is released
  if (@this==0)
      return;

  // Filling Tx Buffer with arbitrary data
  txCount = @sysvar::TxSysVar::FillSize_2;
  if(txCount > cTxSize)
    return;
  for( i=0; i<txCount; i++ )
  {
    gTxDataBuffer[i] = 0x30+i;
  }
  // Show data in panel
  sysSetVariableData(sysvar::SendData_2, gTxDataBuffer, txCount);
  @sysvar::TxSysVar::DataSize_2 = txCount;
  // Request transmission
  RequestTransmission();
}
/*@@end*/

/*@@sysvarChange:MsgSend_2:*/
on sysvar MsgSend_2
{
  int isStreaming;
  long txArraySize;          // message data
  char sourceFilepath[1024];

  // Prevent from sending when button is released
  if(@this == 0)
    return;

  // determine type of transmission (stream or single packet)
  isStreaming = @sysvar::TxSysVar::IsStream_2;
  if(isStreaming == 1)
  {
    sysGetVariableString(sysvar::TxSysVar::SrcFilePath_2, sourceFilepath, elCount(sourceFilepath));
    if(MH_CheckTxFile(sourceFilepath) == 0)
    {
      writeDbgLevel(0,"CAPL: %s: Error: No data to send", gECU);
      return;
    }
  }
  else
  {
    // get the message data from the panel control's edit box
    sysGetVariableData(sysvar::SendData_2, gTxDataBuffer, txArraySize);

    if(txArraySize == 0)
    {
      writeDbgLevel(0,"CAPL: %s: Error: No data to send", gECU);
      return;        // nothing to send
    }

    if (txArraySize >= cTxSize)
        txArraySize = cTxSize;
  }
  // Ok, data is available => initialize transmission 
  RequestTransmission();
}
/*@@end*/

/*@@sysvarChange:RxSysVar::Hold_2:*/
on sysvar RxSysVar::Hold_2
{
  if (@this == 1)
  {
    if(MH_SetRxOnHold(gRxPortHandle, 1, cRxHoldEvent) != 0)    // function successfully executed
    {
      @sysvar::RxSysVar::IsHoldCon_2 = 1;
    }
    else
    {
      writeDbgLevel(3, "CAPL: %s: Attempt to activate cyclic send of HOLD CONNECTION failed", gECU);
    }
  }
  else
  {
    MH_SetRxOnHold(gRxPortHandle, 0, 0);
    @sysvar::RxSysVar::IsHoldCon_2 = 0;                // ... send HOLD deactivated
  }
}
/*@@end*/

/*@@caplFunc:ResetTxCounters():*/
ResetTxCounters ()
{
  // reset Tx counter environment variables
  @sysvar::TxSysVar::Data_2 = 0;
  @sysvar::IsSend_2 = 0;     // switch off LED
}
/*@@end*/

/*@@sysvarChange:RxSysVar::FBlockID_2:*/
on sysvar RxSysVar::FBlockID_2
{
  // re-register the node for the FBlock given in the DSI address 
  MostApUnregisterEx(gMyFBlockID, gMyInstID);
  gMyFBlockID = @this; 
  MostApRegisterEx(gMyFBlockID, gMyInstID);
}
/*@@end*/

/*@@sysvarChange:RxSysVar::InstID_2:*/
on sysvar RxSysVar::InstID_2
{
  // re-register the node for the FBlock given in the DSI address 
  MostApUnregisterEx(gMyFBlockID, gMyInstID);
  gMyInstID = @this; 
  MostApRegisterEx(gMyFBlockID, gMyInstID);
}
/*@@end*/

/*@@sysvarChange:RxSysVar::FktID_2:*/
on sysvar RxSysVar::FktID_2
{
  gMyFktID = @this;
}
/*@@end*/

/*@@sysvarChange:RxSysVar::OpType_2:*/
on sysvar RxSysVar::OpType_2
{
  gMyOpTypeID = @this;
}
/*@@end*/

/*@@sysvarChange:IsBlockAck_2:*/
on sysvar IsBlockAck_2
{
  int isBlockAck;

  isBlockAck = @this;

  if(isBlockAck == 1)
  {
    MH_SetTxBlockAck(gTxPortHandle, 1);    // block
    writeDbgLevel(2, "CAPL: %s: Switched to block acknowledge.", gECU);
  }
  else
  {
    MH_SetTxBlockAck(gTxPortHandle, 0);    // frame
    writeDbgLevel(2, "CAPL: %s: Switched to frame acknowledge.", gECU);
  }
}
/*@@end*/

/*@@sysvarChange:TxSysVar::SrcFilePath_2:*/
on sysvar TxSysVar::SrcFilePath_2
{
  char srcFilepath[4096];
  long fileSize = 0;

  sysGetVariableString(this, srcFilepath, elCount(srcFilepath));
  if(strlen(srcFilepath) > 0)
  {
    fileSize = MH_CheckTxFile(srcFilepath);
    if (fileSize > 0)
    {
      @sysvar::TxSysVar::IsStream_2 = 1;
    }
  }
  @sysvar::TxSysVar::DataSize_2 = fileSize;

  writeDbgLevel(2, "CAPL: %s: Filepath is : %s ", gECU, srcFilepath);
}
/*@@end*/

/*@@sysvarChange:SendData_2:*/
on sysvar SendData_2
{
  long txArraySize;

  // if data is entered in the hex editor, set the transmission type to single packet
  @sysvar::TxSysVar::IsStream_2 = 0;

  txArraySize = sysGetVariableArrayLength(this);
  @sysvar::TxSysVar::DataSize_2 = txArraySize;
}
/*@@end*/

/*@@sysvarChange:TransportMode_2:*/
on sysvar TransportMode_2
{
  int mode;

  mode = @this;

  if(mode == cTransportMode_Control)
  {
    // reset capacity values
    @sysvar::TxSysVar::FrameSize_2 = cMaxUsrDataSize_Control;
    EnableControl("Settings_B", "SysVar:TxSysVar::FrameSize_2", 0); // disable edit box
    MH_SetTxFrameSize(gTxPortHandle, cMaxUsrDataSize_Control);
    MH_SetTxTranspMode(gTxPortHandle, cTransportMode_Control);
    writeDbgLevel(2, "CAPL: %s: Using control channel.", gECU);
  }
  else // (mode == cTransportMode_Packet)
  {
    @sysvar::TxSysVar::FrameSize_2 = gDefaultPacketSize; 
    EnableControl("Settings_B", "SysVar:TxSysVar::FrameSize_2", 1); // enable edit box
    MH_SetTxFrameSize(gTxPortHandle, gDefaultPacketSize);
    MH_SetTxTranspMode(gTxPortHandle, cTransportMode_Packet); 
    writeDbgLevel(2, "CAPL: %s: Using asynchonous channel.", gECU);
  }  
}
/*@@end*/

/*@@sysvarChange:TxSysVar::Priority_2:*/
on sysvar TxSysVar::Priority_2
{
  MH_SetTxPriority(gTxPortHandle, @this);
  writeDbgLevel(2, "CAPL: %s: Priority is set to %d", gECU, @this);
}
/*@@end*/

/*@@sysvarChange:SetRxCapacity_2:*/
on sysvar SetRxCapacity_2
{    
  dword framesPerBlock;
  dword bytesPerFrame;
  dword priority; 
  dword air;     
 
  // No action if button is released
  if (@this==0)
      return;

  framesPerBlock = @sysvar::NOfFramesPerBl_2;
  bytesPerFrame  = @sysvar::RxSysVar::FrameSize_2;
  priority       = @sysvar::RxSysVar::Priority_2;
  air            = @sysvar::RxSysVar::AIR_2;
  
  if(MH_SetRxCapacity(gRxPortHandle, framesPerBlock, bytesPerFrame, air, priority) == 0)
  {
    writeDbgLevel(2, "CAPL: %s: Rx capacity set: %d frames per block, %d bytes per frame, AIR = %d microsecs, priority = %d.", 
        gECU, framesPerBlock, bytesPerFrame, air, priority);
  }
}
/*@@end*/

/*@@sysvarChange:TxSysVar::FrameSize_2:*/
on sysvar TxSysVar::FrameSize_2
{

  MH_SetTxFrameSize(gTxPortHandle, @this);
  writeDbgLevel(2, "CAPL: %s: Frame size is set to %d", gECU, @this);
}
/*@@end*/

/*@@timer:gTimerRxHold:*/
on timer gTimerRxHold
{
  // timeout of t_hold deactivates cyclic sending of HOLD CONNECTION 
  @sysvar::TxSysVar::IsHoldCon_2 = 0; // ...from this node 
  @sysvar::RxSysVar::IsHoldCon_2 = 0; // ...from the other side
}
/*@@end*/

/*@@mostNodeAdr:OnMostNodeAdr(long):*/
OnMostNodeAdr(long nodeadr)
{
  @sysvar::MyDevAdr_2 = nodeadr;
  writeDbgLevel(3,"NodeAdr: %04X",nodeadr);
}
/*@@end*/

/*@@caplFunc:MH_IndTxBlockFinished(dword,long,long,long):*///callback
MH_IndTxBlockFinished(dword handle, long blockSize, long segId, long blockCnt)
{
  long size, isStreaming;
  
  size = @sysvar::TxSysVar::Data_2;
  size += blockSize;

  @sysvar::TxSysVar::Data_2 = size;  // total user data bytes sent
  writeDbgLevel(3, "CAPL: %s: Transmission of block %d with %d bytes finished", gECU, blockCnt, blockSize);
}
/*@@end*/

/*@@caplFunc:MH_IndTxConnectionClosed(dword,long):*///callback
MH_IndTxConnectionClosed(dword handle, long res)
{
  @sysvar::IsSend_2 = 0;
  @sysvar::TxSysVar::Hold_2 = 0;

  ReportErrorsToWrite(res, cSender);
}
/*@@end*/

/*@@caplFunc:MH_IndRxConnectionClosed(dword,long):*///callback
MH_IndRxConnectionClosed(dword handle, long res)
{
  @sysvar::IsReceive_2 = 0;
  @sysvar::RxSysVar::Hold_2 = 0;
  ReportErrorsToWrite(res, cReceiver);
  // Overwrite file during next connection
  gAppendToFile = 0;
}
/*@@end*/

/*@@caplFunc:MH_IndHoldRcvd(dword,long):*///callback
MH_IndHoldRcvd(dword handle, long event)
{
  // Indicate hold connection from other side in panel
  // This function will be called whenever a hold connection frame is received
  @sysvar::RxSysVar::IsHoldCon_2 = 1; // from a sender 
  @sysvar::TxSysVar::IsHoldCon_2 = 1; // from a receiver
  // The timer will reset the indication as soon as no hold connection messages 
  // are received within cTimeoutHold any more
  cancelTimer(gTimerRxHold);
  setTimer(gTimerRxHold, cTimeoutHold);
  writeDbgLevel(0, "CAPL: %s: Received HOLD CONNECTION with event=%X", gECU, event);
}
/*@@end*/

/*@@caplFunc:MH_IndTxPktFinished(dword,long):*///callback
MH_IndTxPktFinished(dword handle, long packetSize)
{
  ////////////////////////////////////////////////////////////////////
  // HINT: Place 
  //         MH_SetTxBuffer(byteArray, longSize);
  //       here, to continue transmission without closing the
  //       connection. Don't forget to set up a counter because otherwise
  //       an endless loop will be the result.
  ////////////////////////////////////////////////////////////////////

  @sysvar::IsSend_2 = 0;    // reset send status => deactivate LED
  writeDbgLevel(3, "CAPL: %s: Transmission of packet with %d bytes finished", gECU, packetSize);
}
/*@@end*/

/*@@caplFunc:MH_IndRxBufferFinished(dword,long,long):*///callback
MH_IndRxBufferFinished (dword handle, long filledSize, long reason)
{
  writeDbgLevel(3, "CAPL: %s: Written receive buffer with %d bytes", gECU, filledSize);
  ///////////////////////////////////////////////////////////////////////////////////
  // This function is called whenever the receiver buffer is full and the application 
  // has to handle the received data. Additionally it is called when the connection 
  // is closed to provide the remaining application data
  // In this demo, processing of the received data takes place in the block handler
  // (MH_IndRxBlckFinished) in order to update the panel controls a soon as possible. 
  // In a normal application, this callback here is the place to save and process the 
  // received data. 

  @sysvar::IsReceive_2 = 0;        // reset send status => deactivate LED
  if(reason == cReasonRxBuff_Packet)
    writeDbgLevel(3, "CAPL: %s: Reception of packet completed. %d bytes in buffer.", gECU, filledSize);
  else
    writeDbgLevel(3, "CAPL: %s: Reception of %d bytes finished. Buffer is full.", gECU, filledSize);
}
/*@@end*/

/*@@caplFunc:MH_IndRxBufferRequested(dword,long):*///callback
MH_IndRxBufferRequested (dword handle, long isPacketBegin)
{
  /////////////////////////////////////////////////////////////////////////////////////
  // This callback is triggered as soon as the data sink receives (another) zero frame
  // announcing the transmission of another block which will not fit into the remaining
  // rx buffer provided by the previous call to MH_IndRxBufferRequested, if there was 
  // already one.
  //
  // WARNING: With MOST_MHP.DLL version 1.0.10 and newer this callback is also triggered
  // when streaming to file is active and a new packet is observed. This allows writing of
  // packets into different files even if the packets are transmitted within one connection.
  // If the filename should not be changed, it must be assured that the file content
  // is not overwritten after each packet (see comment at MH_SetRxBuffer below).

  int isStreaming, i;
  char destFilepath[4096];

  gRxBufferPos = 0;
  if(isPacketBegin == 1)
  {
    writeDbgLevel(3, "CAPL: %s: New rx buffer requested for new packet", gECU);
    ResetRxCounters();                // reset counters
    sysSetVariableData(sysvar::ReceiveData_2, gRxDataBuffer, 0);
  }
  else
    writeDbgLevel(3, "CAPL: %s: New rx buffer requested for next part of packet", gECU);  

  sysGetVariableString(sysvar::RxSysVar::DestFilePath_2, destFilepath, elCount(destFilepath));  

  isStreaming = @sysvar::RxSysVar::IsStream_2;
  if(isStreaming == 1) 
  {
    /////////////////////////////////////////////////////////////////////////////
    // HINT: Set a new filename here to change the file after each packet:
    //  snprintf(destFilepath,4096,"%s.%03d",destFilepath,i++ % 100);
    //
    // If the filename should not be changed, the appendToFile parameter should be
    // 0 during the first call and 1 for all following calls. This is done here
    // with the global variable gAppendToFile which is reset in MH_IndRxBufferRequest.
    if(MH_SetRxBuffer(gRxPortHandle, gAppendToFile, destFilepath) == cAPIResult_Ok)
      writeDbgLevel(0, "CAPL: %s: Streaming into file %s", gECU, destFilepath);
    else
    {
      writeDbgLevel(0, "CAPL: %s: Couldn't open file %s for output", gECU, destFilepath);
      // cannot stream, so use static buffer
      @sysvar::RxSysVar::IsStream_2 = 0;
      if(MH_SetRxBuffer(gRxPortHandle, gRxDataBuffer, cRxSize) != cAPIResult_Ok)
        writeDbgLevel(0, "CAPL: %s: Could not set Buffer !", gECU);
    }

    /////////////////////////////////////////////////////////////////////////////
    // HINT: Remove this line if multiple files are used (see hint above).
    gAppendToFile = 1;
  }
  else
  {
    if(MH_SetRxBuffer(gRxPortHandle, gRxDataBuffer, cRxSize) != cAPIResult_Ok)
      writeDbgLevel(0, "CAPL: %s: Could not set Buffer !", gECU);
  }
}
/*@@end*/

/*@@caplFunc:MH_IndTxZeroFrame(dword,long,long,long,long):*///callback
MH_IndTxZeroFrame (dword handle, long nOfFrames, long segId, long options, long blockCnt)
{
  @sysvar::IsSend_2 = 1;               // set send status => activate LED
  @sysvar::TxSysVar::BlockCnt_2 = blockCnt;
  writeDbgLevel(3, "CAPL: %s: Transmission of block %d started for %d frames", gECU, blockCnt, nOfFrames);
}
/*@@end*/

/*@@caplFunc:MH_IndWrongMsg(dword):*///callback
MH_IndWrongMsg(dword handle)
{
  writeDbgLevel(5, "CAPL: %s: Warning: Wrong message received.", gECU);
}
/*@@end*/

/*@@caplFunc:MH_IndRxZeroFrame(dword,long,long,long,long):*///callback
MH_IndRxZeroFrame(dword handle, long nOfFrames, long segId, long options, long blockCnt)
{
  @sysvar::IsReceive_2 = 1;  // set receive status => activate LED
  @sysvar::RxSysVar::BlockCnt_2 = blockCnt;
  writeDbgLevel(3, "CAPL: %s: Received 0-Frame: %d Frames in Block Nr. %d expected", gECU, nOfFrames, blockCnt);  
}
/*@@end*/

/*@@preStart:PreStart:*/
on preStart
{
  mostApplicationNode();

  ///////////////////////////////////////////////////////////////////////////////////////
  // initialize default transmission parameters for all ports to be created (handle = 0)
  MH_SetTxTranspMode(0, @sysvar::TransportMode_2);
  MH_SetTxFrameSize(0, @sysvar::TxSysVar::FrameSize_2);
  MH_SetTxPriority(0, @sysvar::TxSysVar::Priority_2);
  MH_SetTxBlockAck(0, @sysvar::IsBlockAck_2);
  
  if (mostGetSpeedGrade(mostGetChannel()) == 3)
  {
    MH_UseProtocolRev(0, 3);
    gDefaultPacketSize = cDefaultUsrDataSize_Packet;
    if ((cRxSize / gDefaultPacketSize) > cMaxNOfFrames_Packet)
    {
      gDefaultNOfFrames = cMaxNOfFrames_Packet;
    }
    else
    {
      gDefaultNOfFrames = cRxSize / gDefaultPacketSize;
    }
    MH_SetRxCapacity(gRxPortHandle, gDefaultNOfFrames, gDefaultPacketSize, cDefaultAir, cDefaultPrio);
  }

  // register a MHP tx port for accessing a DSO instance 
  gTxPortHandle = MH_CreateTxPort("");  // empty prefix is used, since only a single port is created
  // register a MHP rx port for accessing a DSI instance
  gRxPortHandle = MH_CreateRxPort("");  // empty prefix is used, since only a single port is created
}
/*@@end*/

/*@@sysvarChange:TxSysVar::Hold_2:*/
on sysvar TxSysVar::Hold_2
{
  if (@this == 1)
  {
    if(MH_SetTxOnHold(gTxPortHandle, 1, cTxHoldEvent) != 0)    // function successfully executed
    {
      @sysvar::TxSysVar::IsHoldCon_2 = 1;
    }
     else
    {
      writeDbgLevel(3, "CAPL: %s: Attempt to activate cyclic send of HOLD CONNECTION failed", gECU);
    }
  }
  else
  {
    MH_SetTxOnHold(gTxPortHandle, 0, 0);
    @sysvar::TxSysVar::IsHoldCon_2 = 0;                // ... send HOLD deactivated
  }
}
/*@@end*/

/*@@caplFunc:MH_IndRxBlockFinished(dword,long,long,long):*///callback
MH_IndRxBlockFinished(dword handle, long blockSize, long segId, long blockCnt)
{
  long size, isStreaming;
  byte data[cRxSize];
  long dataSize, i, maxSize;
  size = @sysvar::RxSysVar::Data_2;
  size += blockSize;

  // update the hex editor content
  isStreaming = @sysvar::RxSysVar::IsStream_2;
  if(isStreaming == 0)
  {
    sysGetVariableData(sysvar::ReceiveData_2, data, dataSize);
    maxSize = (dataSize + blockSize < cRxSize) ? dataSize + blockSize : cRxSize;
    for (i = dataSize; i < maxSize; i++)
    {
      data[i] = gRxDataBuffer[gRxBufferPos];
      gRxBufferPos++;
    }
    sysSetVariableData(sysvar::ReceiveData_2, data, i);
  }

  // Visualization only
  @sysvar::RxSysVar::Data_2 = size;  // total user data bytes received
  writeDbgLevel(3, "CAPL: %s: Reception of block %d with %d bytes finished", gECU, blockCnt, blockSize);
}
/*@@end*/

/*@@caplFunc:ReportErrorsToWrite(long,int):*///function
ReportErrorsToWrite (long res, int nodeType)
{
  char sNodeType[15];
  if (cSender == nodeType)
  {
    snprintf(sNodeType, elcount(sNodeType), "Sender");
  }
  else
  {
    snprintf(sNodeType, elcount(sNodeType), "Receiver");
  }
  switch (res)
  {
    case 0:     writeDbgLevel(0, "CAPL: %s: %s Result (%d): OK", gECU, sNodeType, res);     break;
    case 1:     writeDbgLevel(0, "CAPL: %s: %s Error (%d): Number of Send retries exceeded", gECU, sNodeType, res);          break;
    case 2:     writeDbgLevel(0, "CAPL: %s: %s Error (%d): Number of Trans retries exceeded", gECU, sNodeType, res);         break;
    case 3:     writeDbgLevel(0, "CAPL: %s: %s Error (%d): Number of End retries exceeded", gECU, sNodeType, res);           break;
    case 4:     writeDbgLevel(0, "CAPL: %s: %s Error (%d): Number of Ready retries exceeded", gECU, sNodeType, res);         break;
    case 5:     writeDbgLevel(0, "CAPL: %s: %s Error (%d): Number of Frame Retries exceeded", gECU, sNodeType, res);         break;
    case 6:     writeDbgLevel(0, "CAPL: %s: %s Error (%d): Number of Receive retries execeeded", gECU, sNodeType, res);      break;
    case 10:    writeDbgLevel(0, "CAPL: %s: %s Error (%d): Receive buffer could not be provided", gECU, sNodeType, res);     break;
    case 11:    writeDbgLevel(0, "CAPL: %s: %s Error (%d): Connection rejected via higher priority", gECU, sNodeType, res);  break;
    case 13:    writeDbgLevel(0, "CAPL: %s: %s Result (%d): Transmission terminated by receiver", gECU, sNodeType, res);     break;
    case 14:    writeDbgLevel(0, "CAPL: %s: %s Result (%d): Transmission terminated by sender", gECU, sNodeType, res);       break;
    case 15:    writeDbgLevel(0, "CAPL: %s: %s Error (%d): Transmission killed by sender", gECU, sNodeType, res);            break;
    case 16:    writeDbgLevel(0, "CAPL: %s: %s Error (%d): Parameter out of range", gECU, sNodeType, res);                   break;
    default:    writeDbgLevel(0, "CAPL: %s: %s Error (%d): Unknown error", gECU, sNodeType, res);                            break;
  }
}
/*@@end*/

/*@@caplFunc:MH_IndHoldSent(dword,long):*///callback
MH_IndHoldSent(dword handle, long event)
{
  // Indicate hold connection from user request in panel
  // This function will be called whenever MH_SetTxOnHold was called by the sender application
  // and the transport layer sent a hold message to the receiver...
  @sysvar::TxSysVar::IsHoldCon_2 = 1;
  // ...or whenever MH_SetRxOnHold was called by the receiver application
  // and the transport layer sent a hold message to the sender
  @sysvar::RxSysVar::IsHoldCon_2 = 1;
 
  // The timer will reset the indication as soon as no hold connection messages 
  // are transmitted within cTimeoutHold any more
  cancelTimer(gTimerRxHold);
  setTimer(gTimerRxHold, cTimeoutHold);
  writeDbgLevel(0, "CAPL: %s: Sent HOLD CONNECTION with event=%X", gECU, event);
}
/*@@end*/

/*@@caplFunc:ResetRxCounters():*///function
ResetRxCounters ()
{
  // reset Rx counter environment variables
  @sysvar::RxSysVar::Data_2 = 0;
  @sysvar::IsReceive_2 = 0; // switch off LED
}
/*@@end*/

/*@@sysvarChange:RxSysVar::DestFilePath_2:*/
on sysvar RxSysVar::DestFilePath_2
{
  char destFilepath[4096];
  int  len;
  // Check if file is selected
  sysGetVariableString(sysvar::RxSysVar::DestFilePath_2, destFilepath, len);
  if (len > 0)
  {
    @sysvar::RxSysVar::IsStream_2 = 1;
  }
}
/*@@end*/

/*@@sysvarChange:TxSysVar::Stop_2:*/
on sysvar TxSysVar::Stop_2
{
  if (MH_TxStopTrans(gTxPortHandle))
  {
    @sysvar::IsSend_2 = 0;
    @sysvar::TxSysVar::Hold_2 = 0;
  }
}
/*@@end*/

/*@@sysvarChange:RxSysVar::Stop_2:*/
on sysvar RxSysVar::Stop_2
{
  if (MH_RxStopTrans(gRxPortHandle))
  {
    @sysvar::IsReceive_2 = 0;
    @sysvar::RxSysVar::Hold_2 = 0;
  }
}
/*@@end*/

/*@@caplFunc:MH_IndTxBufferRequested(dword,long):*///callback
MH_IndTxBufferRequested(dword handle, long isPacketBegin)
{
  //////////////////////////////////////////////////////////////////////////////////////////////////////
  // main callback of DSO after a connection is requested and DSI accepts it by sending START CONNECTION
  byte isStreaming;
  char srcFilepath[1024];    // filename
  long bufferSize;
  int  isToBeContinued;      

  // specifies, if MH_IndTxBufferRequested should be called again after complete transmssion of buffer 
  isToBeContinued = 0; // 0 : MH_IndTxBufferRequested is not called again 
                       // 1 : MH_IndTxBufferRequested is called again
 
  // is this the first time a buffer is requested for the packet to be transmitted?  
  if(isPacketBegin == 1)  
  {
    isStreaming = @sysvar::TxSysVar::IsStream_2;
    if(isStreaming == 1) // is packet data a file ?
    {
      // check if there's a file path
      sysGetVariableString(sysvar::TxSysVar::SrcFilePath_2, srcFilepath, elCount(srcFilepath));
      if(strlen(srcFilepath) == 0)
      {
        writeDbgLevel(0,"CAPL: %s: Error: No source file path set", gECU);
        return;
      }
      // try to set file as input buffer
      if(MH_SetTxBuffer(handle, srcFilepath, isToBeContinued) <= 0)
      {
        writeDbgLevel(0,"CAPL: %s: Error: File %s doesn't exist or is empty.", gECU, srcFilepath);
        return;
      }
      writeDbgLevel(3,"CAPL: %s: Transmission of file %s started.", gECU, srcFilepath);                 
    }
    else                 // or simple byte buffer in hex edit control?
    {
      bufferSize = @sysvar::TxSysVar::DataSize_2;
      MH_SetTxBuffer(handle, gTxDataBuffer, bufferSize, isToBeContinued);  
      writeDbgLevel(3,"CAPL: %s: Transmission of buffer with %d bytes started.", gECU, bufferSize);
    }
    ResetTxCounters(); // transmission of new packet started
  }
  else
  {
    //////////////////////////////////////////////////////////////////////
    // continuous sending on existing connection could take place here, if
    // initial calls of MH_SetTxBuffer and MH_SetTxBufferFile had set the 
    // "toBeContinued" parameter to 1

    if(isStreaming)  // If one wishes to send several files in a row
    {
      //////////////////////////////////////////////////////////
      // Insert code to set the next file to be transmitted here

      // check if there's a (new) file path
      sysGetVariableString(sysvar::TxSysVar::SrcFilePath_2, srcFilepath, elCount(srcFilepath));
      if(strlen(srcFilepath) == 0)
      {
        writeDbgLevel(0,"CAPL: %s: Error: No source file path set", gECU);
        return;
      }
      // try to set file as input buffer
      if(MH_SetTxBuffer(handle, srcFilepath, 0 /* or 1 to continue */) <= 0) 
      {
        writeDbgLevel(0,"CAPL: %s: Error: File %s doesn't exist or is empty.", gECU, srcFilepath);
        return;
      }                 
    }
    else             // ...or if the buffer data is updated by an application meanwhile
    {
      ///////////////////////////////////////////////////////////////////////
      // Insert code to write next packet of application data in buffer here

      bufferSize = @sysvar::TxSysVar::DataSize_2;
      MH_SetTxBuffer(handle, gTxDataBuffer, bufferSize, 0 /* or 1 to continue */); 
    }
  }
  @sysvar::IsSend_2 = 1;
}
/*@@end*/

/*@@caplFunc:RequestTransmission():*///function
RequestTransmission ()
{
  dword destDev;
  dword fblockID;
  dword instID;
  dword fktID;
  dword opTypeID;
  int portState;
  int isStreaming; 
  long bufferSize;
  char srcFilepath[1024];   

  portState = MH_GetTxPortState(gTxPortHandle);
  if(portState == cPortState_Inactive)
  {
    // a new connection can only be invoked on the port, if there's not already a running connection
    gDestDev      = @sysvar::DestDevAdr_2;
    gDestFBlockID = @sysvar::TxSysVar::FBlockID_2;
    gDestInstID   = @sysvar::TxSysVar::InstID_2;
    gDestFktID    = @sysvar::TxSysVar::FktID_2;
    gDestOpTypeID = @sysvar::TxSysVar::OpType_2;
    
    ////////////////////////////////////////////////////////////////////////////////
    // This function requests a transmission for the current address parameters set
    // A DSO instance is invoked and waits for a START CONNECTION from the DSI side
    // If transmission parameters are acknowledged, the callback 
    // MHP_IndTxBufferRequested will be called with the assigned port handle to 
    // provide the data to be transmitted
    bufferSize = @sysvar::TxSysVar::DataSize_2;
    
    if(MH_ReqTrans(gTxPortHandle, gDestDev, gDestFBlockID, gDestInstID, gDestFktID, gDestOpTypeID) < 0)
    {
      writeDbgLevel(5,"CAPL: %s: Failed request connection for %02X.%02X.%03X.%01X in device %04X on port %d", 
        gECU, gDestFBlockID, gDestInstID, gDestFktID, gDestOpTypeID, gDestDev, gTxPortHandle);
    }
    else
    {
      writeDbgLevel(5,"CAPL: %s: Request connection for %02X.%02X.%03X.%01X in device %04X on port %d", 
        gECU, gDestFBlockID, gDestInstID, gDestFktID, gDestOpTypeID, gDestDev, gTxPortHandle);
    }
  }
  else if(portState == cPortState_Ready)
  {
    /////////////////////////////////////////////////////////////////////////////////////
    // if a connection is already running on the port and is ready to transmit more data
    // and the destination address wasn't changed by the user in the meantime, this
    // connection can be reused to send the next packet by simply setting a new tx buffer
    
    destDev  = @sysvar::DestDevAdr_2;
    fblockID = @sysvar::TxSysVar::FBlockID_2;
    instID   = @sysvar::TxSysVar::InstID_2;
    fktID    = @sysvar::TxSysVar::FktID_2;
    opTypeID = @sysvar::TxSysVar::OpType_2;

    if((destDev      == gDestDev) &&
       (fblockID     == gDestFBlockID) &&
       (instID       == gDestInstID) &&
       (fktID        == gDestFktID) &&
       (opTypeID     == gDestOpTypeID))
    {
      isStreaming = @sysvar::TxSysVar::IsStream_2;
      if(isStreaming == 1) // is packet data a file ?
      {
        // check if there's a file path
        sysGetVariableString(sysvar::TxSysVar::SrcFilePath_2, srcFilepath, elCount(srcFilepath));
        if(strlen(srcFilepath) == 0)
        {
          writeDbgLevel(0,"CAPL: %s: Error: No source file path set", gECU);
          return;
        }
        // try to set file as input buffer
        if(MH_SetTxBuffer(gTxPortHandle, srcFilepath, 0) <= 0)
        {
          writeDbgLevel(0,"CAPL: %s: Error: File %s doesn't exist or is empty.", gECU, srcFilepath);
          return;
        }                 
      }
      else                 // or simple byte buffer in hex edit control?
      {
        bufferSize = @sysvar::TxSysVar::DataSize_2;
        MH_SetTxBuffer(gTxPortHandle, gTxDataBuffer, bufferSize, 0);
      }
      writeDbgLevel(5,"CAPL: %s: Continue to send new packet over existing connection on port %d", 
        gECU, gTxPortHandle);
      ResetTxCounters(); // transmission of new packet started
    }
    else
    {
      writeDbgLevel(0,"CAPL: %s: Error. Unable to send new packet over port %d, since running connection uses a different address", 
        gECU, gTxPortHandle);
    }
  }
  else
  {
    writeDbgLevel(0,"CAPL: %s: Error. Unable to request new connection on port %d, since it is currently used by running connection", 
      gECU, gTxPortHandle);
  }
}
/*@@end*/

/*@@caplFunc:MH_IndRequestConnection(dword,dword,dword,dword,dword,dword,dword):*///callback
MH_IndRequestConnection(dword dsoDevice, dword fblockID, dword instanceID, dword fktID, dword opTypeID, dword prio, dword frameSize)
{
  ///////////////////////////////////////////////////////////////////////////////////
  // This callback is called whenever the node receives a REQUEST CONNECTION message
  // and is used for accepting a connection by assigning it to a rx port or denying
  // it in case no rx port is available or the functional address doesn't fit
 
  if((gMyFBlockID == fblockID) &&
     (gMyInstID   == instanceID) &&
     (gMyFktID    == fktID) &&
     (gMyOpTypeID == opTypeID) &&
     (MH_GetRxPortState(gRxPortHandle) == cPortState_Inactive))
  {
    MH_AcceptConnection(gRxPortHandle);
    writeDbgLevel(0, "CAPL: %s: Accepted connection for %02X.%02X.%03X.%01X with priority of %d and frame size of %d bytes.", gECU, fblockID, instanceID, fktID, opTypeID, prio, frameSize);
    return;
  }
  //////////////////////////////////////////////////////////////////////////
  // Connection is ignored if neither MH_AcceptConnection nor MH_DenyConnection
  // is called within this callback.
  // Explicit denial of connection is done by a calling MH_DenyConnection, e.g. 
  // MH_DenyConnection(prio + 1). Then START CONNECTION with given priority is
  // sent to the DSO.
  // MH_DenyConnection(prio + 1);
  // writeDbgLevel(0, "CAPL: %s: Denied connection for %02X.%02X.%03X.%01X with priority of %d and frame size of %d bytes.", gECU, fblockID, instanceID, fktID, opTypeID, prio, frameSize);
}
/*@@end*/

/*@@mostNetState:OnMostNetState(long,long):*/
OnMostNetState(long oldstate, long newstate)
{
  if(newstate == 4)
  {
    MH_TxStopTrans(gTxPortHandle);
    MH_RxStopTrans(gTxPortHandle);
  }
}
/*@@end*/

