/*@@var:*/
variables
{
  char panReceivAPreSnd[50] = "ReceiverA PreSend Fault Injection";
  char panReceivAPreRcv[50] = "ReceiverA PreReceive Fault Injection";
  char panReceivASndMsg[50] = "Fault Injection: Send additional message";
}
/*@@end*/

/*@@startStart:Start:*/
on start
{
  callAllOnEnvVar();
}
/*@@end*/

/*@@sysvarChange:RxPreSnd::FrAck:*/
on sysvar RxPreSnd::FrAck
{
  int isActiveHi;
  int isActiveLo;

  if(@this == 1)
  {
    EnableControl(panReceivAPreSnd, "RxPreSnd_FrAck_bHasBlCnt", 1); 
    EnableControl(panReceivAPreSnd, "RxPreSnd_FrAck_HasBlCnt", 
                  (@sysvar::RxPreSnd::FrAck_bHasBlCnt));    
    
    EnableControl(panReceivAPreSnd, "RxPreSnd_FrAck_HasFrAck", 1); 
    switch((@sysvar::RxPreSnd::FrAck_HasFrAck))
    {
     case 1:
      isActiveHi = 1;
      isActiveLo = 0;
      break;
    case 2:
      isActiveHi = 1;
      isActiveLo = 1;
      break;
    case 3:
      isActiveHi = 0;
      isActiveLo = 1;
      break;
    default:
      isActiveHi = 0;
      isActiveLo = 0;
      break;
    }
    EnableControl(panReceivAPreSnd, "RxPreSnd_FrAck_HasFrAHi", isActiveHi); 
    EnableControl(panReceivAPreSnd, "RxPreSnd_FrAck_HasFrALo", isActiveLo); 

    EnableControl(panReceivAPreSnd, "RxPreSnd_FrAck_bRepFrAHi", 1);
    EnableControl(panReceivAPreSnd, "RxPreSnd_FrAck_RepFrAHi", 
                  (@sysvar::RxPreSnd::FrAck_bRepFrAHi));

    EnableControl(panReceivAPreSnd, "RxPreSnd_FrAck_bRepFrALo", 1);
    EnableControl(panReceivAPreSnd, "RxPreSnd_FrAck_RepFrALo", 
                  (@sysvar::RxPreSnd::FrAck_bRepFrALo));

    EnableControl(panReceivAPreSnd, "RxPreSnd_FrAck_bRepBlCnt", 1);
    EnableControl(panReceivAPreSnd, "RxPreSnd_FrAck_RepBlCnt", 
                  (@sysvar::RxPreSnd::FrAck_bRepBlCnt));

    EnableControl(panReceivAPreSnd, "RxPreSnd_FrAck_bSndAMsg", 1);
    EnableControl(panReceivAPreSnd, "Panel_RxPreSend_FrAck_SendMsgCfg", 
                  (@sysvar::RxPreSnd::FrAck_bSndAMsg));

    EnableControl(panReceivAPreSnd, "RxPreSnd_FrAck_Num", 1); 
  }
  else
  {
    EnableControl(panReceivAPreSnd, "RxPreSnd_FrAck_bHasBlCnt", 0); 
    EnableControl(panReceivAPreSnd, "RxPreSnd_FrAck_HasBlCnt", 0);    
    
    EnableControl(panReceivAPreSnd, "RxPreSnd_FrAck_HasFrAck", 0); 
    EnableControl(panReceivAPreSnd, "RxPreSnd_FrAck_HasFrAHi", 0); 
    EnableControl(panReceivAPreSnd, "RxPreSnd_FrAck_HasFrALo", 0); 

    EnableControl(panReceivAPreSnd, "RxPreSnd_FrAck_bRepFrAHi", 0);
    EnableControl(panReceivAPreSnd, "RxPreSnd_FrAck_RepFrAHi", 0);

    EnableControl(panReceivAPreSnd, "RxPreSnd_FrAck_bRepFrALo", 0);
    EnableControl(panReceivAPreSnd, "RxPreSnd_FrAck_RepFrALo", 0);

    EnableControl(panReceivAPreSnd, "RxPreSnd_FrAck_bRepBlCnt", 0);
    EnableControl(panReceivAPreSnd, "RxPreSnd_FrAck_RepBlCnt", 0);

    EnableControl(panReceivAPreSnd, "RxPreSnd_FrAck_bSndAMsg", 0);    
    EnableControl(panReceivAPreSnd, "Panel_RxPreSend_FrAck_SendMsgCfg", 0);  

    EnableControl(panReceivAPreSnd, "RxPreSnd_FrAck_Num", 0); 
  }
}
/*@@end*/

/*@@sysvarChange:RxPreSnd::FrAck_bHasBlCnt:*/
on sysvar RxPreSnd::FrAck_bHasBlCnt
{
  if((@sysvar::RxPreSnd::FrAck) == 1)
    EnableControl(panReceivAPreSnd, "RxPreSnd_FrAck_HasBlCnt", @this);      
  else 
    EnableControl(panReceivAPreSnd, "RxPreSnd_FrAck_HasBlCnt", 0);
}
/*@@end*/

/*@@sysvarChange:RxPreSnd::FrAck_HasFrAck:*/
on sysvar RxPreSnd::FrAck_HasFrAck
{
  int isActiveHi;
  int isActiveLo;

  if((@sysvar::RxPreSnd::FrAck) == 0)
  {
    isActiveHi = 0;
    isActiveLo = 0;
  }
  else
  {
    switch(@this)
    {
    case 1:
      isActiveHi = 1;
      isActiveLo = 0;
      break;
    case 2:
      isActiveHi = 1;
      isActiveLo = 1;
      break;
    case 3:
      isActiveHi = 0;
      isActiveLo = 1;
      break;
    default:
      isActiveHi = 0;
      isActiveLo = 0;
      break;
    }
  }
  EnableControl(panReceivAPreSnd, "RxPreSnd_FrAck_HasFrAHi", isActiveHi); 
  EnableControl(panReceivAPreSnd, "RxPreSnd_FrAck_HasFrALo", isActiveLo); 
}
/*@@end*/

/*@@sysvarChange:RxPreSnd::FrAck_bRepBlCnt:*/
on sysvar RxPreSnd::FrAck_bRepBlCnt
{
  EnableControl(panReceivAPreSnd, "RxPreSnd_FrAck_RepBlCnt", 
                @this);  
}
/*@@end*/

/*@@sysvarChange:RxPreSnd::FrAck_bRepFrAHi:*/
on sysvar RxPreSnd::FrAck_bRepFrAHi
{
  EnableControl(panReceivAPreSnd, "RxPreSnd_FrAck_RepFrAHi", 
                @this);
}
/*@@end*/

/*@@sysvarChange:RxPreSnd::FrAck_bRepFrALo:*/
on sysvar RxPreSnd::FrAck_bRepFrALo
{
  EnableControl(panReceivAPreSnd, "RxPreSnd_FrAck_RepFrALo", 
                @this);
}
/*@@end*/

/*@@sysvarChange:RxPreSnd::EndRx:*/
on sysvar RxPreSnd::EndRx
{
  EnableControl(panReceivAPreSnd, "RxPreSnd_EndRx_Num",
                @this);
}
/*@@end*/

/*@@sysvarChange:RxPreSnd::HoldRx:*/
on sysvar RxPreSnd::HoldRx
{
  EnableControl(panReceivAPreSnd, "RxPreSnd_HoldRx_Num", 
                @this);
    
}
/*@@end*/

/*@@sysvarChange:RxPreSnd::MFrmReq:*/
on sysvar RxPreSnd::MFrmReq
{
  if(@this == 1)
  {
    EnableControl(panReceivAPreSnd, "RxPreSnd_MFrmReq_Num", 1);
    EnableControl(panReceivAPreSnd, "RxPreSnd_MFrmReq_bRepVal", 1);
    EnableControl(panReceivAPreSnd, "RxPreSnd_MFrmReq_RepPos", 
                  (@sysvar::RxPreSnd::MFrmReq_bRepVal));
    EnableControl(panReceivAPreSnd, "RxPreSnd_MFrmReq_RepVal", 
                  (@sysvar::RxPreSnd::MFrmReq_bRepVal));
  }
  else
  {
    EnableControl(panReceivAPreSnd, "RxPreSnd_MFrmReq_Num", 0);
    EnableControl(panReceivAPreSnd, "RxPreSnd_MFrmReq_bRepVal", 0);
    EnableControl(panReceivAPreSnd, "RxPreSnd_MFrmReq_RepPos", 0);
    EnableControl(panReceivAPreSnd, "RxPreSnd_MFrmReq_RepVal", 0);
  }
}
/*@@end*/

/*@@sysvarChange:RxPreSnd::MFrmReq_bRepVal:*/
on sysvar RxPreSnd::MFrmReq_bRepVal
{
  EnableControl(panReceivAPreSnd, "RxPreSnd_MFrmReq_RepPos", 
                @this);
  EnableControl(panReceivAPreSnd, "RxPreSnd_MFrmReq_RepVal", 
                @this);  
}
/*@@end*/

/*@@sysvarChange:RxPreSnd::SFrmReq:*/
on sysvar RxPreSnd::SFrmReq
{
  if(@this == 1)
  {
    EnableControl(panReceivAPreSnd, "RxPreSnd_SFrmReq_Num", 1);
    EnableControl(panReceivAPreSnd, "RxPreSnd_SFrmReq_bRepVal", 1);
    EnableControl(panReceivAPreSnd, "RxPreSnd_SFrmReq_RepPos", 
                  (@sysvar::RxPreSnd::SFrmReq_bRepVal));
    EnableControl(panReceivAPreSnd, "RxPreSnd_SFrmReq_RepVal", 
                  (@sysvar::RxPreSnd::SFrmReq_bRepVal));
  }
  else
  {
    EnableControl(panReceivAPreSnd, "RxPreSnd_SFrmReq_Num", 0);
    EnableControl(panReceivAPreSnd, "RxPreSnd_SFrmReq_bRepVal", 0);
    EnableControl(panReceivAPreSnd, "RxPreSnd_SFrmReq_RepPos", 0);
    EnableControl(panReceivAPreSnd, "RxPreSnd_SFrmReq_RepVal", 0);
  }
}
/*@@end*/

/*@@sysvarChange:RxPreSnd::StrtCon:*/
on sysvar RxPreSnd::StrtCon
{
  if(@this == 1)
  {
    EnableControl(panReceivAPreSnd, "RxPreSnd_StrtCon_Num", 1);  
    EnableControl(panReceivAPreSnd, "RxPreSnd_StrtCon_bRepVal", 1);
    EnableControl(panReceivAPreSnd, "RxPreSnd_StrtCon_RepPos", 
                  (@sysvar::RxPreSnd::StrtCon_bRepVal));
    EnableControl(panReceivAPreSnd, "RxPreSnd_StrtCon_RepVal", 
                  (@sysvar::RxPreSnd::StrtCon_bRepVal));
  }
  else
  {
    EnableControl(panReceivAPreSnd, "RxPreSnd_StrtCon_Num", 0);  
    EnableControl(panReceivAPreSnd, "RxPreSnd_StrtCon_bRepVal", 0);
    EnableControl(panReceivAPreSnd, "RxPreSnd_StrtCon_RepPos", 0);
    EnableControl(panReceivAPreSnd, "RxPreSnd_StrtCon_RepVal", 0);
  }
}
/*@@end*/

/*@@sysvarChange:RxPreSnd::SFrmReq_bRepVal:*/
on sysvar RxPreSnd::SFrmReq_bRepVal
{
  EnableControl(panReceivAPreSnd, "RxPreSnd_SFrmReq_RepPos", 
                @this);
  EnableControl(panReceivAPreSnd, "RxPreSnd_SFrmReq_RepVal", 
                @this);
}
/*@@end*/

/*@@sysvarChange:RxPreSnd::StrtCon_bRepVal:*/
on sysvar RxPreSnd::StrtCon_bRepVal
{
  EnableControl(panReceivAPreSnd, "RxPreSnd_StrtCon_RepPos", 
                @this);
  EnableControl(panReceivAPreSnd, "RxPreSnd_StrtCon_RepVal", 
                @this);
}
/*@@end*/

/*@@sysvarChange:RxPreRcv::DataMsg:*/
on sysvar RxPreRcv::DataMsg
{
  int isActiveLo;
  int isActiveHi;

  if(@this == 1)
  {
    EnableControl(panReceivAPreRcv, "RxPreRcv_DataMsg_HasBlCnt", 1); 
    
    EnableControl(panReceivAPreRcv, "RxPreRcv_DataMsg_HasFrAck", 1); 
    switch((@sysvar::RxPreRcv::DataMsg_HasFrAck))
    {
    case 1:
      isActiveHi = 1;
      isActiveLo = 1;
      break;
    case 2:
      isActiveHi = 0;
      isActiveLo = 1;
      break; 
    default:
      isActiveHi = 1;
      isActiveLo = 0;
      break;
    }
    EnableControl(panReceivAPreRcv, "RxPreRcv_DataMsg_HasFrAHi", isActiveHi); 
    EnableControl(panReceivAPreRcv, "RxPreRcv_DataMsg_HasFrALo", isActiveLo); 

    EnableControl(panReceivAPreRcv, "RxPreRcv_DataMsg_bRepFrAHi", 1); 
    EnableControl(panReceivAPreRcv, "RxPreRcv_DataMsg_RepFrAHi", 
                  (@sysvar::RxPreRcv::DataMsg_bRepFrAHi)); 

    EnableControl(panReceivAPreRcv, "RxPreRcv_DataMsg_bRepFrALo", 1); 
    EnableControl(panReceivAPreRcv, "RxPreRcv_DataMsg_RepFrALo", 
                  (@sysvar::RxPreRcv::DataMsg_bRepFrALo));
                   
    EnableControl(panReceivAPreRcv, "RxPreRcv_DataMsg_bRepVal", 1); 
    EnableControl(panReceivAPreRcv, "RxPreRcv_DataMsg_RepPos", 
                  (@sysvar::RxPreRcv::DataMsg_bRepVal)); 
    EnableControl(panReceivAPreRcv, "RxPreRcv_DataMsg_RepVal", 
                  (@sysvar::RxPreRcv::DataMsg_bRepVal)); 
  

    EnableControl(panReceivAPreRcv, "RxPreRcv_DataMsg_bSndAMsg", 1);
    EnableControl(panReceivAPreRcv, "Panel_RxPreRcv_DataMsg_SendMsgCfg", 
                  (@sysvar::RxPreRcv::DataMsg_bSndAMsg));

    EnableControl(panReceivAPreRcv, "RxPreRcv_DataMsg_bRcv", 1);
  }
  else
  {
    EnableControl(panReceivAPreRcv, "RxPreRcv_DataMsg_HasBlCnt", 0); 
    
    EnableControl(panReceivAPreRcv, "RxPreRcv_DataMsg_HasFrAck", 0); 
    EnableControl(panReceivAPreRcv, "RxPreRcv_DataMsg_HasFrAHi", 0); 
    EnableControl(panReceivAPreRcv, "RxPreRcv_DataMsg_HasFrALo", 0); 

    EnableControl(panReceivAPreRcv, "RxPreRcv_DataMsg_bRepFrAHi", 0); 
    EnableControl(panReceivAPreRcv, "RxPreRcv_DataMsg_RepFrAHi", 0); 

    EnableControl(panReceivAPreRcv, "RxPreRcv_DataMsg_bRepFrALo", 0); 
    EnableControl(panReceivAPreRcv, "RxPreRcv_DataMsg_RepFrALo", 0);
                   
    EnableControl(panReceivAPreRcv, "RxPreRcv_DataMsg_bRepVal", 0); 
    EnableControl(panReceivAPreRcv, "RxPreRcv_DataMsg_RepPos", 0); 
    EnableControl(panReceivAPreRcv, "RxPreRcv_DataMsg_RepVal", 0); 
  
    EnableControl(panReceivAPreRcv, "RxPreRcv_DataMsg_bSndAMsg", 0);
    EnableControl(panReceivAPreRcv, "Panel_RxPreRcv_DataMsg_SendMsgCfg", 0);

    EnableControl(panReceivAPreRcv, "RxPreRcv_DataMsg_bRcv", 0);
  }
}
/*@@end*/

/*@@sysvarChange:RxPreRcv::DataMsg_bRepFrAHi:*/
on sysvar RxPreRcv::DataMsg_bRepFrAHi
{
  EnableControl(panReceivAPreRcv, "RxPreRcv_DataMsg_RepFrAHi", 
                @this); 
}
/*@@end*/

/*@@sysvarChange:RxPreRcv::DataMsg_bRepFrALo:*/
on sysvar RxPreRcv::DataMsg_bRepFrALo
{
  EnableControl(panReceivAPreRcv, "RxPreRcv_DataMsg_RepFrALo", 
                @this);
}
/*@@end*/

/*@@sysvarChange:RxPreRcv::DataMsg_bRepVal:*/
on sysvar RxPreRcv::DataMsg_bRepVal
{
  EnableControl(panReceivAPreRcv, "RxPreRcv_DataMsg_RepPos", 
                @this); 
  EnableControl(panReceivAPreRcv, "RxPreRcv_DataMsg_RepVal", 
                @this); 
}
/*@@end*/

/*@@sysvarChange:RxPreRcv::DataMsg_HasFrAck:*/
on sysvar RxPreRcv::DataMsg_HasFrAck
{
  int isActiveHi;
  int isActiveLo;

  if((@sysvar::RxPreRcv::DataMsg) == 0)
  {
    isActiveHi = 0;
    isActiveLo = 0;  
  }  
  else
  {
    switch(@this)
    {
    case 1:
      isActiveHi = 1;
      isActiveLo = 1;
      break;
    case 2:
      isActiveHi = 0;
      isActiveLo = 1;
      break;
    default:
      isActiveHi = 1;
      isActiveLo = 0;
      break;
    }
  }
  EnableControl(panReceivAPreRcv, "RxPreRcv_DataMsg_HasFrAHi", isActiveHi); 
  EnableControl(panReceivAPreRcv, "RxPreRcv_DataMsg_HasFrALo", isActiveLo); 
}
/*@@end*/

/*@@sysvarChange:RxPreRcv::EndTx:*/
on sysvar RxPreRcv::EndTx
{
  EnableControl(panReceivAPreRcv, "RxPreRcv_EndTx_bRcv", 
                @this);
}
/*@@end*/

/*@@sysvarChange:RxPreRcv::HoldTx:*/
on sysvar RxPreRcv::HoldTx
{
  EnableControl(panReceivAPreRcv, "RxPreRcv_HoldTx_bRcv",
                @this);  
}
/*@@end*/

/*@@sysvarChange:RxPreRcv::Ready:*/
on sysvar RxPreRcv::Ready
{
  EnableControl(panReceivAPreRcv, "RxPreRcv_Ready_bRcv", 
                @this);
}
/*@@end*/

/*@@sysvarChange:RxPreRcv::ReqCon:*/
on sysvar RxPreRcv::ReqCon
{
  if(@this == 1)
  {
    EnableControl(panReceivAPreRcv, "RxPreRcv_ReqCon_bRcv", 1);    
    EnableControl(panReceivAPreRcv, "RxPreRcv_ReqCon_bRepVal", 1);    
    EnableControl(panReceivAPreRcv, "RxPreRcv_ReqCon_RepPos", 
                  (@sysvar::RxPreRcv::ReqCon_bRepVal));    
    EnableControl(panReceivAPreRcv, "RxPreRcv_ReqCon_RepVal", 
                  (@sysvar::RxPreRcv::ReqCon_bRepVal));    
  }
  else
  {
    EnableControl(panReceivAPreRcv, "RxPreRcv_ReqCon_bRcv", 0);    
    EnableControl(panReceivAPreRcv, "RxPreRcv_ReqCon_bRepVal", 0);    
    EnableControl(panReceivAPreRcv, "RxPreRcv_ReqCon_RepPos", 0);    
    EnableControl(panReceivAPreRcv, "RxPreRcv_ReqCon_RepVal", 0);    
  }    
}
/*@@end*/

/*@@sysvarChange:RxPreRcv::ReqCon_bRepVal:*/
on sysvar RxPreRcv::ReqCon_bRepVal
{
    EnableControl(panReceivAPreRcv, "RxPreRcv_ReqCon_RepPos", 
                  @this);    
    EnableControl(panReceivAPreRcv, "RxPreRcv_ReqCon_RepVal", 
                  @this);    
}
/*@@end*/

/*@@sysvarChange:RxPreRcv::ZeroMsg:*/
on sysvar RxPreRcv::ZeroMsg
{
  if(@this == 1)
  {
    EnableControl(panReceivAPreRcv, "RxPreRcv_ZeroMsg_HasBlCnt", 1);

    EnableControl(panReceivAPreRcv, "RxPreRcv_ZeroMsg_HasFrAck", 1);
    EnableControl(panReceivAPreRcv, "RxPreRcv_ZeroMsg_HasFrALo", 
                  (@sysvar::RxPreRcv::ZeroMsg_HasFrAck));

    EnableControl(panReceivAPreRcv, "RxPreRcv_ZeroMsg_bRepFrALo", 1);
    EnableControl(panReceivAPreRcv, "RxPreRcv_ZeroMsg_RepFrALo", 
                  (@sysvar::RxPreRcv::ZeroMsg_bRepFrALo));

    EnableControl(panReceivAPreRcv, "RxPreRcv_ZeroMsg_bRepBlCnt", 1);
    EnableControl(panReceivAPreRcv, "RxPreRcv_ZeroMsg_RepBlCnt", 
                  (@sysvar::RxPreRcv::ZeroMsg_bRepBlCnt));

    EnableControl(panReceivAPreRcv, "RxPreRcv_ZeroMsg_bRepVal", 1);
    EnableControl(panReceivAPreRcv, "RxPreRcv_ZeroMsg_RepPos", 
                  (@sysvar::RxPreRcv::ZeroMsg_bRepVal));
    EnableControl(panReceivAPreRcv, "RxPreRcv_ZeroMsg_RepVal", 
                  (@sysvar::RxPreRcv::ZeroMsg_bRepVal));

    EnableControl(panReceivAPreRcv, "RxPreRcv_ZeroMsg_bSndAMsg", 1);
    EnableControl(panReceivAPreRcv, "Panel_RxPreRcv_ZeroMsg_SendMsgCfg", 
                  (@sysvar::RxPreRcv::ZeroMsg_bSndAMsg));
  
    EnableControl(panReceivAPreRcv, "RxPreRcv_ZeroMsg_bRcv", 1);
  }
  else
  {
    EnableControl(panReceivAPreRcv, "RxPreRcv_ZeroMsg_HasBlCnt", 0);

    EnableControl(panReceivAPreRcv, "RxPreRcv_ZeroMsg_HasFrAck", 0);
    EnableControl(panReceivAPreRcv, "RxPreRcv_ZeroMsg_HasFrALo", 0);

    EnableControl(panReceivAPreRcv, "RxPreRcv_ZeroMsg_bRepFrALo", 0);
    EnableControl(panReceivAPreRcv, "RxPreRcv_ZeroMsg_RepFrALo", 0);

    EnableControl(panReceivAPreRcv, "RxPreRcv_ZeroMsg_bRepBlCnt", 0);
    EnableControl(panReceivAPreRcv, "RxPreRcv_ZeroMsg_RepBlCnt", 0);

    EnableControl(panReceivAPreRcv, "RxPreRcv_ZeroMsg_bRepVal", 0);
    EnableControl(panReceivAPreRcv, "RxPreRcv_ZeroMsg_RepPos", 0);
    EnableControl(panReceivAPreRcv, "RxPreRcv_ZeroMsg_RepVal", 0);

    EnableControl(panReceivAPreRcv, "RxPreRcv_ZeroMsg_bSndAMsg", 0);
    EnableControl(panReceivAPreRcv, "Panel_RxPreRcv_ZeroMsg_SendMsgCfg", 0);
  
    EnableControl(panReceivAPreRcv, "RxPreRcv_ZeroMsg_bRcv", 0);
  }
}
/*@@end*/

/*@@sysvarChange:RxPreRcv::ZeroMsg_bRepBlCnt:*/
on sysvar RxPreRcv::ZeroMsg_bRepBlCnt
{
  EnableControl(panReceivAPreRcv, "RxPreRcv_ZeroMsg_RepBlCnt", 
                @this);
}
/*@@end*/

/*@@sysvarChange:RxPreRcv::ZeroMsg_bRepFrALo:*/
on sysvar RxPreRcv::ZeroMsg_bRepFrALo
{
  EnableControl(panReceivAPreRcv, "RxPreRcv_ZeroMsg_RepFrALo", 
                @this);
}
/*@@end*/

/*@@sysvarChange:RxPreRcv::ZeroMsg_bRepVal:*/
on sysvar RxPreRcv::ZeroMsg_bRepVal
{
  EnableControl(panReceivAPreRcv, "RxPreRcv_ZeroMsg_RepPos", 
                @this);
  EnableControl(panReceivAPreRcv, "RxPreRcv_ZeroMsg_RepVal", 
                @this);
}
/*@@end*/

/*@@sysvarChange:RxPreRcv::ZeroMsg_HasFrAck:*/
on sysvar RxPreRcv::ZeroMsg_HasFrAck
{
  EnableControl(panReceivAPreRcv, "RxPreRcv_ZeroMsg_HasFrALo", @this);
}
/*@@end*/

/*@@sysvarChange:RxPreRcv::DataMsg_bSndAMsg:*/
on sysvar RxPreRcv::DataMsg_bSndAMsg
{
  if((@sysvar::RxPreRcv::DataMsg) == 1)
    EnableControl(panReceivAPreRcv, "Panel_RxPreRcv_DataMsg_SendMsgCfg", @this);
  else
    EnableControl(panReceivAPreRcv, "Panel_RxPreRcv_DataMsg_SendMsgCfg", 0);
}
/*@@end*/

/*@@sysvarChange:RxPreRcv::ZeroMsg_bSndAMsg:*/
on sysvar RxPreRcv::ZeroMsg_bSndAMsg
{
  if((@sysvar::RxPreRcv::ZeroMsg) == 1)
    EnableControl(panReceivAPreRcv, "Panel_RxPreRcv_ZeroMsg_SendMsgCfg", @this);
  else
    EnableControl(panReceivAPreRcv, "Panel_RxPreRcv_ZeroMsg_SendMsgCfg", 0);
}
/*@@end*/

/*@@sysvarChange:RxSndMsg::Type:*/
on sysvar RxSndMsg::Type
{
  int isActiveFrAckHi;
  int isActiveFrAckLo;
  int isActiveBlCnt;
  int isActiveFrmID;
  int isActiveFrmIDs;
  int isActiveOp;

  switch(@this)
  {
  case 1:  // REQUEST
    isActiveFrAckHi = 0;
    isActiveFrAckLo = 0;
    isActiveBlCnt   = 0;
    isActiveFrmID   = 1;
    isActiveFrmIDs  = 0;
    isActiveOp      = 0;    
    break;
  case 2:  // MULTILPE FRAMES REQUEST
    isActiveFrAckHi = 0;
    isActiveFrAckLo = 0;
    isActiveBlCnt   = 0;
    isActiveFrmID   = 0;
    isActiveFrmIDs  = 1;
    isActiveOp      = 0;    
    break;
  case 3:  // ADJUST RATE
    isActiveFrAckHi = 0;
    isActiveFrAckLo = 0;
    isActiveBlCnt   = 0;
    isActiveFrmID   = 0;
    isActiveFrmIDs  = 0;
    isActiveOp      = 1;    
    break;
  default:  // FRAME ACKNOWLEDGE
    isActiveFrAckHi = 1;
    isActiveFrAckLo = 1;
    isActiveBlCnt   = 1;
    isActiveFrmID   = 0;
    isActiveFrmIDs  = 0;
    isActiveOp      = 0;    
    break;
  }
  EnableControl(panReceivASndMsg, "RxSndMsg_FrAck_FrAHi", isActiveFrAckHi); 
  EnableControl(panReceivASndMsg, "RxSndMsg_FrAck_FrALo", isActiveFrAckLo); 
  EnableControl(panReceivASndMsg, "RxSndMsg_FrAck_BlCnt", isActiveBlCnt); 
  EnableControl(panReceivASndMsg, "RxSndMsg_SFrmReq_FrmID", isActiveFrmID); 
  EnableControl(panReceivASndMsg, "RxSndMsg_MFrmReq_FrmIDs", isActiveFrmIDs); 
  EnableControl(panReceivASndMsg, "RxSndMsg_AdjRate_Op", isActiveOp); 
}
/*@@end*/

/*@@sysvarChange:RxPreSnd::FrAck_bSndAMsg:*/
on sysvar RxPreSnd::FrAck_bSndAMsg
{
  if((@sysvar::RxPreSnd::FrAck) == 1)
    EnableControl(panReceivAPreSnd, "Panel_RxPreSend_FrAck_SendMsgCfg", @this);
  else
    EnableControl(panReceivAPreSnd, "Panel_RxPreSend_FrAck_SendMsgCfg", 0);  
}
/*@@end*/

