/*@@var:*/
variables
{
  char panSenderAPreSnd[50] = "SenderA PreSend Fault Injection";
  char panSenderAPreRcv[50] = "SenderA PreReceive Fault Injection";
}
/*@@end*/

/*@@sysvarChange:TxPreSnd::DataMsg:*/
on sysvar TxPreSnd::DataMsg
{
  int isActiveLo;
  int isActiveHi;

  if(@this == 1)
  {
    EnableControl(panSenderAPreSnd, "TxPreSnd_DataMsg_HasBlCnt", 1);

    EnableControl(panSenderAPreSnd, "TxPreSnd_DataMsg_HasFrAck", 1);
    switch(@sysvar::TxPreSnd::DataMsg_HasFrAck)
    {
    case 1:
      isActiveHi = 1;
      isActiveLo = 1;
      break;
    case 2:
      isActiveHi = 0;
      isActiveLo = 1;
      break; 
    default:
      isActiveHi = 1;
      isActiveLo = 0;
      break;
    }
    EnableControl(panSenderAPreSnd, "TxPreSnd_DataMsg_HasFrAHi", isActiveHi);
    EnableControl(panSenderAPreSnd, "TxPreSnd_DataMsg_HasFrALo", isActiveLo);

    EnableControl(panSenderAPreSnd, "TxPreSnd_DataMsg_bRepFrAHi", 1);
    EnableControl(panSenderAPreSnd, "TxPreSnd_DataMsg_RepFrAHi", 
                  (@sysvar::TxPreSnd::DataMsg_bRepFrAHi));

    EnableControl(panSenderAPreSnd, "TxPreSnd_DataMsg_bRepFrALo", 1);
    EnableControl(panSenderAPreSnd, "TxPreSnd_DataMsg_RepFrALo", 
                  (@sysvar::TxPreSnd::DataMsg_bRepFrALo));

    EnableControl(panSenderAPreSnd, "TxPreSnd_DataMsg_bRepVal", 1);
    EnableControl(panSenderAPreSnd, "TxPreSnd_DataMsg_RepPos", 
                  (@sysvar::TxPreSnd::DataMsg_bRepVal));
    EnableControl(panSenderAPreSnd, "TxPreSnd_DataMsg_RepVal", 
                  (@sysvar::TxPreSnd::DataMsg_bRepVal));

    EnableControl(panSenderAPreSnd, "TxPreSnd_DataMsg_Num", 1);
  }
  else
  {
    EnableControl(panSenderAPreSnd, "TxPreSnd_DataMsg_HasBlCnt", 0);

    EnableControl(panSenderAPreSnd, "TxPreSnd_DataMsg_HasFrAck", 0);
    EnableControl(panSenderAPreSnd, "TxPreSnd_DataMsg_HasFrAHi", 0);
    EnableControl(panSenderAPreSnd, "TxPreSnd_DataMsg_HasFrALo", 0);

    EnableControl(panSenderAPreSnd, "TxPreSnd_DataMsg_bRepFrAHi", 0);
    EnableControl(panSenderAPreSnd, "TxPreSnd_DataMsg_RepFrAHi", 0);

    EnableControl(panSenderAPreSnd, "TxPreSnd_DataMsg_bRepFrALo", 0);
    EnableControl(panSenderAPreSnd, "TxPreSnd_DataMsg_RepFrALo", 0);

    EnableControl(panSenderAPreSnd, "TxPreSnd_DataMsg_bRepVal", 0);
    EnableControl(panSenderAPreSnd, "TxPreSnd_DataMsg_RepPos", 0);
    EnableControl(panSenderAPreSnd, "TxPreSnd_DataMsg_RepVal", 0);

    EnableControl(panSenderAPreSnd, "TxPreSnd_DataMsg_Num", 0);
  }
}
/*@@end*/

/*@@startStart:Start:*/
on start
{
  callAllOnEnvVar();
}
/*@@end*/

/*@@sysvarChange:TxPreSnd::DataMsg_HasFrAck:*/
on sysvar TxPreSnd::DataMsg_HasFrAck
{
  int isActiveHi;
  int isActiveLo;

  if((@sysvar::TxPreSnd::DataMsg) == 0)
  {
    isActiveHi = 0;
    isActiveLo = 0;
  }
  else
  {
    switch(@this)
    {
    case 1:
      isActiveHi = 1;
      isActiveLo = 1;
      break;
    case 2:
      isActiveHi = 0;
      isActiveLo = 1;
      break;
    default:
      isActiveHi = 1;
      isActiveLo = 0;
      break;
    }
  }
  EnableControl(panSenderAPreSnd, "TxPreSnd_DataMsg_HasFrAHi", isActiveHi);
  EnableControl(panSenderAPreSnd, "TxPreSnd_DataMsg_HasFrALo", isActiveLo);
}
/*@@end*/

/*@@sysvarChange:TxPreSnd::DataMsg_bRepFrAHi:*/
on sysvar TxPreSnd::DataMsg_bRepFrAHi
{
  EnableControl(panSenderAPreSnd, "TxPreSnd_DataMsg_RepFrAHi", @this);
}
/*@@end*/

/*@@sysvarChange:TxPreSnd::DataMsg_bRepFrALo:*/
on sysvar TxPreSnd::DataMsg_bRepFrALo
{
  EnableControl(panSenderAPreSnd, "TxPreSnd_DataMsg_RepFrALo", @this);
}
/*@@end*/

/*@@sysvarChange:TxPreSnd::DataMsg_bRepVal:*/
on sysvar TxPreSnd::DataMsg_bRepVal
{
  EnableControl(panSenderAPreSnd, "TxPreSnd_DataMsg_RepPos", @this);
  EnableControl(panSenderAPreSnd, "TxPreSnd_DataMsg_RepVal", @this);
}
/*@@end*/

/*@@sysvarChange:TxPreSnd::ZeroMsg:*/
on sysvar TxPreSnd::ZeroMsg
{
  if(@this == 1)
  {
    EnableControl(panSenderAPreSnd, "TxPreSnd_ZeroMsg_HasBlCnt", 1);
  
    EnableControl(panSenderAPreSnd, "TxPreSnd_ZeroMsg_HasFrAck", 1);
    EnableControl(panSenderAPreSnd, "TxPreSnd_ZeroMsg_HasFrALo", 
                  (@sysvar::TxPreSnd::ZeroMsg_HasFrAck));

    EnableControl(panSenderAPreSnd, "TxPreSnd_ZeroMsg_bRepFrALo", 1);
    EnableControl(panSenderAPreSnd, "TxPreSnd_ZeroMsg_RepFrALo", 
                  (@sysvar::TxPreSnd::ZeroMsg_bRepFrALo));

    EnableControl(panSenderAPreSnd, "TxPreSnd_ZeroMsg_bRepBlCnt", 1);
    EnableControl(panSenderAPreSnd, "TxPreSnd_ZeroMsg_RepBlCnt", 
                  (@sysvar::TxPreSnd::ZeroMsg_bRepBlCnt));

    EnableControl(panSenderAPreSnd, "TxPreSnd_ZeroMsg_bRepVal", 1);
    EnableControl(panSenderAPreSnd, "TxPreSnd_ZeroMsg_RepPos", 
                  (@sysvar::TxPreSnd::ZeroMsg_bRepVal));
    EnableControl(panSenderAPreSnd, "TxPreSnd_ZeroMsg_RepVal", 
                  (@sysvar::TxPreSnd::ZeroMsg_bRepVal));

    EnableControl(panSenderAPreSnd, "TxPreSnd_ZeroMsg_Num", 1);
  }
  else
  {
    EnableControl(panSenderAPreSnd, "TxPreSnd_ZeroMsg_HasBlCnt", 0);
  
    EnableControl(panSenderAPreSnd, "TxPreSnd_ZeroMsg_HasFrAck", 0);
    EnableControl(panSenderAPreSnd, "TxPreSnd_ZeroMsg_HasFrALo", 0);

    EnableControl(panSenderAPreSnd, "TxPreSnd_ZeroMsg_bRepFrALo", 0);
    EnableControl(panSenderAPreSnd, "TxPreSnd_ZeroMsg_RepFrALo", 0);

    EnableControl(panSenderAPreSnd, "TxPreSnd_ZeroMsg_bRepBlCnt", 0);
    EnableControl(panSenderAPreSnd, "TxPreSnd_ZeroMsg_RepBlCnt", 0);

    EnableControl(panSenderAPreSnd, "TxPreSnd_ZeroMsg_bRepVal", 0);
    EnableControl(panSenderAPreSnd, "TxPreSnd_ZeroMsg_RepPos", 0);
    EnableControl(panSenderAPreSnd, "TxPreSnd_ZeroMsg_RepVal", 0);

    EnableControl(panSenderAPreSnd, "TxPreSnd_ZeroMsg_Num", 0);
  }
}
/*@@end*/

/*@@sysvarChange:TxPreSnd::ZeroMsg_HasFrAck:*/
on sysvar TxPreSnd::ZeroMsg_HasFrAck
{
  EnableControl(panSenderAPreSnd, "TxPreSnd_ZeroMsg_HasFrALo", @this);
}
/*@@end*/

/*@@sysvarChange:TxPreSnd::ZeroMsg_bRepFrALo:*/
on sysvar TxPreSnd::ZeroMsg_bRepFrALo
{
  EnableControl(panSenderAPreSnd, "TxPreSnd_ZeroMsg_RepFrALo", @this);
}
/*@@end*/

/*@@sysvarChange:TxPreSnd::ZeroMsg_bRepBlCnt:*/
on sysvar TxPreSnd::ZeroMsg_bRepBlCnt
{
  EnableControl(panSenderAPreSnd, "TxPreSnd_ZeroMsg_RepBlCnt", @this);
}
/*@@end*/

/*@@sysvarChange:TxPreSnd::ZeroMsg_bRepVal:*/
on sysvar TxPreSnd::ZeroMsg_bRepVal
{
  EnableControl(panSenderAPreSnd, "TxPreSnd_ZeroMsg_RepPos", @this);
  EnableControl(panSenderAPreSnd, "TxPreSnd_ZeroMsg_RepVal", @this);
}
/*@@end*/

/*@@sysvarChange:TxPreSnd::ReqCon:*/
on sysvar TxPreSnd::ReqCon
{
  if(@this == 1)
  {
    EnableControl(panSenderAPreSnd, "TxPreSnd_ReqCon_Num", 1);
    EnableControl(panSenderAPreSnd, "TxPreSnd_ReqCon_bRepVal", 1);
    EnableControl(panSenderAPreSnd, "TxPreSnd_ReqCon_RepPos", 
                  (@sysvar::TxPreSnd::ReqCon_bRepVal));
    EnableControl(panSenderAPreSnd, "TxPreSnd_ReqCon_RepVal", 
                  (@sysvar::TxPreSnd::ReqCon_bRepVal));                 
  }
  else
  {
    EnableControl(panSenderAPreSnd, "TxPreSnd_ReqCon_Num", 0);
    EnableControl(panSenderAPreSnd, "TxPreSnd_ReqCon_bRepVal", 0);
    EnableControl(panSenderAPreSnd, "TxPreSnd_ReqCon_RepPos", 0);
    EnableControl(panSenderAPreSnd, "TxPreSnd_ReqCon_RepVal", 0);
  }
}
/*@@end*/

/*@@sysvarChange:TxPreSnd::ReqCon_bRepVal:*/
on sysvar TxPreSnd::ReqCon_bRepVal
{
  EnableControl(panSenderAPreSnd, "TxPreSnd_ReqCon_RepPos", @this); 
  EnableControl(panSenderAPreSnd, "TxPreSnd_ReqCon_RepVal", @this);
}
/*@@end*/

/*@@sysvarChange:TxPreSnd::EndTx:*/
on sysvar TxPreSnd::EndTx
{
  EnableControl(panSenderAPreSnd, "TxPreSnd_EndTx_Num", @this);
}
/*@@end*/

/*@@sysvarChange:TxPreSnd::HoldTx:*/
on sysvar TxPreSnd::HoldTx
{
  EnableControl(panSenderAPreSnd, "TxPreSnd_HoldTx_Num", @this);
}
/*@@end*/

/*@@sysvarChange:TxPreSnd::Ready:*/
on sysvar TxPreSnd::Ready
{
  EnableControl(panSenderAPreSnd, "TxPreSnd_Ready_Num", @this);
}
/*@@end*/

/*@@sysvarChange:TxPreRcv::FrAck:*/
on sysvar TxPreRcv::FrAck
{
  int isActiveHi;
  int isActiveLo;

  if(@this == 1)
  {
    EnableControl(panSenderAPreRcv, "TxPreRcv_FrAck_bHasBlCnt", 1);
    EnableControl(panSenderAPreRcv, "TxPreRcv_FrAck_HasBlCnt", 
                  (@sysvar::TxPreRcv::FrAck_bHasBlCnt));

    EnableControl(panSenderAPreRcv, "TxPreRcv_FrAck_HasFrAck", 1);
    switch((@sysvar::TxPreRcv::FrAck_HasFrAck))
    {
    case 1:
      isActiveHi = 1;
      isActiveLo = 0;
      break;
    case 2:
      isActiveHi = 1;
      isActiveLo = 1;
      break;
    case 3:
      isActiveHi = 0;
      isActiveLo = 1;
      break;
    default:
      isActiveHi = 0;
      isActiveLo = 0;
      break;
    }
    EnableControl(panSenderAPreRcv, "TxPreRcv_FrAck_HasFrAHi", isActiveHi);
    EnableControl(panSenderAPreRcv, "TxPreRcv_FrAck_HasFrALo", isActiveLo);

    EnableControl(panSenderAPreRcv, "TxPreRcv_FrAck_bRepFrAHi", 1);
    EnableControl(panSenderAPreRcv, "TxPreRcv_FrAck_RepFrAHi", 
                  (@sysvar::TxPreRcv::FrAck_bRepFrAHi));

    EnableControl(panSenderAPreRcv, "TxPreRcv_FrAck_bRepFrALo", 1);
    EnableControl(panSenderAPreRcv, "TxPreRcv_FrAck_RepFrALo", 
                  (@sysvar::TxPreRcv::FrAck_bRepFrALo));

    EnableControl(panSenderAPreRcv, "TxPreRcv_FrAck_bRepBlCnt", 1);
    EnableControl(panSenderAPreRcv, "TxPreRcv_FrAck_RepBlCnt", 
                  (@sysvar::TxPreRcv::FrAck_bRepBlCnt));

    EnableControl(panSenderAPreRcv, "TxPreRcv_FrAck_bRcv", 1);    
  }
  else
  {
    EnableControl(panSenderAPreRcv, "TxPreRcv_FrAck_bHasBlCnt", 0);
    EnableControl(panSenderAPreRcv, "TxPreRcv_FrAck_HasBlCnt", 0);

    EnableControl(panSenderAPreRcv, "TxPreRcv_FrAck_HasFrAck", 0);
    EnableControl(panSenderAPreRcv, "TxPreRcv_FrAck_HasFrAHi", 0);
    EnableControl(panSenderAPreRcv, "TxPreRcv_FrAck_HasFrALo", 0);

    EnableControl(panSenderAPreRcv, "TxPreRcv_FrAck_bRepFrAHi", 0);
    EnableControl(panSenderAPreRcv, "TxPreRcv_FrAck_RepFrAHi", 0);

    EnableControl(panSenderAPreRcv, "TxPreRcv_FrAck_bRepFrALo", 0);
    EnableControl(panSenderAPreRcv, "TxPreRcv_FrAck_RepFrALo", 0);

    EnableControl(panSenderAPreRcv, "TxPreRcv_FrAck_bRepBlCnt", 0);
    EnableControl(panSenderAPreRcv, "TxPreRcv_FrAck_RepBlCnt", 0);

    EnableControl(panSenderAPreRcv, "TxPreRcv_FrAck_bRcv", 0);    
  }
}
/*@@end*/

/*@@sysvarChange:TxPreRcv::FrAck_HasFrAck:*/
on sysvar TxPreRcv::FrAck_HasFrAck
{
  int isActiveHi = 0;
  int isActiveLo = 0;  
  if((@sysvar::TxPreRcv::FrAck) == 0)
  {
    isActiveHi = 0; 
    isActiveLo = 0;
  }
  else
  {
    switch(@this)
    {
    case 1:
      isActiveHi = 1;
      isActiveLo = 0;
      break;
    case 2:
      isActiveHi = 1;
      isActiveLo = 1;
      break;
    case 3:
      isActiveHi = 0;
      isActiveLo = 1;
      break;
    default:
      isActiveHi = 0;
      isActiveLo = 0;
      break;
    }
  }
  EnableControl(panSenderAPreRcv, "TxPreRcv_FrAck_HasFrAHi", isActiveHi);
  EnableControl(panSenderAPreRcv, "TxPreRcv_FrAck_HasFrALo", isActiveLo);
}
/*@@end*/

/*@@sysvarChange:TxPreRcv::FrAck_bRepFrAHi:*/
on sysvar TxPreRcv::FrAck_bRepFrAHi
{
  EnableControl(panSenderAPreRcv, "TxPreRcv_FrAck_RepFrAHi", 
                @this);
}
/*@@end*/

/*@@sysvarChange:TxPreRcv::FrAck_bRepFrALo:*/
on sysvar TxPreRcv::FrAck_bRepFrALo
{
  EnableControl(panSenderAPreRcv, "TxPreRcv_FrAck_RepFrALo", 
                @this);
}
/*@@end*/

/*@@sysvarChange:TxPreRcv::FrAck_bRepBlCnt:*/
on sysvar TxPreRcv::FrAck_bRepBlCnt
{
  if((@sysvar::TxPreRcv::FrAck) == 1)
    EnableControl(panSenderAPreRcv, "TxPreRcv_FrAck_RepBlCnt", @this);
  else
    EnableControl(panSenderAPreRcv, "TxPreRcv_FrAck_RepBlCnt", 0);
}
/*@@end*/

/*@@sysvarChange:TxPreRcv::StrtCon:*/
on sysvar TxPreRcv::StrtCon
{
  if(@this)
  {
    EnableControl(panSenderAPreRcv, "TxPreRcv_StrtCon_bRcv", 1);
    EnableControl(panSenderAPreRcv, "TxPreRcv_StrtCon_bRepVal", 1);
    EnableControl(panSenderAPreRcv, "TxPreRcv_StrtCon_RepPos",
                  (@sysvar::TxPreRcv::StrtCon_bRepVal));
    EnableControl(panSenderAPreRcv, "TxPreRcv_StrtCon_RepVal", 
                  (@sysvar::TxPreRcv::StrtCon_bRepVal));
    EnableControl(panSenderAPreRcv, "TxPreRcv_StrtCon_bAir", 1);
    EnableControl(panSenderAPreRcv, "TxPreRcv_StrtCon_Air",
                  (@sysvar::TxPreRcv::StrtCon_bAir));
  }
  else
  {
    EnableControl(panSenderAPreRcv, "TxPreRcv_StrtCon_bRcv", 0);
    EnableControl(panSenderAPreRcv, "TxPreRcv_StrtCon_bRepVal", 0);
    EnableControl(panSenderAPreRcv, "TxPreRcv_StrtCon_RepPos", 0);
    EnableControl(panSenderAPreRcv, "TxPreRcv_StrtCon_RepVal", 0);
    EnableControl(panSenderAPreRcv, "TxPreRcv_StrtCon_bAir", 0);
    EnableControl(panSenderAPreRcv, "TxPreRcv_StrtCon_Air", 0);
  }
}
/*@@end*/

/*@@sysvarChange:TxPreRcv::StrtCon_bRepVal:*/
on sysvar TxPreRcv::StrtCon_bRepVal
{
  EnableControl(panSenderAPreRcv, "TxPreRcv_StrtCon_RepPos",
                @this);
  EnableControl(panSenderAPreRcv, "TxPreRcv_StrtCon_RepVal", 
                @this);
}
/*@@end*/

/*@@sysvarChange:TxPreRcv::SFrmReq:*/
on sysvar TxPreRcv::SFrmReq
{
  if(@this == 1)
  {
    EnableControl(panSenderAPreRcv, "TxPreRcv_SFrmReq_bRcv", 1); 
    EnableControl(panSenderAPreRcv, "TxPreRcv_SFrmReq_bRepVal", 1);
    EnableControl(panSenderAPreRcv, "TxPreRcv_SFrmReq_RepPos", 
                  (@sysvar::TxPreRcv::SFrmReq_bRepVal));
    EnableControl(panSenderAPreRcv, "TxPreRcv_SFrmReq_RepVal", 
                  (@sysvar::TxPreRcv::SFrmReq_bRepVal));
  }
  else
  {
    EnableControl(panSenderAPreRcv, "TxPreRcv_SFrmReq_bRcv", 0); 
    EnableControl(panSenderAPreRcv, "TxPreRcv_SFrmReq_bRepVal", 0);
    EnableControl(panSenderAPreRcv, "TxPreRcv_SFrmReq_RepPos", 0);
    EnableControl(panSenderAPreRcv, "TxPreRcv_SFrmReq_RepVal", 0);
  }
}
/*@@end*/

/*@@sysvarChange:TxPreRcv::SFrmReq_bRepVal:*/
on sysvar TxPreRcv::SFrmReq_bRepVal
{
  EnableControl(panSenderAPreRcv, "TxPreRcv_SFrmReq_RepPos", 
                @this);
  EnableControl(panSenderAPreRcv, "TxPreRcv_SFrmReq_RepVal", 
                @this);
}
/*@@end*/

/*@@sysvarChange:TxPreRcv::MFrmReq:*/
on sysvar TxPreRcv::MFrmReq
{
  if(@this == 1)
  {
    EnableControl(panSenderAPreRcv, "TxPreRcv_MFrmReq_bRcv", 1);
    EnableControl(panSenderAPreRcv, "TxPreRcv_MFrmReq_bRepVal", 1);
    EnableControl(panSenderAPreRcv, "TxPreRcv_MFrmReq_RepPos", 
                  (@sysvar::TxPreRcv::MFrmReq_bRepVal));
    EnableControl(panSenderAPreRcv, "TxPreRcv_MFrmReq_RepVal", 
                  (@sysvar::TxPreRcv::MFrmReq_bRepVal));
  }
  else
  {
    EnableControl(panSenderAPreRcv, "TxPreRcv_MFrmReq_bRcv", 0);
    EnableControl(panSenderAPreRcv, "TxPreRcv_MFrmReq_bRepVal", 0);
    EnableControl(panSenderAPreRcv, "TxPreRcv_MFrmReq_RepPos", 0);
    EnableControl(panSenderAPreRcv, "TxPreRcv_MFrmReq_RepVal", 0);
  }   
}
/*@@end*/

/*@@sysvarChange:TxPreRcv::MFrmReq_bRepVal:*/
on sysvar TxPreRcv::MFrmReq_bRepVal
{
  EnableControl(panSenderAPreRcv, "TxPreRcv_MFrmReq_RepPos", 
                @this);
  EnableControl(panSenderAPreRcv, "TxPreRcv_MFrmReq_RepVal", 
                @this);
}
/*@@end*/

/*@@sysvarChange:TxPreRcv::HoldRx:*/
on sysvar TxPreRcv::HoldRx
{
  EnableControl(panSenderAPreRcv, "TxPreRcv_HoldRx_bRcv", 
                @this);
}
/*@@end*/

/*@@sysvarChange:TxPreRcv::EndRx:*/
on sysvar TxPreRcv::EndRx
{
  EnableControl(panSenderAPreRcv, "TxPreRcv_EndRx_bRcv", 
                @this);
}
/*@@end*/

/*@@sysvarChange:TxPreRcv::StrtCon_bAir:*/
on sysvar TxPreRcv::StrtCon_bAir
{
  EnableControl(panSenderAPreRcv, "TxPreRcv_StrtCon_Air",
                @this);
}
/*@@end*/

