/*@!Encoding:1252*/
//
// ECL_Constants.cin:
//  Common constants, enumerations and symbolic functions for the ECL System-Test and ECL Electrical-Wakeup
//  Version 1.0
//
variables
{
  // tXXX are defined as milliseconds ...
  const long cECL_tTSI             =   200; // system test start impulse, +/-5ms tolerance
  const long cECL_tPause           =   100; // Pause impulse after system test start impulse, +/-5ms tolerance 
  const long cECL_tStartUp         =   100; // variable startup-time between 0.1s and 10s - System Integrator specific
  const long cECL_tStartUpMax      = 10000;
  const long cECL_tTestStart       =   250; // Duration of starting the test 
  const long cECL_tTestParam       =    50; // Duration of a test parameter impulse
  const long cECL_tTestPause       =   100; // Waiting while testing, 
  const long cECL_tTestPause2      =  7000; // Waiting while testing - alternative 7s waiting while testing
  const long cECL_tTestSync        =   100; // Duration of the sync phase for triggering
  const long cECL_tTestSep         =   100; // separation time 2 avoid interference iof 2 impulses
  const long cECL_tTestResult      =    50; // Duration of the test result impulse

  const long cECL_tEWU             =    80; // duration of electrical wakup impulse (EWU) as defined in section 3.2 of ECL spec, 
  const long cECL_tEWU_Min         =    50; // tolerance for receiver side
  const long cECL_tEWU_Max         =   135; // impulse for system wakeup with more than one wake-up initiator

  const long cECL_MAX_RETRIES      =    10; // max possible startup tretries
  const long cECL_TOLERANCE        =     5; // ±  5ms fault tolerance for the sender side
  const long eECL_TOLRANCE_RECV    =    30; // ± 30ms fault tolerance for the receiver side
  const long cECL_DEVIATION_MIN    =     5; // fault injection:  5 ms deviation
  const long cECL_DEVIATION_MAX    =    15; // fault injection: 15 ms deviation
  const long cMS_TO_100MuS         =    10; // factor to map milliseconds to 100microseconds  ±
  const long cECL_MAX_PARTICIPANTS =    20; // see ECL spec
  const long cECL_tFinalHigh        =    2; // duration of the final high impulse: the value must be > Glitchfilter (default 1ms)

  const long cECL_DEVICE_STARTUP   =   100; // save amount of time to communicate all hardware-states to CANoe after measurement start

  // ... according to section 3.1.3 of the ECL Specification.
  enum eECL_TestResults
  {
    ECL_TR_MOSTSignRes_RBD         =  0x00, // 00000 - MOST signal result, RBD result
    ECL_TR_MOSTSignRes_Threshold   =  0x08, // 01000 - MOST signal result, threshold
    ECL_TR_OnlyAlive               =  0x10, // 10000 - Only alive result
    ECL_TR_MOSTSignRes_SSO_CU      =  0x18  // 11000 - MOST signal result, SSO/CU result (0 -> "no result available" or "no fault saved")
  };

  enum eECL_VerboseLevel
  {
    ECL_Verbose_Off = 0,
    ECL_Verbose_High = 1,
    ECL_Verbose_Default = 2,
    ECL_Verbose_Low = 3
  };

  enum eECL_VerboseLevel gECL_Verbose; // measurement setup does not support debug levels yet ...
}

//
// returns string constants (human readable text) for test results from ECL devices/participants
// according to section 3.1.3 of the ECL Specification.
//
void ECL_GetStringForSystemTestResult (long testParam, long electrState, long optState, char electrText[], char optText[])
{
  if (electrState == 0)
  {
    strncpy(electrText, "alive", elCount(electrText));
    switch(testParam) {
    case ECL_TR_MOSTSignRes_RBD:
      if (optState == 0)
        strncpy(optText, "Stable Lock", elCount(optText));
      else
        strncpy(optText, "no Stable Lock", elCount(optText));
      break;
      break;
    case ECL_TR_MOSTSignRes_Threshold:
      if (optState == 0)
        strncpy(optText, "Sign. quality ok", elCount(optText));
      else
        strncpy(optText, "Sign. quality not ok", elCount(optText));
      break;
      break;
    case ECL_TR_OnlyAlive:
    default:
      strncpy(optText, "N/A", elCount(optText));
      break;
    case ECL_TR_MOSTSignRes_SSO_CU:
      if (optState == 0)
        strncpy(optText, "n.a. / no fault saved", elCount(optText));
      else
        strncpy(optText, "Sud. Sign. Off / Crit. Unlock", elCount(optText));
      break;
    }
  } else {
    strncpy(electrText, "not alive", elCount(electrText));
    strncpy(optText, "N/A", elCount(optText));
  }
}

//
// Set verbosity level for debug messages
//
void ECL_SetECLVerbose (enum eECL_VerboseLevel level)
{
#if !MEASUREMENT_SETUP
  setWriteDbgLevel(level);
#endif
  gECL_Verbose = level;
}

//
// Get a human readable description for the test-parameter
//
void ECL_GetStringForSystemTestParameter(long testParam, char testText[])
{
  switch (testParam)
  {
    case ECL_TR_MOSTSignRes_RBD:       strncpy(testText, "MOST signal result, RBD result", elCount(testText)); break;
    case ECL_TR_MOSTSignRes_Threshold: strncpy(testText, "MOST signal result, threshold", elCount(testText)); break;
    case ECL_TR_OnlyAlive:             strncpy(testText, "Only alive result", elCount(testText)); break;
    case ECL_TR_MOSTSignRes_SSO_CU:    strncpy(testText, "MOST signal result, SSO/CU result", elCount(testText)); break;
    default:    strncpy(testText, "Unknown or N/A", elCount(testText)); break;
  }
}

