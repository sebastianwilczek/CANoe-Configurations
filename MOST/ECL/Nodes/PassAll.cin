/*@!Encoding:1252*/

on *
{
  // forward all messages to next node in node chain
  output(this);
}
