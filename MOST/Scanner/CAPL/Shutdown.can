/*@@var:*/
variables
{
  // This node is used to suspend the shutdown of the MOST ring by the PowerMaster.
  // Use the panel "NetworkScanner" to suspend the network shutdown.
}
/*@@end*/

/*@@mostAmsMsg:NetBlock.ShutDown.0x0 (0x010060):*/
on mostAMSMessage NetBlock.ShutDown.0
{
  mostAmsMessage NetBlock.ShutDown.Result msgResult;

  if(this.DLC != 1)
    return;

  if(this.BYTE(0) != 0x00) // not Query
    return;

  if(@sysvar::SuspendShutdown == 1)
  {
    msgResult.DA = this.SA;
    msgResult.BYTE(0) = 0x01; // Suspend
    output(msgResult);
  }
}
/*@@end*/

