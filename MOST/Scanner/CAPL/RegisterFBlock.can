/*@@var:*/
variables
{
  // This node is used to register / unregister some function blocks during measurement.
  // Use the panel "NetworkScanner" to register / unregister the function blocks.
}
/*@@end*/

/*@@sysvarChange:RegisterFBlock:*/
on sysvar RegisterFBlock
{
  if(@this != 1)
    return;

  @sysvar::RegResult = MostApRegisterEx(@sysvar::RegFBlockID, @sysvar::RegInstID);
}
/*@@end*/

/*@@sysvarChange:UnRegisterFBlock:*/
on sysvar UnRegisterFBlock
{
  if(@this != 1)
    return;

  @sysvar::RegResult = MostApUnRegisterEx(@sysvar::RegFBlockID, @sysvar::RegInstID);
}
/*@@end*/

