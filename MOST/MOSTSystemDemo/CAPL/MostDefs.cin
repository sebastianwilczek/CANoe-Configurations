/*@!Encoding:1252*/
variables
{
  // This file is intended to be included by CAPL programs
  // for simulation, test and analysis of MOST systems.
  // It defines common constants of the MOST Specification
  // and specific constants applicable in the CAPL function
  // set of CANoe/CANalyzer option MOST.


  //
  // MOST Specification
  // 

  // Special destination addresses
  const word kAdrWildcard              = 0xFFFF;
  const word kAdrBroadcast             = 0x03C8;

  // Special FBlock IDs
  const byte kFBNetworkService         = 0x00;
  const byte kFBAll                    = 0xFF;

  // Special Instance IDs
  const byte kInstIdAny                = 0x00; // addresses any FBlock instance within the device
  const byte kInstIdBroadcast          = 0xFF; // addresses all FBlock instances within the device

  // OpTypes: Properties
  const byte kOpTSet                   = 0x0;
  const byte kOpTGet                   = 0x1;
  const byte kOpTSetGet                = 0x2;
  const byte kOpTIncrement             = 0x3;
  const byte kOpTDecrement             = 0x4;
  const byte kOpTGetInterface          = 0x5;
  const byte kOpTStatus                = 0xC;
  const byte kOpTInterface             = 0xE;
  const byte kOpTError                 = 0xF;

  // OpTypes: Methods
  const byte kOpTStart                 = 0x0;
  const byte kOpTAbort                 = 0x1;
  const byte kOpTStartResult           = 0x2;
  const byte kOpTStartResultAck        = 0x6;
  const byte kOpTAbortAck              = 0x7;
  const byte kOpTStartAck              = 0x8;
  const byte kOpTErrorAck              = 0x9;
  const byte kOpTProcessingAck         = 0xA;
  const byte kOpTProcessing            = 0xB;
  const byte kOpTResult                = 0xC;
  const byte kOpTResultAck             = 0xD;

  // Standard error codes of OpType Error/ErrorAck (MOST Spec 2.5, section 2.3.2.5.1)
  const byte kErrFBlockIdNotAvailable  = 0x01; // FBlock not available 
  const byte kErrInstIdNotAvailable    = 0x02; // Instance of the FBlock not available
  const byte kErrFktIdNotAvailable     = 0x03; // Function not available
  const byte kErrOpTypeNotAvailable    = 0x04; // OpType not available
  const byte kErrInvalidLength         = 0x05; // Invalid message length
  const byte kErrParamWrong            = 0x06; // One or more parameters were wrong, i.e. not within the boundaries
  const byte kErrParamNotAvailable     = 0x07; // One or more parameters were within the boundaries, but are not available at the time
  const byte kErrSecondaryNode         = 0x0A; // Secondary node does not process any commands and replies this error
  const byte kErrDeviceMalfunction     = 0x0B; // Requested function is temporarily not available due to a device malfunction.
  const byte kErrSegmentation          = 0x0C; // The Application Message Service has detected a protocol error.
  const byte kErrFunctionSpecific      = 0x20; // After this error code, any function specific ErrorInfo can be sent.
  const byte kErrBusy                  = 0x40; // Function is available, but busy
  const byte kErrNotAvailable          = 0x41; // Function is implemented in principle, but is not available at the moment
  const byte kErrProcessing            = 0x42; // Processing error
  const byte kErrMethodAborted         = 0x43; // This error code can be used to indicate, that a method has been aborted by the Abort/AbortAck OpType

  // Message sub types on control channel (message selector MOST_RType)
  const byte kRTypeNormal              = 0;    // normal message
  const byte kRTypeRemRead             = 1;    // Remote Read
  const byte kRTypeRemWrite            = 2;    // Remote Write
  const byte kRTypeAlloc               = 3;    // Resource Allocate
  const byte kRTypeDealloc             = 4;    // Resource De-allocate
  const byte kRTypeGetSource           = 5;    // Remote GetSource

  // Telegram Id (message selector MOST_TelId)
  const byte kTelIdSingle              = 0x0;  // single telegram transfer 
  const byte kTelIdFirst               = 0x1;  // 1st telegram (segmented transfer)
  const byte kTelIdNth                 = 0x2;  // mid telegram (segmented transfer)
  const byte kTelIdLast                = 0x3;  // last telegram (segmented transfer)
  const byte kTelIdHighUser            = 0x8;  // MOST High Protocol user data
  const byte kTelIdHighControl         = 0x9;  // MOST High Protocol control data
  const byte kTelIdMAMAC               = 0xA;  // MAMAC unsegmented
  const byte kTelIdMAMAC48             = 0xB;  // MAMAC segmented

  // Timing definitions (MOST Spec 2.5, section 3.8; all values in ms)
  const long ktConfigMin               =   1975;
  const long ktConfig                  =   2000;
  const long ktConfigMax               =   2015;
  const long ktWakeUp                  =     25;
  const long ktWakeUpMax               =     25;
  const long ktWaitNodes               =    100;
  const long ktWaitNodesMax            =    100;
  const long ktBoundary                =     20;
  const long ktBoundaryMax             =     20;
  const long ktWaitBeforeScanMin       =    100;
  const long ktWaitBeforeScan          =    100;
  const long ktWaitBeforeScanMax       =    500;
  const long ktDelayCfgRequest1Min     =    500;
  const long ktDelayCfgRequest1        =    500;
  const long ktDelayCfgRequest1Max     =    550;
  const long ktDelayCfgRequest2Min     =  10000;
  const long ktDelayCfgRequest2        =  10000;
  const long ktDelayCfgRequest2Max     =  11000;
  const long ktShutDown                =     15;
  const long ktShutDownMax             =     15;
  const long ktSuspendMin              =   1975;
  const long ktSuspend                 =   2000;
  const long ktSuspendMax              =   2100;
  const long ktShutDownWaitMin         =   1000;
  const long ktShutDownWait            =   2000;
  const long ktShutDownWaitMax         =  15000;
  const long ktRetryShutDownMin        =   9900;
  const long ktRetryShutDown           =  10000;
  const long ktRetryShutDownMax        =  10100;
  const long ktRestartMin              =    275;
  const long ktRestart                 =    300;
  const long ktRestartMax              =    350;
  const long ktPwrSwitchOffDelayMin    =   5000;
  const long ktPwrSwitchOffDelay       =   5000;
  const long ktPwrSwitchOffDelayMax    =   5000; // device specific
  const long ktSlaveShutDownMin        =  16000;
  const long ktSlaveShutDown           =  16000;
  const long ktWaitAfterOvertempShutDownMin =  20000;
  const long ktWaitAfterOvertempShutDown    =  60000;
  const long ktLockMin                 =     75;
  const long ktLock                    =    100;
  const long ktLockMax                 =    115;
  const long ktUnlockMin               =     60;
  const long ktUnlock                  =     70;
  const long ktUnlockMax               =    100;
  const long ktMPRdelay                =    200;
  const long ktMPRdelayMax             =    200;
  const long ktWaitAfterNCEMin         =    200;
  const long ktWaitAfterNCE            =    200;
  const long ktWaitAfterNCEMax         =    500;
  const long ktBypassMin               =     50;
  const long ktBypass                  =     70;
  const long ktBypassMax               =    100;
  const long ktAnswer                  =     50;
  const long ktAnswerMax               =     50;
  const long ktWaitForAnswerMin        =    100;
  const long ktWaitForAnswer           =    200;
  const long ktWaitForAnswerMax        =    700;
  const long ktResourceRetry           =     10;
  const long ktResourceRetryMax        =     10;
  const long ktProperty                =    200;
  const long ktPropertyMax             =    200;
  const long ktWaitForPropertyMin      =    250;
  const long ktWaitForProperty         =    300;
  const long ktWaitForPropertyMax      =    350;
  const long ktProcessingDefault1      =    100;
  const long ktProcessingDefault1Max   =    150;
  const long ktProcessingDefault2Min   =    100;
  const long ktProcessingDefault2      =    100;
  const long ktWaitForProcessing1Min   =    200;
  const long ktWaitForProcessing1      =    200;
  const long ktWaitForProcessing1Max   =    250;
  const long ktWaitForProcessing2Min   =    200;
  const long ktWaitForProcessing2      =    200;
  const long ktCleanChannelsMin        =      3; // 3.5
  const long ktCleanChannels           =      5;
  const long ktCleanChannelsMax        =     25;
  const long ktCM_DeadlockPrev         =   1000;
  const long ktCM_DeadlockPrevMax      =   1000;
  const long ktWaitForNextSegmentMin   =   4975;
  const long ktWaitForNextSegment      =   5000;
  const long ktWaitForNextSegmentMax   =  10015;
  const long ktMsgResponse             =     15;
  const long ktMsgResponseMax          =     15;
  const long ktBoundaryChangeMin       =    100;
  const long ktBoundaryChange          =    500;
  const long ktBoundaryChangeMax       =   5000;
  const long ktDiagSignalMin           =      0;
  const long ktDiagSignal              =      0;
  const long ktDiagSignalMax           =    100;
  const long ktDiagMasterMin           =   2000;
  const long ktDiagMaster              =  28000;
  const long ktDiagMasterMax           =  58000;
  const long ktDiagSlaveMin            =   4000;
  const long ktDiagSlave               =  30000;
  const long ktDiagSlaveMax            =  60000;
  const long ktDiagLockMin             =    250;
  const long ktDiagLock                =    250;
  const long ktDiagLockMax             =    260;
  const long ktDiagStartMin            =      0;
  const long ktDiagStart               =      0;
  const long ktDiagStartMax            =  10000;
  const long ktDiagRestartMin          =      0;
  const long ktDiagRestart             =      0;
  const long ktDiagRestartMax          =  10000;


  //
  // CANoe/CANalyzer option MOST
  //

  // Network states (see MostGetNetState(), OnMostNetState())
  const long kNetStateUndefined        = 0;    // Network status is unknown.
  const long kNetStatePowerOff         = 2;    // The network interface to the MOST ring is deactivated.
  const long kNetStateNetInterfaceInit = 3;    // Network interface is initializing, e.g. after it has been woken by "light on".
  const long kNetStateConfigNotOk      = 4;    // Network interface is in normal operating mode (stable lock). On application level the MOST ring is in state ConfigNotOk.
  const long kNetStateConfigOk         = 5;    // Network interface is in normal operating mode (stable lock). On application level the MOST ring is in state ConfigOk.


  // Return codes of intrinsic MOST CAPL functions (e.g. MostSetTimingMode())
  const long kMostOK                   =   0;  // No error occurred
  const long kMostInvalidChannel       =  -1;  // The operation was requested for an invalid channel number. 
  const long kMostNoConnection         =  -2;  // The driver was unable to establish a connection to the MOST interface hardware. 
  const long kMostIllegalTime          =  -3;  // The function was called in the wrong phase of the measurement.
  const long kMostWrongThread          =  -4;  // For technical reasons this function may not be called from this area of CANoe/CANalyzer.
  const long kMostWrongHWMode          =  -5;  // The hardware interface to the MOST bus is in a state in which the called function is unavailable.
  const long kMostTxQueueFull          =  -6;  // The transmit queue is full.
  const long kMostHWBusy               =  -7;  // Unable to perform the desired action due to hardware overload.
  const long kMostWrongHWType          =  -8;  // This functionality is not supported by the hardware used.
  const long kMostParameterOutOfRange  =  -9;  // One or more function parameters lie outside of their valid value ranges.
  const long kMostDriverCallFailed     = -10;  // The MOST hardware driver returned an unspecific error.
  const long kMostAsInvalidChannel     = -21;  // The function was called for an invalid channel.
  const long kMostAsDoubleOp           = -22;  // The function cannot be executed, because its results already apply.
  const long kMostAsIllegalTime        = -23;  // The function cannot be executed in this phase of the simulation cycle.
  const long kMostAsParamNotAvailable  = -24;  // The requested parameter value is unavailable.
  const long kMostAsNotAvailable       = -25;  // The function is unavailable or the MOST Application Socket is inactive.
  const long kMostAsBeforeNetOn        = -26;  // The function cannot be called before NetOn.
  const long kMostAsInvalidParameter   = -29;  // At least one parameter passed with the function lies outside of its valid value range.

  // Return codes of symbolic access functions (e.g. MostMsgSet(symbols))
  const long kMostSymGeneralExecError  = -30;  // General execution error.
  const long kMostSymUnknownMsg        = -31;  // The specified message cannot be dissolved with the available function catalogs.
  const long kMostSymMsgSizeExceeded   = -32;  // The function cannot be executed, since the size of the specified message is exceeded.
  const long kMostSymUnknownParamAdr   = -33;  // The specified parameter address cannot be dissolved with the available function catalogs.
  const long kMostSymParamNotFoundInMsg= -34;  // A parameter with the indicated address cannot be found in the message.
  const long kMostSymParamTypeMismatch = -35;  // The function has attempted to read a value that does not have the compatible data type.
  const long kMostSymEncodingMismatch  = -36;  // The function cannot read the string or raw data, since the coding does not match.

  // Return codes of the mostGetSpeedGrade function
  const long kMost25                   = 1;
  const long kMost50                   = 2;
  const long kMost150                  = 3;

  // OpType flags: Properties (MostAsFsFunctionEnable())
  const long kOpTFSet                  = 0x0001;
  const long kOpTFGet                  = 0x0002;
  const long kOpTFSetGet               = 0x0004;
  const long kOpTFIncrement            = 0x0008;
  const long kOpTFDecrement            = 0x0010;
  const long kOpTFGetInterface         = 0x0020;
  const long kOpTFStatus               = 0x1000;
  const long kOpTFIterface             = 0x4000;
  const long kOpTFError                = 0x8000;
  const long kOpTFStdPropR             = kOpTFGet|kOpTFStatus|kOpTFError;                    // standard for readable property
  const long kOpTFStdPropRW            = kOpTFSet|kOpTFGet|kOpTFSetGet|kOpTFStatus|kOpTFError; // standard for readable and writeable property

  // OpType flags: Methods (MostAsFsFunctionEnable())
  const long kOpTFStart                = 0x0001;
  const long kOpTFAbort                = 0x0002;
  const long kOpTFStartResult          = 0x0004;
  const long kOpTFStartResultAck       = 0x0040;
  const long kOpTFAbortAck             = 0x0080;
  const long kOpTFStartAck             = 0x0100;
  const long kOpTFErrorAck             = 0x0200;
  const long kOpTFProcessingAck        = 0x0400;
  const long kOpTFProcessing           = 0x0800;
  const long kOpTFResult               = 0x1000;
  const long kOpTFResultAck            = 0x2000;
  const long kOpTFStdMeth              = kOpTFStartResult|kOpTFResult|kOpTFError;
  const long kOpTFStdMethAck           = kOpTFStartResultAck|kOpTFResultAck|kOpTFErrorAck;

  // OpType flags: enable all operations defined in Function Catalog
  const long kOpTFAllInFCat            = 0x1FFFF;

  // Function ID joker which denotes all functions of the FBlock according to the Function Catalog (MostAsFsFunctionEnable())
  const long kFctAllInFCat             = -1;


  // Registry types (see MostAsRgGetFBlockID(), OnMostAsRegistry())
  const long kLocalFBlockList          = 1;    // list of FBlocks within the device
  const long kBusRegistry              = 2;    // list of FBlocks in the network

  // Wildcard address for "all notification clients" (in combination with MostAsNtfOutput())
  const long kAsNtfDestAdr             = 0xFFFF;

  // Maximum number of bytes in data area of packets on Asynchronous channel (see OutputMostPkt()).
  // The data area starts with the first byte behind the source address (i.e. byte[0] is the FBlockId in MOST High packets).
  const long kPktDataLenMax            = 1014;
  
  // Default number of bytes reserved for AMS user data (mostAMSMessage).
  // (declare larger AMS message variables with mostAMSMessage * msg = { DLC = x }; 0 < x < 65535)
  const long kAmsSizeDefault           = 200;

  // size of MOST Allocation Table (see MostGetAllocTable())
  const byte kMaxAllocTableSize        = 60;

}

long CheckValidReception(mostAmsMessage * msg)
{
  // Description:
  //   Check if the FBlock associated with the CAPL node (through MostApRegister(Ex))
  //   is addressed by the command message.

  // process incoming messages only
  if(msg.dir != RX)
    return 0;

  // this check is mandatory if there are several instances of an
  // FBlock within one device.
  if(MostApIsAddressed(msg.FBlockId, msg.InstanceId))
    return 1; // the current CAPL node implements the addressed FBlock
  else
    return 0;
}

long CheckValidReceptionAndLength(mostAmsMessage * msg, long requiredlength)
{
  // Description:
  //   Check if the FBlock associated with the CAPL node (through MostApRegister(Ex))
  //   is addressed by the command message.
  //   Additionally check the length of the message. If it does not match requiredlength 
  //   exactly an error message 'invalid length' will be send.

  // process incoming messages only
  if(msg.dir != RX)
    return 0;

  // this check is mandatory if there are several instances of an
  // FBlock within one device.
  if(!MostApIsAddressed(msg.FBlockId, msg.InstanceId))
    return 0; // the current CAPL node does not implement the addressed FBlock
 
  return CheckMsgLength(msg, requiredlength);
}

long CheckMsgLength(mostAMSMessage * msg, long length)
{
  // Description:
  //   Checks if message has valid length.
  //   Replies error message if length is invalid.
  // Return:
  //   0: failed; 1: Ok

  if(msg.DLC != length)
  {
    if(msg.OpType < 8) // reply commands only
      mostSendError_Code(msg, kErrInvalidLength);
    return 0;
  }
  return 1; // ok
}

