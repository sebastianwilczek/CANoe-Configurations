VERSION ""

NS_ :

BS_:

BU_: Ignition Dashboard SteeringWheel EngineSimulator Gateway Console2
VAL_TABLE_ Ignition 3 "KL15" 2 "KL15R" 1 "Key" 0 "Off" ;
VAL_TABLE_ AmplifierCmds 1 "VolumeDec" 0 "VolumeInc" ;
VAL_TABLE_ CDPlayerCmds 6 "SearchBack" 5 "SearchFwd" 4 "Unload" 3 "Load" 2 "Pause" 1 "Stop" 0 "Play" ;

BO_ 274 CurrentAudioSource: 1 Gateway
 SG_ SourceID : 0|8@1- (1,0) [0|0] "" Vector__XXX

BO_ 273 IgnitionKeyStatus: 2 Ignition
 SG_ EngineIsRunning : 8|2@1+ (1,0) [0|0] "" Vector__XXX
 SG_ Ignition : 0|3@1+ (1,0) [0|0] "" Vector__XXX

BO_ 272 MuteStatus: 1 Gateway
 SG_ MuteStatus : 0|8@1+ (1,0) [0|1] "" Vector__XXX

BO_ 264 GetTrack: 8 Vector__XXX

BO_ 265 DeckStatusStatus: 1 Gateway
 SG_ CDPlayerCmd : 0|8@1+ (1,0) [0|6] "" Vector__XXX

BO_ 263 VolumeCtrlNotify: 1 Gateway
 SG_ VolCtrlStatus : 0|8@1+ (1,0) [0|1] "" Vector__XXX

BO_ 262 ChangeVolumeCtrl: 0 SteeringWheel

BO_ 261 SetTrack: 1 SteeringWheel
 SG_ TrackChangeCmd : 0|8@1+ (1,0) [0|1] "" Vector__XXX

BO_ 260 TrackStatus: 1 Gateway
 SG_ Track : 0|8@1+ (1,0) [0|99] "" Vector__XXX

BO_ 259 SpeedNotify: 1 EngineSimulator
 SG_ Speed : 0|8@1+ (1,0) [0|150] "km/h" Vector__XXX

BO_ 258 SetAmplifier: 1 Console2
 SG_ AmplifierCmd : 0|8@1+ (1,0) [0|1] "" Vector__XXX

BO_ 257 SetCDPlayer: 1 Console2
 SG_ CDPlayerCmd : 0|8@1+ (1,0) [0|6] "" Vector__XXX

BO_ 256 TimeRelative: 4 Gateway
 SG_ TrackTime : 0|32@1+ (1,0) [0|4294967295] "s" Vector__XXX

BA_DEF_  "BusType" STRING ;
BA_DEF_DEF_  "BusType" "";
VAL_ 274 SourceID 3 "Telephone" 2 "Tuner" 1 "DiscPlayer" 0 "None" ;
VAL_ 265 CDPlayerCmd 6 "SearchBack" 5 "SearchFwd" 4 "Unload" 3 "Load" 2 "Pause" 1 "Stop" 0 "Play" ;
VAL_ 261 TrackChangeCmd 1 "Previous Track" 0 "Next Track" ;
VAL_ 258 AmplifierCmd 3 "Demute" 2 "Mute" 1 "VolumeDec" 0 "VolumeInc" ;
VAL_ 257 CDPlayerCmd 6 "SearchBack" 5 "SearchFwd" 4 "Unload" 3 "Load" 2 "Pause" 1 "Stop" 0 "Play" ;
