/*@!Encoding:1252*/
includes
{
  
}

variables
{
  
}

on start
{
  a429Word A429Ch2::Inner_Tank_1_Fuel_Temp_And_Advisory_Warning fuelTemp;
  a429Word A429Ch2::Inner_Tank_3_Probe_Capacitance probeCap;
  
  output(fuelTemp);
  output(probeCap);
}