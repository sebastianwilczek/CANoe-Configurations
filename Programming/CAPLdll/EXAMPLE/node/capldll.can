/*@!Encoding:1252*/
includes
{
#if X64
  #pragma library("..\Exec64\capldll.dll")
#else
  #pragma library("..\Exec32\capldll.dll")
#endif
}

variables 
{
  byte gBufferGet[10];
  byte gBufferPut[10] = { 9, 8, 7, 55, 66, 77, 0, 0, 0, 0};

  DWORD gHandle;
}

on preStart
{
  /* This function will register the CAPLDLL.
     The handle is important for all function calls.  
     It will indent the CAPL node in the DLL */   

  writeLineEx(1,1,"");
  writeLineEx(1,1,"");
  writeLineEx(1,1,"--------------------- CAPL-DLL Example -----------------------");
  writeLineEx(1,1,"");
  writeLineEx(1,1,"Start procedure:");
  gHandle = registerCAPLDLL();
  writeLineEx(1,1,"1. DLL Registration:   Handle = %d", gHandle);
}

on start 
{
  writeLineEx(1,1,"2. DLL Initialization: Done!");  
  
  /* This function will initialize all callback 
     functions in the CAPLDLL. The handle include 
     the register ID number of CAPL node. */
  dllInit(gHandle);
  
  Help();
}

on key '1'
{
  writeLineEx(1,1,"");
  writeLineEx(1,1,"");
  writeLineEx(1,1,"");
  writeLineEx(1,1,"<1> Direct call of a CAPL Callback Function");
  writeLineEx(1,1,"--------------------------------------------------------------");
  writeLineEx(1,1,"Call: CAPL CallBack Function CALLBACK_ShowValue(21)");
  CALLBACK_ShowValue(21); /* Direct call of one callback function */
  writeLineEx(1,1,"--------------------------------------------------------------");
}

on key '2'
{
  long value;

  writeLineEx(1,1,"");
  writeLineEx(1,1,"");
  writeLineEx(1,1,"");
  writeLineEx(1,1,"<2> Call of CAPL Callback Functions by the DLL");
  writeLineEx(1,1,"--------------------------------------------------------------");
  /* The DLL is informed to call some callback functions. The informations will written in the write windows */

  writeLineEx(1,1,"Call CAPL DLL Function dllSetValue(handle,0x01)");
  value = dllSetValue(gHandle,0x01);

  /* The DLL is informed to call some callback functions. The informations will written in the write windows */
  writeLineEx(1,1,"");
  writeLineEx(1,1,"Call CAPL DLL Function dllReadData(handle, 0x12345678)");
  value = dllReadData(gHandle, 0x12345678);
  writeLineEx(1,1,"--------------------------------------------------------------");
}

on key '3'
{

  /* This functions put two datas from CAPL to DLL*/ 
  writeLineEx(1,1,"");
  writeLineEx(1,1,"");
  writeLineEx(1,1,"");
  writeLineEx(1,1,"<3> Save data from CAPL to DLL memory");
  writeLineEx(1,1,"    Read data from DLL memory to CAPL");
  writeLineEx(1,1,"--------------------------------------------------------------");
  writeLineEx(1,1,"Call CAPL DLL Function dllPut(36)");
  dllPut(36);
  writeLineEx(1,1,"Call CAPL DLL Function dllGet()  Result = %d ", (int)dllGet());

  writeLineEx(1,1,"");

  writeLineEx(1,1,"Call CAPL DLL Function dllPut(0x24)");
  dllPut(0x24);
  writeLineEx(1,1,"Call CAPL DLL Function dllGet()  Result = 0x%x ", (int)dllGet());
  writeLineEx(1,1,"--------------------------------------------------------------");
}

on key '4'
{
  writeLineEx(1,1,"");
  writeLineEx(1,1,"");
  writeLineEx(1,1,"");
  writeLineEx(1,1,"<4> Overwrite DLL memory from CAPL without parameter");
  writeLineEx(1,1,"    Read value from CAPL DLL memory in CAPL back");
  writeLineEx(1,1,"--------------------------------------------------------------");
  writeLineEx(1,1,"Call CAPL DLL Function dllvoid()");
  dllvoid(); 
  
  writeLineEx(1,1,"Call CAPL DLL Function dllGet()  Result = 0x%x ", (int)dllGet());
  writeLineEx(1,1,"--------------------------------------------------------------");
}

on key '5'
{
  int i;
  byte buffer[10];

  writeLineEx(1,1,"");
  writeLineEx(1,1,"");
  writeLineEx(1,1,"");
  writeLineEx(1,1,"<5> Save one data buffer from CAPL array to DLL memory");
  writeLineEx(1,1,"    Read DLL memory from CAPL");
  writeLineEx(1,1,"--------------------------------------------------------------");
  writeLineEx(1,1,"Call CAPL DLL Function dllPutDataOnePar(gBufferPut)");
  dllPutDataOnePar(gBufferPut);  /* This function put data from CAPL array to DLL*/ 

  writeLineEx(1,1,"Call CAPL DLL Function dllGetDataOnePar(buffer)");
  dllGetDataOnePar(buffer);  /* This function get data from DLL into CAPL memory*/  

  for(i = 0; i < 10; ++i) 
  {
    writeLineEx(1,1,"gBufferPut: gBufferPut[%d] = %d", i, gBufferPut[i]);
  }
  writeLineEx(1,1,"--------------------------------------------------------------");
}

on key '6'
{
  int i;
  int number = 6;
  byte buffer[10];

  writeLineEx(1,1,"");
  writeLineEx(1,1,"");
  writeLineEx(1,1,"");
  writeLineEx(1,1,"<6> Save two data from CAPL array to DLL memory");
  writeLineEx(1,1,"    Read DLL memory from CAPL");
  writeLineEx(1,1,"--------------------------------------------------------------");
  writeLineEx(1,1,"Call CAPL DLL Function dllPutDataTwoPars(number,gBufferPut)");
  dllPutDataTwoPars(number, gBufferPut);  /* This function put two datas from CAPL array to DLL*/ 


  writeLineEx(1,1,"Call CAPL DLL Function dllGetDataOnePar(number,buffer)");
  dllGetDataTwoPars(number, buffer);  /* This function get two datas from DLL into CAPL memory*/

  for(i = 0; i < 10; ++i) 
  {
    writeLineEx(1,1,"Result buffer[%d] = %d", i, buffer[i]);
  }
  writeLineEx(1,1,"--------------------------------------------------------------");
}

on key '7'
{
  long par1 = 7;
  long par2 = 6;
  long result;

  writeLineEx(1,1,"");
  writeLineEx(1,1,"");
  writeLineEx(1,1,"");
  writeLineEx(1,1,"<7> Calculate the value by the DLL");
  writeLineEx(1,1,"    The return value is the result!");
  writeLineEx(1,1,"--------------------------------------------------------------");
  result = dllAdd(par1, par2);  /* This function will add two values. The return value is the result	*/ 
  writeLineEx(1,1,"Call CAPL DLL Function dllAdd(7 + 6)  Result = %d",result);

  result = dllSubtract(par1, par2);  /* This function will substract two values. The return value is the result	*/ 
  writeLineEx(1,1,"Call CAPL DLL Function dllAdd(7 - 6)  Result = %d",result);
  writeLineEx(1,1,"--------------------------------------------------------------");
}

on key '8'
{
  long result;
  
  writeLineEx(1,1,"");
  writeLineEx(1,1,"");
  writeLineEx(1,1,"");
  writeLineEx(1,1,"<8> Support of long function names calls");

  writeLineEx(1,1,"--------------------------------------------------------------");  
  result = dllSupportLongFunctionNamesWithUpTo50Characters(); 
  writeLineEx(1,1,"Call CAPL DLL Function dllSupportLongFunctionNamesWithUpTo50Characters()  Result = %d",result);
  writeLineEx(1,1,"--------------------------------------------------------------");
}

on key '9'
{
  long par01 =  1; long par02 =  2; long par03 =  3; long par04 =  4; long par05 =  5; long par06 =  6; long par07 =  7; long par08 =  8;
  long par09 =  9; long par10 = 10; long par11 = 11; long par12 = 12; long par13 = 13; long par14 = 14; long par15 = 15; long par16 = 16;
  long par17 = 17; long par18 = 18; long par19 = 19; long par20 = 20; long par21 = 21; long par22 = 22; long par23 = 23; long par24 = 24;
  long par25 = 25; long par26 = 26; long par27 = 27; long par28 = 28; long par29 = 29; long par30 = 30; long par31 = 31; long par32 = 32;
  long par33 = 33; long par34 = 34; long par35 = 35; long par36 = 36; long par37 = 37; long par38 = 38; long par39 = 39; long par40 = 40;
  long par41 = 41; long par42 = 42; long par43 = 43; long par44 = 44; long par45 = 45; long par46 = 46; long par47 = 47; long par48 = 48;
  long par49 = 49; long par50 = 50; long par51 = 51; long par52 = 52; long par53 = 53; long par54 = 54; long par55 = 55; long par56 = 56;
  long par57 = 57; long par58 = 58; long par59 = 59; long par60 = 60; long par61 = 61; long par62 = 62; long par63 = 63; long par64 = 64;
  long result;

  writeLineEx(1,1,"");
  writeLineEx(1,1,"");
  writeLineEx(1,1,"");
  writeLineEx(1,1,"<9> Calculate the sum of many parameters by the DLL");
  writeLineEx(1,1,"    The return value is the result!");
  writeLineEx(1,1,"--------------------------------------------------------------");
  result = dllAdd63Parameters(par01, par02, par03, par04, par05, par06, par07, par08,
                              par09, par10, par11, par12, par13, par14, par15, par16,
                              par17, par18, par19, par20, par21, par22, par23, par24,
                              par25, par26, par27, par28, par29, par30, par31, par32,
                              par33, par34, par35, par36, par37, par38, par39, par40,
                              par41, par42, par43, par44, par45, par46, par47, par48,
                              par49, par50, par51, par52, par53, par54, par55, par56,
                              par57, par58, par59, par60, par61, par62, par63);  /* This function will add 63 values. The return value is the result	*/ 
  writeLineEx(1,1,"Call CAPL DLL Function dllAdd63Parameters(<Values 1..63>)  Result = %d",result);

  result = dllAdd64Parameters(par01, par02, par03, par04, par05, par06, par07, par08,
                              par09, par10, par11, par12, par13, par14, par15, par16,
                              par17, par18, par19, par20, par21, par22, par23, par24,
                              par25, par26, par27, par28, par29, par30, par31, par32,
                              par33, par34, par35, par36, par37, par38, par39, par40,
                              par41, par42, par43, par44, par45, par46, par47, par48,
                              par49, par50, par51, par52, par53, par54, par55, par56,
                              par57, par58, par59, par60, par61, par62, par63, par64);  /* This function will add 64 values. The return value is the result	*/ 
  writeLineEx(1,1,"Call CAPL DLL Function dllAdd64Parameters(<Values 1..64>)  Result = %d",result);
  writeLineEx(1,1,"--------------------------------------------------------------");
}

on key 'h'
{
  writeLineEx(1,1,"");
  Help();
}

on stopMeasurement
{
  /* This function will release the CAPL function 
     handle in the CAPLDLL */
  dllEnd(gHandle);
}

void CALLBACK_ArrayValues(dword flags, byte databytes[], byte controlcode)
{
  char datadump[100];
  char byteAsText[10];
  int i;

  /* Callback function */
  /* This function will demonstrated an Callback with array parameters. */

  strncpy (datadump, "[", 100);

  for (i=0; i<elcount(databytes); i++)
  {
    if (i>0)
    {
      strncat(datadump, " ", 100);
    }
    snprintf(byteAsText, 10, "%02x", databytes[i]);
    strncat(datadump, byteAsText, 100);
  }
  strncat (datadump, "]", 100);
  writeLineEx(1,1,"CAPL CallBack Function shows ArrayValues(%x,%s,%x)",flags, datadump, controlcode);
}

void CALLBACK_DllInfo(char text[])
{
  /* Callback function */
  /* This function will demonstrated an Callback with character parameters */
  writeLineEx(1,1,"CAPL CallBack Function shows Dll Info = %s", text);
}

void CALLBACK_DllVersion(char text[])
{
  /* Callback function */
  /* This function will demonstrated an Callback with character parameters */
  writeLineEx(1,1,"CAPL CallBack Function shows Dll Version = %s", text);
}

dword CALLBACK_ShowDates(int x, dword y, int z)
{
  /* Callback function */
  /* This function will demonstrated an Callback with more than one parameters. */
  writeLineEx(1,1,"CAPL CallBack Function shows data (%d,%lx,%d) return with 1", x, y, z);
  return 1;
}

dword CALLBACK_ShowValue(dword x)
{
  /* Callback function */
  /* This function will demonstrated an Callback with one parameters. */
  writeLineEx(1,1,"CAPL CallBack Function shows value = 0x%x",x);
  return 2;
}

Help ()
{
  writeLineEx(1,1,""); 
  writeLineEx(1,1,"--------------------------------------------------------------");
  writeLineEx(1,1,""); 
  writeLineEx(1,1,"Use the keyboard to control the program");
  writeLineEx(1,1,"<1> Direct call of a CAPL Callback function");
  writeLineEx(1,1,"<2> Call of CAPL Callback Functions by the DLL");
  writeLineEx(1,1,"<3> Save data from CAPL to DLL memory");
  writeLineEx(1,1,"<4> Overwrite DLL memory from CAPL without parameter");
  writeLineEx(1,1,"<5> Save one data buffer from CAPL array to DLL");
  writeLineEx(1,1,"<6> Save two data buffer from CAPL array to DLL");
  writeLineEx(1,1,"<7> Calculate the value by the DLL");
  writeLineEx(1,1,"<8> Support of long function names");
  writeLineEx(1,1,"<9> Calculate the sum of many parameters by the DLL");
  writeLineEx(1,1,"<h> Help");
  writeLineEx(1,1,""); 
  writeLineEx(1,1,"--------------------------------------------------------------");
}



