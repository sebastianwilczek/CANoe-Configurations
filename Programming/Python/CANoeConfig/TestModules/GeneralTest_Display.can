/*@!Encoding:1252*/
includes
{
  
}

variables
{
  
}

void MainTest ()
{
  tcsDisplay();
}

testcase tcsDisplay()
{
  //Stimulation: Turn on HeadLight
  $HeadLight = 1;
  testWaitForTimeout (50);
  
  //TestSequence
  if (testWaitForSignalMatch (sysvar::Lights::LightDisplay, 4, 2000) == 1)
    testStepPass("HeadLight", "HeadLight is turned on");
  else
    testStepFail("HeadLight", "The HeadLight could not be turned on");
  
  //Completion: Turn on HeadLight
  $HeadLight = 0;
  testWaitForTimeout (50);
  
}

