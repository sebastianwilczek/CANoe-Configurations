/*@!Encoding:1252*/
includes
{
  
}

variables
{
  
}

void MainTest ()
{
  tcsLightTest();
}

testcase tcsLightTest()
{
  //Stimulation: Turn on Hazard
  @sysvar::Lights::HazardLightsSwitch = 1;
  testWaitForTimeout (100);
  
  //TestSequence
  if (testWaitForSignalMatch (FlashLight, 1, 200) == 1)
    testStepPass("FlashLight", "FlashLight is turned on");
  else
    testStepFail("FlashLight", "The FlashLight could not be turned on");
  
  //Completion: Turn on HeadLight
  @sysvar::Lights::HazardLightsSwitch = 0;
  testWaitForTimeout (50);
}

