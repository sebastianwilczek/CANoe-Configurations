/*@!Encoding:1252*/
includes
{
  
}

variables
{
  
}

void MainTest ()
{
  tcsEngineTest2();
}

testcase tcsEngineTest2()
{
  testStep ("Engine", "This is the second EngineTest");
  testWaitForTimeout (500);
}

