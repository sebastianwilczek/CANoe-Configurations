/*@!Encoding:1252*/
includes
{
  
}

variables
{
  
}

void MainTest ()
{
  tcsMsgCycleTimes();
}

testcase tcsMsgCycleTimes()
{
//  **************************************************************************
//  This TestCase checks for relative cycle time violations of the nodes
//  Engine and Light. The checks are added to the TestModule as Condition
//  for automatic reporting.
//  **************************************************************************
  
  dword chkEngine;
  dword chkLight;
  
  chkEngine = ChkCreate_NodeMsgsRelCycleTimeViolation (Engine, 0.8, 1.2);
  chkLight = ChkCreate_NodeMsgsRelCycleTimeViolation (Light, 0.8, 1.2);
  
  ChkControl_Start (chkEngine);
  testAddCondition (chkEngine);
  ChkControl_Start (chkLight);
  testAddCondition (chkLight);
  
  testWaitForTimeout (5000);
  
  ChkControl_Stop (chkEngine);
  testRemoveCondition (chkEngine);
  ChkControl_Stop (chkLight);
  testRemoveCondition (chkLight);   
}

