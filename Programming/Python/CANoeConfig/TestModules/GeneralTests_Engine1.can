/*@!Encoding:1252*/
includes
{
  
}

variables
{
  
}

void MainTest ()
{
  tcsEngineTest1();
}

testcase tcsEngineTest1()
{
  dword stmRampEngSpeed;
  int tmUp, tmHigh, tmDown, tmLow;
  
  tmUp    = 3000;
  tmHigh  = 150;
  tmDown  = 3000;
  tmLow   = 20;
  
  stmRampEngSpeed = StmCreate_Ramp (sysvar::Engine::EngineSpeedEntry, 0, 3500, 100, tmUp, tmHigh, tmDown, tmLow);
  StmControl_Start (stmRampEngSpeed);
  
  //Preparation: Turn on Engine
  @Engine::EngineStateSwitch = 1;
  
  // Test Sequence
  if (testWaitForSignalInRange (EngineSpeed, 3450, 3550, 4000) == 1)
    testStepPass ("EngineSpeed", "Engine Speed correct");
  else
    testStepFail ("EngineSpeed", "Timeout or General Error");
  
  //Completion: Turn off Engine
  StmControl_Stop (stmRampEngSpeed);
  @Engine::EngineStateSwitch = 1;
  $EngineSpeed = 0;
  @Engine::EngineSpeedEntry =0; 
}

