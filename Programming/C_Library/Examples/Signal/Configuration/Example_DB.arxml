AUTOSAR XML (schema 4-0-3)
package /SYSTEM
  system New_Element_214
package /Example_DB
  can cluster Example_DB: protocol-name=CAN, speed=250000
    can physical channel CANChannel: comm-connectors=[Connector_Node_A, Connector_ECU_B]
      frame Frame_A: id 0x1, from ECU_A, to ECU_B, frame-length=8, can-addressing-mode=STANDARD
        pdu PDU_A: length=8, transmission-mode-true-timing=cyclic-timing={time-offset=0.01, time-period=0.05}
          signal Signal_A1: start 0, 32 bit, little-endian, data-type-policy=OVERRIDE, compu {phys=(-1000+0.001*raw)/(1+0*raw) for raw ..2000000}, to ECU_B
          signal Signal_A2: start 32, 8 bit, little-endian, data-type-policy=OVERRIDE, to ECU_B
      frame Frame_B: id 0x2, from ECU_B, to ECU_A, frame-length=8, can-addressing-mode=STANDARD
        pdu PDU_B: length=8, transmission-mode-true-timing=cyclic-timing={time-offset=0.02, time-period=0.05}
          signal Signal_B1: start 0, 32 bit, little-endian, data-type-policy=OVERRIDE, compu {phys=(-1000+0.001*raw)/(1+0*raw) for raw ..2000000}, to ECU_A
          signal Signal_B2: start 32, 8 bit, little-endian, data-type-policy=OVERRIDE, to ECU_A
package /ECU_INSTANCES
  ecu instance ECU_A: diagnostic-address=0, sleep-mode-supported=false, wake-up-over-bus-supported=false
    can communication controller Controller_Node_A
    can communication connector Connector_Node_A: comm-controller=Controller_Node_A
  ecu instance ECU_B: diagnostic-address=0, sleep-mode-supported=false, wake-up-over-bus-supported=false
    can communication controller Controller_ECU_B
    can communication connector Connector_ECU_B: comm-controller=Controller_ECU_B
