/*@@var:*/
variables
{
   msTimer tTestTimer;
   dword gTestTimeout = 5000;
}
/*@@end*/

/*@@startStart:Start:*/
on start
{
   @sysvar::COMAutomation::TestCompleted = 0;

   setTimer( tTestTimer, gTestTimeout);
}
/*@@end*/

/*@@timer:tTestTimer:*/
on timer tTestTimer
{
   @sysvar::COMAutomation::TestCompleted = 1;
}
/*@@end*/

