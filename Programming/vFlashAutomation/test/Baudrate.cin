/*@!Encoding:1252*/
/*
  Read out the actual baud rate, set the new baud rate and returns the previous baud rate.
  This can be done only with a CAN bus, neither LIN nor FlexRay.
*/
float SetBaudRate(float newBaudRate, int channel)
{
  float oldBaudRate = 0;
  char buffer[200]; // buffer for logging to the write window
  CANSettings settings; // settings of the CAN bus

  // Read the CAN settings including the actual baud rate:
  if (canGetConfiguration(channel, settings))
  {
    oldBaudRate = settings.baudrate; // remember the old baud rate to be returned in the end.
    snprintf(buffer, elcount(buffer), "CheckBaudRate: old baud rate=%f", settings.baudrate);
  }
  else
  {
    writeLineEX(1, 3, "ERROR: Cannot get CAN settings and baud rate.");
    return 0;
  }

  // Check if the baud rate needs to be switched
  if (settings.baudrate != newBaudRate)
  {
    // Set new baud rate
    settings.baudrate = newBaudRate;
    settings.flags = 0; // 0= Normal mode
    if (canSetConfiguration(channel, settings))
    {
      write("SetBaudRate: Successfully set new baud rate to %f", settings.baudrate);
    }
    else
    {
      writeLineEX(1, 3, "ERROR: Cannot set CAN settings and baud rate.");
      return 0;
    }
  }

  // return the old baud rate that was set before switching
  return oldBaudRate; 
}
