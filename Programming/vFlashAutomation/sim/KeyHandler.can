/*@!Encoding:1252*/
includes
{
  #include "vFlash/Utilities.cin"
}

variables
{
  char gFlashpack[cMaxPathNameLen] = "";
}

on key F4 // Button on VN89xx
{
  @sysvar::vFlash::StartReprogramming=1;
}

on key F2 // Button on VN88xx and VN89xx
{
  @sysvar::vFlash::StartReprogramming=1;
}

// Will be called when the flash progress changed
void vFlashProgramProgressCallback(DWORD progressInPercent, DWORD remainingTimeInS)
{
  @vFlash::Progress = progressInPercent;
  if (progressInPercent == 100) {
    write ("Flashing done!");
  }
  @vFlash::RemainingTime = remainingTimeInS;
}

on key 'f'
{
  if (@vFlash::RemainingTime>0) {
    write( "Flash request ignored, flash process is still in progress!");
  }
  else {
    write( "Calling vFlashStartPackReprogramming (loading flashpack may need a few seconds)...");
    @vFlash::RemainingTime=100; // Set to value != 0
    vFlashStartPackReprogramming("flashpacks\\demo.vflashpack");
  }
}
