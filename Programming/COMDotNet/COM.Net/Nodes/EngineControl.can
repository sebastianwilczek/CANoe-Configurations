variables
{

}

// Used for display purposes.
on signal EngineSpeed
{
	@sysvar::Display::SetRPM = this / 1000.0;
}