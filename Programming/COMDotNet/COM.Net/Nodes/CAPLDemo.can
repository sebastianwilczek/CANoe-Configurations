includes
{
  
}

variables
{
  
}

// Called via COM interface.
int Multiply(long a, long b)
{  
  write("%d * %d = %d", a, b, a * b);
  
  return(a * b);
}
