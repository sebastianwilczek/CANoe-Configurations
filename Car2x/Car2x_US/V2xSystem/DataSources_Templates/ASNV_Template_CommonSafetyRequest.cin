/*@!Encoding:1252*/
/*
//  (c) Vector Informatik GmbH. All rights reserved.
//
//  This file contains definitions of structs and methods that may be used
//  to set and get the values of an ASN.1 defined packet's payload.
//
//  //This example demonstrates how to set a packet's payload:
//  LONG packetHandle;
//  struct CommonSafetyRequest payload;
//  //you need to set the values of the variable "payload" yourself
//  packetHandle = API_InitCommonSafetyRequestPacket();
//  if (packetHandle!=0) {
//    if (API_SetCommonSafetyRequestParams(packetHandle, payload)==0) {
//      if (C2xCompletePacket(packetHandle)==0) {
//        C2xOutputPacket(packetHandle);
//      }
//    }
//  }
//                                                                             */
includes
{

}
variables
{
    struct CommonSafetyRequestTemporaryID {
        INT isValidFlag;   // necessary if this struct is used as an optional field of a SEQUENCE
        CHAR string[5];
        INT  stringLength;
    };
    
    struct CommonSafetyRequestRequestedItemList {
        INT isValidFlag;   // necessary if this struct is used as an optional field of a SEQUENCE
        INT length;
        INT arrayValue[32];  // ENUMERATED, reserved(0), itemA(1), itemB(2), itemC(3), itemD(4), itemE(5), itemF(6), itemG(7), itemI(8), itemJ(9), itemK(10), itemL(11), itemM(12), itemN(13), itemO(14), itemP(15), itemQ(16);
    };
    
    struct CommonSafetyRequestREG_EXT_ID_AND_TYPE_Empty {
    };
    
    struct CommonSafetyRequestRegionalExtensionCommonSafetyRequest {
        INT isValidFlag;   // necessary if this struct is used as an optional field of a SEQUENCE
        BYTE regionId;  // INTEGER, 0..255, noRegion(0), addGrpA(1), addGrpB(2), addGrpC(3);
        struct CommonSafetyRequestREG_EXT_ID_AND_TYPE_Empty regExtValue;  // TABLE;
    };
    
    struct CommonSafetyRequest_CommonSafetyRequest_regional {
        INT isValidFlag;   // necessary if this struct is used as an optional field of a SEQUENCE
        INT length;
        struct CommonSafetyRequestRegionalExtensionCommonSafetyRequest arrayValue[4];  // SEQUENCE;
    };
    
    struct CommonSafetyRequestCSR {
        INT isValidFlag;   // necessary if this struct is used as an optional field of a SEQUENCE
        struct OPT_DWORD_ASN timeStamp;  // INTEGER, OPTIONAL, 0..527040;
        struct OPT_BYTE_ASN msgCnt;  // INTEGER, OPTIONAL, 0..127;
        struct CommonSafetyRequestTemporaryID id;  // OCTETSTRING, OPTIONAL;
        struct CommonSafetyRequestRequestedItemList requests;  // SEQUENCEOF;
        struct CommonSafetyRequest_CommonSafetyRequest_regional regional;  // SEQUENCEOF, OPTIONAL;
    };
    
    struct CommonSafetyRequestMESSAGE_ID_AND_TYPE {
        struct CommonSafetyRequestCSR commonSafetyRequest;  // SEQUENCE;
    };
    
    struct CommonSafetyRequest {
        INT isValidFlag;   // necessary if this struct is used as an optional field of a SEQUENCE
        WORD messageId;  // INTEGER, 0..32767, reservedMessageId_D(0), alaCarteMessage_D(1), basicSafetyMessage_D(2), basicSafetyMessageVerbose_D(3), commonSafetyRequest_D(4), emergencyVehicleAlert_D(5), intersectionCollision_D(6), mapData_D(7), nmeaCorrections_D(8), probeDataManagement_D(9), probeVehicleData_D(10), roadSideAlert_D(11), rtcmCorrections_D(12), signalPhaseAndTimingMessage_D(13), signalRequestMessage_D(14), signalStatusMessage_D(15), travelerInformation_D(16), uperFrame_D(17), mapData(18), signalPhaseAndTimingMessage(19), basicSafetyMessage(20), commonSafetyRequest(21), emergencyVehicleAlert(22), intersectionCollision(23), nmeaCorrections(24), probeDataManagement(25), probeVehicleData(26), roadSideAlert(27), rtcmCorrections(28), signalRequestMessage(29), signalStatusMessage(30), travelerInformation(31), personalSafetyMessage(32), testMessage00(240), testMessage01(241), testMessage02(242), testMessage03(243), testMessage04(244), testMessage05(245), testMessage06(246), testMessage07(247), testMessage08(248), testMessage09(249), testMessage10(250), testMessage11(251), testMessage12(252), testMessage13(253), testMessage14(254), testMessage15(255);
        struct CommonSafetyRequestMESSAGE_ID_AND_TYPE value;  // TABLE;
    };
    
}

/*
// init function to create a simple packet handle
*/ 
LONG API_InitCommonSafetyRequestPacket()
{
  return C2xInitPacket("CommonSafetyRequest"); 
}

/*
// init function to create a simple packet handle and
// initialize the struct with valid data
*/ 
LONG API_InitCommonSafetyRequestPacket(struct CommonSafetyRequest msgStruct)
{
  long pktHandle;

  pktHandle = API_InitCommonSafetyRequestPacket();

  if (pktHandle != 0)
  {
    // create valid message and application data
    if (C2xCompletePacket(pktHandle) == 0) 
    {
      API_GetCommonSafetyRequestParams(pktHandle, msgStruct);
    }
  }
  return pktHandle;
}

/*
// init function to create a packet with security layer and
// initialize the struct with valid data
*/ 
LONG API_InitCommonSafetyRequestPacket(struct CommonSafetyRequest msgStruct, char packetTypeDesignator[], char certificateName[])
{
  long pktHandle, certHdl;

  // initialize the packet
  pktHandle = C2xInitPacket("CommonSafetyRequest", packetTypeDesignator);

  if (pktHandle != 0)
  {
    certHdl = C2xSecCertificateGetHandle(certificateName);  // get the certificate handle for the cert with name "certificateName"
    if (certHdl != 0) 
    {
      C2xSecPacketSetSignerHandle(pktHandle, certHdl); // set the certHdl to the packet
    }

    // create valid message and application data
    if (C2xCompletePacket(pktHandle) == 0) 
    {
      // copy application data to the application structure
      API_GetCommonSafetyRequestParams(pktHandle, msgStruct);
    }
  }
  return pktHandle;
}
    

int GetCommonSafetyRequestRequestedItemListParams(LONG packetHandle, struct CommonSafetyRequestRequestedItemList value, char oldPath[])
{
  char newPath[300]; 
  int i;
  int result;

  result = 0;

  value.length = C2xGetTokenInt(packetHandle, "CommonSafetyRequest", oldPath);
  if((result = CheckLastError("CommonSafetyRequest", gkFuncRefGet, result))==0)
  {
    for(i=0; i<value.length; i++)
    {
      snprintf(newPath, elcount(newPath), "%s[%d]", oldPath, i);
      value.arrayValue[i] = C2xGetTokenInt64(packetHandle, "CommonSafetyRequest", newPath);
      result = CheckLastError("CommonSafetyRequest", gkFuncRefGet, result);
    }
  }
  return result;
}

int SetCommonSafetyRequestRequestedItemListParams(LONG packetHandle, struct CommonSafetyRequestRequestedItemList value, char oldPath[])
{
  char newPath[300]; 
  int i;
  int result;

  result = 0;

  C2xRemoveToken(packetHandle, "CommonSafetyRequest", oldPath);
  for(i=0; i<value.length; i++)
  {
    snprintf(newPath, elcount(newPath), "%s[%d]", oldPath, i);
    C2xSetTokenInt64(packetHandle, "CommonSafetyRequest", newPath, value.arrayValue[i]);
    result = CheckLastError("CommonSafetyRequest", gkFuncRefGet, result);
  }
  return result;
}

int GetCommonSafetyRequestRegionalExtensionCommonSafetyRequestParams(LONG packetHandle, struct CommonSafetyRequestRegionalExtensionCommonSafetyRequest value, char oldPath[])
{
  char newPath[300];
  int result;

  result = 0;

  snprintf(newPath, elcount(newPath), "%s.%s", oldPath, "regionId");
  value.regionId = C2xGetTokenInt(packetHandle, "CommonSafetyRequest", newPath);
  result = CheckLastError("CommonSafetyRequest", gkFuncRefGet, result);

  return result;
}

int SetCommonSafetyRequestRegionalExtensionCommonSafetyRequestParams(LONG packetHandle, struct CommonSafetyRequestRegionalExtensionCommonSafetyRequest value, char oldPath[])
{
  char newPath[300];
  int result;

  result = 0;


  return result;
}

int GetCommonSafetyRequest_CommonSafetyRequest_regionalParams(LONG packetHandle, struct CommonSafetyRequest_CommonSafetyRequest_regional value, char oldPath[])
{
  char newPath[300]; 
  int i;
  int result;

  result = 0;

  value.length = C2xGetTokenInt(packetHandle, "CommonSafetyRequest", oldPath);
  if((result = CheckLastError("CommonSafetyRequest", gkFuncRefGet, result))==0)
  {
    for(i=0; i<value.length; i++)
    {
      snprintf(newPath, elcount(newPath), "%s[%d]", oldPath, i);
      GetCommonSafetyRequestRegionalExtensionCommonSafetyRequestParams(packetHandle, value.arrayValue[i], newPath);
      result = CheckLastError("CommonSafetyRequest", gkFuncRefGet, result);
    }
  }
  return result;
}

int SetCommonSafetyRequest_CommonSafetyRequest_regionalParams(LONG packetHandle, struct CommonSafetyRequest_CommonSafetyRequest_regional value, char oldPath[])
{
  char newPath[300]; 
  int i;
  int result;

  result = 0;

  C2xRemoveToken(packetHandle, "CommonSafetyRequest", oldPath);
  for(i=0; i<value.length; i++)
  {
    snprintf(newPath, elcount(newPath), "%s[%d]", oldPath, i);
    SetCommonSafetyRequestRegionalExtensionCommonSafetyRequestParams(packetHandle, value.arrayValue[i], newPath);
    result = CheckLastError("CommonSafetyRequest", gkFuncRefGet, result);
  }
  return result;
}

int GetCommonSafetyRequestCSRParams(LONG packetHandle, struct CommonSafetyRequestCSR value, char oldPath[])
{
  char newPath[300];
  int result;

  result = 0;

  snprintf(newPath, elcount(newPath), "%s.%s", oldPath, "timeStamp");
  value.timeStamp.isValidFlag = C2xIsTokenAvailable(packetHandle, "CommonSafetyRequest", newPath);
  if(value.timeStamp.isValidFlag==1)
  {
    value.timeStamp.value = C2xGetTokenInt(packetHandle, "CommonSafetyRequest", newPath);
    result = CheckLastError("CommonSafetyRequest", gkFuncRefGet, result);
  }
  snprintf(newPath, elcount(newPath), "%s.%s", oldPath, "msgCnt");
  value.msgCnt.isValidFlag = C2xIsTokenAvailable(packetHandle, "CommonSafetyRequest", newPath);
  if(value.msgCnt.isValidFlag==1)
  {
    value.msgCnt.value = C2xGetTokenInt(packetHandle, "CommonSafetyRequest", newPath);
    result = CheckLastError("CommonSafetyRequest", gkFuncRefGet, result);
  }
  snprintf(newPath, elcount(newPath), "%s.%s", oldPath, "id");
  value.id.isValidFlag = C2xIsTokenAvailable(packetHandle, "CommonSafetyRequest", newPath);
  if(value.id.isValidFlag==1)
  {
    value.id.isValidFlag = 1;
    value.id.stringLength = C2xGetTokenData(packetHandle, "CommonSafetyRequest", newPath, elcount(value.id.string), value.id.string);
  }
  snprintf(newPath, elcount(newPath), "%s.%s", oldPath, "requests");
  GetCommonSafetyRequestRequestedItemListParams(packetHandle, value.requests, newPath);
  result = CheckLastError("CommonSafetyRequest", gkFuncRefGet, result);

  snprintf(newPath, elcount(newPath), "%s.%s", oldPath, "regional");
  value.regional.isValidFlag = C2xIsTokenAvailable(packetHandle, "CommonSafetyRequest", newPath);
  if(value.regional.isValidFlag==1)
  {
    GetCommonSafetyRequest_CommonSafetyRequest_regionalParams(packetHandle, value.regional, newPath);
    result = CheckLastError("CommonSafetyRequest", gkFuncRefGet, result);
  }
  return result;
}

int SetCommonSafetyRequestCSRParams(LONG packetHandle, struct CommonSafetyRequestCSR value, char oldPath[])
{
  char newPath[300];
  int result;

  result = 0;

  snprintf(newPath, elcount(newPath), "%s.%s", oldPath, "timeStamp");
  if(value.timeStamp.isValidFlag==1)
  {
    C2xSetTokenInt(packetHandle, "CommonSafetyRequest", newPath, value.timeStamp.value);
    result = CheckLastError("CommonSafetyRequest", gkFuncRefGet, result);
  }
  else
  {
    if( C2xIsTokenAvailable(packetHandle, "CommonSafetyRequest", newPath) )
    {
      C2xRemoveToken(packetHandle, "CommonSafetyRequest", newPath);
    }
  }

  snprintf(newPath, elcount(newPath), "%s.%s", oldPath, "msgCnt");
  if(value.msgCnt.isValidFlag==1)
  {
    C2xSetTokenInt(packetHandle, "CommonSafetyRequest", newPath, value.msgCnt.value);
    result = CheckLastError("CommonSafetyRequest", gkFuncRefGet, result);
  }
  else
  {
    if( C2xIsTokenAvailable(packetHandle, "CommonSafetyRequest", newPath) )
    {
      C2xRemoveToken(packetHandle, "CommonSafetyRequest", newPath);
    }
  }

  if(value.id.stringLength == 0)
  {
    value.id.stringLength = 4;
    memcpy(value.id.string, "0000", value.id.stringLength);
  }

  snprintf(newPath, elcount(newPath), "%s.%s", oldPath, "id");
  if(value.id.isValidFlag==1)
  {
    C2xSetTokenData(packetHandle, "CommonSafetyRequest", newPath, value.id.stringLength, value.id.string);
  }
  else
  {
    if( C2xIsTokenAvailable(packetHandle, "CommonSafetyRequest", newPath) )
    {
      C2xRemoveToken(packetHandle, "CommonSafetyRequest", newPath);
    }
  }

  snprintf(newPath, elcount(newPath), "%s.%s", oldPath, "requests");
  SetCommonSafetyRequestRequestedItemListParams(packetHandle, value.requests, newPath);
  result = CheckLastError("CommonSafetyRequest", gkFuncRefGet, result);

  snprintf(newPath, elcount(newPath), "%s.%s", oldPath, "regional");
  if(value.regional.isValidFlag==1)
  {
    SetCommonSafetyRequest_CommonSafetyRequest_regionalParams(packetHandle, value.regional, newPath);
    result = CheckLastError("CommonSafetyRequest", gkFuncRefGet, result);
  }
  else
  {
    if( C2xIsTokenAvailable(packetHandle, "CommonSafetyRequest", newPath) )
    {
      C2xRemoveToken(packetHandle, "CommonSafetyRequest", newPath);
    }
  }

  return result;
}

int GetCommonSafetyRequestMESSAGE_ID_AND_TYPEParams(LONG packetHandle, WORD tableKey, struct CommonSafetyRequestMESSAGE_ID_AND_TYPE value, char oldPath[])
{
  char newPath[300];
  int result;

  result = 0;

  switch(tableKey)
  {
    case 21:
    {
      snprintf(newPath, elcount(newPath), "%s.%s", oldPath, "commonSafetyRequest");
      GetCommonSafetyRequestCSRParams(packetHandle, value.commonSafetyRequest, newPath);
      result = CheckLastError("CommonSafetyRequest", gkFuncRefGet, result);
    }
    break;
  }
  return result;
}

int SetCommonSafetyRequestMESSAGE_ID_AND_TYPEParams(LONG packetHandle, WORD tableKey, struct CommonSafetyRequestMESSAGE_ID_AND_TYPE value, char oldPath[])
{
  char newPath[300];
  int result;

  result = 0;

  switch(tableKey)
  {
    case 21:
    {
      snprintf(newPath, elcount(newPath), "%s.%s", oldPath, "commonSafetyRequest");
      SetCommonSafetyRequestCSRParams(packetHandle, value.commonSafetyRequest, newPath);
      result = CheckLastError("CommonSafetyRequest", gkFuncRefGet, result);
    }
    break;
  }
  return result;
}

int API_GetCommonSafetyRequestParams(LONG packetHandle, struct CommonSafetyRequest value)
{
  int result;
  result = 0;

  value.messageId = C2xGetTokenInt(packetHandle, "CommonSafetyRequest", "messageId");
  result = CheckLastError("CommonSafetyRequest", gkFuncRefGet, result);

  GetCommonSafetyRequestMESSAGE_ID_AND_TYPEParams(packetHandle, value.messageId, value.value, "value");
  result = CheckLastError("CommonSafetyRequest", gkFuncRefGet, result);

  return result;
}

int API_SetCommonSafetyRequestParams(LONG packetHandle, struct CommonSafetyRequest value)
{
  int result;
  result = 0;

  value.messageId = 21;

  SetCommonSafetyRequestMESSAGE_ID_AND_TYPEParams(packetHandle, value.messageId, value.value, "value");
  result = CheckLastError("CommonSafetyRequest", gkFuncRefGet, result);

  return result;
}

