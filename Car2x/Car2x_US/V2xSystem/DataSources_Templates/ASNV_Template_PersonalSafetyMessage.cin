/*@!Encoding:1252*/
/*
//  (c) Vector Informatik GmbH. All rights reserved.
//
//  This file contains definitions of structs and methods that may be used
//  to set and get the values of an ASN.1 defined packet's payload.
//
//  //This example demonstrates how to set a packet's payload:
//  LONG packetHandle;
//  struct PersonalSafetyMessage payload;
//  //you need to set the values of the variable "payload" yourself
//  packetHandle = API_InitPersonalSafetyMessagePacket();
//  if (packetHandle!=0) {
//    if (API_SetPersonalSafetyMessageParams(packetHandle, payload)==0) {
//      if (C2xCompletePacket(packetHandle)==0) {
//        C2xOutputPacket(packetHandle);
//      }
//    }
//  }
//                                                                             */
includes
{

}
variables
{
    struct PersonalSafetyMessageTemporaryID {
        INT isValidFlag;   // necessary if this struct is used as an optional field of a SEQUENCE
        CHAR string[5];
        INT  stringLength;
    };
    
    struct PersonalSafetyMessage_AddGrpB_LatitudeDMS2 {
        INT isValidFlag;   // necessary if this struct is used as an optional field of a SEQUENCE
        INT d;  // INTEGER, -90..90;
        BYTE m;  // INTEGER, 0..59;
        WORD s;  // INTEGER, 0..5999;
    };
    
    struct PersonalSafetyMessage_AddGrpB_LongitudeDMS2 {
        INT isValidFlag;   // necessary if this struct is used as an optional field of a SEQUENCE
        INT d;  // INTEGER, -180..180;
        BYTE m;  // INTEGER, 0..59;
        WORD s;  // INTEGER, 0..5999;
    };
    
    struct PersonalSafetyMessage_AddGrpB_Position3D_addGrpB {
        INT isValidFlag;   // necessary if this struct is used as an optional field of a SEQUENCE
        struct PersonalSafetyMessage_AddGrpB_LatitudeDMS2 latitude;  // SEQUENCE;
        struct PersonalSafetyMessage_AddGrpB_LongitudeDMS2 longitude;  // SEQUENCE;
        INT elevation;  // INTEGER, -32768..32767;
    };
    
    struct PersonalSafetyMessage_AddGrpC_Altitude {
        INT isValidFlag;   // necessary if this struct is used as an optional field of a SEQUENCE
        LONG value;  // INTEGER, -100000..800001;
        INT confidence;  // ENUMERATED, alt_000_01(0), alt_000_02(1), alt_000_05(2), alt_000_10(3), alt_000_20(4), alt_000_50(5), alt_001_00(6), alt_002_00(7), alt_005_00(8), alt_010_00(9), alt_020_00(10), alt_050_00(11), alt_100_00(12), alt_200_00(13), outOfRange(14), unavailable(15);
    };
    
    struct PersonalSafetyMessage_AddGrpC_Position3D_addGrpC {
        INT isValidFlag;   // necessary if this struct is used as an optional field of a SEQUENCE
        struct PersonalSafetyMessage_AddGrpC_Altitude altitude;  // SEQUENCE;
    };
    
    struct PersonalSafetyMessageREG_EXT_ID_AND_TYPE_Position3D {
        struct PersonalSafetyMessage_AddGrpB_Position3D_addGrpB addGrpB;  // SEQUENCE;
        struct PersonalSafetyMessage_AddGrpC_Position3D_addGrpC addGrpC;  // SEQUENCE;
    };
    
    struct PersonalSafetyMessageRegionalExtensionPosition3D {
        INT isValidFlag;   // necessary if this struct is used as an optional field of a SEQUENCE
        BYTE regionId;  // INTEGER, 0..255, noRegion(0), addGrpA(1), addGrpB(2), addGrpC(3);
        struct PersonalSafetyMessageREG_EXT_ID_AND_TYPE_Position3D regExtValue;  // TABLE;
    };
    
    struct PersonalSafetyMessage_Position3D_regional {
        INT isValidFlag;   // necessary if this struct is used as an optional field of a SEQUENCE
        INT length;
        struct PersonalSafetyMessageRegionalExtensionPosition3D arrayValue[4];  // SEQUENCE;
    };
    
    struct PersonalSafetyMessagePosition3D {
        INT isValidFlag;   // necessary if this struct is used as an optional field of a SEQUENCE
        LONG lat;  // INTEGER, -900000000..900000001;
        LONG lon;  // INTEGER, -1799999999..1800000001;
        struct OPT_LONG_ASN elevation;  // INTEGER, OPTIONAL, -4096..61439;
        struct PersonalSafetyMessage_Position3D_regional regional;  // SEQUENCEOF, OPTIONAL;
    };
    
    struct PersonalSafetyMessagePositionalAccuracy {
        INT isValidFlag;   // necessary if this struct is used as an optional field of a SEQUENCE
        BYTE semiMajor;  // INTEGER, 0..255;
        BYTE semiMinor;  // INTEGER, 0..255;
        WORD orientation;  // INTEGER, 0..65535;
    };
    
    struct PersonalSafetyMessageAccelerationSet4Way {
        INT isValidFlag;   // necessary if this struct is used as an optional field of a SEQUENCE
        INT lon;  // INTEGER, -2000..2001;
        INT lat;  // INTEGER, -2000..2001;
        INT vert;  // INTEGER, -127..127;
        INT yaw;  // INTEGER, -32767..32767;
    };
    
    struct PersonalSafetyMessageDDateTime {
        INT isValidFlag;   // necessary if this struct is used as an optional field of a SEQUENCE
        struct OPT_WORD_ASN year;  // INTEGER, OPTIONAL, 0..4095;
        struct OPT_BYTE_ASN month;  // INTEGER, OPTIONAL, 0..12;
        struct OPT_BYTE_ASN day;  // INTEGER, OPTIONAL, 0..31;
        struct OPT_BYTE_ASN hour;  // INTEGER, OPTIONAL, 0..31;
        struct OPT_BYTE_ASN minute;  // INTEGER, OPTIONAL, 0..60;
        struct OPT_WORD_ASN second;  // INTEGER, OPTIONAL, 0..65535;
        struct OPT_INT_ASN offset;  // INTEGER, OPTIONAL, -840..840;
    };
    
    struct PersonalSafetyMessageTransmissionAndSpeed {
        INT isValidFlag;   // necessary if this struct is used as an optional field of a SEQUENCE
        INT transmisson;  // ENUMERATED, neutral(0), park(1), forwardGears(2), reverseGears(3), reserved1(4), reserved2(5), reserved3(6), unavailable(7);
        WORD speed;  // INTEGER, 0..8191;
    };
    
    struct PersonalSafetyMessagePositionConfidenceSet {
        INT isValidFlag;   // necessary if this struct is used as an optional field of a SEQUENCE
        INT pos;  // ENUMERATED, unavailable(0), a500m(1), a200m(2), a100m(3), a50m(4), a20m(5), a10m(6), a5m(7), a2m(8), a1m(9), a50cm(10), a20cm(11), a10cm(12), a5cm(13), a2cm(14), a1cm(15);
        INT elevation;  // ENUMERATED, unavailable(0), elev_500_00(1), elev_200_00(2), elev_100_00(3), elev_050_00(4), elev_020_00(5), elev_010_00(6), elev_005_00(7), elev_002_00(8), elev_001_00(9), elev_000_50(10), elev_000_20(11), elev_000_10(12), elev_000_05(13), elev_000_02(14), elev_000_01(15);
    };
    
    struct PersonalSafetyMessageSpeedandHeadingandThrottleConfidence {
        INT isValidFlag;   // necessary if this struct is used as an optional field of a SEQUENCE
        INT heading;  // ENUMERATED, unavailable(0), prec10deg(1), prec05deg(2), prec01deg(3), prec0_1deg(4), prec0_05deg(5), prec0_01deg(6), prec0_0125deg(7);
        INT speed;  // ENUMERATED, unavailable(0), prec100ms(1), prec10ms(2), prec5ms(3), prec1ms(4), prec0_1ms(5), prec0_05ms(6), prec0_01ms(7);
        INT throttle;  // ENUMERATED, unavailable(0), prec10percent(1), prec1percent(2), prec0_5percent(3);
    };
    
    struct PersonalSafetyMessageFullPositionVector {
        INT isValidFlag;   // necessary if this struct is used as an optional field of a SEQUENCE
        struct PersonalSafetyMessageDDateTime utcTime;  // SEQUENCE, OPTIONAL;
        LONG lon;  // INTEGER, -1799999999..1800000001;
        LONG lat;  // INTEGER, -900000000..900000001;
        struct OPT_LONG_ASN elevation;  // INTEGER, OPTIONAL, -4096..61439;
        struct OPT_WORD_ASN heading;  // INTEGER, OPTIONAL, 0..28800;
        struct PersonalSafetyMessageTransmissionAndSpeed speed;  // SEQUENCE, OPTIONAL;
        struct PersonalSafetyMessagePositionalAccuracy posAccuracy;  // SEQUENCE, OPTIONAL;
        struct OPT_ENUM_ASN timeConfidence;  // ENUMERATED, OPTIONAL, unavailable(0), time_100_000(1), time_050_000(2), time_020_000(3), time_010_000(4), time_002_000(5), time_001_000(6), time_000_500(7), time_000_200(8), time_000_100(9), time_000_050(10), time_000_020(11), time_000_010(12), time_000_005(13), time_000_002(14), time_000_001(15), time_000_000_5(16), time_000_000_2(17), time_000_000_1(18), time_000_000_05(19), time_000_000_02(20), time_000_000_01(21), time_000_000_005(22), time_000_000_002(23), time_000_000_001(24), time_000_000_000_5(25), time_000_000_000_2(26), time_000_000_000_1(27), time_000_000_000_05(28), time_000_000_000_02(29), time_000_000_000_01(30), time_000_000_000_005(31), time_000_000_000_002(32), time_000_000_000_001(33), time_000_000_000_000_5(34), time_000_000_000_000_2(35), time_000_000_000_000_1(36), time_000_000_000_000_05(37), time_000_000_000_000_02(38), time_000_000_000_000_01(39);
        struct PersonalSafetyMessagePositionConfidenceSet posConfidence;  // SEQUENCE, OPTIONAL;
        struct PersonalSafetyMessageSpeedandHeadingandThrottleConfidence speedConfidence;  // SEQUENCE, OPTIONAL;
    };
    
    struct PersonalSafetyMessageGNSSstatus {
        INT isValidFlag;   // necessary if this struct is used as an optional field of a SEQUENCE
        CHAR string[9];
        INT  stringLength;
    };
    
    struct PersonalSafetyMessagePathHistoryPoint {
        INT isValidFlag;   // necessary if this struct is used as an optional field of a SEQUENCE
        LONG latOffset;  // INTEGER, -131072..131071;
        LONG lonOffset;  // INTEGER, -131072..131071;
        INT elevationOffset;  // INTEGER, -2048..2047;
        WORD timeOffset;  // INTEGER, 1..65535;
        struct OPT_WORD_ASN speed;  // INTEGER, OPTIONAL, 0..8191;
        struct PersonalSafetyMessagePositionalAccuracy posAccuracy;  // SEQUENCE, OPTIONAL;
        struct OPT_BYTE_ASN heading;  // INTEGER, OPTIONAL, 0..240;
    };
    
    struct PersonalSafetyMessagePathHistoryPointList {
        INT isValidFlag;   // necessary if this struct is used as an optional field of a SEQUENCE
        INT length;
        struct PersonalSafetyMessagePathHistoryPoint arrayValue[23];  // SEQUENCE;
    };
    
    struct PersonalSafetyMessagePathHistory {
        INT isValidFlag;   // necessary if this struct is used as an optional field of a SEQUENCE
        struct PersonalSafetyMessageFullPositionVector initialPosition;  // SEQUENCE, OPTIONAL;
        struct PersonalSafetyMessageGNSSstatus currGNSSstatus;  // BITSTRING, OPTIONAL;
        struct PersonalSafetyMessagePathHistoryPointList crumbData;  // SEQUENCEOF;
    };
    
    struct PersonalSafetyMessagePathPrediction {
        INT isValidFlag;   // necessary if this struct is used as an optional field of a SEQUENCE
        INT radiusOfCurve;  // INTEGER, -32767..32767;
        BYTE confidence;  // INTEGER, 0..200;
    };
    
    struct PersonalSafetyMessagePropelledInformation {
        INT isValidFlag;   // necessary if this struct is used as an optional field of a SEQUENCE
        INT choice;
        INT human;  // ENUMERATED, unavailable(0), otherTypes(1), onFoot(2), skateboard(3), pushOrKickScooter(4), wheelchair(5);
        INT animal;  // ENUMERATED, unavailable(0), otherTypes(1), animalMounted(2), animalDrawnCarriage(3);
        INT motor;  // ENUMERATED, unavailable(0), otherTypes(1), wheelChair(2), bicycle(3), scooter(4), selfBalancingDevice(5);
    };
    
    struct PersonalSafetyMessagePersonalDeviceUsageState {
        INT isValidFlag;   // necessary if this struct is used as an optional field of a SEQUENCE
        CHAR string[10];
        INT  stringLength;
    };
    
    struct PersonalSafetyMessagePublicSafetyAndRoadWorkerActivity {
        INT isValidFlag;   // necessary if this struct is used as an optional field of a SEQUENCE
        CHAR string[7];
        INT  stringLength;
    };
    
    struct PersonalSafetyMessagePublicSafetyDirectingTrafficSubType {
        INT isValidFlag;   // necessary if this struct is used as an optional field of a SEQUENCE
        CHAR string[8];
        INT  stringLength;
    };
    
    struct PersonalSafetyMessagePersonalAssistive {
        INT isValidFlag;   // necessary if this struct is used as an optional field of a SEQUENCE
        CHAR string[7];
        INT  stringLength;
    };
    
    struct PersonalSafetyMessageUserSizeAndBehaviour {
        INT isValidFlag;   // necessary if this struct is used as an optional field of a SEQUENCE
        CHAR string[6];
        INT  stringLength;
    };
    
    struct PersonalSafetyMessageREG_EXT_ID_AND_TYPE_Empty {
    };
    
    struct PersonalSafetyMessageRegionalExtensionPersonalSafetyMessage {
        INT isValidFlag;   // necessary if this struct is used as an optional field of a SEQUENCE
        BYTE regionId;  // INTEGER, 0..255, noRegion(0), addGrpA(1), addGrpB(2), addGrpC(3);
        struct PersonalSafetyMessageREG_EXT_ID_AND_TYPE_Empty regExtValue;  // TABLE;
    };
    
    struct PersonalSafetyMessage_PersonalSafetyMessage_regional {
        INT isValidFlag;   // necessary if this struct is used as an optional field of a SEQUENCE
        INT length;
        struct PersonalSafetyMessageRegionalExtensionPersonalSafetyMessage arrayValue[4];  // SEQUENCE;
    };
    
    struct PersonalSafetyMessagePSM {
        INT isValidFlag;   // necessary if this struct is used as an optional field of a SEQUENCE
        INT basicType;  // ENUMERATED, unavailable(0), aPEDESTRIAN(1), aPEDALCYCLIST(2), aPUBLICSAFETYWORKER(3), anANIMAL(4);
        WORD secMark;  // INTEGER, 0..65535;
        BYTE msgCnt;  // INTEGER, 0..127;
        struct PersonalSafetyMessageTemporaryID id;  // OCTETSTRING;
        struct PersonalSafetyMessagePosition3D position;  // SEQUENCE;
        struct PersonalSafetyMessagePositionalAccuracy accuracy;  // SEQUENCE;
        WORD speed;  // INTEGER, 0..8191;
        WORD heading;  // INTEGER, 0..28800;
        struct PersonalSafetyMessageAccelerationSet4Way accelSet;  // SEQUENCE, OPTIONAL;
        struct PersonalSafetyMessagePathHistory pathHistory;  // SEQUENCE, OPTIONAL;
        struct PersonalSafetyMessagePathPrediction pathPrediction;  // SEQUENCE, OPTIONAL;
        struct PersonalSafetyMessagePropelledInformation propulsion;  // CHOICE, OPTIONAL;
        struct PersonalSafetyMessagePersonalDeviceUsageState useState;  // BITSTRING, OPTIONAL;
        struct OPT_BOOL_ASN crossRequest;  // BOOLEAN, OPTIONAL;
        struct OPT_BOOL_ASN crossState;  // BOOLEAN, OPTIONAL;
        struct OPT_ENUM_ASN clusterSize;  // ENUMERATED, OPTIONAL, unavailable(0), small(1), medium(2), large(3);
        struct OPT_BYTE_ASN clusterRadius;  // INTEGER, OPTIONAL, 0..100;
        struct OPT_ENUM_ASN eventResponderType;  // ENUMERATED, OPTIONAL, unavailable(0), towOperater(1), fireAndEMSWorker(2), aDOTWorker(3), lawEnforcement(4), hazmatResponder(5), animalControlWorker(6), otherPersonnel(7);
        struct PersonalSafetyMessagePublicSafetyAndRoadWorkerActivity activityType;  // BITSTRING, OPTIONAL;
        struct PersonalSafetyMessagePublicSafetyDirectingTrafficSubType activitySubType;  // BITSTRING, OPTIONAL;
        struct PersonalSafetyMessagePersonalAssistive assistType;  // BITSTRING, OPTIONAL;
        struct PersonalSafetyMessageUserSizeAndBehaviour sizing;  // BITSTRING, OPTIONAL;
        struct OPT_ENUM_ASN attachment;  // ENUMERATED, OPTIONAL, unavailable(0), stroller(1), bicycleTrailer(2), cart(3), wheelchair(4), otherWalkAssistAttachments(5), pet(6);
        struct OPT_BYTE_ASN attachmentRadius;  // INTEGER, OPTIONAL, 0..200;
        struct OPT_ENUM_ASN animalType;  // ENUMERATED, OPTIONAL, unavailable(0), serviceUse(1), pet(2), farm(3);
        struct PersonalSafetyMessage_PersonalSafetyMessage_regional regional;  // SEQUENCEOF, OPTIONAL;
    };
    
    struct PersonalSafetyMessageMESSAGE_ID_AND_TYPE {
        struct PersonalSafetyMessagePSM personalSafetyMessage;  // SEQUENCE;
    };
    
    struct PersonalSafetyMessage {
        INT isValidFlag;   // necessary if this struct is used as an optional field of a SEQUENCE
        WORD messageId;  // INTEGER, 0..32767, reservedMessageId_D(0), alaCarteMessage_D(1), basicSafetyMessage_D(2), basicSafetyMessageVerbose_D(3), commonSafetyRequest_D(4), emergencyVehicleAlert_D(5), intersectionCollision_D(6), mapData_D(7), nmeaCorrections_D(8), probeDataManagement_D(9), probeVehicleData_D(10), roadSideAlert_D(11), rtcmCorrections_D(12), signalPhaseAndTimingMessage_D(13), signalRequestMessage_D(14), signalStatusMessage_D(15), travelerInformation_D(16), uperFrame_D(17), mapData(18), signalPhaseAndTimingMessage(19), basicSafetyMessage(20), commonSafetyRequest(21), emergencyVehicleAlert(22), intersectionCollision(23), nmeaCorrections(24), probeDataManagement(25), probeVehicleData(26), roadSideAlert(27), rtcmCorrections(28), signalRequestMessage(29), signalStatusMessage(30), travelerInformation(31), personalSafetyMessage(32), testMessage00(240), testMessage01(241), testMessage02(242), testMessage03(243), testMessage04(244), testMessage05(245), testMessage06(246), testMessage07(247), testMessage08(248), testMessage09(249), testMessage10(250), testMessage11(251), testMessage12(252), testMessage13(253), testMessage14(254), testMessage15(255);
        struct PersonalSafetyMessageMESSAGE_ID_AND_TYPE value;  // TABLE;
    };
    
}

/*
// init function to create a simple packet handle
*/ 
LONG API_InitPersonalSafetyMessagePacket()
{
  return C2xInitPacket("PersonalSafetyMessage"); 
}

/*
// init function to create a simple packet handle and
// initialize the struct with valid data
*/ 
LONG API_InitPersonalSafetyMessagePacket(struct PersonalSafetyMessage msgStruct)
{
  long pktHandle;

  pktHandle = API_InitPersonalSafetyMessagePacket();

  if (pktHandle != 0)
  {
    // create valid message and application data
    if (C2xCompletePacket(pktHandle) == 0) 
    {
      API_GetPersonalSafetyMessageParams(pktHandle, msgStruct);
    }
  }
  return pktHandle;
}

/*
// init function to create a packet with security layer and
// initialize the struct with valid data
*/ 
LONG API_InitPersonalSafetyMessagePacket(struct PersonalSafetyMessage msgStruct, char packetTypeDesignator[], char certificateName[])
{
  long pktHandle, certHdl;

  // initialize the packet
  pktHandle = C2xInitPacket("PersonalSafetyMessage", packetTypeDesignator);

  if (pktHandle != 0)
  {
    certHdl = C2xSecCertificateGetHandle(certificateName);  // get the certificate handle for the cert with name "certificateName"
    if (certHdl != 0) 
    {
      C2xSecPacketSetSignerHandle(pktHandle, certHdl); // set the certHdl to the packet
    }

    // create valid message and application data
    if (C2xCompletePacket(pktHandle) == 0) 
    {
      // copy application data to the application structure
      API_GetPersonalSafetyMessageParams(pktHandle, msgStruct);
    }
  }
  return pktHandle;
}
    

int GetPersonalSafetyMessage_AddGrpB_LatitudeDMS2Params(LONG packetHandle, struct PersonalSafetyMessage_AddGrpB_LatitudeDMS2 value, char oldPath[])
{
  char newPath[300];
  int result;

  result = 0;

  snprintf(newPath, elcount(newPath), "%s.%s", oldPath, "d");
  value.d = C2xGetTokenInt(packetHandle, "PersonalSafetyMessage", newPath);
  result = CheckLastError("PersonalSafetyMessage", gkFuncRefGet, result);

  snprintf(newPath, elcount(newPath), "%s.%s", oldPath, "m");
  value.m = C2xGetTokenInt(packetHandle, "PersonalSafetyMessage", newPath);
  result = CheckLastError("PersonalSafetyMessage", gkFuncRefGet, result);

  snprintf(newPath, elcount(newPath), "%s.%s", oldPath, "s");
  value.s = C2xGetTokenInt(packetHandle, "PersonalSafetyMessage", newPath);
  result = CheckLastError("PersonalSafetyMessage", gkFuncRefGet, result);

  return result;
}

int SetPersonalSafetyMessage_AddGrpB_LatitudeDMS2Params(LONG packetHandle, struct PersonalSafetyMessage_AddGrpB_LatitudeDMS2 value, char oldPath[])
{
  char newPath[300];
  int result;

  result = 0;

  snprintf(newPath, elcount(newPath), "%s.%s", oldPath, "d");
  C2xSetTokenInt(packetHandle, "PersonalSafetyMessage", newPath, value.d);
  result = CheckLastError("PersonalSafetyMessage", gkFuncRefGet, result);

  snprintf(newPath, elcount(newPath), "%s.%s", oldPath, "m");
  C2xSetTokenInt(packetHandle, "PersonalSafetyMessage", newPath, value.m);
  result = CheckLastError("PersonalSafetyMessage", gkFuncRefGet, result);

  snprintf(newPath, elcount(newPath), "%s.%s", oldPath, "s");
  C2xSetTokenInt(packetHandle, "PersonalSafetyMessage", newPath, value.s);
  result = CheckLastError("PersonalSafetyMessage", gkFuncRefGet, result);

  return result;
}

int GetPersonalSafetyMessage_AddGrpB_LongitudeDMS2Params(LONG packetHandle, struct PersonalSafetyMessage_AddGrpB_LongitudeDMS2 value, char oldPath[])
{
  char newPath[300];
  int result;

  result = 0;

  snprintf(newPath, elcount(newPath), "%s.%s", oldPath, "d");
  value.d = C2xGetTokenInt(packetHandle, "PersonalSafetyMessage", newPath);
  result = CheckLastError("PersonalSafetyMessage", gkFuncRefGet, result);

  snprintf(newPath, elcount(newPath), "%s.%s", oldPath, "m");
  value.m = C2xGetTokenInt(packetHandle, "PersonalSafetyMessage", newPath);
  result = CheckLastError("PersonalSafetyMessage", gkFuncRefGet, result);

  snprintf(newPath, elcount(newPath), "%s.%s", oldPath, "s");
  value.s = C2xGetTokenInt(packetHandle, "PersonalSafetyMessage", newPath);
  result = CheckLastError("PersonalSafetyMessage", gkFuncRefGet, result);

  return result;
}

int SetPersonalSafetyMessage_AddGrpB_LongitudeDMS2Params(LONG packetHandle, struct PersonalSafetyMessage_AddGrpB_LongitudeDMS2 value, char oldPath[])
{
  char newPath[300];
  int result;

  result = 0;

  snprintf(newPath, elcount(newPath), "%s.%s", oldPath, "d");
  C2xSetTokenInt(packetHandle, "PersonalSafetyMessage", newPath, value.d);
  result = CheckLastError("PersonalSafetyMessage", gkFuncRefGet, result);

  snprintf(newPath, elcount(newPath), "%s.%s", oldPath, "m");
  C2xSetTokenInt(packetHandle, "PersonalSafetyMessage", newPath, value.m);
  result = CheckLastError("PersonalSafetyMessage", gkFuncRefGet, result);

  snprintf(newPath, elcount(newPath), "%s.%s", oldPath, "s");
  C2xSetTokenInt(packetHandle, "PersonalSafetyMessage", newPath, value.s);
  result = CheckLastError("PersonalSafetyMessage", gkFuncRefGet, result);

  return result;
}

int GetPersonalSafetyMessage_AddGrpB_Position3D_addGrpBParams(LONG packetHandle, struct PersonalSafetyMessage_AddGrpB_Position3D_addGrpB value, char oldPath[])
{
  char newPath[300];
  int result;

  result = 0;

  snprintf(newPath, elcount(newPath), "%s.%s", oldPath, "latitude");
  GetPersonalSafetyMessage_AddGrpB_LatitudeDMS2Params(packetHandle, value.latitude, newPath);
  result = CheckLastError("PersonalSafetyMessage", gkFuncRefGet, result);

  snprintf(newPath, elcount(newPath), "%s.%s", oldPath, "longitude");
  GetPersonalSafetyMessage_AddGrpB_LongitudeDMS2Params(packetHandle, value.longitude, newPath);
  result = CheckLastError("PersonalSafetyMessage", gkFuncRefGet, result);

  snprintf(newPath, elcount(newPath), "%s.%s", oldPath, "elevation");
  value.elevation = C2xGetTokenInt(packetHandle, "PersonalSafetyMessage", newPath);
  result = CheckLastError("PersonalSafetyMessage", gkFuncRefGet, result);

  return result;
}

int SetPersonalSafetyMessage_AddGrpB_Position3D_addGrpBParams(LONG packetHandle, struct PersonalSafetyMessage_AddGrpB_Position3D_addGrpB value, char oldPath[])
{
  char newPath[300];
  int result;

  result = 0;

  snprintf(newPath, elcount(newPath), "%s.%s", oldPath, "latitude");
  SetPersonalSafetyMessage_AddGrpB_LatitudeDMS2Params(packetHandle, value.latitude, newPath);
  result = CheckLastError("PersonalSafetyMessage", gkFuncRefGet, result);

  snprintf(newPath, elcount(newPath), "%s.%s", oldPath, "longitude");
  SetPersonalSafetyMessage_AddGrpB_LongitudeDMS2Params(packetHandle, value.longitude, newPath);
  result = CheckLastError("PersonalSafetyMessage", gkFuncRefGet, result);

  snprintf(newPath, elcount(newPath), "%s.%s", oldPath, "elevation");
  C2xSetTokenInt(packetHandle, "PersonalSafetyMessage", newPath, value.elevation);
  result = CheckLastError("PersonalSafetyMessage", gkFuncRefGet, result);

  return result;
}

int GetPersonalSafetyMessage_AddGrpC_AltitudeParams(LONG packetHandle, struct PersonalSafetyMessage_AddGrpC_Altitude value, char oldPath[])
{
  char newPath[300];
  int result;

  result = 0;

  snprintf(newPath, elcount(newPath), "%s.%s", oldPath, "value");
  value.value = C2xGetTokenInt(packetHandle, "PersonalSafetyMessage", newPath);
  result = CheckLastError("PersonalSafetyMessage", gkFuncRefGet, result);

  snprintf(newPath, elcount(newPath), "%s.%s", oldPath, "confidence");
  value.confidence = C2xGetTokenInt(packetHandle, "PersonalSafetyMessage", newPath);
  result = CheckLastError("PersonalSafetyMessage", gkFuncRefGet, result);

  return result;
}

int SetPersonalSafetyMessage_AddGrpC_AltitudeParams(LONG packetHandle, struct PersonalSafetyMessage_AddGrpC_Altitude value, char oldPath[])
{
  char newPath[300];
  int result;

  result = 0;

  snprintf(newPath, elcount(newPath), "%s.%s", oldPath, "value");
  C2xSetTokenInt(packetHandle, "PersonalSafetyMessage", newPath, value.value);
  result = CheckLastError("PersonalSafetyMessage", gkFuncRefGet, result);

  snprintf(newPath, elcount(newPath), "%s.%s", oldPath, "confidence");
  C2xSetTokenInt(packetHandle, "PersonalSafetyMessage", newPath, value.confidence);
  result = CheckLastError("PersonalSafetyMessage", gkFuncRefGet, result);

  return result;
}

int GetPersonalSafetyMessage_AddGrpC_Position3D_addGrpCParams(LONG packetHandle, struct PersonalSafetyMessage_AddGrpC_Position3D_addGrpC value, char oldPath[])
{
  char newPath[300];
  int result;

  result = 0;

  snprintf(newPath, elcount(newPath), "%s.%s", oldPath, "altitude");
  GetPersonalSafetyMessage_AddGrpC_AltitudeParams(packetHandle, value.altitude, newPath);
  result = CheckLastError("PersonalSafetyMessage", gkFuncRefGet, result);

  return result;
}

int SetPersonalSafetyMessage_AddGrpC_Position3D_addGrpCParams(LONG packetHandle, struct PersonalSafetyMessage_AddGrpC_Position3D_addGrpC value, char oldPath[])
{
  char newPath[300];
  int result;

  result = 0;

  snprintf(newPath, elcount(newPath), "%s.%s", oldPath, "altitude");
  SetPersonalSafetyMessage_AddGrpC_AltitudeParams(packetHandle, value.altitude, newPath);
  result = CheckLastError("PersonalSafetyMessage", gkFuncRefGet, result);

  return result;
}

int GetPersonalSafetyMessageREG_EXT_ID_AND_TYPE_Position3DParams(LONG packetHandle, WORD tableKey, struct PersonalSafetyMessageREG_EXT_ID_AND_TYPE_Position3D value, char oldPath[])
{
  char newPath[300];
  int result;

  result = 0;

  switch(tableKey)
  {
    case 2:
    {
      snprintf(newPath, elcount(newPath), "%s.%s", oldPath, "addGrpB");
      GetPersonalSafetyMessage_AddGrpB_Position3D_addGrpBParams(packetHandle, value.addGrpB, newPath);
      result = CheckLastError("PersonalSafetyMessage", gkFuncRefGet, result);
    }
    break;
    case 3:
    {
      snprintf(newPath, elcount(newPath), "%s.%s", oldPath, "addGrpC");
      GetPersonalSafetyMessage_AddGrpC_Position3D_addGrpCParams(packetHandle, value.addGrpC, newPath);
      result = CheckLastError("PersonalSafetyMessage", gkFuncRefGet, result);
    }
    break;
  }
  return result;
}

int SetPersonalSafetyMessageREG_EXT_ID_AND_TYPE_Position3DParams(LONG packetHandle, WORD tableKey, struct PersonalSafetyMessageREG_EXT_ID_AND_TYPE_Position3D value, char oldPath[])
{
  char newPath[300];
  int result;

  result = 0;

  switch(tableKey)
  {
    case 2:
    {
      snprintf(newPath, elcount(newPath), "%s.%s", oldPath, "addGrpB");
      SetPersonalSafetyMessage_AddGrpB_Position3D_addGrpBParams(packetHandle, value.addGrpB, newPath);
      result = CheckLastError("PersonalSafetyMessage", gkFuncRefGet, result);
    }
    break;
    case 3:
    {
      snprintf(newPath, elcount(newPath), "%s.%s", oldPath, "addGrpC");
      SetPersonalSafetyMessage_AddGrpC_Position3D_addGrpCParams(packetHandle, value.addGrpC, newPath);
      result = CheckLastError("PersonalSafetyMessage", gkFuncRefGet, result);
    }
    break;
  }
  return result;
}

int GetPersonalSafetyMessageRegionalExtensionPosition3DParams(LONG packetHandle, struct PersonalSafetyMessageRegionalExtensionPosition3D value, char oldPath[])
{
  char newPath[300];
  int result;

  result = 0;

  snprintf(newPath, elcount(newPath), "%s.%s", oldPath, "regionId");
  value.regionId = C2xGetTokenInt(packetHandle, "PersonalSafetyMessage", newPath);
  result = CheckLastError("PersonalSafetyMessage", gkFuncRefGet, result);

  snprintf(newPath, elcount(newPath), "%s.%s", oldPath, "regExtValue");
  GetPersonalSafetyMessageREG_EXT_ID_AND_TYPE_Position3DParams(packetHandle, value.regionId, value.regExtValue, newPath);
  result = CheckLastError("PersonalSafetyMessage", gkFuncRefGet, result);

  return result;
}

int SetPersonalSafetyMessageRegionalExtensionPosition3DParams(LONG packetHandle, struct PersonalSafetyMessageRegionalExtensionPosition3D value, char oldPath[])
{
  char newPath[300];
  int result;

  result = 0;


  snprintf(newPath, elcount(newPath), "%s.%s", oldPath, "regExtValue");
  SetPersonalSafetyMessageREG_EXT_ID_AND_TYPE_Position3DParams(packetHandle, value.regionId, value.regExtValue, newPath);
  result = CheckLastError("PersonalSafetyMessage", gkFuncRefGet, result);

  return result;
}

int GetPersonalSafetyMessage_Position3D_regionalParams(LONG packetHandle, struct PersonalSafetyMessage_Position3D_regional value, char oldPath[])
{
  char newPath[300]; 
  int i;
  int result;

  result = 0;

  value.length = C2xGetTokenInt(packetHandle, "PersonalSafetyMessage", oldPath);
  if((result = CheckLastError("PersonalSafetyMessage", gkFuncRefGet, result))==0)
  {
    for(i=0; i<value.length; i++)
    {
      snprintf(newPath, elcount(newPath), "%s[%d]", oldPath, i);
      GetPersonalSafetyMessageRegionalExtensionPosition3DParams(packetHandle, value.arrayValue[i], newPath);
      result = CheckLastError("PersonalSafetyMessage", gkFuncRefGet, result);
    }
  }
  return result;
}

int SetPersonalSafetyMessage_Position3D_regionalParams(LONG packetHandle, struct PersonalSafetyMessage_Position3D_regional value, char oldPath[])
{
  char newPath[300]; 
  int i;
  int result;

  result = 0;

  C2xRemoveToken(packetHandle, "PersonalSafetyMessage", oldPath);
  for(i=0; i<value.length; i++)
  {
    snprintf(newPath, elcount(newPath), "%s[%d]", oldPath, i);
    SetPersonalSafetyMessageRegionalExtensionPosition3DParams(packetHandle, value.arrayValue[i], newPath);
    result = CheckLastError("PersonalSafetyMessage", gkFuncRefGet, result);
  }
  return result;
}

int GetPersonalSafetyMessagePosition3DParams(LONG packetHandle, struct PersonalSafetyMessagePosition3D value, char oldPath[])
{
  char newPath[300];
  int result;

  result = 0;

  snprintf(newPath, elcount(newPath), "%s.%s", oldPath, "lat");
  value.lat = C2xGetTokenInt(packetHandle, "PersonalSafetyMessage", newPath);
  result = CheckLastError("PersonalSafetyMessage", gkFuncRefGet, result);

  snprintf(newPath, elcount(newPath), "%s.%s", oldPath, "lon");
  value.lon = C2xGetTokenInt(packetHandle, "PersonalSafetyMessage", newPath);
  result = CheckLastError("PersonalSafetyMessage", gkFuncRefGet, result);

  snprintf(newPath, elcount(newPath), "%s.%s", oldPath, "elevation");
  value.elevation.isValidFlag = C2xIsTokenAvailable(packetHandle, "PersonalSafetyMessage", newPath);
  if(value.elevation.isValidFlag==1)
  {
    value.elevation.value = C2xGetTokenInt(packetHandle, "PersonalSafetyMessage", newPath);
    result = CheckLastError("PersonalSafetyMessage", gkFuncRefGet, result);
  }
  snprintf(newPath, elcount(newPath), "%s.%s", oldPath, "regional");
  value.regional.isValidFlag = C2xIsTokenAvailable(packetHandle, "PersonalSafetyMessage", newPath);
  if(value.regional.isValidFlag==1)
  {
    GetPersonalSafetyMessage_Position3D_regionalParams(packetHandle, value.regional, newPath);
    result = CheckLastError("PersonalSafetyMessage", gkFuncRefGet, result);
  }
  return result;
}

int SetPersonalSafetyMessagePosition3DParams(LONG packetHandle, struct PersonalSafetyMessagePosition3D value, char oldPath[])
{
  char newPath[300];
  int result;

  result = 0;

  snprintf(newPath, elcount(newPath), "%s.%s", oldPath, "lat");
  C2xSetTokenInt(packetHandle, "PersonalSafetyMessage", newPath, value.lat);
  result = CheckLastError("PersonalSafetyMessage", gkFuncRefGet, result);

  snprintf(newPath, elcount(newPath), "%s.%s", oldPath, "lon");
  C2xSetTokenInt(packetHandle, "PersonalSafetyMessage", newPath, value.lon);
  result = CheckLastError("PersonalSafetyMessage", gkFuncRefGet, result);

  snprintf(newPath, elcount(newPath), "%s.%s", oldPath, "elevation");
  if(value.elevation.isValidFlag==1)
  {
    C2xSetTokenInt(packetHandle, "PersonalSafetyMessage", newPath, value.elevation.value);
    result = CheckLastError("PersonalSafetyMessage", gkFuncRefGet, result);
  }
  else
  {
    if( C2xIsTokenAvailable(packetHandle, "PersonalSafetyMessage", newPath) )
    {
      C2xRemoveToken(packetHandle, "PersonalSafetyMessage", newPath);
    }
  }

  snprintf(newPath, elcount(newPath), "%s.%s", oldPath, "regional");
  if(value.regional.isValidFlag==1)
  {
    SetPersonalSafetyMessage_Position3D_regionalParams(packetHandle, value.regional, newPath);
    result = CheckLastError("PersonalSafetyMessage", gkFuncRefGet, result);
  }
  else
  {
    if( C2xIsTokenAvailable(packetHandle, "PersonalSafetyMessage", newPath) )
    {
      C2xRemoveToken(packetHandle, "PersonalSafetyMessage", newPath);
    }
  }

  return result;
}

int GetPersonalSafetyMessagePositionalAccuracyParams(LONG packetHandle, struct PersonalSafetyMessagePositionalAccuracy value, char oldPath[])
{
  char newPath[300];
  int result;

  result = 0;

  snprintf(newPath, elcount(newPath), "%s.%s", oldPath, "semiMajor");
  value.semiMajor = C2xGetTokenInt(packetHandle, "PersonalSafetyMessage", newPath);
  result = CheckLastError("PersonalSafetyMessage", gkFuncRefGet, result);

  snprintf(newPath, elcount(newPath), "%s.%s", oldPath, "semiMinor");
  value.semiMinor = C2xGetTokenInt(packetHandle, "PersonalSafetyMessage", newPath);
  result = CheckLastError("PersonalSafetyMessage", gkFuncRefGet, result);

  snprintf(newPath, elcount(newPath), "%s.%s", oldPath, "orientation");
  value.orientation = C2xGetTokenInt(packetHandle, "PersonalSafetyMessage", newPath);
  result = CheckLastError("PersonalSafetyMessage", gkFuncRefGet, result);

  return result;
}

int SetPersonalSafetyMessagePositionalAccuracyParams(LONG packetHandle, struct PersonalSafetyMessagePositionalAccuracy value, char oldPath[])
{
  char newPath[300];
  int result;

  result = 0;

  snprintf(newPath, elcount(newPath), "%s.%s", oldPath, "semiMajor");
  C2xSetTokenInt(packetHandle, "PersonalSafetyMessage", newPath, value.semiMajor);
  result = CheckLastError("PersonalSafetyMessage", gkFuncRefGet, result);

  snprintf(newPath, elcount(newPath), "%s.%s", oldPath, "semiMinor");
  C2xSetTokenInt(packetHandle, "PersonalSafetyMessage", newPath, value.semiMinor);
  result = CheckLastError("PersonalSafetyMessage", gkFuncRefGet, result);

  snprintf(newPath, elcount(newPath), "%s.%s", oldPath, "orientation");
  C2xSetTokenInt(packetHandle, "PersonalSafetyMessage", newPath, value.orientation);
  result = CheckLastError("PersonalSafetyMessage", gkFuncRefGet, result);

  return result;
}

int GetPersonalSafetyMessageAccelerationSet4WayParams(LONG packetHandle, struct PersonalSafetyMessageAccelerationSet4Way value, char oldPath[])
{
  char newPath[300];
  int result;

  result = 0;

  snprintf(newPath, elcount(newPath), "%s.%s", oldPath, "lon");
  value.lon = C2xGetTokenInt(packetHandle, "PersonalSafetyMessage", newPath);
  result = CheckLastError("PersonalSafetyMessage", gkFuncRefGet, result);

  snprintf(newPath, elcount(newPath), "%s.%s", oldPath, "lat");
  value.lat = C2xGetTokenInt(packetHandle, "PersonalSafetyMessage", newPath);
  result = CheckLastError("PersonalSafetyMessage", gkFuncRefGet, result);

  snprintf(newPath, elcount(newPath), "%s.%s", oldPath, "vert");
  value.vert = C2xGetTokenInt(packetHandle, "PersonalSafetyMessage", newPath);
  result = CheckLastError("PersonalSafetyMessage", gkFuncRefGet, result);

  snprintf(newPath, elcount(newPath), "%s.%s", oldPath, "yaw");
  value.yaw = C2xGetTokenInt(packetHandle, "PersonalSafetyMessage", newPath);
  result = CheckLastError("PersonalSafetyMessage", gkFuncRefGet, result);

  return result;
}

int SetPersonalSafetyMessageAccelerationSet4WayParams(LONG packetHandle, struct PersonalSafetyMessageAccelerationSet4Way value, char oldPath[])
{
  char newPath[300];
  int result;

  result = 0;

  snprintf(newPath, elcount(newPath), "%s.%s", oldPath, "lon");
  C2xSetTokenInt(packetHandle, "PersonalSafetyMessage", newPath, value.lon);
  result = CheckLastError("PersonalSafetyMessage", gkFuncRefGet, result);

  snprintf(newPath, elcount(newPath), "%s.%s", oldPath, "lat");
  C2xSetTokenInt(packetHandle, "PersonalSafetyMessage", newPath, value.lat);
  result = CheckLastError("PersonalSafetyMessage", gkFuncRefGet, result);

  snprintf(newPath, elcount(newPath), "%s.%s", oldPath, "vert");
  C2xSetTokenInt(packetHandle, "PersonalSafetyMessage", newPath, value.vert);
  result = CheckLastError("PersonalSafetyMessage", gkFuncRefGet, result);

  snprintf(newPath, elcount(newPath), "%s.%s", oldPath, "yaw");
  C2xSetTokenInt(packetHandle, "PersonalSafetyMessage", newPath, value.yaw);
  result = CheckLastError("PersonalSafetyMessage", gkFuncRefGet, result);

  return result;
}

int GetPersonalSafetyMessageDDateTimeParams(LONG packetHandle, struct PersonalSafetyMessageDDateTime value, char oldPath[])
{
  char newPath[300];
  int result;

  result = 0;

  snprintf(newPath, elcount(newPath), "%s.%s", oldPath, "year");
  value.year.isValidFlag = C2xIsTokenAvailable(packetHandle, "PersonalSafetyMessage", newPath);
  if(value.year.isValidFlag==1)
  {
    value.year.value = C2xGetTokenInt(packetHandle, "PersonalSafetyMessage", newPath);
    result = CheckLastError("PersonalSafetyMessage", gkFuncRefGet, result);
  }
  snprintf(newPath, elcount(newPath), "%s.%s", oldPath, "month");
  value.month.isValidFlag = C2xIsTokenAvailable(packetHandle, "PersonalSafetyMessage", newPath);
  if(value.month.isValidFlag==1)
  {
    value.month.value = C2xGetTokenInt(packetHandle, "PersonalSafetyMessage", newPath);
    result = CheckLastError("PersonalSafetyMessage", gkFuncRefGet, result);
  }
  snprintf(newPath, elcount(newPath), "%s.%s", oldPath, "day");
  value.day.isValidFlag = C2xIsTokenAvailable(packetHandle, "PersonalSafetyMessage", newPath);
  if(value.day.isValidFlag==1)
  {
    value.day.value = C2xGetTokenInt(packetHandle, "PersonalSafetyMessage", newPath);
    result = CheckLastError("PersonalSafetyMessage", gkFuncRefGet, result);
  }
  snprintf(newPath, elcount(newPath), "%s.%s", oldPath, "hour");
  value.hour.isValidFlag = C2xIsTokenAvailable(packetHandle, "PersonalSafetyMessage", newPath);
  if(value.hour.isValidFlag==1)
  {
    value.hour.value = C2xGetTokenInt(packetHandle, "PersonalSafetyMessage", newPath);
    result = CheckLastError("PersonalSafetyMessage", gkFuncRefGet, result);
  }
  snprintf(newPath, elcount(newPath), "%s.%s", oldPath, "minute");
  value.minute.isValidFlag = C2xIsTokenAvailable(packetHandle, "PersonalSafetyMessage", newPath);
  if(value.minute.isValidFlag==1)
  {
    value.minute.value = C2xGetTokenInt(packetHandle, "PersonalSafetyMessage", newPath);
    result = CheckLastError("PersonalSafetyMessage", gkFuncRefGet, result);
  }
  snprintf(newPath, elcount(newPath), "%s.%s", oldPath, "second");
  value.second.isValidFlag = C2xIsTokenAvailable(packetHandle, "PersonalSafetyMessage", newPath);
  if(value.second.isValidFlag==1)
  {
    value.second.value = C2xGetTokenInt(packetHandle, "PersonalSafetyMessage", newPath);
    result = CheckLastError("PersonalSafetyMessage", gkFuncRefGet, result);
  }
  snprintf(newPath, elcount(newPath), "%s.%s", oldPath, "offset");
  value.offset.isValidFlag = C2xIsTokenAvailable(packetHandle, "PersonalSafetyMessage", newPath);
  if(value.offset.isValidFlag==1)
  {
    value.offset.value = C2xGetTokenInt(packetHandle, "PersonalSafetyMessage", newPath);
    result = CheckLastError("PersonalSafetyMessage", gkFuncRefGet, result);
  }
  return result;
}

int SetPersonalSafetyMessageDDateTimeParams(LONG packetHandle, struct PersonalSafetyMessageDDateTime value, char oldPath[])
{
  char newPath[300];
  int result;

  result = 0;

  snprintf(newPath, elcount(newPath), "%s.%s", oldPath, "year");
  if(value.year.isValidFlag==1)
  {
    C2xSetTokenInt(packetHandle, "PersonalSafetyMessage", newPath, value.year.value);
    result = CheckLastError("PersonalSafetyMessage", gkFuncRefGet, result);
  }
  else
  {
    if( C2xIsTokenAvailable(packetHandle, "PersonalSafetyMessage", newPath) )
    {
      C2xRemoveToken(packetHandle, "PersonalSafetyMessage", newPath);
    }
  }

  snprintf(newPath, elcount(newPath), "%s.%s", oldPath, "month");
  if(value.month.isValidFlag==1)
  {
    C2xSetTokenInt(packetHandle, "PersonalSafetyMessage", newPath, value.month.value);
    result = CheckLastError("PersonalSafetyMessage", gkFuncRefGet, result);
  }
  else
  {
    if( C2xIsTokenAvailable(packetHandle, "PersonalSafetyMessage", newPath) )
    {
      C2xRemoveToken(packetHandle, "PersonalSafetyMessage", newPath);
    }
  }

  snprintf(newPath, elcount(newPath), "%s.%s", oldPath, "day");
  if(value.day.isValidFlag==1)
  {
    C2xSetTokenInt(packetHandle, "PersonalSafetyMessage", newPath, value.day.value);
    result = CheckLastError("PersonalSafetyMessage", gkFuncRefGet, result);
  }
  else
  {
    if( C2xIsTokenAvailable(packetHandle, "PersonalSafetyMessage", newPath) )
    {
      C2xRemoveToken(packetHandle, "PersonalSafetyMessage", newPath);
    }
  }

  snprintf(newPath, elcount(newPath), "%s.%s", oldPath, "hour");
  if(value.hour.isValidFlag==1)
  {
    C2xSetTokenInt(packetHandle, "PersonalSafetyMessage", newPath, value.hour.value);
    result = CheckLastError("PersonalSafetyMessage", gkFuncRefGet, result);
  }
  else
  {
    if( C2xIsTokenAvailable(packetHandle, "PersonalSafetyMessage", newPath) )
    {
      C2xRemoveToken(packetHandle, "PersonalSafetyMessage", newPath);
    }
  }

  snprintf(newPath, elcount(newPath), "%s.%s", oldPath, "minute");
  if(value.minute.isValidFlag==1)
  {
    C2xSetTokenInt(packetHandle, "PersonalSafetyMessage", newPath, value.minute.value);
    result = CheckLastError("PersonalSafetyMessage", gkFuncRefGet, result);
  }
  else
  {
    if( C2xIsTokenAvailable(packetHandle, "PersonalSafetyMessage", newPath) )
    {
      C2xRemoveToken(packetHandle, "PersonalSafetyMessage", newPath);
    }
  }

  snprintf(newPath, elcount(newPath), "%s.%s", oldPath, "second");
  if(value.second.isValidFlag==1)
  {
    C2xSetTokenInt(packetHandle, "PersonalSafetyMessage", newPath, value.second.value);
    result = CheckLastError("PersonalSafetyMessage", gkFuncRefGet, result);
  }
  else
  {
    if( C2xIsTokenAvailable(packetHandle, "PersonalSafetyMessage", newPath) )
    {
      C2xRemoveToken(packetHandle, "PersonalSafetyMessage", newPath);
    }
  }

  snprintf(newPath, elcount(newPath), "%s.%s", oldPath, "offset");
  if(value.offset.isValidFlag==1)
  {
    C2xSetTokenInt(packetHandle, "PersonalSafetyMessage", newPath, value.offset.value);
    result = CheckLastError("PersonalSafetyMessage", gkFuncRefGet, result);
  }
  else
  {
    if( C2xIsTokenAvailable(packetHandle, "PersonalSafetyMessage", newPath) )
    {
      C2xRemoveToken(packetHandle, "PersonalSafetyMessage", newPath);
    }
  }

  return result;
}

int GetPersonalSafetyMessageTransmissionAndSpeedParams(LONG packetHandle, struct PersonalSafetyMessageTransmissionAndSpeed value, char oldPath[])
{
  char newPath[300];
  int result;

  result = 0;

  snprintf(newPath, elcount(newPath), "%s.%s", oldPath, "transmisson");
  value.transmisson = C2xGetTokenInt(packetHandle, "PersonalSafetyMessage", newPath);
  result = CheckLastError("PersonalSafetyMessage", gkFuncRefGet, result);

  snprintf(newPath, elcount(newPath), "%s.%s", oldPath, "speed");
  value.speed = C2xGetTokenInt(packetHandle, "PersonalSafetyMessage", newPath);
  result = CheckLastError("PersonalSafetyMessage", gkFuncRefGet, result);

  return result;
}

int SetPersonalSafetyMessageTransmissionAndSpeedParams(LONG packetHandle, struct PersonalSafetyMessageTransmissionAndSpeed value, char oldPath[])
{
  char newPath[300];
  int result;

  result = 0;

  snprintf(newPath, elcount(newPath), "%s.%s", oldPath, "transmisson");
  C2xSetTokenInt(packetHandle, "PersonalSafetyMessage", newPath, value.transmisson);
  result = CheckLastError("PersonalSafetyMessage", gkFuncRefGet, result);

  snprintf(newPath, elcount(newPath), "%s.%s", oldPath, "speed");
  C2xSetTokenInt(packetHandle, "PersonalSafetyMessage", newPath, value.speed);
  result = CheckLastError("PersonalSafetyMessage", gkFuncRefGet, result);

  return result;
}

int GetPersonalSafetyMessagePositionConfidenceSetParams(LONG packetHandle, struct PersonalSafetyMessagePositionConfidenceSet value, char oldPath[])
{
  char newPath[300];
  int result;

  result = 0;

  snprintf(newPath, elcount(newPath), "%s.%s", oldPath, "pos");
  value.pos = C2xGetTokenInt(packetHandle, "PersonalSafetyMessage", newPath);
  result = CheckLastError("PersonalSafetyMessage", gkFuncRefGet, result);

  snprintf(newPath, elcount(newPath), "%s.%s", oldPath, "elevation");
  value.elevation = C2xGetTokenInt(packetHandle, "PersonalSafetyMessage", newPath);
  result = CheckLastError("PersonalSafetyMessage", gkFuncRefGet, result);

  return result;
}

int SetPersonalSafetyMessagePositionConfidenceSetParams(LONG packetHandle, struct PersonalSafetyMessagePositionConfidenceSet value, char oldPath[])
{
  char newPath[300];
  int result;

  result = 0;

  snprintf(newPath, elcount(newPath), "%s.%s", oldPath, "pos");
  C2xSetTokenInt(packetHandle, "PersonalSafetyMessage", newPath, value.pos);
  result = CheckLastError("PersonalSafetyMessage", gkFuncRefGet, result);

  snprintf(newPath, elcount(newPath), "%s.%s", oldPath, "elevation");
  C2xSetTokenInt(packetHandle, "PersonalSafetyMessage", newPath, value.elevation);
  result = CheckLastError("PersonalSafetyMessage", gkFuncRefGet, result);

  return result;
}

int GetPersonalSafetyMessageSpeedandHeadingandThrottleConfidenceParams(LONG packetHandle, struct PersonalSafetyMessageSpeedandHeadingandThrottleConfidence value, char oldPath[])
{
  char newPath[300];
  int result;

  result = 0;

  snprintf(newPath, elcount(newPath), "%s.%s", oldPath, "heading");
  value.heading = C2xGetTokenInt(packetHandle, "PersonalSafetyMessage", newPath);
  result = CheckLastError("PersonalSafetyMessage", gkFuncRefGet, result);

  snprintf(newPath, elcount(newPath), "%s.%s", oldPath, "speed");
  value.speed = C2xGetTokenInt(packetHandle, "PersonalSafetyMessage", newPath);
  result = CheckLastError("PersonalSafetyMessage", gkFuncRefGet, result);

  snprintf(newPath, elcount(newPath), "%s.%s", oldPath, "throttle");
  value.throttle = C2xGetTokenInt(packetHandle, "PersonalSafetyMessage", newPath);
  result = CheckLastError("PersonalSafetyMessage", gkFuncRefGet, result);

  return result;
}

int SetPersonalSafetyMessageSpeedandHeadingandThrottleConfidenceParams(LONG packetHandle, struct PersonalSafetyMessageSpeedandHeadingandThrottleConfidence value, char oldPath[])
{
  char newPath[300];
  int result;

  result = 0;

  snprintf(newPath, elcount(newPath), "%s.%s", oldPath, "heading");
  C2xSetTokenInt(packetHandle, "PersonalSafetyMessage", newPath, value.heading);
  result = CheckLastError("PersonalSafetyMessage", gkFuncRefGet, result);

  snprintf(newPath, elcount(newPath), "%s.%s", oldPath, "speed");
  C2xSetTokenInt(packetHandle, "PersonalSafetyMessage", newPath, value.speed);
  result = CheckLastError("PersonalSafetyMessage", gkFuncRefGet, result);

  snprintf(newPath, elcount(newPath), "%s.%s", oldPath, "throttle");
  C2xSetTokenInt(packetHandle, "PersonalSafetyMessage", newPath, value.throttle);
  result = CheckLastError("PersonalSafetyMessage", gkFuncRefGet, result);

  return result;
}

int GetPersonalSafetyMessageFullPositionVectorParams(LONG packetHandle, struct PersonalSafetyMessageFullPositionVector value, char oldPath[])
{
  char newPath[300];
  int result;

  result = 0;

  snprintf(newPath, elcount(newPath), "%s.%s", oldPath, "utcTime");
  value.utcTime.isValidFlag = C2xIsTokenAvailable(packetHandle, "PersonalSafetyMessage", newPath);
  if(value.utcTime.isValidFlag==1)
  {
    GetPersonalSafetyMessageDDateTimeParams(packetHandle, value.utcTime, newPath);
    result = CheckLastError("PersonalSafetyMessage", gkFuncRefGet, result);
  }
  snprintf(newPath, elcount(newPath), "%s.%s", oldPath, "lon");
  value.lon = C2xGetTokenInt(packetHandle, "PersonalSafetyMessage", newPath);
  result = CheckLastError("PersonalSafetyMessage", gkFuncRefGet, result);

  snprintf(newPath, elcount(newPath), "%s.%s", oldPath, "lat");
  value.lat = C2xGetTokenInt(packetHandle, "PersonalSafetyMessage", newPath);
  result = CheckLastError("PersonalSafetyMessage", gkFuncRefGet, result);

  snprintf(newPath, elcount(newPath), "%s.%s", oldPath, "elevation");
  value.elevation.isValidFlag = C2xIsTokenAvailable(packetHandle, "PersonalSafetyMessage", newPath);
  if(value.elevation.isValidFlag==1)
  {
    value.elevation.value = C2xGetTokenInt(packetHandle, "PersonalSafetyMessage", newPath);
    result = CheckLastError("PersonalSafetyMessage", gkFuncRefGet, result);
  }
  snprintf(newPath, elcount(newPath), "%s.%s", oldPath, "heading");
  value.heading.isValidFlag = C2xIsTokenAvailable(packetHandle, "PersonalSafetyMessage", newPath);
  if(value.heading.isValidFlag==1)
  {
    value.heading.value = C2xGetTokenInt(packetHandle, "PersonalSafetyMessage", newPath);
    result = CheckLastError("PersonalSafetyMessage", gkFuncRefGet, result);
  }
  snprintf(newPath, elcount(newPath), "%s.%s", oldPath, "speed");
  value.speed.isValidFlag = C2xIsTokenAvailable(packetHandle, "PersonalSafetyMessage", newPath);
  if(value.speed.isValidFlag==1)
  {
    GetPersonalSafetyMessageTransmissionAndSpeedParams(packetHandle, value.speed, newPath);
    result = CheckLastError("PersonalSafetyMessage", gkFuncRefGet, result);
  }
  snprintf(newPath, elcount(newPath), "%s.%s", oldPath, "posAccuracy");
  value.posAccuracy.isValidFlag = C2xIsTokenAvailable(packetHandle, "PersonalSafetyMessage", newPath);
  if(value.posAccuracy.isValidFlag==1)
  {
    GetPersonalSafetyMessagePositionalAccuracyParams(packetHandle, value.posAccuracy, newPath);
    result = CheckLastError("PersonalSafetyMessage", gkFuncRefGet, result);
  }
  snprintf(newPath, elcount(newPath), "%s.%s", oldPath, "timeConfidence");
  value.timeConfidence.isValidFlag = C2xIsTokenAvailable(packetHandle, "PersonalSafetyMessage", newPath);
  if(value.timeConfidence.isValidFlag==1)
  {
    value.timeConfidence.value = C2xGetTokenInt(packetHandle, "PersonalSafetyMessage", newPath);
    result = CheckLastError("PersonalSafetyMessage", gkFuncRefGet, result);
  }
  snprintf(newPath, elcount(newPath), "%s.%s", oldPath, "posConfidence");
  value.posConfidence.isValidFlag = C2xIsTokenAvailable(packetHandle, "PersonalSafetyMessage", newPath);
  if(value.posConfidence.isValidFlag==1)
  {
    GetPersonalSafetyMessagePositionConfidenceSetParams(packetHandle, value.posConfidence, newPath);
    result = CheckLastError("PersonalSafetyMessage", gkFuncRefGet, result);
  }
  snprintf(newPath, elcount(newPath), "%s.%s", oldPath, "speedConfidence");
  value.speedConfidence.isValidFlag = C2xIsTokenAvailable(packetHandle, "PersonalSafetyMessage", newPath);
  if(value.speedConfidence.isValidFlag==1)
  {
    GetPersonalSafetyMessageSpeedandHeadingandThrottleConfidenceParams(packetHandle, value.speedConfidence, newPath);
    result = CheckLastError("PersonalSafetyMessage", gkFuncRefGet, result);
  }
  return result;
}

int SetPersonalSafetyMessageFullPositionVectorParams(LONG packetHandle, struct PersonalSafetyMessageFullPositionVector value, char oldPath[])
{
  char newPath[300];
  int result;

  result = 0;

  snprintf(newPath, elcount(newPath), "%s.%s", oldPath, "utcTime");
  if(value.utcTime.isValidFlag==1)
  {
    SetPersonalSafetyMessageDDateTimeParams(packetHandle, value.utcTime, newPath);
    result = CheckLastError("PersonalSafetyMessage", gkFuncRefGet, result);
  }
  else
  {
    if( C2xIsTokenAvailable(packetHandle, "PersonalSafetyMessage", newPath) )
    {
      C2xRemoveToken(packetHandle, "PersonalSafetyMessage", newPath);
    }
  }

  snprintf(newPath, elcount(newPath), "%s.%s", oldPath, "lon");
  C2xSetTokenInt(packetHandle, "PersonalSafetyMessage", newPath, value.lon);
  result = CheckLastError("PersonalSafetyMessage", gkFuncRefGet, result);

  snprintf(newPath, elcount(newPath), "%s.%s", oldPath, "lat");
  C2xSetTokenInt(packetHandle, "PersonalSafetyMessage", newPath, value.lat);
  result = CheckLastError("PersonalSafetyMessage", gkFuncRefGet, result);

  snprintf(newPath, elcount(newPath), "%s.%s", oldPath, "elevation");
  if(value.elevation.isValidFlag==1)
  {
    C2xSetTokenInt(packetHandle, "PersonalSafetyMessage", newPath, value.elevation.value);
    result = CheckLastError("PersonalSafetyMessage", gkFuncRefGet, result);
  }
  else
  {
    if( C2xIsTokenAvailable(packetHandle, "PersonalSafetyMessage", newPath) )
    {
      C2xRemoveToken(packetHandle, "PersonalSafetyMessage", newPath);
    }
  }

  snprintf(newPath, elcount(newPath), "%s.%s", oldPath, "heading");
  if(value.heading.isValidFlag==1)
  {
    C2xSetTokenInt(packetHandle, "PersonalSafetyMessage", newPath, value.heading.value);
    result = CheckLastError("PersonalSafetyMessage", gkFuncRefGet, result);
  }
  else
  {
    if( C2xIsTokenAvailable(packetHandle, "PersonalSafetyMessage", newPath) )
    {
      C2xRemoveToken(packetHandle, "PersonalSafetyMessage", newPath);
    }
  }

  snprintf(newPath, elcount(newPath), "%s.%s", oldPath, "speed");
  if(value.speed.isValidFlag==1)
  {
    SetPersonalSafetyMessageTransmissionAndSpeedParams(packetHandle, value.speed, newPath);
    result = CheckLastError("PersonalSafetyMessage", gkFuncRefGet, result);
  }
  else
  {
    if( C2xIsTokenAvailable(packetHandle, "PersonalSafetyMessage", newPath) )
    {
      C2xRemoveToken(packetHandle, "PersonalSafetyMessage", newPath);
    }
  }

  snprintf(newPath, elcount(newPath), "%s.%s", oldPath, "posAccuracy");
  if(value.posAccuracy.isValidFlag==1)
  {
    SetPersonalSafetyMessagePositionalAccuracyParams(packetHandle, value.posAccuracy, newPath);
    result = CheckLastError("PersonalSafetyMessage", gkFuncRefGet, result);
  }
  else
  {
    if( C2xIsTokenAvailable(packetHandle, "PersonalSafetyMessage", newPath) )
    {
      C2xRemoveToken(packetHandle, "PersonalSafetyMessage", newPath);
    }
  }

  snprintf(newPath, elcount(newPath), "%s.%s", oldPath, "timeConfidence");
  if(value.timeConfidence.isValidFlag==1)
  {
    C2xSetTokenInt(packetHandle, "PersonalSafetyMessage", newPath, value.timeConfidence.value);
    result = CheckLastError("PersonalSafetyMessage", gkFuncRefGet, result);
  }
  else
  {
    if( C2xIsTokenAvailable(packetHandle, "PersonalSafetyMessage", newPath) )
    {
      C2xRemoveToken(packetHandle, "PersonalSafetyMessage", newPath);
    }
  }

  snprintf(newPath, elcount(newPath), "%s.%s", oldPath, "posConfidence");
  if(value.posConfidence.isValidFlag==1)
  {
    SetPersonalSafetyMessagePositionConfidenceSetParams(packetHandle, value.posConfidence, newPath);
    result = CheckLastError("PersonalSafetyMessage", gkFuncRefGet, result);
  }
  else
  {
    if( C2xIsTokenAvailable(packetHandle, "PersonalSafetyMessage", newPath) )
    {
      C2xRemoveToken(packetHandle, "PersonalSafetyMessage", newPath);
    }
  }

  snprintf(newPath, elcount(newPath), "%s.%s", oldPath, "speedConfidence");
  if(value.speedConfidence.isValidFlag==1)
  {
    SetPersonalSafetyMessageSpeedandHeadingandThrottleConfidenceParams(packetHandle, value.speedConfidence, newPath);
    result = CheckLastError("PersonalSafetyMessage", gkFuncRefGet, result);
  }
  else
  {
    if( C2xIsTokenAvailable(packetHandle, "PersonalSafetyMessage", newPath) )
    {
      C2xRemoveToken(packetHandle, "PersonalSafetyMessage", newPath);
    }
  }

  return result;
}

int GetPersonalSafetyMessagePathHistoryPointParams(LONG packetHandle, struct PersonalSafetyMessagePathHistoryPoint value, char oldPath[])
{
  char newPath[300];
  int result;

  result = 0;

  snprintf(newPath, elcount(newPath), "%s.%s", oldPath, "latOffset");
  value.latOffset = C2xGetTokenInt(packetHandle, "PersonalSafetyMessage", newPath);
  result = CheckLastError("PersonalSafetyMessage", gkFuncRefGet, result);

  snprintf(newPath, elcount(newPath), "%s.%s", oldPath, "lonOffset");
  value.lonOffset = C2xGetTokenInt(packetHandle, "PersonalSafetyMessage", newPath);
  result = CheckLastError("PersonalSafetyMessage", gkFuncRefGet, result);

  snprintf(newPath, elcount(newPath), "%s.%s", oldPath, "elevationOffset");
  value.elevationOffset = C2xGetTokenInt(packetHandle, "PersonalSafetyMessage", newPath);
  result = CheckLastError("PersonalSafetyMessage", gkFuncRefGet, result);

  snprintf(newPath, elcount(newPath), "%s.%s", oldPath, "timeOffset");
  value.timeOffset = C2xGetTokenInt(packetHandle, "PersonalSafetyMessage", newPath);
  result = CheckLastError("PersonalSafetyMessage", gkFuncRefGet, result);

  snprintf(newPath, elcount(newPath), "%s.%s", oldPath, "speed");
  value.speed.isValidFlag = C2xIsTokenAvailable(packetHandle, "PersonalSafetyMessage", newPath);
  if(value.speed.isValidFlag==1)
  {
    value.speed.value = C2xGetTokenInt(packetHandle, "PersonalSafetyMessage", newPath);
    result = CheckLastError("PersonalSafetyMessage", gkFuncRefGet, result);
  }
  snprintf(newPath, elcount(newPath), "%s.%s", oldPath, "posAccuracy");
  value.posAccuracy.isValidFlag = C2xIsTokenAvailable(packetHandle, "PersonalSafetyMessage", newPath);
  if(value.posAccuracy.isValidFlag==1)
  {
    GetPersonalSafetyMessagePositionalAccuracyParams(packetHandle, value.posAccuracy, newPath);
    result = CheckLastError("PersonalSafetyMessage", gkFuncRefGet, result);
  }
  snprintf(newPath, elcount(newPath), "%s.%s", oldPath, "heading");
  value.heading.isValidFlag = C2xIsTokenAvailable(packetHandle, "PersonalSafetyMessage", newPath);
  if(value.heading.isValidFlag==1)
  {
    value.heading.value = C2xGetTokenInt(packetHandle, "PersonalSafetyMessage", newPath);
    result = CheckLastError("PersonalSafetyMessage", gkFuncRefGet, result);
  }
  return result;
}

int SetPersonalSafetyMessagePathHistoryPointParams(LONG packetHandle, struct PersonalSafetyMessagePathHistoryPoint value, char oldPath[])
{
  char newPath[300];
  int result;

  result = 0;

  snprintf(newPath, elcount(newPath), "%s.%s", oldPath, "latOffset");
  C2xSetTokenInt(packetHandle, "PersonalSafetyMessage", newPath, value.latOffset);
  result = CheckLastError("PersonalSafetyMessage", gkFuncRefGet, result);

  snprintf(newPath, elcount(newPath), "%s.%s", oldPath, "lonOffset");
  C2xSetTokenInt(packetHandle, "PersonalSafetyMessage", newPath, value.lonOffset);
  result = CheckLastError("PersonalSafetyMessage", gkFuncRefGet, result);

  snprintf(newPath, elcount(newPath), "%s.%s", oldPath, "elevationOffset");
  C2xSetTokenInt(packetHandle, "PersonalSafetyMessage", newPath, value.elevationOffset);
  result = CheckLastError("PersonalSafetyMessage", gkFuncRefGet, result);

  snprintf(newPath, elcount(newPath), "%s.%s", oldPath, "timeOffset");
  C2xSetTokenInt(packetHandle, "PersonalSafetyMessage", newPath, value.timeOffset);
  result = CheckLastError("PersonalSafetyMessage", gkFuncRefGet, result);

  snprintf(newPath, elcount(newPath), "%s.%s", oldPath, "speed");
  if(value.speed.isValidFlag==1)
  {
    C2xSetTokenInt(packetHandle, "PersonalSafetyMessage", newPath, value.speed.value);
    result = CheckLastError("PersonalSafetyMessage", gkFuncRefGet, result);
  }
  else
  {
    if( C2xIsTokenAvailable(packetHandle, "PersonalSafetyMessage", newPath) )
    {
      C2xRemoveToken(packetHandle, "PersonalSafetyMessage", newPath);
    }
  }

  snprintf(newPath, elcount(newPath), "%s.%s", oldPath, "posAccuracy");
  if(value.posAccuracy.isValidFlag==1)
  {
    SetPersonalSafetyMessagePositionalAccuracyParams(packetHandle, value.posAccuracy, newPath);
    result = CheckLastError("PersonalSafetyMessage", gkFuncRefGet, result);
  }
  else
  {
    if( C2xIsTokenAvailable(packetHandle, "PersonalSafetyMessage", newPath) )
    {
      C2xRemoveToken(packetHandle, "PersonalSafetyMessage", newPath);
    }
  }

  snprintf(newPath, elcount(newPath), "%s.%s", oldPath, "heading");
  if(value.heading.isValidFlag==1)
  {
    C2xSetTokenInt(packetHandle, "PersonalSafetyMessage", newPath, value.heading.value);
    result = CheckLastError("PersonalSafetyMessage", gkFuncRefGet, result);
  }
  else
  {
    if( C2xIsTokenAvailable(packetHandle, "PersonalSafetyMessage", newPath) )
    {
      C2xRemoveToken(packetHandle, "PersonalSafetyMessage", newPath);
    }
  }

  return result;
}

int GetPersonalSafetyMessagePathHistoryPointListParams(LONG packetHandle, struct PersonalSafetyMessagePathHistoryPointList value, char oldPath[])
{
  char newPath[300]; 
  int i;
  int result;

  result = 0;

  value.length = C2xGetTokenInt(packetHandle, "PersonalSafetyMessage", oldPath);
  if((result = CheckLastError("PersonalSafetyMessage", gkFuncRefGet, result))==0)
  {
    for(i=0; i<value.length; i++)
    {
      snprintf(newPath, elcount(newPath), "%s[%d]", oldPath, i);
      GetPersonalSafetyMessagePathHistoryPointParams(packetHandle, value.arrayValue[i], newPath);
      result = CheckLastError("PersonalSafetyMessage", gkFuncRefGet, result);
    }
  }
  return result;
}

int SetPersonalSafetyMessagePathHistoryPointListParams(LONG packetHandle, struct PersonalSafetyMessagePathHistoryPointList value, char oldPath[])
{
  char newPath[300]; 
  int i;
  int result;

  result = 0;

  C2xRemoveToken(packetHandle, "PersonalSafetyMessage", oldPath);
  for(i=0; i<value.length; i++)
  {
    snprintf(newPath, elcount(newPath), "%s[%d]", oldPath, i);
    SetPersonalSafetyMessagePathHistoryPointParams(packetHandle, value.arrayValue[i], newPath);
    result = CheckLastError("PersonalSafetyMessage", gkFuncRefGet, result);
  }
  return result;
}

int GetPersonalSafetyMessagePathHistoryParams(LONG packetHandle, struct PersonalSafetyMessagePathHistory value, char oldPath[])
{
  char newPath[300]; 
  int j; 
  int k;
  int result;

  result = 0;

  snprintf(newPath, elcount(newPath), "%s.%s", oldPath, "initialPosition");
  value.initialPosition.isValidFlag = C2xIsTokenAvailable(packetHandle, "PersonalSafetyMessage", newPath);
  if(value.initialPosition.isValidFlag==1)
  {
    GetPersonalSafetyMessageFullPositionVectorParams(packetHandle, value.initialPosition, newPath);
    result = CheckLastError("PersonalSafetyMessage", gkFuncRefGet, result);
  }
  snprintf(newPath, elcount(newPath), "%s.%s", oldPath, "currGNSSstatus");
  value.currGNSSstatus.isValidFlag = C2xIsTokenAvailable(packetHandle, "PersonalSafetyMessage", newPath);
  if(value.currGNSSstatus.isValidFlag==1)
  {
    value.currGNSSstatus.isValidFlag = 1;
    value.currGNSSstatus.stringLength = C2xGetTokenLengthBit(packetHandle, "PersonalSafetyMessage", newPath);
    if ((result = CheckLastError("PersonalSafetyMessage", gkFuncRefGet, result))==0)
    {
      if(value.currGNSSstatus.stringLength > 0)
      {
        for(j=0; j<value.currGNSSstatus.stringLength; j++)
        {
          if(C2xGetTokenBitOfBitString(packetHandle, "PersonalSafetyMessage", newPath, j) == 0)
          {
            value.currGNSSstatus.string[j] = '0';
          }
          else if(C2xGetTokenBitOfBitString(packetHandle, "PersonalSafetyMessage", newPath, j) == 1)
          {
            value.currGNSSstatus.string[j] = '1';
          }

          if(value.currGNSSstatus.stringLength == 1)
          {
            value.currGNSSstatus.string[1] = '0';
          }
          result = CheckLastError("PersonalSafetyMessage", gkFuncRefGet, result);
        }
      }
      else
      {
        for(k = value.currGNSSstatus.stringLength+1; k > -1; k--)
        {
          if(value.currGNSSstatus.string[k] == '1')
          {
            value.currGNSSstatus.string[k] = '0';
          }
        }
      }
    }

  }
  snprintf(newPath, elcount(newPath), "%s.%s", oldPath, "crumbData");
  GetPersonalSafetyMessagePathHistoryPointListParams(packetHandle, value.crumbData, newPath);
  result = CheckLastError("PersonalSafetyMessage", gkFuncRefGet, result);

  return result;
}

int SetPersonalSafetyMessagePathHistoryParams(LONG packetHandle, struct PersonalSafetyMessagePathHistory value, char oldPath[])
{
  char newPath[300]; 
  int j;
  int result;

  result = 0;

  snprintf(newPath, elcount(newPath), "%s.%s", oldPath, "initialPosition");
  if(value.initialPosition.isValidFlag==1)
  {
    SetPersonalSafetyMessageFullPositionVectorParams(packetHandle, value.initialPosition, newPath);
    result = CheckLastError("PersonalSafetyMessage", gkFuncRefGet, result);
  }
  else
  {
    if( C2xIsTokenAvailable(packetHandle, "PersonalSafetyMessage", newPath) )
    {
      C2xRemoveToken(packetHandle, "PersonalSafetyMessage", newPath);
    }
  }

  snprintf(newPath, elcount(newPath), "%s.%s", oldPath, "currGNSSstatus");
  if(value.currGNSSstatus.isValidFlag==1)
  {
      for(j=0; j<value.currGNSSstatus.stringLength; j++)
      {
        if(value.currGNSSstatus.string[j] == '0')
        {
          C2xSetTokenBitOfBitString(packetHandle, "PersonalSafetyMessage", newPath, j, 0);
        }
        else
        {
          C2xSetTokenBitOfBitString(packetHandle, "PersonalSafetyMessage", newPath, j, 1);
        }
        result = CheckLastError("PersonalSafetyMessage", gkFuncRefGet, result);
      }
  }
  else
  {
    if( C2xIsTokenAvailable(packetHandle, "PersonalSafetyMessage", newPath) )
    {
      C2xRemoveToken(packetHandle, "PersonalSafetyMessage", newPath);
    }
  }

  snprintf(newPath, elcount(newPath), "%s.%s", oldPath, "crumbData");
  SetPersonalSafetyMessagePathHistoryPointListParams(packetHandle, value.crumbData, newPath);
  result = CheckLastError("PersonalSafetyMessage", gkFuncRefGet, result);

  return result;
}

int GetPersonalSafetyMessagePathPredictionParams(LONG packetHandle, struct PersonalSafetyMessagePathPrediction value, char oldPath[])
{
  char newPath[300];
  int result;

  result = 0;

  snprintf(newPath, elcount(newPath), "%s.%s", oldPath, "radiusOfCurve");
  value.radiusOfCurve = C2xGetTokenInt(packetHandle, "PersonalSafetyMessage", newPath);
  result = CheckLastError("PersonalSafetyMessage", gkFuncRefGet, result);

  snprintf(newPath, elcount(newPath), "%s.%s", oldPath, "confidence");
  value.confidence = C2xGetTokenInt(packetHandle, "PersonalSafetyMessage", newPath);
  result = CheckLastError("PersonalSafetyMessage", gkFuncRefGet, result);

  return result;
}

int SetPersonalSafetyMessagePathPredictionParams(LONG packetHandle, struct PersonalSafetyMessagePathPrediction value, char oldPath[])
{
  char newPath[300];
  int result;

  result = 0;

  snprintf(newPath, elcount(newPath), "%s.%s", oldPath, "radiusOfCurve");
  C2xSetTokenInt(packetHandle, "PersonalSafetyMessage", newPath, value.radiusOfCurve);
  result = CheckLastError("PersonalSafetyMessage", gkFuncRefGet, result);

  snprintf(newPath, elcount(newPath), "%s.%s", oldPath, "confidence");
  C2xSetTokenInt(packetHandle, "PersonalSafetyMessage", newPath, value.confidence);
  result = CheckLastError("PersonalSafetyMessage", gkFuncRefGet, result);

  return result;
}

int GetPersonalSafetyMessagePropelledInformationParams(LONG packetHandle, struct PersonalSafetyMessagePropelledInformation value, char oldPath[])
{
  char newPath[300];
  int result;

  result = 0;

  value.choice = C2xGetTokenInt(packetHandle, "PersonalSafetyMessage", oldPath);

  switch(value.choice)
  {
    case 0:
    {
      snprintf(newPath, elcount(newPath), "%s.%s", oldPath, "human");
      value.human = C2xGetTokenInt(packetHandle, "PersonalSafetyMessage", newPath);
      result = CheckLastError("PersonalSafetyMessage", gkFuncRefGet, result);
    }
    break;
    case 1:
    {
      snprintf(newPath, elcount(newPath), "%s.%s", oldPath, "animal");
      value.animal = C2xGetTokenInt(packetHandle, "PersonalSafetyMessage", newPath);
      result = CheckLastError("PersonalSafetyMessage", gkFuncRefGet, result);
    }
    break;
    case 2:
    {
      snprintf(newPath, elcount(newPath), "%s.%s", oldPath, "motor");
      value.motor = C2xGetTokenInt(packetHandle, "PersonalSafetyMessage", newPath);
      result = CheckLastError("PersonalSafetyMessage", gkFuncRefGet, result);
    }
    break;
  }
  return result;
}

int SetPersonalSafetyMessagePropelledInformationParams(LONG packetHandle, struct PersonalSafetyMessagePropelledInformation value, char oldPath[])
{
  char newPath[300];
  int result;

  result = 0;

  switch(value.choice)
  {
    case 0:
    {
      snprintf(newPath, elcount(newPath), "%s.%s", oldPath, "human");
      C2xSetTokenInt(packetHandle, "PersonalSafetyMessage", newPath, value.human);
      result = CheckLastError("PersonalSafetyMessage", gkFuncRefGet, result);
    }
    break;
    case 1:
    {
      snprintf(newPath, elcount(newPath), "%s.%s", oldPath, "animal");
      C2xSetTokenInt(packetHandle, "PersonalSafetyMessage", newPath, value.animal);
      result = CheckLastError("PersonalSafetyMessage", gkFuncRefGet, result);
    }
    break;
    case 2:
    {
      snprintf(newPath, elcount(newPath), "%s.%s", oldPath, "motor");
      C2xSetTokenInt(packetHandle, "PersonalSafetyMessage", newPath, value.motor);
      result = CheckLastError("PersonalSafetyMessage", gkFuncRefGet, result);
    }
    break;
  }
  return result;
}

int GetPersonalSafetyMessageRegionalExtensionPersonalSafetyMessageParams(LONG packetHandle, struct PersonalSafetyMessageRegionalExtensionPersonalSafetyMessage value, char oldPath[])
{
  char newPath[300];
  int result;

  result = 0;

  snprintf(newPath, elcount(newPath), "%s.%s", oldPath, "regionId");
  value.regionId = C2xGetTokenInt(packetHandle, "PersonalSafetyMessage", newPath);
  result = CheckLastError("PersonalSafetyMessage", gkFuncRefGet, result);

  return result;
}

int SetPersonalSafetyMessageRegionalExtensionPersonalSafetyMessageParams(LONG packetHandle, struct PersonalSafetyMessageRegionalExtensionPersonalSafetyMessage value, char oldPath[])
{
  char newPath[300];
  int result;

  result = 0;


  return result;
}

int GetPersonalSafetyMessage_PersonalSafetyMessage_regionalParams(LONG packetHandle, struct PersonalSafetyMessage_PersonalSafetyMessage_regional value, char oldPath[])
{
  char newPath[300]; 
  int i;
  int result;

  result = 0;

  value.length = C2xGetTokenInt(packetHandle, "PersonalSafetyMessage", oldPath);
  if((result = CheckLastError("PersonalSafetyMessage", gkFuncRefGet, result))==0)
  {
    for(i=0; i<value.length; i++)
    {
      snprintf(newPath, elcount(newPath), "%s[%d]", oldPath, i);
      GetPersonalSafetyMessageRegionalExtensionPersonalSafetyMessageParams(packetHandle, value.arrayValue[i], newPath);
      result = CheckLastError("PersonalSafetyMessage", gkFuncRefGet, result);
    }
  }
  return result;
}

int SetPersonalSafetyMessage_PersonalSafetyMessage_regionalParams(LONG packetHandle, struct PersonalSafetyMessage_PersonalSafetyMessage_regional value, char oldPath[])
{
  char newPath[300]; 
  int i;
  int result;

  result = 0;

  C2xRemoveToken(packetHandle, "PersonalSafetyMessage", oldPath);
  for(i=0; i<value.length; i++)
  {
    snprintf(newPath, elcount(newPath), "%s[%d]", oldPath, i);
    SetPersonalSafetyMessageRegionalExtensionPersonalSafetyMessageParams(packetHandle, value.arrayValue[i], newPath);
    result = CheckLastError("PersonalSafetyMessage", gkFuncRefGet, result);
  }
  return result;
}

int GetPersonalSafetyMessagePSMParams(LONG packetHandle, struct PersonalSafetyMessagePSM value, char oldPath[])
{
  char newPath[300]; 
  int j; 
  int k;
  int result;

  result = 0;

  snprintf(newPath, elcount(newPath), "%s.%s", oldPath, "basicType");
  value.basicType = C2xGetTokenInt(packetHandle, "PersonalSafetyMessage", newPath);
  result = CheckLastError("PersonalSafetyMessage", gkFuncRefGet, result);

  snprintf(newPath, elcount(newPath), "%s.%s", oldPath, "secMark");
  value.secMark = C2xGetTokenInt(packetHandle, "PersonalSafetyMessage", newPath);
  result = CheckLastError("PersonalSafetyMessage", gkFuncRefGet, result);

  snprintf(newPath, elcount(newPath), "%s.%s", oldPath, "msgCnt");
  value.msgCnt = C2xGetTokenInt(packetHandle, "PersonalSafetyMessage", newPath);
  result = CheckLastError("PersonalSafetyMessage", gkFuncRefGet, result);

  snprintf(newPath, elcount(newPath), "%s.%s", oldPath, "id");
  value.id.stringLength = C2xGetTokenData(packetHandle, "PersonalSafetyMessage", newPath, elcount(value.id.string), value.id.string);
  snprintf(newPath, elcount(newPath), "%s.%s", oldPath, "position");
  GetPersonalSafetyMessagePosition3DParams(packetHandle, value.position, newPath);
  result = CheckLastError("PersonalSafetyMessage", gkFuncRefGet, result);

  snprintf(newPath, elcount(newPath), "%s.%s", oldPath, "accuracy");
  GetPersonalSafetyMessagePositionalAccuracyParams(packetHandle, value.accuracy, newPath);
  result = CheckLastError("PersonalSafetyMessage", gkFuncRefGet, result);

  snprintf(newPath, elcount(newPath), "%s.%s", oldPath, "speed");
  value.speed = C2xGetTokenInt(packetHandle, "PersonalSafetyMessage", newPath);
  result = CheckLastError("PersonalSafetyMessage", gkFuncRefGet, result);

  snprintf(newPath, elcount(newPath), "%s.%s", oldPath, "heading");
  value.heading = C2xGetTokenInt(packetHandle, "PersonalSafetyMessage", newPath);
  result = CheckLastError("PersonalSafetyMessage", gkFuncRefGet, result);

  snprintf(newPath, elcount(newPath), "%s.%s", oldPath, "accelSet");
  value.accelSet.isValidFlag = C2xIsTokenAvailable(packetHandle, "PersonalSafetyMessage", newPath);
  if(value.accelSet.isValidFlag==1)
  {
    GetPersonalSafetyMessageAccelerationSet4WayParams(packetHandle, value.accelSet, newPath);
    result = CheckLastError("PersonalSafetyMessage", gkFuncRefGet, result);
  }
  snprintf(newPath, elcount(newPath), "%s.%s", oldPath, "pathHistory");
  value.pathHistory.isValidFlag = C2xIsTokenAvailable(packetHandle, "PersonalSafetyMessage", newPath);
  if(value.pathHistory.isValidFlag==1)
  {
    GetPersonalSafetyMessagePathHistoryParams(packetHandle, value.pathHistory, newPath);
    result = CheckLastError("PersonalSafetyMessage", gkFuncRefGet, result);
  }
  snprintf(newPath, elcount(newPath), "%s.%s", oldPath, "pathPrediction");
  value.pathPrediction.isValidFlag = C2xIsTokenAvailable(packetHandle, "PersonalSafetyMessage", newPath);
  if(value.pathPrediction.isValidFlag==1)
  {
    GetPersonalSafetyMessagePathPredictionParams(packetHandle, value.pathPrediction, newPath);
    result = CheckLastError("PersonalSafetyMessage", gkFuncRefGet, result);
  }
  snprintf(newPath, elcount(newPath), "%s.%s", oldPath, "propulsion");
  value.propulsion.isValidFlag = C2xIsTokenAvailable(packetHandle, "PersonalSafetyMessage", newPath);
  if(value.propulsion.isValidFlag==1)
  {
    GetPersonalSafetyMessagePropelledInformationParams(packetHandle, value.propulsion, newPath);
    result = CheckLastError("PersonalSafetyMessage", gkFuncRefGet, result);
  }
  snprintf(newPath, elcount(newPath), "%s.%s", oldPath, "useState");
  value.useState.isValidFlag = C2xIsTokenAvailable(packetHandle, "PersonalSafetyMessage", newPath);
  if(value.useState.isValidFlag==1)
  {
    value.useState.isValidFlag = 1;
    value.useState.stringLength = C2xGetTokenLengthBit(packetHandle, "PersonalSafetyMessage", newPath);
    if ((result = CheckLastError("PersonalSafetyMessage", gkFuncRefGet, result))==0)
    {
      if(value.useState.stringLength > 0)
      {
        for(j=0; j<value.useState.stringLength; j++)
        {
          if(C2xGetTokenBitOfBitString(packetHandle, "PersonalSafetyMessage", newPath, j) == 0)
          {
            value.useState.string[j] = '0';
          }
          else if(C2xGetTokenBitOfBitString(packetHandle, "PersonalSafetyMessage", newPath, j) == 1)
          {
            value.useState.string[j] = '1';
          }

          if(value.useState.stringLength == 1)
          {
            value.useState.string[1] = '0';
          }
          result = CheckLastError("PersonalSafetyMessage", gkFuncRefGet, result);
        }
      }
      else
      {
        for(k = value.useState.stringLength+1; k > -1; k--)
        {
          if(value.useState.string[k] == '1')
          {
            value.useState.string[k] = '0';
          }
        }
      }
    }

  }
  snprintf(newPath, elcount(newPath), "%s.%s", oldPath, "crossRequest");
  value.crossRequest.isValidFlag = C2xIsTokenAvailable(packetHandle, "PersonalSafetyMessage", newPath);
  if(value.crossRequest.isValidFlag==1)
  {
    value.crossRequest.value = C2xGetTokenInt64(packetHandle, "PersonalSafetyMessage", newPath);
    result = CheckLastError("PersonalSafetyMessage", gkFuncRefGet, result);
  }
  snprintf(newPath, elcount(newPath), "%s.%s", oldPath, "crossState");
  value.crossState.isValidFlag = C2xIsTokenAvailable(packetHandle, "PersonalSafetyMessage", newPath);
  if(value.crossState.isValidFlag==1)
  {
    value.crossState.value = C2xGetTokenInt64(packetHandle, "PersonalSafetyMessage", newPath);
    result = CheckLastError("PersonalSafetyMessage", gkFuncRefGet, result);
  }
  snprintf(newPath, elcount(newPath), "%s.%s", oldPath, "clusterSize");
  value.clusterSize.isValidFlag = C2xIsTokenAvailable(packetHandle, "PersonalSafetyMessage", newPath);
  if(value.clusterSize.isValidFlag==1)
  {
    value.clusterSize.value = C2xGetTokenInt(packetHandle, "PersonalSafetyMessage", newPath);
    result = CheckLastError("PersonalSafetyMessage", gkFuncRefGet, result);
  }
  snprintf(newPath, elcount(newPath), "%s.%s", oldPath, "clusterRadius");
  value.clusterRadius.isValidFlag = C2xIsTokenAvailable(packetHandle, "PersonalSafetyMessage", newPath);
  if(value.clusterRadius.isValidFlag==1)
  {
    value.clusterRadius.value = C2xGetTokenInt(packetHandle, "PersonalSafetyMessage", newPath);
    result = CheckLastError("PersonalSafetyMessage", gkFuncRefGet, result);
  }
  snprintf(newPath, elcount(newPath), "%s.%s", oldPath, "eventResponderType");
  value.eventResponderType.isValidFlag = C2xIsTokenAvailable(packetHandle, "PersonalSafetyMessage", newPath);
  if(value.eventResponderType.isValidFlag==1)
  {
    value.eventResponderType.value = C2xGetTokenInt(packetHandle, "PersonalSafetyMessage", newPath);
    result = CheckLastError("PersonalSafetyMessage", gkFuncRefGet, result);
  }
  snprintf(newPath, elcount(newPath), "%s.%s", oldPath, "activityType");
  value.activityType.isValidFlag = C2xIsTokenAvailable(packetHandle, "PersonalSafetyMessage", newPath);
  if(value.activityType.isValidFlag==1)
  {
    value.activityType.isValidFlag = 1;
    value.activityType.stringLength = C2xGetTokenLengthBit(packetHandle, "PersonalSafetyMessage", newPath);
    if ((result = CheckLastError("PersonalSafetyMessage", gkFuncRefGet, result))==0)
    {
      if(value.activityType.stringLength > 0)
      {
        for(j=0; j<value.activityType.stringLength; j++)
        {
          if(C2xGetTokenBitOfBitString(packetHandle, "PersonalSafetyMessage", newPath, j) == 0)
          {
            value.activityType.string[j] = '0';
          }
          else if(C2xGetTokenBitOfBitString(packetHandle, "PersonalSafetyMessage", newPath, j) == 1)
          {
            value.activityType.string[j] = '1';
          }

          if(value.activityType.stringLength == 1)
          {
            value.activityType.string[1] = '0';
          }
          result = CheckLastError("PersonalSafetyMessage", gkFuncRefGet, result);
        }
      }
      else
      {
        for(k = value.activityType.stringLength+1; k > -1; k--)
        {
          if(value.activityType.string[k] == '1')
          {
            value.activityType.string[k] = '0';
          }
        }
      }
    }

  }
  snprintf(newPath, elcount(newPath), "%s.%s", oldPath, "activitySubType");
  value.activitySubType.isValidFlag = C2xIsTokenAvailable(packetHandle, "PersonalSafetyMessage", newPath);
  if(value.activitySubType.isValidFlag==1)
  {
    value.activitySubType.isValidFlag = 1;
    value.activitySubType.stringLength = C2xGetTokenLengthBit(packetHandle, "PersonalSafetyMessage", newPath);
    if ((result = CheckLastError("PersonalSafetyMessage", gkFuncRefGet, result))==0)
    {
      if(value.activitySubType.stringLength > 0)
      {
        for(j=0; j<value.activitySubType.stringLength; j++)
        {
          if(C2xGetTokenBitOfBitString(packetHandle, "PersonalSafetyMessage", newPath, j) == 0)
          {
            value.activitySubType.string[j] = '0';
          }
          else if(C2xGetTokenBitOfBitString(packetHandle, "PersonalSafetyMessage", newPath, j) == 1)
          {
            value.activitySubType.string[j] = '1';
          }

          if(value.activitySubType.stringLength == 1)
          {
            value.activitySubType.string[1] = '0';
          }
          result = CheckLastError("PersonalSafetyMessage", gkFuncRefGet, result);
        }
      }
      else
      {
        for(k = value.activitySubType.stringLength+1; k > -1; k--)
        {
          if(value.activitySubType.string[k] == '1')
          {
            value.activitySubType.string[k] = '0';
          }
        }
      }
    }

  }
  snprintf(newPath, elcount(newPath), "%s.%s", oldPath, "assistType");
  value.assistType.isValidFlag = C2xIsTokenAvailable(packetHandle, "PersonalSafetyMessage", newPath);
  if(value.assistType.isValidFlag==1)
  {
    value.assistType.isValidFlag = 1;
    value.assistType.stringLength = C2xGetTokenLengthBit(packetHandle, "PersonalSafetyMessage", newPath);
    if ((result = CheckLastError("PersonalSafetyMessage", gkFuncRefGet, result))==0)
    {
      if(value.assistType.stringLength > 0)
      {
        for(j=0; j<value.assistType.stringLength; j++)
        {
          if(C2xGetTokenBitOfBitString(packetHandle, "PersonalSafetyMessage", newPath, j) == 0)
          {
            value.assistType.string[j] = '0';
          }
          else if(C2xGetTokenBitOfBitString(packetHandle, "PersonalSafetyMessage", newPath, j) == 1)
          {
            value.assistType.string[j] = '1';
          }

          if(value.assistType.stringLength == 1)
          {
            value.assistType.string[1] = '0';
          }
          result = CheckLastError("PersonalSafetyMessage", gkFuncRefGet, result);
        }
      }
      else
      {
        for(k = value.assistType.stringLength+1; k > -1; k--)
        {
          if(value.assistType.string[k] == '1')
          {
            value.assistType.string[k] = '0';
          }
        }
      }
    }

  }
  snprintf(newPath, elcount(newPath), "%s.%s", oldPath, "sizing");
  value.sizing.isValidFlag = C2xIsTokenAvailable(packetHandle, "PersonalSafetyMessage", newPath);
  if(value.sizing.isValidFlag==1)
  {
    value.sizing.isValidFlag = 1;
    value.sizing.stringLength = C2xGetTokenLengthBit(packetHandle, "PersonalSafetyMessage", newPath);
    if ((result = CheckLastError("PersonalSafetyMessage", gkFuncRefGet, result))==0)
    {
      if(value.sizing.stringLength > 0)
      {
        for(j=0; j<value.sizing.stringLength; j++)
        {
          if(C2xGetTokenBitOfBitString(packetHandle, "PersonalSafetyMessage", newPath, j) == 0)
          {
            value.sizing.string[j] = '0';
          }
          else if(C2xGetTokenBitOfBitString(packetHandle, "PersonalSafetyMessage", newPath, j) == 1)
          {
            value.sizing.string[j] = '1';
          }

          if(value.sizing.stringLength == 1)
          {
            value.sizing.string[1] = '0';
          }
          result = CheckLastError("PersonalSafetyMessage", gkFuncRefGet, result);
        }
      }
      else
      {
        for(k = value.sizing.stringLength+1; k > -1; k--)
        {
          if(value.sizing.string[k] == '1')
          {
            value.sizing.string[k] = '0';
          }
        }
      }
    }

  }
  snprintf(newPath, elcount(newPath), "%s.%s", oldPath, "attachment");
  value.attachment.isValidFlag = C2xIsTokenAvailable(packetHandle, "PersonalSafetyMessage", newPath);
  if(value.attachment.isValidFlag==1)
  {
    value.attachment.value = C2xGetTokenInt(packetHandle, "PersonalSafetyMessage", newPath);
    result = CheckLastError("PersonalSafetyMessage", gkFuncRefGet, result);
  }
  snprintf(newPath, elcount(newPath), "%s.%s", oldPath, "attachmentRadius");
  value.attachmentRadius.isValidFlag = C2xIsTokenAvailable(packetHandle, "PersonalSafetyMessage", newPath);
  if(value.attachmentRadius.isValidFlag==1)
  {
    value.attachmentRadius.value = C2xGetTokenInt(packetHandle, "PersonalSafetyMessage", newPath);
    result = CheckLastError("PersonalSafetyMessage", gkFuncRefGet, result);
  }
  snprintf(newPath, elcount(newPath), "%s.%s", oldPath, "animalType");
  value.animalType.isValidFlag = C2xIsTokenAvailable(packetHandle, "PersonalSafetyMessage", newPath);
  if(value.animalType.isValidFlag==1)
  {
    value.animalType.value = C2xGetTokenInt(packetHandle, "PersonalSafetyMessage", newPath);
    result = CheckLastError("PersonalSafetyMessage", gkFuncRefGet, result);
  }
  snprintf(newPath, elcount(newPath), "%s.%s", oldPath, "regional");
  value.regional.isValidFlag = C2xIsTokenAvailable(packetHandle, "PersonalSafetyMessage", newPath);
  if(value.regional.isValidFlag==1)
  {
    GetPersonalSafetyMessage_PersonalSafetyMessage_regionalParams(packetHandle, value.regional, newPath);
    result = CheckLastError("PersonalSafetyMessage", gkFuncRefGet, result);
  }
  return result;
}

int SetPersonalSafetyMessagePSMParams(LONG packetHandle, struct PersonalSafetyMessagePSM value, char oldPath[])
{
  char newPath[300]; 
  int j;
  int result;

  result = 0;

  snprintf(newPath, elcount(newPath), "%s.%s", oldPath, "basicType");
  C2xSetTokenInt(packetHandle, "PersonalSafetyMessage", newPath, value.basicType);
  result = CheckLastError("PersonalSafetyMessage", gkFuncRefGet, result);

  snprintf(newPath, elcount(newPath), "%s.%s", oldPath, "secMark");
  C2xSetTokenInt(packetHandle, "PersonalSafetyMessage", newPath, value.secMark);
  result = CheckLastError("PersonalSafetyMessage", gkFuncRefGet, result);

  snprintf(newPath, elcount(newPath), "%s.%s", oldPath, "msgCnt");
  C2xSetTokenInt(packetHandle, "PersonalSafetyMessage", newPath, value.msgCnt);
  result = CheckLastError("PersonalSafetyMessage", gkFuncRefGet, result);

  if(value.id.stringLength == 0)
  {
    value.id.stringLength = 4;
    memcpy(value.id.string, "0000", value.id.stringLength);
  }

  snprintf(newPath, elcount(newPath), "%s.%s", oldPath, "id");
  C2xSetTokenData(packetHandle, "PersonalSafetyMessage", newPath, value.id.stringLength, value.id.string);

  snprintf(newPath, elcount(newPath), "%s.%s", oldPath, "position");
  SetPersonalSafetyMessagePosition3DParams(packetHandle, value.position, newPath);
  result = CheckLastError("PersonalSafetyMessage", gkFuncRefGet, result);

  snprintf(newPath, elcount(newPath), "%s.%s", oldPath, "accuracy");
  SetPersonalSafetyMessagePositionalAccuracyParams(packetHandle, value.accuracy, newPath);
  result = CheckLastError("PersonalSafetyMessage", gkFuncRefGet, result);

  snprintf(newPath, elcount(newPath), "%s.%s", oldPath, "speed");
  C2xSetTokenInt(packetHandle, "PersonalSafetyMessage", newPath, value.speed);
  result = CheckLastError("PersonalSafetyMessage", gkFuncRefGet, result);

  snprintf(newPath, elcount(newPath), "%s.%s", oldPath, "heading");
  C2xSetTokenInt(packetHandle, "PersonalSafetyMessage", newPath, value.heading);
  result = CheckLastError("PersonalSafetyMessage", gkFuncRefGet, result);

  snprintf(newPath, elcount(newPath), "%s.%s", oldPath, "accelSet");
  if(value.accelSet.isValidFlag==1)
  {
    SetPersonalSafetyMessageAccelerationSet4WayParams(packetHandle, value.accelSet, newPath);
    result = CheckLastError("PersonalSafetyMessage", gkFuncRefGet, result);
  }
  else
  {
    if( C2xIsTokenAvailable(packetHandle, "PersonalSafetyMessage", newPath) )
    {
      C2xRemoveToken(packetHandle, "PersonalSafetyMessage", newPath);
    }
  }

  snprintf(newPath, elcount(newPath), "%s.%s", oldPath, "pathHistory");
  if(value.pathHistory.isValidFlag==1)
  {
    SetPersonalSafetyMessagePathHistoryParams(packetHandle, value.pathHistory, newPath);
    result = CheckLastError("PersonalSafetyMessage", gkFuncRefGet, result);
  }
  else
  {
    if( C2xIsTokenAvailable(packetHandle, "PersonalSafetyMessage", newPath) )
    {
      C2xRemoveToken(packetHandle, "PersonalSafetyMessage", newPath);
    }
  }

  snprintf(newPath, elcount(newPath), "%s.%s", oldPath, "pathPrediction");
  if(value.pathPrediction.isValidFlag==1)
  {
    SetPersonalSafetyMessagePathPredictionParams(packetHandle, value.pathPrediction, newPath);
    result = CheckLastError("PersonalSafetyMessage", gkFuncRefGet, result);
  }
  else
  {
    if( C2xIsTokenAvailable(packetHandle, "PersonalSafetyMessage", newPath) )
    {
      C2xRemoveToken(packetHandle, "PersonalSafetyMessage", newPath);
    }
  }

  snprintf(newPath, elcount(newPath), "%s.%s", oldPath, "propulsion");
  if(value.propulsion.isValidFlag==1)
  {
    SetPersonalSafetyMessagePropelledInformationParams(packetHandle, value.propulsion, newPath);
    result = CheckLastError("PersonalSafetyMessage", gkFuncRefGet, result);
  }
  else
  {
    if( C2xIsTokenAvailable(packetHandle, "PersonalSafetyMessage", newPath) )
    {
      C2xRemoveToken(packetHandle, "PersonalSafetyMessage", newPath);
    }
  }

  snprintf(newPath, elcount(newPath), "%s.%s", oldPath, "useState");
  if(value.useState.isValidFlag==1)
  {
      for(j=0; j<value.useState.stringLength; j++)
      {
        if(value.useState.string[j] == '0')
        {
          C2xSetTokenBitOfBitString(packetHandle, "PersonalSafetyMessage", newPath, j, 0);
        }
        else
        {
          C2xSetTokenBitOfBitString(packetHandle, "PersonalSafetyMessage", newPath, j, 1);
        }
        result = CheckLastError("PersonalSafetyMessage", gkFuncRefGet, result);
      }
  }
  else
  {
    if( C2xIsTokenAvailable(packetHandle, "PersonalSafetyMessage", newPath) )
    {
      C2xRemoveToken(packetHandle, "PersonalSafetyMessage", newPath);
    }
  }

  snprintf(newPath, elcount(newPath), "%s.%s", oldPath, "crossRequest");
  if(value.crossRequest.isValidFlag==1)
  {
    C2xSetTokenInt64(packetHandle, "PersonalSafetyMessage", newPath, value.crossRequest.value);
    result = CheckLastError("PersonalSafetyMessage", gkFuncRefGet, result);
  }
  else
  {
    if( C2xIsTokenAvailable(packetHandle, "PersonalSafetyMessage", newPath) )
    {
      C2xRemoveToken(packetHandle, "PersonalSafetyMessage", newPath);
    }
  }

  snprintf(newPath, elcount(newPath), "%s.%s", oldPath, "crossState");
  if(value.crossState.isValidFlag==1)
  {
    C2xSetTokenInt64(packetHandle, "PersonalSafetyMessage", newPath, value.crossState.value);
    result = CheckLastError("PersonalSafetyMessage", gkFuncRefGet, result);
  }
  else
  {
    if( C2xIsTokenAvailable(packetHandle, "PersonalSafetyMessage", newPath) )
    {
      C2xRemoveToken(packetHandle, "PersonalSafetyMessage", newPath);
    }
  }

  snprintf(newPath, elcount(newPath), "%s.%s", oldPath, "clusterSize");
  if(value.clusterSize.isValidFlag==1)
  {
    C2xSetTokenInt(packetHandle, "PersonalSafetyMessage", newPath, value.clusterSize.value);
    result = CheckLastError("PersonalSafetyMessage", gkFuncRefGet, result);
  }
  else
  {
    if( C2xIsTokenAvailable(packetHandle, "PersonalSafetyMessage", newPath) )
    {
      C2xRemoveToken(packetHandle, "PersonalSafetyMessage", newPath);
    }
  }

  snprintf(newPath, elcount(newPath), "%s.%s", oldPath, "clusterRadius");
  if(value.clusterRadius.isValidFlag==1)
  {
    C2xSetTokenInt(packetHandle, "PersonalSafetyMessage", newPath, value.clusterRadius.value);
    result = CheckLastError("PersonalSafetyMessage", gkFuncRefGet, result);
  }
  else
  {
    if( C2xIsTokenAvailable(packetHandle, "PersonalSafetyMessage", newPath) )
    {
      C2xRemoveToken(packetHandle, "PersonalSafetyMessage", newPath);
    }
  }

  snprintf(newPath, elcount(newPath), "%s.%s", oldPath, "eventResponderType");
  if(value.eventResponderType.isValidFlag==1)
  {
    C2xSetTokenInt(packetHandle, "PersonalSafetyMessage", newPath, value.eventResponderType.value);
    result = CheckLastError("PersonalSafetyMessage", gkFuncRefGet, result);
  }
  else
  {
    if( C2xIsTokenAvailable(packetHandle, "PersonalSafetyMessage", newPath) )
    {
      C2xRemoveToken(packetHandle, "PersonalSafetyMessage", newPath);
    }
  }

  snprintf(newPath, elcount(newPath), "%s.%s", oldPath, "activityType");
  if(value.activityType.isValidFlag==1)
  {
      for(j=0; j<value.activityType.stringLength; j++)
      {
        if(value.activityType.string[j] == '0')
        {
          C2xSetTokenBitOfBitString(packetHandle, "PersonalSafetyMessage", newPath, j, 0);
        }
        else
        {
          C2xSetTokenBitOfBitString(packetHandle, "PersonalSafetyMessage", newPath, j, 1);
        }
        result = CheckLastError("PersonalSafetyMessage", gkFuncRefGet, result);
      }
  }
  else
  {
    if( C2xIsTokenAvailable(packetHandle, "PersonalSafetyMessage", newPath) )
    {
      C2xRemoveToken(packetHandle, "PersonalSafetyMessage", newPath);
    }
  }

  snprintf(newPath, elcount(newPath), "%s.%s", oldPath, "activitySubType");
  if(value.activitySubType.isValidFlag==1)
  {
      for(j=0; j<value.activitySubType.stringLength; j++)
      {
        if(value.activitySubType.string[j] == '0')
        {
          C2xSetTokenBitOfBitString(packetHandle, "PersonalSafetyMessage", newPath, j, 0);
        }
        else
        {
          C2xSetTokenBitOfBitString(packetHandle, "PersonalSafetyMessage", newPath, j, 1);
        }
        result = CheckLastError("PersonalSafetyMessage", gkFuncRefGet, result);
      }
  }
  else
  {
    if( C2xIsTokenAvailable(packetHandle, "PersonalSafetyMessage", newPath) )
    {
      C2xRemoveToken(packetHandle, "PersonalSafetyMessage", newPath);
    }
  }

  snprintf(newPath, elcount(newPath), "%s.%s", oldPath, "assistType");
  if(value.assistType.isValidFlag==1)
  {
      for(j=0; j<value.assistType.stringLength; j++)
      {
        if(value.assistType.string[j] == '0')
        {
          C2xSetTokenBitOfBitString(packetHandle, "PersonalSafetyMessage", newPath, j, 0);
        }
        else
        {
          C2xSetTokenBitOfBitString(packetHandle, "PersonalSafetyMessage", newPath, j, 1);
        }
        result = CheckLastError("PersonalSafetyMessage", gkFuncRefGet, result);
      }
  }
  else
  {
    if( C2xIsTokenAvailable(packetHandle, "PersonalSafetyMessage", newPath) )
    {
      C2xRemoveToken(packetHandle, "PersonalSafetyMessage", newPath);
    }
  }

  snprintf(newPath, elcount(newPath), "%s.%s", oldPath, "sizing");
  if(value.sizing.isValidFlag==1)
  {
      for(j=0; j<value.sizing.stringLength; j++)
      {
        if(value.sizing.string[j] == '0')
        {
          C2xSetTokenBitOfBitString(packetHandle, "PersonalSafetyMessage", newPath, j, 0);
        }
        else
        {
          C2xSetTokenBitOfBitString(packetHandle, "PersonalSafetyMessage", newPath, j, 1);
        }
        result = CheckLastError("PersonalSafetyMessage", gkFuncRefGet, result);
      }
  }
  else
  {
    if( C2xIsTokenAvailable(packetHandle, "PersonalSafetyMessage", newPath) )
    {
      C2xRemoveToken(packetHandle, "PersonalSafetyMessage", newPath);
    }
  }

  snprintf(newPath, elcount(newPath), "%s.%s", oldPath, "attachment");
  if(value.attachment.isValidFlag==1)
  {
    C2xSetTokenInt(packetHandle, "PersonalSafetyMessage", newPath, value.attachment.value);
    result = CheckLastError("PersonalSafetyMessage", gkFuncRefGet, result);
  }
  else
  {
    if( C2xIsTokenAvailable(packetHandle, "PersonalSafetyMessage", newPath) )
    {
      C2xRemoveToken(packetHandle, "PersonalSafetyMessage", newPath);
    }
  }

  snprintf(newPath, elcount(newPath), "%s.%s", oldPath, "attachmentRadius");
  if(value.attachmentRadius.isValidFlag==1)
  {
    C2xSetTokenInt(packetHandle, "PersonalSafetyMessage", newPath, value.attachmentRadius.value);
    result = CheckLastError("PersonalSafetyMessage", gkFuncRefGet, result);
  }
  else
  {
    if( C2xIsTokenAvailable(packetHandle, "PersonalSafetyMessage", newPath) )
    {
      C2xRemoveToken(packetHandle, "PersonalSafetyMessage", newPath);
    }
  }

  snprintf(newPath, elcount(newPath), "%s.%s", oldPath, "animalType");
  if(value.animalType.isValidFlag==1)
  {
    C2xSetTokenInt(packetHandle, "PersonalSafetyMessage", newPath, value.animalType.value);
    result = CheckLastError("PersonalSafetyMessage", gkFuncRefGet, result);
  }
  else
  {
    if( C2xIsTokenAvailable(packetHandle, "PersonalSafetyMessage", newPath) )
    {
      C2xRemoveToken(packetHandle, "PersonalSafetyMessage", newPath);
    }
  }

  snprintf(newPath, elcount(newPath), "%s.%s", oldPath, "regional");
  if(value.regional.isValidFlag==1)
  {
    SetPersonalSafetyMessage_PersonalSafetyMessage_regionalParams(packetHandle, value.regional, newPath);
    result = CheckLastError("PersonalSafetyMessage", gkFuncRefGet, result);
  }
  else
  {
    if( C2xIsTokenAvailable(packetHandle, "PersonalSafetyMessage", newPath) )
    {
      C2xRemoveToken(packetHandle, "PersonalSafetyMessage", newPath);
    }
  }

  return result;
}

int GetPersonalSafetyMessageMESSAGE_ID_AND_TYPEParams(LONG packetHandle, WORD tableKey, struct PersonalSafetyMessageMESSAGE_ID_AND_TYPE value, char oldPath[])
{
  char newPath[300];
  int result;

  result = 0;

  switch(tableKey)
  {
    case 32:
    {
      snprintf(newPath, elcount(newPath), "%s.%s", oldPath, "personalSafetyMessage");
      GetPersonalSafetyMessagePSMParams(packetHandle, value.personalSafetyMessage, newPath);
      result = CheckLastError("PersonalSafetyMessage", gkFuncRefGet, result);
    }
    break;
  }
  return result;
}

int SetPersonalSafetyMessageMESSAGE_ID_AND_TYPEParams(LONG packetHandle, WORD tableKey, struct PersonalSafetyMessageMESSAGE_ID_AND_TYPE value, char oldPath[])
{
  char newPath[300];
  int result;

  result = 0;

  switch(tableKey)
  {
    case 32:
    {
      snprintf(newPath, elcount(newPath), "%s.%s", oldPath, "personalSafetyMessage");
      SetPersonalSafetyMessagePSMParams(packetHandle, value.personalSafetyMessage, newPath);
      result = CheckLastError("PersonalSafetyMessage", gkFuncRefGet, result);
    }
    break;
  }
  return result;
}

int API_GetPersonalSafetyMessageParams(LONG packetHandle, struct PersonalSafetyMessage value)
{
  int result;
  result = 0;

  value.messageId = C2xGetTokenInt(packetHandle, "PersonalSafetyMessage", "messageId");
  result = CheckLastError("PersonalSafetyMessage", gkFuncRefGet, result);

  GetPersonalSafetyMessageMESSAGE_ID_AND_TYPEParams(packetHandle, value.messageId, value.value, "value");
  result = CheckLastError("PersonalSafetyMessage", gkFuncRefGet, result);

  return result;
}

int API_SetPersonalSafetyMessageParams(LONG packetHandle, struct PersonalSafetyMessage value)
{
  int result;
  result = 0;

  value.messageId = 32;

  SetPersonalSafetyMessageMESSAGE_ID_AND_TYPEParams(packetHandle, value.messageId, value.value, "value");
  result = CheckLastError("PersonalSafetyMessage", gkFuncRefGet, result);

  return result;
}

