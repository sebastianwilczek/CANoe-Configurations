/*@!Encoding:1252*/
/*
//  (c) Vector Informatik GmbH. All rights reserved.
//
//  This file contains definitions of structs and methods that may be used
//  to set and get the values of an ASN.1 defined packet's payload.
//
//  //This example demonstrates how to set a packet's payload:
//  LONG packetHandle;
//  struct WSA payload;
//  //you need to set the values of the variable "payload" yourself
//  packetHandle = API_InitWSAPacket();
//  if (packetHandle!=0) {
//    if (API_SetWSAParams(packetHandle, payload)==0) {
//      if (C2xCompletePacket(packetHandle)==0) {
//        C2xOutputPacket(packetHandle);
//      }
//    }
//  }
//                                                                             */
includes
{

}
variables
{
    struct WSASrvAdvChangeCount {
        INT isValidFlag;   // necessary if this struct is used as an optional field of a SEQUENCE
        BYTE saID;  // INTEGER, 0..15;
        BYTE contentCount;  // INTEGER, 0..15;
    };
    
    struct WSAIEEE_1609_3_WEE_Latitude_fill {
        INT isValidFlag;   // necessary if this struct is used as an optional field of a SEQUENCE
        CHAR string[2];
        INT  stringLength;
    };
    
    struct WSAIEEE_1609_3_WEE_Latitude {
        INT isValidFlag;   // necessary if this struct is used as an optional field of a SEQUENCE
        struct WSAIEEE_1609_3_WEE_Latitude_fill fill;  // BITSTRING;
        LONG lat;  // INTEGER, -900000000..900000001;
    };
    
    struct WSAIEEE_1609_3_WEE_TwoDLocation {
        INT isValidFlag;   // necessary if this struct is used as an optional field of a SEQUENCE
        struct WSAIEEE_1609_3_WEE_Latitude latitude;  // SEQUENCE;
        LONG longitude;  // INTEGER, -1800000000..1800000001;
    };
    
    struct WSAIEEE_1609_3_WEE_ThreeDLocation {
        INT isValidFlag;   // necessary if this struct is used as an optional field of a SEQUENCE
        struct WSAIEEE_1609_3_WEE_Latitude latitude;  // SEQUENCE;
        LONG longitude;  // INTEGER, -1800000000..1800000001;
        LONG elevation;  // INTEGER, -4096..61439;
    };
    
    struct WSAIEEE_1609_3_WEE_AdvertiserIdentifier {
        INT isValidFlag;   // necessary if this struct is used as an optional field of a SEQUENCE
        CHAR string[33];
        INT  stringLength;
    };
    
    struct WSASrvAdvMsgHeaderExtTypes {
        BYTE c_RepeatRate;  // INTEGER, 0..255;
        struct WSAIEEE_1609_3_WEE_TwoDLocation c_2Dlocation;  // SEQUENCE;
        struct WSAIEEE_1609_3_WEE_ThreeDLocation c_3Dlocation;  // SEQUENCE;
        struct WSAIEEE_1609_3_WEE_AdvertiserIdentifier c_advertiserID;  // UTF8STRING;
    };
    
    struct WSAExtension_SrvAdvMsgHeaderExtTypes {
        INT isValidFlag;   // necessary if this struct is used as an optional field of a SEQUENCE
        BYTE extensionId;  // INTEGER, 0..255, c_Reserved(0), c_TxPowerUsed80211(4), c_2Dlocation(5), c_3Dlocation(6), c_advertiserID(7), c_ProviderServContext(8), c_IPv6Address(9), c_servicePort(10), c_ProviderMACaddress(11), c_EDCAparameterSet(12), c_SecondaryDNS(13), c_GatewayMACaddress(14), c_ChannelNumber80211(15), c_DataRate80211(16), c_RepeatRate(17), c_RCPIthreshold(19), c_WSAcountThreshold(20), c_ChannelAccess(21), c_WSAcountThresInt(22), c_ChannelLoad(23);
        struct WSASrvAdvMsgHeaderExtTypes value;  // TABLE;
    };
    
    struct WSASrvAdvMsgHeaderExts {
        INT isValidFlag;   // necessary if this struct is used as an optional field of a SEQUENCE
        INT length;
        struct WSAExtension_SrvAdvMsgHeaderExtTypes arrayValue[32];  // SEQUENCE;
    };
    
    struct WSACITSapplMgmtIDs_Ext2 {
        INT isValidFlag;   // necessary if this struct is used as an optional field of a SEQUENCE
        INT choice;
        DWORD content;  // INTEGER, 16512..2113663;
        DWORD extension;  // INTEGER, 2113664..270549119;
    };
    
    struct WSACITSapplMgmtIDs_Ext1 {
        INT isValidFlag;   // necessary if this struct is used as an optional field of a SEQUENCE
        INT choice;
        WORD content;  // INTEGER, 128..16511;
        struct WSACITSapplMgmtIDs_Ext2 extension;  // CHOICE;
    };
    
    struct WSACITSapplMgmtIDs_VarLengthNumber {
        INT isValidFlag;   // necessary if this struct is used as an optional field of a SEQUENCE
        INT choice;
        BYTE content;  // INTEGER, 0..127;
        struct WSACITSapplMgmtIDs_Ext1 extension;  // CHOICE;
    };
    
    struct WSAIEEE_1609_3_WEE_ProviderServiceContext_fillBit {
        INT isValidFlag;   // necessary if this struct is used as an optional field of a SEQUENCE
        CHAR string[4];
        INT  stringLength;
    };
    
    struct WSAIEEE_1609_3_WEE_ProviderServiceContext_psc {
        INT isValidFlag;   // necessary if this struct is used as an optional field of a SEQUENCE
        CHAR string[32];
        INT  stringLength;
    };
    
    struct WSAIEEE_1609_3_WEE_ProviderServiceContext {
        INT isValidFlag;   // necessary if this struct is used as an optional field of a SEQUENCE
        struct WSAIEEE_1609_3_WEE_ProviderServiceContext_fillBit fillBit;  // BITSTRING;
        struct WSAIEEE_1609_3_WEE_ProviderServiceContext_psc psc;  // OCTETSTRING;
    };
    
    struct WSAIEEE_1609_3_WEE_IPv6Address {
        INT isValidFlag;   // necessary if this struct is used as an optional field of a SEQUENCE
        CHAR string[17];
        INT  stringLength;
    };
    
    struct WSAIEEE_1609_3_WEE_MACaddress {
        INT isValidFlag;   // necessary if this struct is used as an optional field of a SEQUENCE
        CHAR string[7];
        INT  stringLength;
    };
    
    struct WSAServiceInfoExtTypes {
        struct WSAIEEE_1609_3_WEE_ProviderServiceContext c_ProviderServContext;  // SEQUENCE;
        struct WSAIEEE_1609_3_WEE_IPv6Address c_IPv6Address;  // OCTETSTRING;
        WORD c_servicePort;  // INTEGER, 0..65535;
        struct WSAIEEE_1609_3_WEE_MACaddress c_ProviderMACaddress;  // OCTETSTRING;
        BYTE c_RCPIthreshold;  // INTEGER, 0..255;
        BYTE c_WSAcountThreshold;  // INTEGER, 0..255;
        BYTE c_WSAcountThresInt;  // INTEGER, 0..255;
    };
    
    struct WSAExtension_ServiceInfoExtTypes {
        INT isValidFlag;   // necessary if this struct is used as an optional field of a SEQUENCE
        BYTE extensionId;  // INTEGER, 0..255, c_Reserved(0), c_TxPowerUsed80211(4), c_2Dlocation(5), c_3Dlocation(6), c_advertiserID(7), c_ProviderServContext(8), c_IPv6Address(9), c_servicePort(10), c_ProviderMACaddress(11), c_EDCAparameterSet(12), c_SecondaryDNS(13), c_GatewayMACaddress(14), c_ChannelNumber80211(15), c_DataRate80211(16), c_RepeatRate(17), c_RCPIthreshold(19), c_WSAcountThreshold(20), c_ChannelAccess(21), c_WSAcountThresInt(22), c_ChannelLoad(23);
        struct WSAServiceInfoExtTypes value;  // TABLE;
    };
    
    struct WSAServiceInfoExts {
        INT isValidFlag;   // necessary if this struct is used as an optional field of a SEQUENCE
        INT length;
        struct WSAExtension_ServiceInfoExtTypes arrayValue[32];  // SEQUENCE;
    };
    
    struct WSAChannelOptions {
        INT isValidFlag;   // necessary if this struct is used as an optional field of a SEQUENCE
        struct WSAServiceInfoExts extensions;  // SEQUENCEOF, OPTIONAL;
    };
    
    struct WSAServiceInfo {
        INT isValidFlag;   // necessary if this struct is used as an optional field of a SEQUENCE
        struct WSACITSapplMgmtIDs_VarLengthNumber serviceID;  // CHOICE;
        BYTE channelIndex;  // INTEGER, 0..31, notUsed(0), firstEntry(1);
        struct WSAChannelOptions chOptions;  // SEQUENCE;
    };
    
    struct WSAServiceInfos {
        INT isValidFlag;   // necessary if this struct is used as an optional field of a SEQUENCE
        INT length;
        struct WSAServiceInfo arrayValue[32];  // SEQUENCE;
    };
    
    struct WSAWsaChInfoDataRate_adaptable {
        INT isValidFlag;   // necessary if this struct is used as an optional field of a SEQUENCE
        CHAR string[2];
        INT  stringLength;
    };
    
    struct WSAWsaChInfoDataRate {
        INT isValidFlag;   // necessary if this struct is used as an optional field of a SEQUENCE
        struct WSAWsaChInfoDataRate_adaptable adaptable;  // BITSTRING;
        BYTE dataRate;  // INTEGER, 0..127;
    };
    
    struct WSAIEEE_1609_3_WEE_EdcaParameterRecord {
        INT isValidFlag;   // necessary if this struct is used as an optional field of a SEQUENCE
        BYTE res;  // INTEGER, 0..1;
        BYTE aci;  // INTEGER, 0..3;
        BYTE acm;  // INTEGER, 0..1;
        BYTE aifsn;  // INTEGER, 0..15;
        BYTE ecwMax;  // INTEGER, 0..15;
        BYTE ecwMin;  // INTEGER, 0..15;
        WORD txopLimit;  // INTEGER, 0..65535;
    };
    
    struct WSAIEEE_1609_3_WEE_EdcaParameterSet {
        INT isValidFlag;   // necessary if this struct is used as an optional field of a SEQUENCE
        struct WSAIEEE_1609_3_WEE_EdcaParameterRecord acbeRecord;  // SEQUENCE;
        struct WSAIEEE_1609_3_WEE_EdcaParameterRecord acbkRecord;  // SEQUENCE;
        struct WSAIEEE_1609_3_WEE_EdcaParameterRecord acviRecord;  // SEQUENCE;
        struct WSAIEEE_1609_3_WEE_EdcaParameterRecord acvoRecord;  // SEQUENCE;
    };
    
    struct WSAChannelInfoExtTypes {
        struct WSAIEEE_1609_3_WEE_EdcaParameterSet c_EDCAparameterSet;  // SEQUENCE;
        BYTE c_ChannelAccess;  // INTEGER, 0..255, continuous(0), alternatingSCH(1), alternatingCCH(2);
    };
    
    struct WSAExtension_ChannelInfoExtTypes {
        INT isValidFlag;   // necessary if this struct is used as an optional field of a SEQUENCE
        BYTE extensionId;  // INTEGER, 0..255, c_Reserved(0), c_TxPowerUsed80211(4), c_2Dlocation(5), c_3Dlocation(6), c_advertiserID(7), c_ProviderServContext(8), c_IPv6Address(9), c_servicePort(10), c_ProviderMACaddress(11), c_EDCAparameterSet(12), c_SecondaryDNS(13), c_GatewayMACaddress(14), c_ChannelNumber80211(15), c_DataRate80211(16), c_RepeatRate(17), c_RCPIthreshold(19), c_WSAcountThreshold(20), c_ChannelAccess(21), c_WSAcountThresInt(22), c_ChannelLoad(23);
        struct WSAChannelInfoExtTypes value;  // TABLE;
    };
    
    struct WSAChannelInfoExts {
        INT isValidFlag;   // necessary if this struct is used as an optional field of a SEQUENCE
        INT length;
        struct WSAExtension_ChannelInfoExtTypes arrayValue[32];  // SEQUENCE;
    };
    
    struct WSAChInfoOptions {
        INT isValidFlag;   // necessary if this struct is used as an optional field of a SEQUENCE
        struct WSAChannelInfoExts extensions;  // SEQUENCEOF, OPTIONAL;
    };
    
    struct WSAChannelInfo {
        INT isValidFlag;   // necessary if this struct is used as an optional field of a SEQUENCE
        BYTE operatingClass;  // INTEGER, 0..255;
        BYTE channelNumber;  // INTEGER, 0..255;
        INT powerLevel;  // INTEGER, -128..127;
        struct WSAWsaChInfoDataRate dataRate;  // SEQUENCE;
        struct WSAChInfoOptions extensions;  // SEQUENCE;
    };
    
    struct WSAChannelInfos {
        INT isValidFlag;   // necessary if this struct is used as an optional field of a SEQUENCE
        INT length;
        struct WSAChannelInfo arrayValue[32];  // SEQUENCE;
    };
    
    struct WSAIpV6Prefix {
        INT isValidFlag;   // necessary if this struct is used as an optional field of a SEQUENCE
        CHAR string[17];
        INT  stringLength;
    };
    
    struct WSARoutAdvertExtTypes {
        struct WSAIEEE_1609_3_WEE_IPv6Address c_SecondaryDNS;  // OCTETSTRING;
        struct WSAIEEE_1609_3_WEE_MACaddress c_GatewayMACaddress;  // OCTETSTRING;
    };
    
    struct WSAExtension_RoutAdvertExtTypes {
        INT isValidFlag;   // necessary if this struct is used as an optional field of a SEQUENCE
        BYTE extensionId;  // INTEGER, 0..255, c_Reserved(0), c_TxPowerUsed80211(4), c_2Dlocation(5), c_3Dlocation(6), c_advertiserID(7), c_ProviderServContext(8), c_IPv6Address(9), c_servicePort(10), c_ProviderMACaddress(11), c_EDCAparameterSet(12), c_SecondaryDNS(13), c_GatewayMACaddress(14), c_ChannelNumber80211(15), c_DataRate80211(16), c_RepeatRate(17), c_RCPIthreshold(19), c_WSAcountThreshold(20), c_ChannelAccess(21), c_WSAcountThresInt(22), c_ChannelLoad(23);
        struct WSARoutAdvertExtTypes value;  // TABLE;
    };
    
    struct WSARoutAdvertExts {
        INT isValidFlag;   // necessary if this struct is used as an optional field of a SEQUENCE
        INT length;
        struct WSAExtension_RoutAdvertExtTypes arrayValue[32];  // SEQUENCE;
    };
    
    struct WSARoutingAdvertisement {
        INT isValidFlag;   // necessary if this struct is used as an optional field of a SEQUENCE
        WORD lifetime;  // INTEGER, 0..65535;
        struct WSAIpV6Prefix ipPrefix;  // OCTETSTRING;
        BYTE ipPrefixLength;  // INTEGER, 0..255;
        struct WSAIEEE_1609_3_WEE_IPv6Address defaultGateway;  // OCTETSTRING;
        struct WSAIEEE_1609_3_WEE_IPv6Address primaryDns;  // OCTETSTRING;
        struct WSARoutAdvertExts extensions;  // SEQUENCEOF;
    };
    
    struct WSASrvAdvBody {
        INT isValidFlag;   // necessary if this struct is used as an optional field of a SEQUENCE
        struct WSASrvAdvChangeCount changeCount;  // SEQUENCE;
        struct WSASrvAdvMsgHeaderExts extensions;  // SEQUENCEOF, OPTIONAL;
        struct WSAServiceInfos serviceInfos;  // SEQUENCEOF, OPTIONAL;
        struct WSAChannelInfos channelInfos;  // SEQUENCEOF, OPTIONAL;
        struct WSARoutingAdvertisement routingAdvertisement;  // SEQUENCE, OPTIONAL;
    };
    
    struct WSA {
        INT isValidFlag;   // necessary if this struct is used as an optional field of a SEQUENCE
        BYTE version;  // INTEGER, 0..15, c_rsvAdvPrtVersionNo(3);
        struct WSASrvAdvBody body;  // SEQUENCE;
    };
    
}

/*
// init function to create a simple packet handle
*/ 
LONG API_InitWSAPacket()
{
  return C2xInitPacket("WSA"); 
}

/*
// init function to create a simple packet handle and
// initialize the struct with valid data
*/ 
LONG API_InitWSAPacket(struct WSA msgStruct)
{
  long pktHandle;

  pktHandle = API_InitWSAPacket();

  if (pktHandle != 0)
  {
    // create valid message and application data
    if (C2xCompletePacket(pktHandle) == 0) 
    {
      API_GetWSAParams(pktHandle, msgStruct);
    }
  }
  return pktHandle;
}

/*
// init function to create a packet with security layer and
// initialize the struct with valid data
*/ 
LONG API_InitWSAPacket(struct WSA msgStruct, char packetTypeDesignator[], char certificateName[])
{
  long pktHandle, certHdl;

  // initialize the packet
  pktHandle = C2xInitPacket("WSA", packetTypeDesignator);

  if (pktHandle != 0)
  {
    certHdl = C2xSecCertificateGetHandle(certificateName);  // get the certificate handle for the cert with name "certificateName"
    if (certHdl != 0) 
    {
      C2xSecPacketSetSignerHandle(pktHandle, certHdl); // set the certHdl to the packet
    }

    // create valid message and application data
    if (C2xCompletePacket(pktHandle) == 0) 
    {
      // copy application data to the application structure
      API_GetWSAParams(pktHandle, msgStruct);
    }
  }
  return pktHandle;
}
    

int GetWSASrvAdvChangeCountParams(LONG packetHandle, struct WSASrvAdvChangeCount value, char oldPath[])
{
  char newPath[300];
  int result;

  result = 0;

  snprintf(newPath, elcount(newPath), "%s.%s", oldPath, "saID");
  value.saID = C2xGetTokenInt(packetHandle, "WSA", newPath);
  result = CheckLastError("WSA", gkFuncRefGet, result);

  snprintf(newPath, elcount(newPath), "%s.%s", oldPath, "contentCount");
  value.contentCount = C2xGetTokenInt(packetHandle, "WSA", newPath);
  result = CheckLastError("WSA", gkFuncRefGet, result);

  return result;
}

int SetWSASrvAdvChangeCountParams(LONG packetHandle, struct WSASrvAdvChangeCount value, char oldPath[])
{
  char newPath[300];
  int result;

  result = 0;

  snprintf(newPath, elcount(newPath), "%s.%s", oldPath, "saID");
  C2xSetTokenInt(packetHandle, "WSA", newPath, value.saID);
  result = CheckLastError("WSA", gkFuncRefGet, result);

  snprintf(newPath, elcount(newPath), "%s.%s", oldPath, "contentCount");
  C2xSetTokenInt(packetHandle, "WSA", newPath, value.contentCount);
  result = CheckLastError("WSA", gkFuncRefGet, result);

  return result;
}

int GetWSAIEEE_1609_3_WEE_LatitudeParams(LONG packetHandle, struct WSAIEEE_1609_3_WEE_Latitude value, char oldPath[])
{
  char newPath[300]; 
  int j; 
  int k;
  int result;

  result = 0;

  snprintf(newPath, elcount(newPath), "%s.%s", oldPath, "fill");
  value.fill.isValidFlag = 1;
  value.fill.stringLength = C2xGetTokenLengthBit(packetHandle, "WSA", newPath);
  if ((result = CheckLastError("WSA", gkFuncRefGet, result))==0)
  {
    if(value.fill.stringLength > 0)
    {
      for(j=0; j<value.fill.stringLength; j++)
      {
        if(C2xGetTokenBitOfBitString(packetHandle, "WSA", newPath, j) == 0)
        {
          value.fill.string[j] = '0';
        }
        else if(C2xGetTokenBitOfBitString(packetHandle, "WSA", newPath, j) == 1)
        {
          value.fill.string[j] = '1';
        }

        if(value.fill.stringLength == 1)
        {
          value.fill.string[1] = '0';
        }
        result = CheckLastError("WSA", gkFuncRefGet, result);
      }
    }
    else
    {
      for(k = value.fill.stringLength+1; k > -1; k--)
      {
        if(value.fill.string[k] == '1')
        {
          value.fill.string[k] = '0';
        }
      }
    }
  }

  snprintf(newPath, elcount(newPath), "%s.%s", oldPath, "lat");
  value.lat = C2xGetTokenInt(packetHandle, "WSA", newPath);
  result = CheckLastError("WSA", gkFuncRefGet, result);

  return result;
}

int SetWSAIEEE_1609_3_WEE_LatitudeParams(LONG packetHandle, struct WSAIEEE_1609_3_WEE_Latitude value, char oldPath[])
{
  char newPath[300]; 
  int j;
  int result;

  result = 0;

  snprintf(newPath, elcount(newPath), "%s.%s", oldPath, "fill");
    for(j=0; j<value.fill.stringLength; j++)
    {
      if(value.fill.string[j] == '0')
      {
        C2xSetTokenBitOfBitString(packetHandle, "WSA", newPath, j, 0);
      }
      else
      {
        C2xSetTokenBitOfBitString(packetHandle, "WSA", newPath, j, 1);
      }
      result = CheckLastError("WSA", gkFuncRefGet, result);
    }

  snprintf(newPath, elcount(newPath), "%s.%s", oldPath, "lat");
  C2xSetTokenInt(packetHandle, "WSA", newPath, value.lat);
  result = CheckLastError("WSA", gkFuncRefGet, result);

  return result;
}

int GetWSAIEEE_1609_3_WEE_TwoDLocationParams(LONG packetHandle, struct WSAIEEE_1609_3_WEE_TwoDLocation value, char oldPath[])
{
  char newPath[300];
  int result;

  result = 0;

  snprintf(newPath, elcount(newPath), "%s.%s", oldPath, "latitude");
  GetWSAIEEE_1609_3_WEE_LatitudeParams(packetHandle, value.latitude, newPath);
  result = CheckLastError("WSA", gkFuncRefGet, result);

  snprintf(newPath, elcount(newPath), "%s.%s", oldPath, "longitude");
  value.longitude = C2xGetTokenInt(packetHandle, "WSA", newPath);
  result = CheckLastError("WSA", gkFuncRefGet, result);

  return result;
}

int SetWSAIEEE_1609_3_WEE_TwoDLocationParams(LONG packetHandle, struct WSAIEEE_1609_3_WEE_TwoDLocation value, char oldPath[])
{
  char newPath[300];
  int result;

  result = 0;

  snprintf(newPath, elcount(newPath), "%s.%s", oldPath, "latitude");
  SetWSAIEEE_1609_3_WEE_LatitudeParams(packetHandle, value.latitude, newPath);
  result = CheckLastError("WSA", gkFuncRefGet, result);

  snprintf(newPath, elcount(newPath), "%s.%s", oldPath, "longitude");
  C2xSetTokenInt(packetHandle, "WSA", newPath, value.longitude);
  result = CheckLastError("WSA", gkFuncRefGet, result);

  return result;
}

int GetWSAIEEE_1609_3_WEE_ThreeDLocationParams(LONG packetHandle, struct WSAIEEE_1609_3_WEE_ThreeDLocation value, char oldPath[])
{
  char newPath[300];
  int result;

  result = 0;

  snprintf(newPath, elcount(newPath), "%s.%s", oldPath, "latitude");
  GetWSAIEEE_1609_3_WEE_LatitudeParams(packetHandle, value.latitude, newPath);
  result = CheckLastError("WSA", gkFuncRefGet, result);

  snprintf(newPath, elcount(newPath), "%s.%s", oldPath, "longitude");
  value.longitude = C2xGetTokenInt(packetHandle, "WSA", newPath);
  result = CheckLastError("WSA", gkFuncRefGet, result);

  snprintf(newPath, elcount(newPath), "%s.%s", oldPath, "elevation");
  value.elevation = C2xGetTokenInt(packetHandle, "WSA", newPath);
  result = CheckLastError("WSA", gkFuncRefGet, result);

  return result;
}

int SetWSAIEEE_1609_3_WEE_ThreeDLocationParams(LONG packetHandle, struct WSAIEEE_1609_3_WEE_ThreeDLocation value, char oldPath[])
{
  char newPath[300];
  int result;

  result = 0;

  snprintf(newPath, elcount(newPath), "%s.%s", oldPath, "latitude");
  SetWSAIEEE_1609_3_WEE_LatitudeParams(packetHandle, value.latitude, newPath);
  result = CheckLastError("WSA", gkFuncRefGet, result);

  snprintf(newPath, elcount(newPath), "%s.%s", oldPath, "longitude");
  C2xSetTokenInt(packetHandle, "WSA", newPath, value.longitude);
  result = CheckLastError("WSA", gkFuncRefGet, result);

  snprintf(newPath, elcount(newPath), "%s.%s", oldPath, "elevation");
  C2xSetTokenInt(packetHandle, "WSA", newPath, value.elevation);
  result = CheckLastError("WSA", gkFuncRefGet, result);

  return result;
}

int GetWSASrvAdvMsgHeaderExtTypesParams(LONG packetHandle, WORD tableKey, struct WSASrvAdvMsgHeaderExtTypes value, char oldPath[])
{
  char newPath[300];
  int result;

  result = 0;

  switch(tableKey)
  {
    case 17:
    {
      snprintf(newPath, elcount(newPath), "%s.%s", oldPath, "c_RepeatRate");
      value.c_RepeatRate = C2xGetTokenInt(packetHandle, "WSA", newPath);
      result = CheckLastError("WSA", gkFuncRefGet, result);
    }
    break;
    case 5:
    {
      snprintf(newPath, elcount(newPath), "%s.%s", oldPath, "c_2Dlocation");
      GetWSAIEEE_1609_3_WEE_TwoDLocationParams(packetHandle, value.c_2Dlocation, newPath);
      result = CheckLastError("WSA", gkFuncRefGet, result);
    }
    break;
    case 6:
    {
      snprintf(newPath, elcount(newPath), "%s.%s", oldPath, "c_3Dlocation");
      GetWSAIEEE_1609_3_WEE_ThreeDLocationParams(packetHandle, value.c_3Dlocation, newPath);
      result = CheckLastError("WSA", gkFuncRefGet, result);
    }
    break;
    case 7:
    {
      snprintf(newPath, elcount(newPath), "%s.%s", oldPath, "c_advertiserID");
      value.c_advertiserID.stringLength = C2xGetTokenData(packetHandle, "WSA", newPath, elcount(value.c_advertiserID.string), value.c_advertiserID.string);
      result = CheckLastError("WSA", gkFuncRefGet, result);
    }
    break;
  }
  return result;
}

int SetWSASrvAdvMsgHeaderExtTypesParams(LONG packetHandle, WORD tableKey, struct WSASrvAdvMsgHeaderExtTypes value, char oldPath[])
{
  char newPath[300];
  int result;

  result = 0;

  switch(tableKey)
  {
    case 17:
    {
      snprintf(newPath, elcount(newPath), "%s.%s", oldPath, "c_RepeatRate");
      value.c_RepeatRate = C2xSetTokenInt(packetHandle, "WSA", newPath, value.c_RepeatRate);
      result = CheckLastError("WSA", gkFuncRefGet, result);
    }
    break;
    case 5:
    {
      snprintf(newPath, elcount(newPath), "%s.%s", oldPath, "c_2Dlocation");
      SetWSAIEEE_1609_3_WEE_TwoDLocationParams(packetHandle, value.c_2Dlocation, newPath);
      result = CheckLastError("WSA", gkFuncRefGet, result);
    }
    break;
    case 6:
    {
      snprintf(newPath, elcount(newPath), "%s.%s", oldPath, "c_3Dlocation");
      SetWSAIEEE_1609_3_WEE_ThreeDLocationParams(packetHandle, value.c_3Dlocation, newPath);
      result = CheckLastError("WSA", gkFuncRefGet, result);
    }
    break;
    case 7:
    {
      snprintf(newPath, elcount(newPath), "%s.%s", oldPath, "c_advertiserID");
      C2xSetTokenData(packetHandle, "WSA", newPath, value.c_advertiserID.stringLength, value.c_advertiserID.string);
      result = CheckLastError("WSA", gkFuncRefGet, result);
    }
    break;
  }
  return result;
}

int GetWSAExtension_SrvAdvMsgHeaderExtTypesParams(LONG packetHandle, struct WSAExtension_SrvAdvMsgHeaderExtTypes value, char oldPath[])
{
  char newPath[300];
  int result;

  result = 0;

  snprintf(newPath, elcount(newPath), "%s.%s", oldPath, "extensionId");
  value.extensionId = C2xGetTokenInt(packetHandle, "WSA", newPath);
  result = CheckLastError("WSA", gkFuncRefGet, result);

  snprintf(newPath, elcount(newPath), "%s.%s", oldPath, "value");
  GetWSASrvAdvMsgHeaderExtTypesParams(packetHandle, value.extensionId, value.value, newPath);
  result = CheckLastError("WSA", gkFuncRefGet, result);

  return result;
}

int SetWSAExtension_SrvAdvMsgHeaderExtTypesParams(LONG packetHandle, struct WSAExtension_SrvAdvMsgHeaderExtTypes value, char oldPath[])
{
  char newPath[300];
  int result;

  result = 0;


  snprintf(newPath, elcount(newPath), "%s.%s", oldPath, "value");
  SetWSASrvAdvMsgHeaderExtTypesParams(packetHandle, value.extensionId, value.value, newPath);
  result = CheckLastError("WSA", gkFuncRefGet, result);

  return result;
}

int GetWSASrvAdvMsgHeaderExtsParams(LONG packetHandle, struct WSASrvAdvMsgHeaderExts value, char oldPath[])
{
  char newPath[300]; 
  int i;
  int result;

  result = 0;

  value.length = C2xGetTokenInt(packetHandle, "WSA", oldPath);
  if((result = CheckLastError("WSA", gkFuncRefGet, result))==0)
  {
    for(i=0; i<value.length; i++)
    {
      snprintf(newPath, elcount(newPath), "%s[%d]", oldPath, i);
      GetWSAExtension_SrvAdvMsgHeaderExtTypesParams(packetHandle, value.arrayValue[i], newPath);
      result = CheckLastError("WSA", gkFuncRefGet, result);
    }
  }
  return result;
}

int SetWSASrvAdvMsgHeaderExtsParams(LONG packetHandle, struct WSASrvAdvMsgHeaderExts value, char oldPath[])
{
  char newPath[300]; 
  int i;
  int result;

  result = 0;

  C2xRemoveToken(packetHandle, "WSA", oldPath);
  for(i=0; i<value.length; i++)
  {
    snprintf(newPath, elcount(newPath), "%s[%d]", oldPath, i);
    SetWSAExtension_SrvAdvMsgHeaderExtTypesParams(packetHandle, value.arrayValue[i], newPath);
    result = CheckLastError("WSA", gkFuncRefGet, result);
  }
  return result;
}

int GetWSACITSapplMgmtIDs_Ext2Params(LONG packetHandle, struct WSACITSapplMgmtIDs_Ext2 value, char oldPath[])
{
  char newPath[300];
  int result;

  result = 0;

  value.choice = C2xGetTokenInt(packetHandle, "WSA", oldPath);

  switch(value.choice)
  {
    case 0:
    {
      snprintf(newPath, elcount(newPath), "%s.%s", oldPath, "content");
      value.content = C2xGetTokenInt(packetHandle, "WSA", newPath);
      result = CheckLastError("WSA", gkFuncRefGet, result);
    }
    break;
    case 1:
    {
      snprintf(newPath, elcount(newPath), "%s.%s", oldPath, "extension");
      value.extension = C2xGetTokenInt(packetHandle, "WSA", newPath);
      result = CheckLastError("WSA", gkFuncRefGet, result);
    }
    break;
  }
  return result;
}

int SetWSACITSapplMgmtIDs_Ext2Params(LONG packetHandle, struct WSACITSapplMgmtIDs_Ext2 value, char oldPath[])
{
  char newPath[300];
  int result;

  result = 0;

  switch(value.choice)
  {
    case 0:
    {
      snprintf(newPath, elcount(newPath), "%s.%s", oldPath, "content");
      C2xSetTokenInt(packetHandle, "WSA", newPath, value.content);
      result = CheckLastError("WSA", gkFuncRefGet, result);
    }
    break;
    case 1:
    {
      snprintf(newPath, elcount(newPath), "%s.%s", oldPath, "extension");
      C2xSetTokenInt(packetHandle, "WSA", newPath, value.extension);
      result = CheckLastError("WSA", gkFuncRefGet, result);
    }
    break;
  }
  return result;
}

int GetWSACITSapplMgmtIDs_Ext1Params(LONG packetHandle, struct WSACITSapplMgmtIDs_Ext1 value, char oldPath[])
{
  char newPath[300];
  int result;

  result = 0;

  value.choice = C2xGetTokenInt(packetHandle, "WSA", oldPath);

  switch(value.choice)
  {
    case 0:
    {
      snprintf(newPath, elcount(newPath), "%s.%s", oldPath, "content");
      value.content = C2xGetTokenInt(packetHandle, "WSA", newPath);
      result = CheckLastError("WSA", gkFuncRefGet, result);
    }
    break;
    case 1:
    {
      snprintf(newPath, elcount(newPath), "%s.%s", oldPath, "extension");
      GetWSACITSapplMgmtIDs_Ext2Params(packetHandle, value.extension, newPath);
      result = CheckLastError("WSA", gkFuncRefGet, result);
    }
    break;
  }
  return result;
}

int SetWSACITSapplMgmtIDs_Ext1Params(LONG packetHandle, struct WSACITSapplMgmtIDs_Ext1 value, char oldPath[])
{
  char newPath[300];
  int result;

  result = 0;

  switch(value.choice)
  {
    case 0:
    {
      snprintf(newPath, elcount(newPath), "%s.%s", oldPath, "content");
      C2xSetTokenInt(packetHandle, "WSA", newPath, value.content);
      result = CheckLastError("WSA", gkFuncRefGet, result);
    }
    break;
    case 1:
    {
      snprintf(newPath, elcount(newPath), "%s.%s", oldPath, "extension");
      SetWSACITSapplMgmtIDs_Ext2Params(packetHandle, value.extension, newPath);
      result = CheckLastError("WSA", gkFuncRefGet, result);
    }
    break;
  }
  return result;
}

int GetWSACITSapplMgmtIDs_VarLengthNumberParams(LONG packetHandle, struct WSACITSapplMgmtIDs_VarLengthNumber value, char oldPath[])
{
  char newPath[300];
  int result;

  result = 0;

  value.choice = C2xGetTokenInt(packetHandle, "WSA", oldPath);

  switch(value.choice)
  {
    case 0:
    {
      snprintf(newPath, elcount(newPath), "%s.%s", oldPath, "content");
      value.content = C2xGetTokenInt(packetHandle, "WSA", newPath);
      result = CheckLastError("WSA", gkFuncRefGet, result);
    }
    break;
    case 1:
    {
      snprintf(newPath, elcount(newPath), "%s.%s", oldPath, "extension");
      GetWSACITSapplMgmtIDs_Ext1Params(packetHandle, value.extension, newPath);
      result = CheckLastError("WSA", gkFuncRefGet, result);
    }
    break;
  }
  return result;
}

int SetWSACITSapplMgmtIDs_VarLengthNumberParams(LONG packetHandle, struct WSACITSapplMgmtIDs_VarLengthNumber value, char oldPath[])
{
  char newPath[300];
  int result;

  result = 0;

  switch(value.choice)
  {
    case 0:
    {
      snprintf(newPath, elcount(newPath), "%s.%s", oldPath, "content");
      C2xSetTokenInt(packetHandle, "WSA", newPath, value.content);
      result = CheckLastError("WSA", gkFuncRefGet, result);
    }
    break;
    case 1:
    {
      snprintf(newPath, elcount(newPath), "%s.%s", oldPath, "extension");
      SetWSACITSapplMgmtIDs_Ext1Params(packetHandle, value.extension, newPath);
      result = CheckLastError("WSA", gkFuncRefGet, result);
    }
    break;
  }
  return result;
}

int GetWSAIEEE_1609_3_WEE_ProviderServiceContextParams(LONG packetHandle, struct WSAIEEE_1609_3_WEE_ProviderServiceContext value, char oldPath[])
{
  char newPath[300]; 
  int j; 
  int k;
  int result;

  result = 0;

  snprintf(newPath, elcount(newPath), "%s.%s", oldPath, "fillBit");
  value.fillBit.isValidFlag = 1;
  value.fillBit.stringLength = C2xGetTokenLengthBit(packetHandle, "WSA", newPath);
  if ((result = CheckLastError("WSA", gkFuncRefGet, result))==0)
  {
    if(value.fillBit.stringLength > 0)
    {
      for(j=0; j<value.fillBit.stringLength; j++)
      {
        if(C2xGetTokenBitOfBitString(packetHandle, "WSA", newPath, j) == 0)
        {
          value.fillBit.string[j] = '0';
        }
        else if(C2xGetTokenBitOfBitString(packetHandle, "WSA", newPath, j) == 1)
        {
          value.fillBit.string[j] = '1';
        }

        if(value.fillBit.stringLength == 1)
        {
          value.fillBit.string[1] = '0';
        }
        result = CheckLastError("WSA", gkFuncRefGet, result);
      }
    }
    else
    {
      for(k = value.fillBit.stringLength+1; k > -1; k--)
      {
        if(value.fillBit.string[k] == '1')
        {
          value.fillBit.string[k] = '0';
        }
      }
    }
  }

  snprintf(newPath, elcount(newPath), "%s.%s", oldPath, "psc");
  value.psc.stringLength = C2xGetTokenData(packetHandle, "WSA", newPath, elcount(value.psc.string), value.psc.string);
  return result;
}

int SetWSAIEEE_1609_3_WEE_ProviderServiceContextParams(LONG packetHandle, struct WSAIEEE_1609_3_WEE_ProviderServiceContext value, char oldPath[])
{
  char newPath[300]; 
  int j;
  int result;

  result = 0;

  snprintf(newPath, elcount(newPath), "%s.%s", oldPath, "fillBit");
    for(j=0; j<value.fillBit.stringLength; j++)
    {
      if(value.fillBit.string[j] == '0')
      {
        C2xSetTokenBitOfBitString(packetHandle, "WSA", newPath, j, 0);
      }
      else
      {
        C2xSetTokenBitOfBitString(packetHandle, "WSA", newPath, j, 1);
      }
      result = CheckLastError("WSA", gkFuncRefGet, result);
    }

  snprintf(newPath, elcount(newPath), "%s.%s", oldPath, "psc");
  C2xSetTokenData(packetHandle, "WSA", newPath, value.psc.stringLength, value.psc.string);

  return result;
}

int GetWSAServiceInfoExtTypesParams(LONG packetHandle, WORD tableKey, struct WSAServiceInfoExtTypes value, char oldPath[])
{
  char newPath[300];
  int result;

  result = 0;

  switch(tableKey)
  {
    case 8:
    {
      snprintf(newPath, elcount(newPath), "%s.%s", oldPath, "c_ProviderServContext");
      GetWSAIEEE_1609_3_WEE_ProviderServiceContextParams(packetHandle, value.c_ProviderServContext, newPath);
      result = CheckLastError("WSA", gkFuncRefGet, result);
    }
    break;
    case 9:
    {
      snprintf(newPath, elcount(newPath), "%s.%s", oldPath, "c_IPv6Address");
      value.c_IPv6Address.stringLength = C2xGetTokenData(packetHandle, "WSA", newPath, elcount(value.c_IPv6Address.string), value.c_IPv6Address.string);
      result = CheckLastError("WSA", gkFuncRefGet, result);
    }
    break;
    case 10:
    {
      snprintf(newPath, elcount(newPath), "%s.%s", oldPath, "c_servicePort");
      value.c_servicePort = C2xGetTokenInt(packetHandle, "WSA", newPath);
      result = CheckLastError("WSA", gkFuncRefGet, result);
    }
    break;
    case 11:
    {
      snprintf(newPath, elcount(newPath), "%s.%s", oldPath, "c_ProviderMACaddress");
      value.c_ProviderMACaddress.stringLength = C2xGetTokenData(packetHandle, "WSA", newPath, elcount(value.c_ProviderMACaddress.string), value.c_ProviderMACaddress.string);
      result = CheckLastError("WSA", gkFuncRefGet, result);
    }
    break;
    case 19:
    {
      snprintf(newPath, elcount(newPath), "%s.%s", oldPath, "c_RCPIthreshold");
      value.c_RCPIthreshold = C2xGetTokenInt(packetHandle, "WSA", newPath);
      result = CheckLastError("WSA", gkFuncRefGet, result);
    }
    break;
    case 20:
    {
      snprintf(newPath, elcount(newPath), "%s.%s", oldPath, "c_WSAcountThreshold");
      value.c_WSAcountThreshold = C2xGetTokenInt(packetHandle, "WSA", newPath);
      result = CheckLastError("WSA", gkFuncRefGet, result);
    }
    break;
    case 22:
    {
      snprintf(newPath, elcount(newPath), "%s.%s", oldPath, "c_WSAcountThresInt");
      value.c_WSAcountThresInt = C2xGetTokenInt(packetHandle, "WSA", newPath);
      result = CheckLastError("WSA", gkFuncRefGet, result);
    }
    break;
  }
  return result;
}

int SetWSAServiceInfoExtTypesParams(LONG packetHandle, WORD tableKey, struct WSAServiceInfoExtTypes value, char oldPath[])
{
  char newPath[300];
  int result;

  result = 0;

  switch(tableKey)
  {
    case 8:
    {
      snprintf(newPath, elcount(newPath), "%s.%s", oldPath, "c_ProviderServContext");
      SetWSAIEEE_1609_3_WEE_ProviderServiceContextParams(packetHandle, value.c_ProviderServContext, newPath);
      result = CheckLastError("WSA", gkFuncRefGet, result);
    }
    break;
    case 9:
    {
      snprintf(newPath, elcount(newPath), "%s.%s", oldPath, "c_IPv6Address");
      C2xSetTokenData(packetHandle, "WSA", newPath, value.c_IPv6Address.stringLength, value.c_IPv6Address.string);
      result = CheckLastError("WSA", gkFuncRefGet, result);
    }
    break;
    case 10:
    {
      snprintf(newPath, elcount(newPath), "%s.%s", oldPath, "c_servicePort");
      value.c_servicePort = C2xSetTokenInt(packetHandle, "WSA", newPath, value.c_servicePort);
      result = CheckLastError("WSA", gkFuncRefGet, result);
    }
    break;
    case 11:
    {
      snprintf(newPath, elcount(newPath), "%s.%s", oldPath, "c_ProviderMACaddress");
      C2xSetTokenData(packetHandle, "WSA", newPath, value.c_ProviderMACaddress.stringLength, value.c_ProviderMACaddress.string);
      result = CheckLastError("WSA", gkFuncRefGet, result);
    }
    break;
    case 19:
    {
      snprintf(newPath, elcount(newPath), "%s.%s", oldPath, "c_RCPIthreshold");
      value.c_RCPIthreshold = C2xSetTokenInt(packetHandle, "WSA", newPath, value.c_RCPIthreshold);
      result = CheckLastError("WSA", gkFuncRefGet, result);
    }
    break;
    case 20:
    {
      snprintf(newPath, elcount(newPath), "%s.%s", oldPath, "c_WSAcountThreshold");
      value.c_WSAcountThreshold = C2xSetTokenInt(packetHandle, "WSA", newPath, value.c_WSAcountThreshold);
      result = CheckLastError("WSA", gkFuncRefGet, result);
    }
    break;
    case 22:
    {
      snprintf(newPath, elcount(newPath), "%s.%s", oldPath, "c_WSAcountThresInt");
      value.c_WSAcountThresInt = C2xSetTokenInt(packetHandle, "WSA", newPath, value.c_WSAcountThresInt);
      result = CheckLastError("WSA", gkFuncRefGet, result);
    }
    break;
  }
  return result;
}

int GetWSAExtension_ServiceInfoExtTypesParams(LONG packetHandle, struct WSAExtension_ServiceInfoExtTypes value, char oldPath[])
{
  char newPath[300];
  int result;

  result = 0;

  snprintf(newPath, elcount(newPath), "%s.%s", oldPath, "extensionId");
  value.extensionId = C2xGetTokenInt(packetHandle, "WSA", newPath);
  result = CheckLastError("WSA", gkFuncRefGet, result);

  snprintf(newPath, elcount(newPath), "%s.%s", oldPath, "value");
  GetWSAServiceInfoExtTypesParams(packetHandle, value.extensionId, value.value, newPath);
  result = CheckLastError("WSA", gkFuncRefGet, result);

  return result;
}

int SetWSAExtension_ServiceInfoExtTypesParams(LONG packetHandle, struct WSAExtension_ServiceInfoExtTypes value, char oldPath[])
{
  char newPath[300];
  int result;

  result = 0;


  snprintf(newPath, elcount(newPath), "%s.%s", oldPath, "value");
  SetWSAServiceInfoExtTypesParams(packetHandle, value.extensionId, value.value, newPath);
  result = CheckLastError("WSA", gkFuncRefGet, result);

  return result;
}

int GetWSAServiceInfoExtsParams(LONG packetHandle, struct WSAServiceInfoExts value, char oldPath[])
{
  char newPath[300]; 
  int i;
  int result;

  result = 0;

  value.length = C2xGetTokenInt(packetHandle, "WSA", oldPath);
  if((result = CheckLastError("WSA", gkFuncRefGet, result))==0)
  {
    for(i=0; i<value.length; i++)
    {
      snprintf(newPath, elcount(newPath), "%s[%d]", oldPath, i);
      GetWSAExtension_ServiceInfoExtTypesParams(packetHandle, value.arrayValue[i], newPath);
      result = CheckLastError("WSA", gkFuncRefGet, result);
    }
  }
  return result;
}

int SetWSAServiceInfoExtsParams(LONG packetHandle, struct WSAServiceInfoExts value, char oldPath[])
{
  char newPath[300]; 
  int i;
  int result;

  result = 0;

  C2xRemoveToken(packetHandle, "WSA", oldPath);
  for(i=0; i<value.length; i++)
  {
    snprintf(newPath, elcount(newPath), "%s[%d]", oldPath, i);
    SetWSAExtension_ServiceInfoExtTypesParams(packetHandle, value.arrayValue[i], newPath);
    result = CheckLastError("WSA", gkFuncRefGet, result);
  }
  return result;
}

int GetWSAChannelOptionsParams(LONG packetHandle, struct WSAChannelOptions value, char oldPath[])
{
  char newPath[300];
  int result;

  result = 0;

  snprintf(newPath, elcount(newPath), "%s.%s", oldPath, "extensions");
  value.extensions.isValidFlag = C2xIsTokenAvailable(packetHandle, "WSA", newPath);
  if(value.extensions.isValidFlag==1)
  {
    GetWSAServiceInfoExtsParams(packetHandle, value.extensions, newPath);
    result = CheckLastError("WSA", gkFuncRefGet, result);
  }
  return result;
}

int SetWSAChannelOptionsParams(LONG packetHandle, struct WSAChannelOptions value, char oldPath[])
{
  char newPath[300];
  int result;

  result = 0;

  snprintf(newPath, elcount(newPath), "%s.%s", oldPath, "extensions");
  if(value.extensions.isValidFlag==1)
  {
    SetWSAServiceInfoExtsParams(packetHandle, value.extensions, newPath);
    result = CheckLastError("WSA", gkFuncRefGet, result);
  }
  else
  {
    if( C2xIsTokenAvailable(packetHandle, "WSA", newPath) )
    {
      C2xRemoveToken(packetHandle, "WSA", newPath);
    }
  }

  return result;
}

int GetWSAServiceInfoParams(LONG packetHandle, struct WSAServiceInfo value, char oldPath[])
{
  char newPath[300];
  int result;

  result = 0;

  snprintf(newPath, elcount(newPath), "%s.%s", oldPath, "serviceID");
  GetWSACITSapplMgmtIDs_VarLengthNumberParams(packetHandle, value.serviceID, newPath);
  result = CheckLastError("WSA", gkFuncRefGet, result);

  snprintf(newPath, elcount(newPath), "%s.%s", oldPath, "channelIndex");
  value.channelIndex = C2xGetTokenInt(packetHandle, "WSA", newPath);
  result = CheckLastError("WSA", gkFuncRefGet, result);

  snprintf(newPath, elcount(newPath), "%s.%s", oldPath, "chOptions");
  GetWSAChannelOptionsParams(packetHandle, value.chOptions, newPath);
  result = CheckLastError("WSA", gkFuncRefGet, result);

  return result;
}

int SetWSAServiceInfoParams(LONG packetHandle, struct WSAServiceInfo value, char oldPath[])
{
  char newPath[300];
  int result;

  result = 0;

  snprintf(newPath, elcount(newPath), "%s.%s", oldPath, "serviceID");
  SetWSACITSapplMgmtIDs_VarLengthNumberParams(packetHandle, value.serviceID, newPath);
  result = CheckLastError("WSA", gkFuncRefGet, result);

  snprintf(newPath, elcount(newPath), "%s.%s", oldPath, "channelIndex");
  C2xSetTokenInt(packetHandle, "WSA", newPath, value.channelIndex);
  result = CheckLastError("WSA", gkFuncRefGet, result);

  snprintf(newPath, elcount(newPath), "%s.%s", oldPath, "chOptions");
  SetWSAChannelOptionsParams(packetHandle, value.chOptions, newPath);
  result = CheckLastError("WSA", gkFuncRefGet, result);

  return result;
}

int GetWSAServiceInfosParams(LONG packetHandle, struct WSAServiceInfos value, char oldPath[])
{
  char newPath[300]; 
  int i;
  int result;

  result = 0;

  value.length = C2xGetTokenInt(packetHandle, "WSA", oldPath);
  if((result = CheckLastError("WSA", gkFuncRefGet, result))==0)
  {
    for(i=0; i<value.length; i++)
    {
      snprintf(newPath, elcount(newPath), "%s[%d]", oldPath, i);
      GetWSAServiceInfoParams(packetHandle, value.arrayValue[i], newPath);
      result = CheckLastError("WSA", gkFuncRefGet, result);
    }
  }
  return result;
}

int SetWSAServiceInfosParams(LONG packetHandle, struct WSAServiceInfos value, char oldPath[])
{
  char newPath[300]; 
  int i;
  int result;

  result = 0;

  C2xRemoveToken(packetHandle, "WSA", oldPath);
  for(i=0; i<value.length; i++)
  {
    snprintf(newPath, elcount(newPath), "%s[%d]", oldPath, i);
    SetWSAServiceInfoParams(packetHandle, value.arrayValue[i], newPath);
    result = CheckLastError("WSA", gkFuncRefGet, result);
  }
  return result;
}

int GetWSAWsaChInfoDataRateParams(LONG packetHandle, struct WSAWsaChInfoDataRate value, char oldPath[])
{
  char newPath[300]; 
  int j; 
  int k;
  int result;

  result = 0;

  snprintf(newPath, elcount(newPath), "%s.%s", oldPath, "adaptable");
  value.adaptable.isValidFlag = 1;
  value.adaptable.stringLength = C2xGetTokenLengthBit(packetHandle, "WSA", newPath);
  if ((result = CheckLastError("WSA", gkFuncRefGet, result))==0)
  {
    if(value.adaptable.stringLength > 0)
    {
      for(j=0; j<value.adaptable.stringLength; j++)
      {
        if(C2xGetTokenBitOfBitString(packetHandle, "WSA", newPath, j) == 0)
        {
          value.adaptable.string[j] = '0';
        }
        else if(C2xGetTokenBitOfBitString(packetHandle, "WSA", newPath, j) == 1)
        {
          value.adaptable.string[j] = '1';
        }

        if(value.adaptable.stringLength == 1)
        {
          value.adaptable.string[1] = '0';
        }
        result = CheckLastError("WSA", gkFuncRefGet, result);
      }
    }
    else
    {
      for(k = value.adaptable.stringLength+1; k > -1; k--)
      {
        if(value.adaptable.string[k] == '1')
        {
          value.adaptable.string[k] = '0';
        }
      }
    }
  }

  snprintf(newPath, elcount(newPath), "%s.%s", oldPath, "dataRate");
  value.dataRate = C2xGetTokenInt(packetHandle, "WSA", newPath);
  result = CheckLastError("WSA", gkFuncRefGet, result);

  return result;
}

int SetWSAWsaChInfoDataRateParams(LONG packetHandle, struct WSAWsaChInfoDataRate value, char oldPath[])
{
  char newPath[300]; 
  int j;
  int result;

  result = 0;

  snprintf(newPath, elcount(newPath), "%s.%s", oldPath, "adaptable");
    for(j=0; j<value.adaptable.stringLength; j++)
    {
      if(value.adaptable.string[j] == '0')
      {
        C2xSetTokenBitOfBitString(packetHandle, "WSA", newPath, j, 0);
      }
      else
      {
        C2xSetTokenBitOfBitString(packetHandle, "WSA", newPath, j, 1);
      }
      result = CheckLastError("WSA", gkFuncRefGet, result);
    }

  snprintf(newPath, elcount(newPath), "%s.%s", oldPath, "dataRate");
  C2xSetTokenInt(packetHandle, "WSA", newPath, value.dataRate);
  result = CheckLastError("WSA", gkFuncRefGet, result);

  return result;
}

int GetWSAIEEE_1609_3_WEE_EdcaParameterRecordParams(LONG packetHandle, struct WSAIEEE_1609_3_WEE_EdcaParameterRecord value, char oldPath[])
{
  char newPath[300];
  int result;

  result = 0;

  snprintf(newPath, elcount(newPath), "%s.%s", oldPath, "res");
  value.res = C2xGetTokenInt(packetHandle, "WSA", newPath);
  result = CheckLastError("WSA", gkFuncRefGet, result);

  snprintf(newPath, elcount(newPath), "%s.%s", oldPath, "aci");
  value.aci = C2xGetTokenInt(packetHandle, "WSA", newPath);
  result = CheckLastError("WSA", gkFuncRefGet, result);

  snprintf(newPath, elcount(newPath), "%s.%s", oldPath, "acm");
  value.acm = C2xGetTokenInt(packetHandle, "WSA", newPath);
  result = CheckLastError("WSA", gkFuncRefGet, result);

  snprintf(newPath, elcount(newPath), "%s.%s", oldPath, "aifsn");
  value.aifsn = C2xGetTokenInt(packetHandle, "WSA", newPath);
  result = CheckLastError("WSA", gkFuncRefGet, result);

  snprintf(newPath, elcount(newPath), "%s.%s", oldPath, "ecwMax");
  value.ecwMax = C2xGetTokenInt(packetHandle, "WSA", newPath);
  result = CheckLastError("WSA", gkFuncRefGet, result);

  snprintf(newPath, elcount(newPath), "%s.%s", oldPath, "ecwMin");
  value.ecwMin = C2xGetTokenInt(packetHandle, "WSA", newPath);
  result = CheckLastError("WSA", gkFuncRefGet, result);

  snprintf(newPath, elcount(newPath), "%s.%s", oldPath, "txopLimit");
  value.txopLimit = C2xGetTokenInt(packetHandle, "WSA", newPath);
  result = CheckLastError("WSA", gkFuncRefGet, result);

  return result;
}

int SetWSAIEEE_1609_3_WEE_EdcaParameterRecordParams(LONG packetHandle, struct WSAIEEE_1609_3_WEE_EdcaParameterRecord value, char oldPath[])
{
  char newPath[300];
  int result;

  result = 0;

  snprintf(newPath, elcount(newPath), "%s.%s", oldPath, "res");
  C2xSetTokenInt(packetHandle, "WSA", newPath, value.res);
  result = CheckLastError("WSA", gkFuncRefGet, result);

  snprintf(newPath, elcount(newPath), "%s.%s", oldPath, "aci");
  C2xSetTokenInt(packetHandle, "WSA", newPath, value.aci);
  result = CheckLastError("WSA", gkFuncRefGet, result);

  snprintf(newPath, elcount(newPath), "%s.%s", oldPath, "acm");
  C2xSetTokenInt(packetHandle, "WSA", newPath, value.acm);
  result = CheckLastError("WSA", gkFuncRefGet, result);

  snprintf(newPath, elcount(newPath), "%s.%s", oldPath, "aifsn");
  C2xSetTokenInt(packetHandle, "WSA", newPath, value.aifsn);
  result = CheckLastError("WSA", gkFuncRefGet, result);

  snprintf(newPath, elcount(newPath), "%s.%s", oldPath, "ecwMax");
  C2xSetTokenInt(packetHandle, "WSA", newPath, value.ecwMax);
  result = CheckLastError("WSA", gkFuncRefGet, result);

  snprintf(newPath, elcount(newPath), "%s.%s", oldPath, "ecwMin");
  C2xSetTokenInt(packetHandle, "WSA", newPath, value.ecwMin);
  result = CheckLastError("WSA", gkFuncRefGet, result);

  snprintf(newPath, elcount(newPath), "%s.%s", oldPath, "txopLimit");
  C2xSetTokenInt(packetHandle, "WSA", newPath, value.txopLimit);
  result = CheckLastError("WSA", gkFuncRefGet, result);

  return result;
}

int GetWSAIEEE_1609_3_WEE_EdcaParameterSetParams(LONG packetHandle, struct WSAIEEE_1609_3_WEE_EdcaParameterSet value, char oldPath[])
{
  char newPath[300];
  int result;

  result = 0;

  snprintf(newPath, elcount(newPath), "%s.%s", oldPath, "acbeRecord");
  GetWSAIEEE_1609_3_WEE_EdcaParameterRecordParams(packetHandle, value.acbeRecord, newPath);
  result = CheckLastError("WSA", gkFuncRefGet, result);

  snprintf(newPath, elcount(newPath), "%s.%s", oldPath, "acbkRecord");
  GetWSAIEEE_1609_3_WEE_EdcaParameterRecordParams(packetHandle, value.acbkRecord, newPath);
  result = CheckLastError("WSA", gkFuncRefGet, result);

  snprintf(newPath, elcount(newPath), "%s.%s", oldPath, "acviRecord");
  GetWSAIEEE_1609_3_WEE_EdcaParameterRecordParams(packetHandle, value.acviRecord, newPath);
  result = CheckLastError("WSA", gkFuncRefGet, result);

  snprintf(newPath, elcount(newPath), "%s.%s", oldPath, "acvoRecord");
  GetWSAIEEE_1609_3_WEE_EdcaParameterRecordParams(packetHandle, value.acvoRecord, newPath);
  result = CheckLastError("WSA", gkFuncRefGet, result);

  return result;
}

int SetWSAIEEE_1609_3_WEE_EdcaParameterSetParams(LONG packetHandle, struct WSAIEEE_1609_3_WEE_EdcaParameterSet value, char oldPath[])
{
  char newPath[300];
  int result;

  result = 0;

  snprintf(newPath, elcount(newPath), "%s.%s", oldPath, "acbeRecord");
  SetWSAIEEE_1609_3_WEE_EdcaParameterRecordParams(packetHandle, value.acbeRecord, newPath);
  result = CheckLastError("WSA", gkFuncRefGet, result);

  snprintf(newPath, elcount(newPath), "%s.%s", oldPath, "acbkRecord");
  SetWSAIEEE_1609_3_WEE_EdcaParameterRecordParams(packetHandle, value.acbkRecord, newPath);
  result = CheckLastError("WSA", gkFuncRefGet, result);

  snprintf(newPath, elcount(newPath), "%s.%s", oldPath, "acviRecord");
  SetWSAIEEE_1609_3_WEE_EdcaParameterRecordParams(packetHandle, value.acviRecord, newPath);
  result = CheckLastError("WSA", gkFuncRefGet, result);

  snprintf(newPath, elcount(newPath), "%s.%s", oldPath, "acvoRecord");
  SetWSAIEEE_1609_3_WEE_EdcaParameterRecordParams(packetHandle, value.acvoRecord, newPath);
  result = CheckLastError("WSA", gkFuncRefGet, result);

  return result;
}

int GetWSAChannelInfoExtTypesParams(LONG packetHandle, WORD tableKey, struct WSAChannelInfoExtTypes value, char oldPath[])
{
  char newPath[300];
  int result;

  result = 0;

  switch(tableKey)
  {
    case 12:
    {
      snprintf(newPath, elcount(newPath), "%s.%s", oldPath, "c_EDCAparameterSet");
      GetWSAIEEE_1609_3_WEE_EdcaParameterSetParams(packetHandle, value.c_EDCAparameterSet, newPath);
      result = CheckLastError("WSA", gkFuncRefGet, result);
    }
    break;
    case 21:
    {
      snprintf(newPath, elcount(newPath), "%s.%s", oldPath, "c_ChannelAccess");
      value.c_ChannelAccess = C2xGetTokenInt(packetHandle, "WSA", newPath);
      result = CheckLastError("WSA", gkFuncRefGet, result);
    }
    break;
  }
  return result;
}

int SetWSAChannelInfoExtTypesParams(LONG packetHandle, WORD tableKey, struct WSAChannelInfoExtTypes value, char oldPath[])
{
  char newPath[300];
  int result;

  result = 0;

  switch(tableKey)
  {
    case 12:
    {
      snprintf(newPath, elcount(newPath), "%s.%s", oldPath, "c_EDCAparameterSet");
      SetWSAIEEE_1609_3_WEE_EdcaParameterSetParams(packetHandle, value.c_EDCAparameterSet, newPath);
      result = CheckLastError("WSA", gkFuncRefGet, result);
    }
    break;
    case 21:
    {
      snprintf(newPath, elcount(newPath), "%s.%s", oldPath, "c_ChannelAccess");
      value.c_ChannelAccess = C2xSetTokenInt(packetHandle, "WSA", newPath, value.c_ChannelAccess);
      result = CheckLastError("WSA", gkFuncRefGet, result);
    }
    break;
  }
  return result;
}

int GetWSAExtension_ChannelInfoExtTypesParams(LONG packetHandle, struct WSAExtension_ChannelInfoExtTypes value, char oldPath[])
{
  char newPath[300];
  int result;

  result = 0;

  snprintf(newPath, elcount(newPath), "%s.%s", oldPath, "extensionId");
  value.extensionId = C2xGetTokenInt(packetHandle, "WSA", newPath);
  result = CheckLastError("WSA", gkFuncRefGet, result);

  snprintf(newPath, elcount(newPath), "%s.%s", oldPath, "value");
  GetWSAChannelInfoExtTypesParams(packetHandle, value.extensionId, value.value, newPath);
  result = CheckLastError("WSA", gkFuncRefGet, result);

  return result;
}

int SetWSAExtension_ChannelInfoExtTypesParams(LONG packetHandle, struct WSAExtension_ChannelInfoExtTypes value, char oldPath[])
{
  char newPath[300];
  int result;

  result = 0;


  snprintf(newPath, elcount(newPath), "%s.%s", oldPath, "value");
  SetWSAChannelInfoExtTypesParams(packetHandle, value.extensionId, value.value, newPath);
  result = CheckLastError("WSA", gkFuncRefGet, result);

  return result;
}

int GetWSAChannelInfoExtsParams(LONG packetHandle, struct WSAChannelInfoExts value, char oldPath[])
{
  char newPath[300]; 
  int i;
  int result;

  result = 0;

  value.length = C2xGetTokenInt(packetHandle, "WSA", oldPath);
  if((result = CheckLastError("WSA", gkFuncRefGet, result))==0)
  {
    for(i=0; i<value.length; i++)
    {
      snprintf(newPath, elcount(newPath), "%s[%d]", oldPath, i);
      GetWSAExtension_ChannelInfoExtTypesParams(packetHandle, value.arrayValue[i], newPath);
      result = CheckLastError("WSA", gkFuncRefGet, result);
    }
  }
  return result;
}

int SetWSAChannelInfoExtsParams(LONG packetHandle, struct WSAChannelInfoExts value, char oldPath[])
{
  char newPath[300]; 
  int i;
  int result;

  result = 0;

  C2xRemoveToken(packetHandle, "WSA", oldPath);
  for(i=0; i<value.length; i++)
  {
    snprintf(newPath, elcount(newPath), "%s[%d]", oldPath, i);
    SetWSAExtension_ChannelInfoExtTypesParams(packetHandle, value.arrayValue[i], newPath);
    result = CheckLastError("WSA", gkFuncRefGet, result);
  }
  return result;
}

int GetWSAChInfoOptionsParams(LONG packetHandle, struct WSAChInfoOptions value, char oldPath[])
{
  char newPath[300];
  int result;

  result = 0;

  snprintf(newPath, elcount(newPath), "%s.%s", oldPath, "extensions");
  value.extensions.isValidFlag = C2xIsTokenAvailable(packetHandle, "WSA", newPath);
  if(value.extensions.isValidFlag==1)
  {
    GetWSAChannelInfoExtsParams(packetHandle, value.extensions, newPath);
    result = CheckLastError("WSA", gkFuncRefGet, result);
  }
  return result;
}

int SetWSAChInfoOptionsParams(LONG packetHandle, struct WSAChInfoOptions value, char oldPath[])
{
  char newPath[300];
  int result;

  result = 0;

  snprintf(newPath, elcount(newPath), "%s.%s", oldPath, "extensions");
  if(value.extensions.isValidFlag==1)
  {
    SetWSAChannelInfoExtsParams(packetHandle, value.extensions, newPath);
    result = CheckLastError("WSA", gkFuncRefGet, result);
  }
  else
  {
    if( C2xIsTokenAvailable(packetHandle, "WSA", newPath) )
    {
      C2xRemoveToken(packetHandle, "WSA", newPath);
    }
  }

  return result;
}

int GetWSAChannelInfoParams(LONG packetHandle, struct WSAChannelInfo value, char oldPath[])
{
  char newPath[300];
  int result;

  result = 0;

  snprintf(newPath, elcount(newPath), "%s.%s", oldPath, "operatingClass");
  value.operatingClass = C2xGetTokenInt(packetHandle, "WSA", newPath);
  result = CheckLastError("WSA", gkFuncRefGet, result);

  snprintf(newPath, elcount(newPath), "%s.%s", oldPath, "channelNumber");
  value.channelNumber = C2xGetTokenInt(packetHandle, "WSA", newPath);
  result = CheckLastError("WSA", gkFuncRefGet, result);

  snprintf(newPath, elcount(newPath), "%s.%s", oldPath, "powerLevel");
  value.powerLevel = C2xGetTokenInt(packetHandle, "WSA", newPath);
  result = CheckLastError("WSA", gkFuncRefGet, result);

  snprintf(newPath, elcount(newPath), "%s.%s", oldPath, "dataRate");
  GetWSAWsaChInfoDataRateParams(packetHandle, value.dataRate, newPath);
  result = CheckLastError("WSA", gkFuncRefGet, result);

  snprintf(newPath, elcount(newPath), "%s.%s", oldPath, "extensions");
  GetWSAChInfoOptionsParams(packetHandle, value.extensions, newPath);
  result = CheckLastError("WSA", gkFuncRefGet, result);

  return result;
}

int SetWSAChannelInfoParams(LONG packetHandle, struct WSAChannelInfo value, char oldPath[])
{
  char newPath[300];
  int result;

  result = 0;

  snprintf(newPath, elcount(newPath), "%s.%s", oldPath, "operatingClass");
  C2xSetTokenInt(packetHandle, "WSA", newPath, value.operatingClass);
  result = CheckLastError("WSA", gkFuncRefGet, result);

  snprintf(newPath, elcount(newPath), "%s.%s", oldPath, "channelNumber");
  C2xSetTokenInt(packetHandle, "WSA", newPath, value.channelNumber);
  result = CheckLastError("WSA", gkFuncRefGet, result);

  snprintf(newPath, elcount(newPath), "%s.%s", oldPath, "powerLevel");
  C2xSetTokenInt(packetHandle, "WSA", newPath, value.powerLevel);
  result = CheckLastError("WSA", gkFuncRefGet, result);

  snprintf(newPath, elcount(newPath), "%s.%s", oldPath, "dataRate");
  SetWSAWsaChInfoDataRateParams(packetHandle, value.dataRate, newPath);
  result = CheckLastError("WSA", gkFuncRefGet, result);

  snprintf(newPath, elcount(newPath), "%s.%s", oldPath, "extensions");
  SetWSAChInfoOptionsParams(packetHandle, value.extensions, newPath);
  result = CheckLastError("WSA", gkFuncRefGet, result);

  return result;
}

int GetWSAChannelInfosParams(LONG packetHandle, struct WSAChannelInfos value, char oldPath[])
{
  char newPath[300]; 
  int i;
  int result;

  result = 0;

  value.length = C2xGetTokenInt(packetHandle, "WSA", oldPath);
  if((result = CheckLastError("WSA", gkFuncRefGet, result))==0)
  {
    for(i=0; i<value.length; i++)
    {
      snprintf(newPath, elcount(newPath), "%s[%d]", oldPath, i);
      GetWSAChannelInfoParams(packetHandle, value.arrayValue[i], newPath);
      result = CheckLastError("WSA", gkFuncRefGet, result);
    }
  }
  return result;
}

int SetWSAChannelInfosParams(LONG packetHandle, struct WSAChannelInfos value, char oldPath[])
{
  char newPath[300]; 
  int i;
  int result;

  result = 0;

  C2xRemoveToken(packetHandle, "WSA", oldPath);
  for(i=0; i<value.length; i++)
  {
    snprintf(newPath, elcount(newPath), "%s[%d]", oldPath, i);
    SetWSAChannelInfoParams(packetHandle, value.arrayValue[i], newPath);
    result = CheckLastError("WSA", gkFuncRefGet, result);
  }
  return result;
}

int GetWSARoutAdvertExtTypesParams(LONG packetHandle, WORD tableKey, struct WSARoutAdvertExtTypes value, char oldPath[])
{
  char newPath[300];
  char buffer[300];
  int result;

  result = 0;

  switch(tableKey)
  {
    case 13:
    {
      snprintf(newPath, elcount(newPath), "%s.%s", oldPath, "c_SecondaryDNS");
      value.c_SecondaryDNS.stringLength = C2xGetTokenData(packetHandle, "WSA", newPath, elcount(value.c_SecondaryDNS.string), value.c_SecondaryDNS.string);
      result = CheckLastError("WSA", gkFuncRefGet, result);
    }
    break;
    case 14:
    {
      snprintf(newPath, elcount(newPath), "%s.%s", oldPath, "c_GatewayMACaddress");
      value.c_GatewayMACaddress.stringLength = C2xGetTokenData(packetHandle, "WSA", newPath, elcount(value.c_GatewayMACaddress.string), value.c_GatewayMACaddress.string);
      result = CheckLastError("WSA", gkFuncRefGet, result);
    }
    break;
  }
  return result;
}

int SetWSARoutAdvertExtTypesParams(LONG packetHandle, WORD tableKey, struct WSARoutAdvertExtTypes value, char oldPath[])
{
  char newPath[300];
  char buffer[300];
  int result;

  result = 0;

  switch(tableKey)
  {
    case 13:
    {
      snprintf(newPath, elcount(newPath), "%s.%s", oldPath, "c_SecondaryDNS");
      C2xSetTokenData(packetHandle, "WSA", newPath, value.c_SecondaryDNS.stringLength, value.c_SecondaryDNS.string);
      result = CheckLastError("WSA", gkFuncRefGet, result);
    }
    break;
    case 14:
    {
      snprintf(newPath, elcount(newPath), "%s.%s", oldPath, "c_GatewayMACaddress");
      C2xSetTokenData(packetHandle, "WSA", newPath, value.c_GatewayMACaddress.stringLength, value.c_GatewayMACaddress.string);
      result = CheckLastError("WSA", gkFuncRefGet, result);
    }
    break;
  }
  return result;
}

int GetWSAExtension_RoutAdvertExtTypesParams(LONG packetHandle, struct WSAExtension_RoutAdvertExtTypes value, char oldPath[])
{
  char newPath[300];
  int result;

  result = 0;

  snprintf(newPath, elcount(newPath), "%s.%s", oldPath, "extensionId");
  value.extensionId = C2xGetTokenInt(packetHandle, "WSA", newPath);
  result = CheckLastError("WSA", gkFuncRefGet, result);

  snprintf(newPath, elcount(newPath), "%s.%s", oldPath, "value");
  GetWSARoutAdvertExtTypesParams(packetHandle, value.extensionId, value.value, newPath);
  result = CheckLastError("WSA", gkFuncRefGet, result);

  return result;
}

int SetWSAExtension_RoutAdvertExtTypesParams(LONG packetHandle, struct WSAExtension_RoutAdvertExtTypes value, char oldPath[])
{
  char newPath[300];
  int result;

  result = 0;


  snprintf(newPath, elcount(newPath), "%s.%s", oldPath, "value");
  SetWSARoutAdvertExtTypesParams(packetHandle, value.extensionId, value.value, newPath);
  result = CheckLastError("WSA", gkFuncRefGet, result);

  return result;
}

int GetWSARoutAdvertExtsParams(LONG packetHandle, struct WSARoutAdvertExts value, char oldPath[])
{
  char newPath[300]; 
  int i;
  int result;

  result = 0;

  value.length = C2xGetTokenInt(packetHandle, "WSA", oldPath);
  if((result = CheckLastError("WSA", gkFuncRefGet, result))==0)
  {
    for(i=0; i<value.length; i++)
    {
      snprintf(newPath, elcount(newPath), "%s[%d]", oldPath, i);
      GetWSAExtension_RoutAdvertExtTypesParams(packetHandle, value.arrayValue[i], newPath);
      result = CheckLastError("WSA", gkFuncRefGet, result);
    }
  }
  return result;
}

int SetWSARoutAdvertExtsParams(LONG packetHandle, struct WSARoutAdvertExts value, char oldPath[])
{
  char newPath[300]; 
  int i;
  int result;

  result = 0;

  C2xRemoveToken(packetHandle, "WSA", oldPath);
  for(i=0; i<value.length; i++)
  {
    snprintf(newPath, elcount(newPath), "%s[%d]", oldPath, i);
    SetWSAExtension_RoutAdvertExtTypesParams(packetHandle, value.arrayValue[i], newPath);
    result = CheckLastError("WSA", gkFuncRefGet, result);
  }
  return result;
}

int GetWSARoutingAdvertisementParams(LONG packetHandle, struct WSARoutingAdvertisement value, char oldPath[])
{
  char newPath[300];
  int result;

  result = 0;

  snprintf(newPath, elcount(newPath), "%s.%s", oldPath, "lifetime");
  value.lifetime = C2xGetTokenInt(packetHandle, "WSA", newPath);
  result = CheckLastError("WSA", gkFuncRefGet, result);

  snprintf(newPath, elcount(newPath), "%s.%s", oldPath, "ipPrefix");
  value.ipPrefix.stringLength = C2xGetTokenData(packetHandle, "WSA", newPath, elcount(value.ipPrefix.string), value.ipPrefix.string);
  snprintf(newPath, elcount(newPath), "%s.%s", oldPath, "ipPrefixLength");
  value.ipPrefixLength = C2xGetTokenInt(packetHandle, "WSA", newPath);
  result = CheckLastError("WSA", gkFuncRefGet, result);

  snprintf(newPath, elcount(newPath), "%s.%s", oldPath, "defaultGateway");
  value.defaultGateway.stringLength = C2xGetTokenData(packetHandle, "WSA", newPath, elcount(value.defaultGateway.string), value.defaultGateway.string);
  snprintf(newPath, elcount(newPath), "%s.%s", oldPath, "primaryDns");
  value.primaryDns.stringLength = C2xGetTokenData(packetHandle, "WSA", newPath, elcount(value.primaryDns.string), value.primaryDns.string);
  snprintf(newPath, elcount(newPath), "%s.%s", oldPath, "extensions");
  GetWSARoutAdvertExtsParams(packetHandle, value.extensions, newPath);
  result = CheckLastError("WSA", gkFuncRefGet, result);

  return result;
}

int SetWSARoutingAdvertisementParams(LONG packetHandle, struct WSARoutingAdvertisement value, char oldPath[])
{
  char newPath[300];
  int result;

  result = 0;

  snprintf(newPath, elcount(newPath), "%s.%s", oldPath, "lifetime");
  C2xSetTokenInt(packetHandle, "WSA", newPath, value.lifetime);
  result = CheckLastError("WSA", gkFuncRefGet, result);

  snprintf(newPath, elcount(newPath), "%s.%s", oldPath, "ipPrefix");
  C2xSetTokenData(packetHandle, "WSA", newPath, value.ipPrefix.stringLength, value.ipPrefix.string);

  snprintf(newPath, elcount(newPath), "%s.%s", oldPath, "ipPrefixLength");
  C2xSetTokenInt(packetHandle, "WSA", newPath, value.ipPrefixLength);
  result = CheckLastError("WSA", gkFuncRefGet, result);

  snprintf(newPath, elcount(newPath), "%s.%s", oldPath, "defaultGateway");
  C2xSetTokenData(packetHandle, "WSA", newPath, value.defaultGateway.stringLength, value.defaultGateway.string);

  snprintf(newPath, elcount(newPath), "%s.%s", oldPath, "primaryDns");
  C2xSetTokenData(packetHandle, "WSA", newPath, value.primaryDns.stringLength, value.primaryDns.string);

  snprintf(newPath, elcount(newPath), "%s.%s", oldPath, "extensions");
  SetWSARoutAdvertExtsParams(packetHandle, value.extensions, newPath);
  result = CheckLastError("WSA", gkFuncRefGet, result);

  return result;
}

int GetWSASrvAdvBodyParams(LONG packetHandle, struct WSASrvAdvBody value, char oldPath[])
{
  char newPath[300];
  int result;

  result = 0;

  snprintf(newPath, elcount(newPath), "%s.%s", oldPath, "changeCount");
  GetWSASrvAdvChangeCountParams(packetHandle, value.changeCount, newPath);
  result = CheckLastError("WSA", gkFuncRefGet, result);

  snprintf(newPath, elcount(newPath), "%s.%s", oldPath, "extensions");
  value.extensions.isValidFlag = C2xIsTokenAvailable(packetHandle, "WSA", newPath);
  if(value.extensions.isValidFlag==1)
  {
    GetWSASrvAdvMsgHeaderExtsParams(packetHandle, value.extensions, newPath);
    result = CheckLastError("WSA", gkFuncRefGet, result);
  }
  snprintf(newPath, elcount(newPath), "%s.%s", oldPath, "serviceInfos");
  value.serviceInfos.isValidFlag = C2xIsTokenAvailable(packetHandle, "WSA", newPath);
  if(value.serviceInfos.isValidFlag==1)
  {
    GetWSAServiceInfosParams(packetHandle, value.serviceInfos, newPath);
    result = CheckLastError("WSA", gkFuncRefGet, result);
  }
  snprintf(newPath, elcount(newPath), "%s.%s", oldPath, "channelInfos");
  value.channelInfos.isValidFlag = C2xIsTokenAvailable(packetHandle, "WSA", newPath);
  if(value.channelInfos.isValidFlag==1)
  {
    GetWSAChannelInfosParams(packetHandle, value.channelInfos, newPath);
    result = CheckLastError("WSA", gkFuncRefGet, result);
  }
  snprintf(newPath, elcount(newPath), "%s.%s", oldPath, "routingAdvertisement");
  value.routingAdvertisement.isValidFlag = C2xIsTokenAvailable(packetHandle, "WSA", newPath);
  if(value.routingAdvertisement.isValidFlag==1)
  {
    GetWSARoutingAdvertisementParams(packetHandle, value.routingAdvertisement, newPath);
    result = CheckLastError("WSA", gkFuncRefGet, result);
  }
  return result;
}

int SetWSASrvAdvBodyParams(LONG packetHandle, struct WSASrvAdvBody value, char oldPath[])
{
  char newPath[300];
  int result;

  result = 0;

  snprintf(newPath, elcount(newPath), "%s.%s", oldPath, "changeCount");
  SetWSASrvAdvChangeCountParams(packetHandle, value.changeCount, newPath);
  result = CheckLastError("WSA", gkFuncRefGet, result);

  snprintf(newPath, elcount(newPath), "%s.%s", oldPath, "extensions");
  if(value.extensions.isValidFlag==1)
  {
    SetWSASrvAdvMsgHeaderExtsParams(packetHandle, value.extensions, newPath);
    result = CheckLastError("WSA", gkFuncRefGet, result);
  }
  else
  {
    if( C2xIsTokenAvailable(packetHandle, "WSA", newPath) )
    {
      C2xRemoveToken(packetHandle, "WSA", newPath);
    }
  }

  snprintf(newPath, elcount(newPath), "%s.%s", oldPath, "serviceInfos");
  if(value.serviceInfos.isValidFlag==1)
  {
    SetWSAServiceInfosParams(packetHandle, value.serviceInfos, newPath);
    result = CheckLastError("WSA", gkFuncRefGet, result);
  }
  else
  {
    if( C2xIsTokenAvailable(packetHandle, "WSA", newPath) )
    {
      C2xRemoveToken(packetHandle, "WSA", newPath);
    }
  }

  snprintf(newPath, elcount(newPath), "%s.%s", oldPath, "channelInfos");
  if(value.channelInfos.isValidFlag==1)
  {
    SetWSAChannelInfosParams(packetHandle, value.channelInfos, newPath);
    result = CheckLastError("WSA", gkFuncRefGet, result);
  }
  else
  {
    if( C2xIsTokenAvailable(packetHandle, "WSA", newPath) )
    {
      C2xRemoveToken(packetHandle, "WSA", newPath);
    }
  }

  snprintf(newPath, elcount(newPath), "%s.%s", oldPath, "routingAdvertisement");
  if(value.routingAdvertisement.isValidFlag==1)
  {
    SetWSARoutingAdvertisementParams(packetHandle, value.routingAdvertisement, newPath);
    result = CheckLastError("WSA", gkFuncRefGet, result);
  }
  else
  {
    if( C2xIsTokenAvailable(packetHandle, "WSA", newPath) )
    {
      C2xRemoveToken(packetHandle, "WSA", newPath);
    }
  }

  return result;
}

int API_GetWSAParams(LONG packetHandle, struct WSA value)
{
  int result;
  result = 0;

  value.version = C2xGetTokenInt(packetHandle, "WSA", "version");
  result = CheckLastError("WSA", gkFuncRefGet, result);

  value.body.isValidFlag = 1;
  GetWSASrvAdvBodyParams(packetHandle, value.body, "body");
  result = CheckLastError("WSA", gkFuncRefGet, result);

  return result;
}

int API_SetWSAParams(LONG packetHandle, struct WSA value)
{
  int result;
  result = 0;

  C2xSetTokenInt(packetHandle, "WSA", "version", value.version);
  result = CheckLastError("WSA", gkFuncRefGet, result);

  SetWSASrvAdvBodyParams(packetHandle, value.body, "body");
  result = CheckLastError("WSA", gkFuncRefGet, result);

  return result;
}

