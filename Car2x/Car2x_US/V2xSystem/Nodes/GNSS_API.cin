/*@!Encoding:1252*/
includes
{
  #include "Car2xAPI.cin"
}

variables
{
  struct GNSSItem
  {
    long hMapHandleAntenna;
    long hMapHandleItem;
    long hMapHandleText;
    
    char name[256];
    
    char img_item[128];
    char img_antenna[128];
    double latitude;
    double longitude;
    double direction;
  }; 
  
  struct GNSSItem g_gnssItem;
}

void API_SetVisibility_GNSS_Device(int isVisible)
{
  // Show or hide the GNSS device
  C2xSetMapObjectPropertyDouble(g_gnssItem.hMapHandleItem, "VISIBLE", isVisible);
  C2xDrawMapObject(g_gnssItem.hMapHandleItem);
  
  C2xSetMapObjectPropertyDouble(g_gnssItem.hMapHandleAntenna, "VISIBLE", isVisible);
  C2xDrawMapObject(g_gnssItem.hMapHandleAntenna);  
  
  C2xSetMapObjectPropertyDouble(g_gnssItem.hMapHandleText, "VISIBLE", isVisible);
  C2xDrawMapObject(g_gnssItem.hMapHandleText);  
}


void API_Init_GNSS_Device(char name[])
{
  
  strncpy(g_gnssItem.img_item,    "Bitmaps\\gnss_item.bmp", elcount(g_gnssItem.img_item));
  strncpy(g_gnssItem.img_antenna, "Bitmaps\\satellite.bmp", elcount(g_gnssItem.img_antenna));
  
  g_gnssItem.hMapHandleAntenna = C2xCreateMapObject(kBitmap);
  g_gnssItem.hMapHandleItem    = C2xCreateMapObject(kBitmap);
  g_gnssItem.hMapHandleText    = C2xCreateMapObject(kText);
  
  strncpy(g_gnssItem.name, name, elcount(g_gnssItem.name));  
}

void API_Draw_Device(struct GNSSItem gnssItem, int showDeviceOnMap)
{ 
  char buffer_pos_text[256];
    
  if(showDeviceOnMap > 0)
  { 
    // draw Device name, latitude, longitude, direction as text
    C2xSetMapObjectPosition(gnssItem.hMapHandleText, gnssItem.latitude - 0.00017, gnssItem.longitude);
    snprintf(buffer_pos_text,elcount(buffer_pos_text),"%s", gnssItem.name);
    
    C2xSetMapObjectText(gnssItem.hMapHandleText, buffer_pos_text);
    C2xSetMapObjectFillColor(gnssItem.hMapHandleText, makeRGB(0, 0, 0));
    C2xDrawMapObject(gnssItem.hMapHandleText);  
    
    // draw the satellite
    C2xSetMapObjectPosition(gnssItem.hMapHandleAntenna, gnssItem.latitude + 0.00025, gnssItem.longitude - 0.00045);
    C2xSetMapObjectBmpFilePath(gnssItem.hMapHandleAntenna, gnssItem.img_antenna);
    C2xDrawMapObject(gnssItem.hMapHandleAntenna);  
    
    // draw the item with direction indicator
    C2xSetMapObjectPosition(gnssItem.hMapHandleItem, gnssItem.latitude, gnssItem.longitude);
    C2xSetMapObjectHeading(gnssItem.hMapHandleItem, gnssItem.direction);
    C2xSetMapObjectBmpFilePath(gnssItem.hMapHandleItem, gnssItem.img_item);
    C2xDrawMapObject(gnssItem.hMapHandleItem);  
    
    // Set the position of the map (optional)
    C2xSetMapPosition(gnssItem.latitude, gnssItem.longitude);
  }
}
