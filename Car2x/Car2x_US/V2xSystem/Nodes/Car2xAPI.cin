/*@!Encoding:1252*/
// *************************************************************************************
//
//  Constants for the C2x API functions
//
// *************************************************************************************

variables
{
  ////////////////////////////////////////
  // Register Callback
  ////////////////////////////////////////

  enum VRegisterCallback
  {
    kRxIndication    = 0,
    kPreTxIndication = 1
  };


  ////////////////////////////////////////
  // MAP API constants
  ////////////////////////////////////////

  // Figures of the CAPL-Map Drawining-API
  enum VEnumFigures { kSquare = 1, kRectangle = 2, kEllipse = 3, kCross = 4, kTriangle = 5, kLine = 6, kBitmap = 7, kText = 8 };

  // RGB color codes
  const double kWhite       = 0xFFFFFF;
  const double kTurquoise   = 0x00FFFF;
  const double kMagenta     = 0xFF00FF;
  const double kRed         = 0x0000FF;
  const double kGrey        = 0xC0C0C0;
  const double kYellow      = 0xFFFF00;
  const double kGreen       = 0x00FF00;
  const double kBlue        = 0xFF0000;
  const double kBlack       = 0x000000;
  const double kTransparent = -1;
}

/*************************************************************************/
// Function converts the value of the heading to a value which is needed 
// to transmit it in a BSM. Conversion according to the 1609.3 document. 
//
// param val: The raw value of the heading, e.g. 90°
// returns:   The value of the heading in a BSM, e.g. 7200
/*************************************************************************/
int HeadingToBSMValue(int val)
{
  return val / 0.0125;
}

/***********************************************************/
// Function converts the value of the heading in a BSM to 
// its real value . Conversion according to the 1609.3 document. 
//
// param val: The value of the heading in a BSM, e.g. 7200 
// returns:   The raw value of the heading, e.g. 90°
/***********************************************************/
int BSMValueToHeading(int val)
{
  return val * 0.0125;
}

/*************************************************************************/
// Function converts the value of the speed to a value which is needed 
// to transmit it in a BSM. Conversion according to the 1609.3 document. 
//
// param val: The raw value of the speed, e.g. 100 km/h
// returns:   The value of the heading in a BSM, e.g. 1388
/*************************************************************************/
int SpeedToBSMValue(int val)
{
  return ( (val / 3.6) / 0.02);
}

/***********************************************************/
// Function converts the value of the speed in a BSM to 
// its real value . Conversion according to the 1609.3 document. 
//
// param val: The value of the heading in a BSM, e.g. 18000 
// returns:   The raw value of the heading, e.g. 100 km/h
/***********************************************************/
int BSMValueToSpeed(int val)
{
  return ( (val * 0.02) * 3.6);
}

////////////////////////////////////////////////////////////////////////////////
// EOF
////////////////////////////////////////////////////////////////////////////////
