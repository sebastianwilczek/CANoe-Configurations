/*@!Encoding:1252*/
variables
{
  long gHeading;  // 175°, divide through 0.0125 to get the heading val
  long gLatitude;
  long gLongitude;

  // modify gSpeed to change position update time, this does not affect message send time.
  long gSpeed = 50; // milli seconds
  
  msTimer setLatTimer; // set latitude
  msTimer setLonTimer; // set longitude
  msTimer resetTimer;  // reset position
}

/****************************************************************/
// Called on simulation start
/****************************************************************/
on start
{
  resetPosition();
  setLatTimer.setCyclic(gSpeed * 1);
  setLonTimer.setCyclic(gSpeed * 10);
  resetTimer.setCyclic(gSpeed * 338);
}

/****************************************************************/
// reset BSM position
/****************************************************************/
void resetPosition()
{
  gHeading   = 14000;
  gLatitude  = 424442610;
  gLongitude = -834387100;
  
  C2xSetSignal("BasicSafetyMessage::value::basicSafetyMessage::coreData::heading", gHeading) ;
  C2xSetSignal("BasicSafetyMessage::value::basicSafetyMessage::coreData::lat", gLatitude);
  C2xSetSignal("BasicSafetyMessage::value::basicSafetyMessage::coreData::lon", gLongitude);
}

/****************************************************************/
// Timer to set BSM position
/****************************************************************/
on timer setLatTimer
{
  gLatitude -= 100 ;
  C2xSetSignal("BasicSafetyMessage::value::basicSafetyMessage::coreData::lat", gLatitude);
}

on timer setLonTimer
{
  gHeading   -= 30;
  gLongitude += 80;
  C2xSetSignal("BasicSafetyMessage::value::basicSafetyMessage::coreData::heading", gHeading) ;
  C2xSetSignal("BasicSafetyMessage::value::basicSafetyMessage::coreData::lon", gLongitude);
}

on timer resetTimer
{
  resetPosition() ;  // Set values back, so that vehicles drive in a loop
}
