/*
//  (c) Vector Informatik GmbH. All rights reserved.
//                                                      */
variables
{
  struct OPT_BYTE_ASN
  {
    BYTE value;
    INT isValidFlag;
  };
  
  struct OPT_WORD_ASN
  {
    WORD value;
    INT isValidFlag;
  };
  
  struct OPT_DWORD_ASN
  {
    DWORD value;
    INT isValidFlag;
  };
  
  struct OPT_QWORD_ASN
  {
    QWORD value;
    INT isValidFlag;
  };

  struct OPT_INT_ASN
  {
    INT64 value;
    INT isValidFlag;
  };

  struct OPT_INT64_ASN
  {
    INT64 value;
    INT isValidFlag;
  };

  struct OPT_LONG_ASN
  {
    LONG value;
    INT isValidFlag;
  };

  struct OPT_ENUM_ASN
  {
    INT value;
    INT isValidFlag;
  };

  struct OPT_BOOL_ASN
  {
    INT value;
    INT isValidFlag;
  };

  INT gDebugOutput = 1;  //overwrite it in your onStart-Handler to disable debug output
  const BYTE gkFuncRefGeneral = 0;
  const BYTE gkFuncRefSet     = 1;
  const BYTE gkFuncRefGet     = 2;
  const BYTE gkFuncRefRemove  = 3;
}

/**********************************************************/
// checks if an error of the NL function occured and reports,
// if debugging is enabled, an error in the write window
/**********************************************************/
int CheckLastError (char applMsgName[], int functionRef, int result)
{
  long errorId;
  char  errorText[1024];

  errorId = C2xGetLastError();
  if (errorId != 0)
  {
    // handle error
    C2xGetLastErrorText(elcount(errorText), errorText);
    if (gDebugOutput >= 1)
    {
      if (functionRef == gkFuncRefSet)
      {
        write("%s: C2x Set-function returned code %i (%s)", applMsgName, errorId, errorText);
      }
      else if (functionRef == gkFuncRefGet)
      {
        write("%s: C2x Get-function returned code %i (%s)", applMsgName, errorId, errorText);
      }
      else if (functionRef == gkFuncRefRemove)
      {
        write("%s: C2x Remove-function returned code %i (%s)", applMsgName, errorId, errorText);
      }
      else
      {
        write("%s: C2x NL function returned code %i (%s)", applMsgName, errorId, errorText);
      }
    }
    return errorId;
  }
  return result;
}