/*@!Encoding:1252*/
/*
//  (c) Vector Informatik GmbH. All rights reserved.
//
//  This file contains definitions of structs and methods that may be used
//  to set and get the values of an ASN.1 defined packet's payload.
//
//  //This example demonstrates how to set a packet's payload:
//  LONG packetHandle;
//  struct ProbeVehicleData payload;
//  //you need to set the values of the variable "payload" yourself
//  packetHandle = API_InitProbeVehicleDataPacket();
//  if (packetHandle!=0) {
//    if (API_SetProbeVehicleDataParams(packetHandle, payload)==0) {
//      if (C2xCompletePacket(packetHandle)==0) {
//        C2xOutputPacket(packetHandle);
//      }
//    }
//  }
//                                                                             */
includes
{

}
variables
{
    struct ProbeVehicleDataDescriptiveName {
        INT isValidFlag;   // necessary if this struct is used as an optional field of a SEQUENCE
        CHAR string[64];
        INT  stringLength;
    };
    
    struct ProbeVehicleDataVINstring {
        INT isValidFlag;   // necessary if this struct is used as an optional field of a SEQUENCE
        CHAR string[18];
        INT  stringLength;
    };
    
    struct ProbeVehicleData_VehicleIdent_ownerCode {
        INT isValidFlag;   // necessary if this struct is used as an optional field of a SEQUENCE
        CHAR string[33];
        INT  stringLength;
    };
    
    struct ProbeVehicleDataTemporaryID {
        INT isValidFlag;   // necessary if this struct is used as an optional field of a SEQUENCE
        CHAR string[5];
        INT  stringLength;
    };
    
    struct ProbeVehicleDataVehicleID {
        INT isValidFlag;   // necessary if this struct is used as an optional field of a SEQUENCE
        INT choice;
        struct ProbeVehicleDataTemporaryID entityID;  // OCTETSTRING;
        DWORD stationID;  // INTEGER, 0..4294967295;
    };
    
    struct ProbeVehicleData_VehicleIdent_vehicleClass {
        INT isValidFlag;   // necessary if this struct is used as an optional field of a SEQUENCE
        INT choice;
        INT vGroup;  // ENUMERATED, all_vehicles(9217), bicycles(9218), motorcycles(9219), cars(9220), light_vehicles(9221), cars_and_light_vehicles(9222), cars_with_trailers(9223), cars_with_recreational_trailers(9224), vehicles_with_trailers(9225), heavy_vehicles(9226), trucks(9227), buses(9228), articulated_buses(9229), school_buses(9230), vehicles_with_semi_trailers(9231), vehicles_with_double_trailers(9232), high_profile_vehicles(9233), wide_vehicles(9234), long_vehicles(9235), hazardous_loads(9236), exceptional_loads(9237), abnormal_loads(9238), convoys(9239), maintenance_vehicles(9240), delivery_vehicles(9241), vehicles_with_even_numbered_license_plates(9242), vehicles_with_odd_numbered_license_plates(9243), vehicles_with_parking_permits(9244), vehicles_with_catalytic_converters(9245), vehicles_without_catalytic_converters(9246), gas_powered_vehicles(9247), diesel_powered_vehicles(9248), lPG_vehicles(9249), military_convoys(9250), military_vehicles(9251);
        INT rGroup;  // ENUMERATED, emergency_vehicle_units(9729), federal_law_enforcement_units(9730), state_police_units(9731), county_police_units(9732), local_police_units(9733), ambulance_units(9734), rescue_units(9735), fire_units(9736), hAZMAT_units(9737), light_tow_unit(9738), heavy_tow_unit(9739), freeway_service_patrols(9740), transportation_response_units(9741), private_contractor_response_units(9742);
        INT rEquip;  // ENUMERATED, ground_fire_suppression(9985), heavy_ground_equipment(9986), aircraft(9988), marine_equipment(9989), support_equipment(9990), medical_rescue_unit(9991), other(9993), ground_fire_suppression_other(9994), engine(9995), truck_or_aerial(9996), quint(9997), tanker_pumper_combination(9998), brush_truck(10000), aircraft_rescue_firefighting(10001), heavy_ground_equipment_other(10004), dozer_or_plow(10005), tractor(10006), tanker_or_tender(10008), aircraft_other(10024), aircraft_fixed_wing_tanker(10025), helitanker(10026), helicopter(10027), marine_equipment_other(10034), fire_boat_with_pump(10035), boat_no_pump(10036), support_apparatus_other(10044), breathing_apparatus_support(10045), light_and_air_unit(10046), medical_rescue_unit_other(10054), rescue_unit(10055), urban_search_rescue_unit(10056), high_angle_rescue(10057), crash_fire_rescue(10058), bLS_unit(10059), aLS_unit(10060), mobile_command_post(10075), chief_officer_car(10076), hAZMAT_unit(10077), type_i_hand_crew(10078), type_ii_hand_crew(10079), privately_owned_vehicle(10083), other_apparatus_resource(10084), ambulance(10085), bomb_squad_van(10086), combine_harvester(10087), construction_vehicle(10088), farm_tractor(10089), grass_cutting_machines(10090), hAZMAT_containment_tow(10091), heavy_tow(10092), light_tow(10094), flatbed_tow(10114), hedge_cutting_machines(10093), mobile_crane(10095), refuse_collection_vehicle(10096), resurfacing_vehicle(10097), road_sweeper(10098), roadside_litter_collection_crews(10099), salvage_vehicle(10100), sand_truck(10101), snowplow(10102), steam_roller(10103), swat_team_van(10104), track_laying_vehicle(10105), unknown_vehicle(10106), white_lining_vehicle(10107), dump_truck(10108), supervisor_vehicle(10109), snow_blower(10110), rotary_snow_blower(10111), road_grader(10112), steam_truck(10113);
    };
    
    struct ProbeVehicleDataVehicleIdent {
        INT isValidFlag;   // necessary if this struct is used as an optional field of a SEQUENCE
        struct ProbeVehicleDataDescriptiveName name;  // IA5STRING, OPTIONAL;
        struct ProbeVehicleDataVINstring vin;  // OCTETSTRING, OPTIONAL;
        struct ProbeVehicleData_VehicleIdent_ownerCode ownerCode;  // IA5STRING, OPTIONAL;
        struct ProbeVehicleDataVehicleID id;  // CHOICE, OPTIONAL;
        struct OPT_ENUM_ASN vehicleType;  // ENUMERATED, OPTIONAL, none(0), unknown(1), special(2), moto(3), car(4), carOther(5), bus(6), axleCnt2(7), axleCnt3(8), axleCnt4(9), axleCnt4Trailer(10), axleCnt5Trailer(11), axleCnt6Trailer(12), axleCnt5MultiTrailer(13), axleCnt6MultiTrailer(14), axleCnt7MultiTrailer(15);
        struct ProbeVehicleData_VehicleIdent_vehicleClass vehicleClass;  // CHOICE, OPTIONAL;
    };
    
    struct ProbeVehicleDataDDateTime {
        INT isValidFlag;   // necessary if this struct is used as an optional field of a SEQUENCE
        struct OPT_WORD_ASN year;  // INTEGER, OPTIONAL, 0..4095;
        struct OPT_BYTE_ASN month;  // INTEGER, OPTIONAL, 0..12;
        struct OPT_BYTE_ASN day;  // INTEGER, OPTIONAL, 0..31;
        struct OPT_BYTE_ASN hour;  // INTEGER, OPTIONAL, 0..31;
        struct OPT_BYTE_ASN minute;  // INTEGER, OPTIONAL, 0..60;
        struct OPT_WORD_ASN second;  // INTEGER, OPTIONAL, 0..65535;
        struct OPT_INT_ASN offset;  // INTEGER, OPTIONAL, -840..840;
    };
    
    struct ProbeVehicleDataTransmissionAndSpeed {
        INT isValidFlag;   // necessary if this struct is used as an optional field of a SEQUENCE
        INT transmisson;  // ENUMERATED, neutral(0), park(1), forwardGears(2), reverseGears(3), reserved1(4), reserved2(5), reserved3(6), unavailable(7);
        WORD speed;  // INTEGER, 0..8191;
    };
    
    struct ProbeVehicleDataPositionalAccuracy {
        INT isValidFlag;   // necessary if this struct is used as an optional field of a SEQUENCE
        BYTE semiMajor;  // INTEGER, 0..255;
        BYTE semiMinor;  // INTEGER, 0..255;
        WORD orientation;  // INTEGER, 0..65535;
    };
    
    struct ProbeVehicleDataPositionConfidenceSet {
        INT isValidFlag;   // necessary if this struct is used as an optional field of a SEQUENCE
        INT pos;  // ENUMERATED, unavailable(0), a500m(1), a200m(2), a100m(3), a50m(4), a20m(5), a10m(6), a5m(7), a2m(8), a1m(9), a50cm(10), a20cm(11), a10cm(12), a5cm(13), a2cm(14), a1cm(15);
        INT elevation;  // ENUMERATED, unavailable(0), elev_500_00(1), elev_200_00(2), elev_100_00(3), elev_050_00(4), elev_020_00(5), elev_010_00(6), elev_005_00(7), elev_002_00(8), elev_001_00(9), elev_000_50(10), elev_000_20(11), elev_000_10(12), elev_000_05(13), elev_000_02(14), elev_000_01(15);
    };
    
    struct ProbeVehicleDataSpeedandHeadingandThrottleConfidence {
        INT isValidFlag;   // necessary if this struct is used as an optional field of a SEQUENCE
        INT heading;  // ENUMERATED, unavailable(0), prec10deg(1), prec05deg(2), prec01deg(3), prec0_1deg(4), prec0_05deg(5), prec0_01deg(6), prec0_0125deg(7);
        INT speed;  // ENUMERATED, unavailable(0), prec100ms(1), prec10ms(2), prec5ms(3), prec1ms(4), prec0_1ms(5), prec0_05ms(6), prec0_01ms(7);
        INT throttle;  // ENUMERATED, unavailable(0), prec10percent(1), prec1percent(2), prec0_5percent(3);
    };
    
    struct ProbeVehicleDataFullPositionVector {
        INT isValidFlag;   // necessary if this struct is used as an optional field of a SEQUENCE
        struct ProbeVehicleDataDDateTime utcTime;  // SEQUENCE, OPTIONAL;
        LONG lon;  // INTEGER, -1799999999..1800000001;
        LONG lat;  // INTEGER, -900000000..900000001;
        struct OPT_LONG_ASN elevation;  // INTEGER, OPTIONAL, -4096..61439;
        struct OPT_WORD_ASN heading;  // INTEGER, OPTIONAL, 0..28800;
        struct ProbeVehicleDataTransmissionAndSpeed speed;  // SEQUENCE, OPTIONAL;
        struct ProbeVehicleDataPositionalAccuracy posAccuracy;  // SEQUENCE, OPTIONAL;
        struct OPT_ENUM_ASN timeConfidence;  // ENUMERATED, OPTIONAL, unavailable(0), time_100_000(1), time_050_000(2), time_020_000(3), time_010_000(4), time_002_000(5), time_001_000(6), time_000_500(7), time_000_200(8), time_000_100(9), time_000_050(10), time_000_020(11), time_000_010(12), time_000_005(13), time_000_002(14), time_000_001(15), time_000_000_5(16), time_000_000_2(17), time_000_000_1(18), time_000_000_05(19), time_000_000_02(20), time_000_000_01(21), time_000_000_005(22), time_000_000_002(23), time_000_000_001(24), time_000_000_000_5(25), time_000_000_000_2(26), time_000_000_000_1(27), time_000_000_000_05(28), time_000_000_000_02(29), time_000_000_000_01(30), time_000_000_000_005(31), time_000_000_000_002(32), time_000_000_000_001(33), time_000_000_000_000_5(34), time_000_000_000_000_2(35), time_000_000_000_000_1(36), time_000_000_000_000_05(37), time_000_000_000_000_02(38), time_000_000_000_000_01(39);
        struct ProbeVehicleDataPositionConfidenceSet posConfidence;  // SEQUENCE, OPTIONAL;
        struct ProbeVehicleDataSpeedandHeadingandThrottleConfidence speedConfidence;  // SEQUENCE, OPTIONAL;
    };
    
    struct ProbeVehicleDataREG_EXT_ID_AND_TYPE_Empty {
    };
    
    struct ProbeVehicleDataRegionalExtensionVehicleClassification {
        INT isValidFlag;   // necessary if this struct is used as an optional field of a SEQUENCE
        BYTE regionId;  // INTEGER, 0..255, noRegion(0), addGrpA(1), addGrpB(2), addGrpC(3);
        struct ProbeVehicleDataREG_EXT_ID_AND_TYPE_Empty regExtValue;  // TABLE;
    };
    
    struct ProbeVehicleData_VehicleClassification_regional {
        INT isValidFlag;   // necessary if this struct is used as an optional field of a SEQUENCE
        INT length;
        struct ProbeVehicleDataRegionalExtensionVehicleClassification arrayValue[4];  // SEQUENCE;
    };
    
    struct ProbeVehicleDataVehicleClassification {
        INT isValidFlag;   // necessary if this struct is used as an optional field of a SEQUENCE
        struct OPT_BYTE_ASN keyType;  // INTEGER, OPTIONAL, 0..255;
        struct OPT_ENUM_ASN role;  // ENUMERATED, OPTIONAL, basicVehicle(0), publicTransport(1), specialTransport(2), dangerousGoods(3), roadWork(4), roadRescue(5), emergency(6), safetyCar(7), none_unknown(8), truck(9), motorcycle(10), roadSideSource(11), police(12), fire(13), ambulance(14), dot(15), transit(16), slowMoving(17), stopNgo(18), cyclist(19), pedestrian(20), nonMotorized(21), military(22);
        struct OPT_BYTE_ASN iso3883;  // INTEGER, OPTIONAL, 0..100;
        struct OPT_ENUM_ASN hpmsType;  // ENUMERATED, OPTIONAL, none(0), unknown(1), special(2), moto(3), car(4), carOther(5), bus(6), axleCnt2(7), axleCnt3(8), axleCnt4(9), axleCnt4Trailer(10), axleCnt5Trailer(11), axleCnt6Trailer(12), axleCnt5MultiTrailer(13), axleCnt6MultiTrailer(14), axleCnt7MultiTrailer(15);
        struct OPT_ENUM_ASN vehicleType;  // ENUMERATED, OPTIONAL, all_vehicles(9217), bicycles(9218), motorcycles(9219), cars(9220), light_vehicles(9221), cars_and_light_vehicles(9222), cars_with_trailers(9223), cars_with_recreational_trailers(9224), vehicles_with_trailers(9225), heavy_vehicles(9226), trucks(9227), buses(9228), articulated_buses(9229), school_buses(9230), vehicles_with_semi_trailers(9231), vehicles_with_double_trailers(9232), high_profile_vehicles(9233), wide_vehicles(9234), long_vehicles(9235), hazardous_loads(9236), exceptional_loads(9237), abnormal_loads(9238), convoys(9239), maintenance_vehicles(9240), delivery_vehicles(9241), vehicles_with_even_numbered_license_plates(9242), vehicles_with_odd_numbered_license_plates(9243), vehicles_with_parking_permits(9244), vehicles_with_catalytic_converters(9245), vehicles_without_catalytic_converters(9246), gas_powered_vehicles(9247), diesel_powered_vehicles(9248), lPG_vehicles(9249), military_convoys(9250), military_vehicles(9251);
        struct OPT_ENUM_ASN responseEquip;  // ENUMERATED, OPTIONAL, ground_fire_suppression(9985), heavy_ground_equipment(9986), aircraft(9988), marine_equipment(9989), support_equipment(9990), medical_rescue_unit(9991), other(9993), ground_fire_suppression_other(9994), engine(9995), truck_or_aerial(9996), quint(9997), tanker_pumper_combination(9998), brush_truck(10000), aircraft_rescue_firefighting(10001), heavy_ground_equipment_other(10004), dozer_or_plow(10005), tractor(10006), tanker_or_tender(10008), aircraft_other(10024), aircraft_fixed_wing_tanker(10025), helitanker(10026), helicopter(10027), marine_equipment_other(10034), fire_boat_with_pump(10035), boat_no_pump(10036), support_apparatus_other(10044), breathing_apparatus_support(10045), light_and_air_unit(10046), medical_rescue_unit_other(10054), rescue_unit(10055), urban_search_rescue_unit(10056), high_angle_rescue(10057), crash_fire_rescue(10058), bLS_unit(10059), aLS_unit(10060), mobile_command_post(10075), chief_officer_car(10076), hAZMAT_unit(10077), type_i_hand_crew(10078), type_ii_hand_crew(10079), privately_owned_vehicle(10083), other_apparatus_resource(10084), ambulance(10085), bomb_squad_van(10086), combine_harvester(10087), construction_vehicle(10088), farm_tractor(10089), grass_cutting_machines(10090), hAZMAT_containment_tow(10091), heavy_tow(10092), light_tow(10094), flatbed_tow(10114), hedge_cutting_machines(10093), mobile_crane(10095), refuse_collection_vehicle(10096), resurfacing_vehicle(10097), road_sweeper(10098), roadside_litter_collection_crews(10099), salvage_vehicle(10100), sand_truck(10101), snowplow(10102), steam_roller(10103), swat_team_van(10104), track_laying_vehicle(10105), unknown_vehicle(10106), white_lining_vehicle(10107), dump_truck(10108), supervisor_vehicle(10109), snow_blower(10110), rotary_snow_blower(10111), road_grader(10112), steam_truck(10113);
        struct OPT_ENUM_ASN responderType;  // ENUMERATED, OPTIONAL, emergency_vehicle_units(9729), federal_law_enforcement_units(9730), state_police_units(9731), county_police_units(9732), local_police_units(9733), ambulance_units(9734), rescue_units(9735), fire_units(9736), hAZMAT_units(9737), light_tow_unit(9738), heavy_tow_unit(9739), freeway_service_patrols(9740), transportation_response_units(9741), private_contractor_response_units(9742);
        struct OPT_BYTE_ASN fuelType;  // INTEGER, OPTIONAL, 0..15;
        struct ProbeVehicleData_VehicleClassification_regional regional;  // SEQUENCEOF, OPTIONAL;
    };
    
    struct ProbeVehicleDataVehicleEventFlags {
        INT isValidFlag;   // necessary if this struct is used as an optional field of a SEQUENCE
        CHAR string[14];
        INT  stringLength;
    };
    
    struct ProbeVehicleDataGNSSstatus {
        INT isValidFlag;   // necessary if this struct is used as an optional field of a SEQUENCE
        CHAR string[9];
        INT  stringLength;
    };
    
    struct ProbeVehicleDataPathHistoryPoint {
        INT isValidFlag;   // necessary if this struct is used as an optional field of a SEQUENCE
        LONG latOffset;  // INTEGER, -131072..131071;
        LONG lonOffset;  // INTEGER, -131072..131071;
        INT elevationOffset;  // INTEGER, -2048..2047;
        WORD timeOffset;  // INTEGER, 1..65535;
        struct OPT_WORD_ASN speed;  // INTEGER, OPTIONAL, 0..8191;
        struct ProbeVehicleDataPositionalAccuracy posAccuracy;  // SEQUENCE, OPTIONAL;
        struct OPT_BYTE_ASN heading;  // INTEGER, OPTIONAL, 0..240;
    };
    
    struct ProbeVehicleDataPathHistoryPointList {
        INT isValidFlag;   // necessary if this struct is used as an optional field of a SEQUENCE
        INT length;
        struct ProbeVehicleDataPathHistoryPoint arrayValue[23];  // SEQUENCE;
    };
    
    struct ProbeVehicleDataPathHistory {
        INT isValidFlag;   // necessary if this struct is used as an optional field of a SEQUENCE
        struct ProbeVehicleDataFullPositionVector initialPosition;  // SEQUENCE, OPTIONAL;
        struct ProbeVehicleDataGNSSstatus currGNSSstatus;  // BITSTRING, OPTIONAL;
        struct ProbeVehicleDataPathHistoryPointList crumbData;  // SEQUENCEOF;
    };
    
    struct ProbeVehicleDataPathPrediction {
        INT isValidFlag;   // necessary if this struct is used as an optional field of a SEQUENCE
        INT radiusOfCurve;  // INTEGER, -32767..32767;
        BYTE confidence;  // INTEGER, 0..200;
    };
    
    struct ProbeVehicleDataExteriorLights {
        INT isValidFlag;   // necessary if this struct is used as an optional field of a SEQUENCE
        CHAR string[10];
        INT  stringLength;
    };
    
    struct ProbeVehicleDataVehicleSafetyExtensions {
        INT isValidFlag;   // necessary if this struct is used as an optional field of a SEQUENCE
        struct ProbeVehicleDataVehicleEventFlags events;  // BITSTRING, OPTIONAL;
        struct ProbeVehicleDataPathHistory pathHistory;  // SEQUENCE, OPTIONAL;
        struct ProbeVehicleDataPathPrediction pathPrediction;  // SEQUENCE, OPTIONAL;
        struct ProbeVehicleDataExteriorLights lights;  // BITSTRING, OPTIONAL;
    };
    
    struct ProbeVehicleDataWiperSet {
        INT isValidFlag;   // necessary if this struct is used as an optional field of a SEQUENCE
        INT statusFront;  // ENUMERATED, unavailable(0), off(1), intermittent(2), low(3), high(4), washerInUse(5), automaticPresent(6);
        BYTE rateFront;  // INTEGER, 0..127;
        struct OPT_ENUM_ASN statusRear;  // ENUMERATED, OPTIONAL, unavailable(0), off(1), intermittent(2), low(3), high(4), washerInUse(5), automaticPresent(6);
        struct OPT_BYTE_ASN rateRear;  // INTEGER, OPTIONAL, 0..127;
    };
    
    struct ProbeVehicleDataBrakeAppliedStatus {
        INT isValidFlag;   // necessary if this struct is used as an optional field of a SEQUENCE
        CHAR string[6];
        INT  stringLength;
    };
    
    struct ProbeVehicleDataBrakeSystemStatus {
        INT isValidFlag;   // necessary if this struct is used as an optional field of a SEQUENCE
        struct ProbeVehicleDataBrakeAppliedStatus wheelBrakes;  // BITSTRING;
        INT traction;  // ENUMERATED, unavailable(0), off(1), on(2), engaged(3);
        INT antiLockBrakes;  // ENUMERATED, unavailable(0), off(1), on(2), engaged(3);
        INT scs;  // ENUMERATED, unavailable(0), off(1), on(2), engaged(3);
        INT brakeBoost;  // ENUMERATED, unavailable(0), off(1), on(2);
        INT auxBrakes;  // ENUMERATED, unavailable(0), off(1), on(2), reserved(3);
    };
    
    struct ProbeVehicleData_VehicleStatus_steering {
        INT isValidFlag;   // necessary if this struct is used as an optional field of a SEQUENCE
        INT angle;  // INTEGER, -126..127;
        struct OPT_ENUM_ASN confidence;  // ENUMERATED, OPTIONAL, unavailable(0), prec2deg(1), prec1deg(2), prec0_02deg(3);
        struct OPT_INT_ASN rate;  // INTEGER, OPTIONAL, -127..127;
        struct OPT_INT_ASN wheels;  // INTEGER, OPTIONAL, -128..127;
    };
    
    struct ProbeVehicleDataAccelerationSet4Way {
        INT isValidFlag;   // necessary if this struct is used as an optional field of a SEQUENCE
        INT lon;  // INTEGER, -2000..2001;
        INT lat;  // INTEGER, -2000..2001;
        INT vert;  // INTEGER, -127..127;
        INT yaw;  // INTEGER, -32767..32767;
    };
    
    struct ProbeVehicleDataVerticalAccelerationThreshold {
        INT isValidFlag;   // necessary if this struct is used as an optional field of a SEQUENCE
        CHAR string[6];
        INT  stringLength;
    };
    
    struct ProbeVehicleDataAccelSteerYawRateConfidence {
        INT isValidFlag;   // necessary if this struct is used as an optional field of a SEQUENCE
        INT yawRate;  // ENUMERATED, unavailable(0), degSec_100_00(1), degSec_010_00(2), degSec_005_00(3), degSec_001_00(4), degSec_000_10(5), degSec_000_05(6), degSec_000_01(7);
        INT acceleration;  // ENUMERATED, unavailable(0), accl_100_00(1), accl_010_00(2), accl_005_00(3), accl_001_00(4), accl_000_10(5), accl_000_05(6), accl_000_01(7);
        INT steeringWheelAngle;  // ENUMERATED, unavailable(0), prec2deg(1), prec1deg(2), prec0_02deg(3);
    };
    
    struct ProbeVehicleDataConfidenceSet {
        INT isValidFlag;   // necessary if this struct is used as an optional field of a SEQUENCE
        struct ProbeVehicleDataAccelSteerYawRateConfidence accelConfidence;  // SEQUENCE, OPTIONAL;
        struct ProbeVehicleDataSpeedandHeadingandThrottleConfidence speedConfidence;  // SEQUENCE, OPTIONAL;
        struct OPT_ENUM_ASN timeConfidence;  // ENUMERATED, OPTIONAL, unavailable(0), time_100_000(1), time_050_000(2), time_020_000(3), time_010_000(4), time_002_000(5), time_001_000(6), time_000_500(7), time_000_200(8), time_000_100(9), time_000_050(10), time_000_020(11), time_000_010(12), time_000_005(13), time_000_002(14), time_000_001(15), time_000_000_5(16), time_000_000_2(17), time_000_000_1(18), time_000_000_05(19), time_000_000_02(20), time_000_000_01(21), time_000_000_005(22), time_000_000_002(23), time_000_000_001(24), time_000_000_000_5(25), time_000_000_000_2(26), time_000_000_000_1(27), time_000_000_000_05(28), time_000_000_000_02(29), time_000_000_000_01(30), time_000_000_000_005(31), time_000_000_000_002(32), time_000_000_000_001(33), time_000_000_000_000_5(34), time_000_000_000_000_2(35), time_000_000_000_000_1(36), time_000_000_000_000_05(37), time_000_000_000_000_02(38), time_000_000_000_000_01(39);
        struct ProbeVehicleDataPositionConfidenceSet posConfidence;  // SEQUENCE, OPTIONAL;
        struct OPT_ENUM_ASN steerConfidence;  // ENUMERATED, OPTIONAL, unavailable(0), prec2deg(1), prec1deg(2), prec0_02deg(3);
        struct OPT_ENUM_ASN headingConfidence;  // ENUMERATED, OPTIONAL, unavailable(0), prec10deg(1), prec05deg(2), prec01deg(3), prec0_1deg(4), prec0_05deg(5), prec0_01deg(6), prec0_0125deg(7);
        struct OPT_ENUM_ASN throttleConfidence;  // ENUMERATED, OPTIONAL, unavailable(0), prec10percent(1), prec1percent(2), prec0_5percent(3);
    };
    
    struct ProbeVehicleData_VehicleStatus_accelSets {
        INT isValidFlag;   // necessary if this struct is used as an optional field of a SEQUENCE
        struct ProbeVehicleDataAccelerationSet4Way accel4way;  // SEQUENCE, OPTIONAL;
        struct ProbeVehicleDataVerticalAccelerationThreshold vertAccelThres;  // BITSTRING, OPTIONAL;
        struct OPT_ENUM_ASN yawRateCon;  // ENUMERATED, OPTIONAL, unavailable(0), degSec_100_00(1), degSec_010_00(2), degSec_005_00(3), degSec_001_00(4), degSec_000_10(5), degSec_000_05(6), degSec_000_01(7);
        struct OPT_ENUM_ASN hozAccelCon;  // ENUMERATED, OPTIONAL, unavailable(0), accl_100_00(1), accl_010_00(2), accl_005_00(3), accl_001_00(4), accl_000_10(5), accl_000_05(6), accl_000_01(7);
        struct ProbeVehicleDataConfidenceSet confidenceSet;  // SEQUENCE, OPTIONAL;
    };
    
    struct ProbeVehicleData_VehicleStatus_object {
        INT isValidFlag;   // necessary if this struct is used as an optional field of a SEQUENCE
        WORD obDist;  // INTEGER, 0..32767;
        WORD obDirect;  // INTEGER, 0..28800;
        struct ProbeVehicleDataDDateTime dateTime;  // SEQUENCE;
    };
    
    struct ProbeVehicleDataBumperHeights {
        INT isValidFlag;   // necessary if this struct is used as an optional field of a SEQUENCE
        BYTE front;  // INTEGER, 0..127;
        BYTE rear;  // INTEGER, 0..127;
    };
    
    struct ProbeVehicleData_VehicleStatus_vehicleData {
        INT isValidFlag;   // necessary if this struct is used as an optional field of a SEQUENCE
        BYTE height;  // INTEGER, 0..127;
        struct ProbeVehicleDataBumperHeights bumpers;  // SEQUENCE;
        BYTE mass;  // INTEGER, 0..255;
        WORD trailerWeight;  // INTEGER, 0..64255;
        INT type;  // ENUMERATED, none(0), unknown(1), special(2), moto(3), car(4), carOther(5), bus(6), axleCnt2(7), axleCnt3(8), axleCnt4(9), axleCnt4Trailer(10), axleCnt5Trailer(11), axleCnt6Trailer(12), axleCnt5MultiTrailer(13), axleCnt6MultiTrailer(14), axleCnt7MultiTrailer(15);
    };
    
    struct ProbeVehicleDataTireData {
        INT isValidFlag;   // necessary if this struct is used as an optional field of a SEQUENCE
        struct OPT_BYTE_ASN location;  // INTEGER, OPTIONAL, 0..255;
        struct OPT_BYTE_ASN pressure;  // INTEGER, OPTIONAL, 0..250;
        struct OPT_LONG_ASN temp;  // INTEGER, OPTIONAL, -8736..55519;
        struct OPT_ENUM_ASN wheelSensorStatus;  // ENUMERATED, OPTIONAL, off(0), on(1), notDefined(2), notSupported(3);
        struct OPT_ENUM_ASN wheelEndElectFault;  // ENUMERATED, OPTIONAL, isOk(0), isNotDefined(1), isError(2), isNotSupported(3);
        struct OPT_WORD_ASN leakageRate;  // INTEGER, OPTIONAL, 0..64255;
        struct OPT_ENUM_ASN detection;  // ENUMERATED, OPTIONAL, noData(0), overPressure(1), noWarningPressure(2), underPressure(3), extremeUnderPressure(4), undefined(5), errorIndicator(6), notAvailable(7);
    };
    
    struct ProbeVehicleDataTireDataList {
        INT isValidFlag;   // necessary if this struct is used as an optional field of a SEQUENCE
        INT length;
        struct ProbeVehicleDataTireData arrayValue[16];  // SEQUENCE;
    };
    
    struct ProbeVehicleDataAxleWeightSet {
        INT isValidFlag;   // necessary if this struct is used as an optional field of a SEQUENCE
        struct OPT_BYTE_ASN location;  // INTEGER, OPTIONAL, 0..255;
        struct OPT_WORD_ASN weight;  // INTEGER, OPTIONAL, 0..64255;
    };
    
    struct ProbeVehicleDataAxleWeightList {
        INT isValidFlag;   // necessary if this struct is used as an optional field of a SEQUENCE
        INT length;
        struct ProbeVehicleDataAxleWeightSet arrayValue[16];  // SEQUENCE;
    };
    
    struct ProbeVehicleDataJ1939data {
        INT isValidFlag;   // necessary if this struct is used as an optional field of a SEQUENCE
        struct ProbeVehicleDataTireDataList tires;  // SEQUENCEOF, OPTIONAL;
        struct ProbeVehicleDataAxleWeightList axles;  // SEQUENCEOF, OPTIONAL;
        struct OPT_WORD_ASN trailerWeight;  // INTEGER, OPTIONAL, 0..64255;
        struct OPT_WORD_ASN cargoWeight;  // INTEGER, OPTIONAL, 0..64255;
        struct OPT_INT_ASN steeringAxleTemperature;  // INTEGER, OPTIONAL, -40..210;
        struct OPT_BYTE_ASN driveAxleLocation;  // INTEGER, OPTIONAL, 0..255;
        struct OPT_WORD_ASN driveAxleLiftAirPressure;  // INTEGER, OPTIONAL, 0..1000;
        struct OPT_INT_ASN driveAxleTemperature;  // INTEGER, OPTIONAL, -40..210;
        struct OPT_BYTE_ASN driveAxleLubePressure;  // INTEGER, OPTIONAL, 0..250;
        struct OPT_BYTE_ASN steeringAxleLubePressure;  // INTEGER, OPTIONAL, 0..250;
    };
    
    struct ProbeVehicleData_VehicleStatus_weatherReport {
        INT isValidFlag;   // necessary if this struct is used as an optional field of a SEQUENCE
        INT isRaining;  // ENUMERATED, precip(1), noPrecip(2), error(3);
        struct OPT_WORD_ASN rainRate;  // INTEGER, OPTIONAL, 0..65535;
        struct OPT_ENUM_ASN precipSituation;  // ENUMERATED, OPTIONAL, other(1), unknown(2), noPrecipitation(3), unidentifiedSlight(4), unidentifiedModerate(5), unidentifiedHeavy(6), snowSlight(7), snowModerate(8), snowHeavy(9), rainSlight(10), rainModerate(11), rainHeavy(12), frozenPrecipitationSlight(13), frozenPrecipitationModerate(14), frozenPrecipitationHeavy(15);
        struct OPT_WORD_ASN solarRadiation;  // INTEGER, OPTIONAL, 0..65535;
        struct OPT_BYTE_ASN friction;  // INTEGER, OPTIONAL, 0..101;
    };
    
    struct ProbeVehicleDataVehicleStatus {
        INT isValidFlag;   // necessary if this struct is used as an optional field of a SEQUENCE
        struct ProbeVehicleDataExteriorLights lights;  // BITSTRING, OPTIONAL;
        struct OPT_ENUM_ASN lightBar;  // ENUMERATED, OPTIONAL, unavailable(0), notInUse(1), inUse(2), yellowCautionLights(3), schooldBusLights(4), arrowSignsActive(5), slowMovingVehicle(6), freqStops(7);
        struct ProbeVehicleDataWiperSet wipers;  // SEQUENCE, OPTIONAL;
        struct ProbeVehicleDataBrakeSystemStatus brakeStatus;  // SEQUENCE, OPTIONAL;
        struct OPT_ENUM_ASN brakePressure;  // ENUMERATED, OPTIONAL, unavailable(0), minPressure(1), bkLvl_2(2), bkLvl_3(3), bkLvl_4(4), bkLvl_5(5), bkLvl_6(6), bkLvl_7(7), bkLvl_8(8), bkLvl_9(9), bkLvl_10(10), bkLvl_11(11), bkLvl_12(12), bkLvl_13(13), bkLvl_14(14), maxPressure(15);
        struct OPT_BYTE_ASN roadFriction;  // INTEGER, OPTIONAL, 0..50;
        struct OPT_WORD_ASN sunData;  // INTEGER, OPTIONAL, 0..1000;
        struct OPT_ENUM_ASN rainData;  // ENUMERATED, OPTIONAL, none(0), lightMist(1), heavyMist(2), lightRainOrDrizzle(3), rain(4), moderateRain(5), heavyRain(6), heavyDownpour(7);
        struct OPT_BYTE_ASN airTemp;  // INTEGER, OPTIONAL, 0..191;
        struct OPT_BYTE_ASN airPres;  // INTEGER, OPTIONAL, 0..255;
        struct ProbeVehicleData_VehicleStatus_steering steering;  // SEQUENCE, OPTIONAL;
        struct ProbeVehicleData_VehicleStatus_accelSets accelSets;  // SEQUENCE, OPTIONAL;
        struct ProbeVehicleData_VehicleStatus_object object;  // SEQUENCE, OPTIONAL;
        struct ProbeVehicleDataFullPositionVector fullPos;  // SEQUENCE, OPTIONAL;
        struct OPT_BYTE_ASN throttlePos;  // INTEGER, OPTIONAL, 0..200;
        struct ProbeVehicleDataSpeedandHeadingandThrottleConfidence speedHeadC;  // SEQUENCE, OPTIONAL;
        struct OPT_ENUM_ASN speedC;  // ENUMERATED, OPTIONAL, unavailable(0), prec100ms(1), prec10ms(2), prec5ms(3), prec1ms(4), prec0_1ms(5), prec0_05ms(6), prec0_01ms(7);
        struct ProbeVehicleData_VehicleStatus_vehicleData vehicleData;  // SEQUENCE, OPTIONAL;
        struct ProbeVehicleDataVehicleIdent vehicleIdent;  // SEQUENCE, OPTIONAL;
        struct ProbeVehicleDataJ1939data j1939data;  // SEQUENCE, OPTIONAL;
        struct ProbeVehicleData_VehicleStatus_weatherReport weatherReport;  // SEQUENCE, OPTIONAL;
        struct ProbeVehicleDataGNSSstatus gnssStatus;  // BITSTRING, OPTIONAL;
    };
    
    struct ProbeVehicleDataSnapshot {
        INT isValidFlag;   // necessary if this struct is used as an optional field of a SEQUENCE
        struct ProbeVehicleDataFullPositionVector thePosition;  // SEQUENCE;
        struct ProbeVehicleDataVehicleSafetyExtensions safetyExt;  // SEQUENCE, OPTIONAL;
        struct ProbeVehicleDataVehicleStatus dataSet;  // SEQUENCE, OPTIONAL;
    };
    
    struct ProbeVehicleData_ProbeVehicleData_snapshots {
        INT isValidFlag;   // necessary if this struct is used as an optional field of a SEQUENCE
        INT length;
        struct ProbeVehicleDataSnapshot arrayValue[32];  // SEQUENCE;
    };
    
    struct ProbeVehicleDataRegionalExtensionProbeVehicleData {
        INT isValidFlag;   // necessary if this struct is used as an optional field of a SEQUENCE
        BYTE regionId;  // INTEGER, 0..255, noRegion(0), addGrpA(1), addGrpB(2), addGrpC(3);
        struct ProbeVehicleDataREG_EXT_ID_AND_TYPE_Empty regExtValue;  // TABLE;
    };
    
    struct ProbeVehicleData_ProbeVehicleData_regional {
        INT isValidFlag;   // necessary if this struct is used as an optional field of a SEQUENCE
        INT length;
        struct ProbeVehicleDataRegionalExtensionProbeVehicleData arrayValue[4];  // SEQUENCE;
    };
    
    struct ProbeVehicleDataPVD {
        INT isValidFlag;   // necessary if this struct is used as an optional field of a SEQUENCE
        struct OPT_DWORD_ASN timeStamp;  // INTEGER, OPTIONAL, 0..527040;
        struct OPT_WORD_ASN segNum;  // INTEGER, OPTIONAL, 0..32767;
        struct ProbeVehicleDataVehicleIdent probeID;  // SEQUENCE, OPTIONAL;
        struct ProbeVehicleDataFullPositionVector startVector;  // SEQUENCE;
        struct ProbeVehicleDataVehicleClassification vehicleType;  // SEQUENCE;
        struct ProbeVehicleData_ProbeVehicleData_snapshots snapshots;  // SEQUENCEOF;
        struct ProbeVehicleData_ProbeVehicleData_regional regional;  // SEQUENCEOF, OPTIONAL;
    };
    
    struct ProbeVehicleDataMESSAGE_ID_AND_TYPE {
        struct ProbeVehicleDataPVD probeVehicleData;  // SEQUENCE;
    };
    
    struct ProbeVehicleData {
        INT isValidFlag;   // necessary if this struct is used as an optional field of a SEQUENCE
        WORD messageId;  // INTEGER, 0..32767, reservedMessageId_D(0), alaCarteMessage_D(1), basicSafetyMessage_D(2), basicSafetyMessageVerbose_D(3), commonSafetyRequest_D(4), emergencyVehicleAlert_D(5), intersectionCollision_D(6), mapData_D(7), nmeaCorrections_D(8), probeDataManagement_D(9), probeVehicleData_D(10), roadSideAlert_D(11), rtcmCorrections_D(12), signalPhaseAndTimingMessage_D(13), signalRequestMessage_D(14), signalStatusMessage_D(15), travelerInformation_D(16), uperFrame_D(17), mapData(18), signalPhaseAndTimingMessage(19), basicSafetyMessage(20), commonSafetyRequest(21), emergencyVehicleAlert(22), intersectionCollision(23), nmeaCorrections(24), probeDataManagement(25), probeVehicleData(26), roadSideAlert(27), rtcmCorrections(28), signalRequestMessage(29), signalStatusMessage(30), travelerInformation(31), personalSafetyMessage(32), testMessage00(240), testMessage01(241), testMessage02(242), testMessage03(243), testMessage04(244), testMessage05(245), testMessage06(246), testMessage07(247), testMessage08(248), testMessage09(249), testMessage10(250), testMessage11(251), testMessage12(252), testMessage13(253), testMessage14(254), testMessage15(255);
        struct ProbeVehicleDataMESSAGE_ID_AND_TYPE value;  // TABLE;
    };
    
}

/*
// init function to create a simple packet handle
*/ 
LONG API_InitProbeVehicleDataPacket()
{
  return C2xInitPacket("ProbeVehicleData"); 
}

/*
// init function to create a simple packet handle and
// initialize the struct with valid data
*/ 
LONG API_InitProbeVehicleDataPacket(struct ProbeVehicleData msgStruct)
{
  long pktHandle;

  pktHandle = API_InitProbeVehicleDataPacket();

  if (pktHandle != 0)
  {
    // create valid message and application data
    if (C2xCompletePacket(pktHandle) == 0) 
    {
      API_GetProbeVehicleDataParams(pktHandle, msgStruct);
    }
  }
  return pktHandle;
}

/*
// init function to create a packet with security layer and
// initialize the struct with valid data
*/ 
LONG API_InitProbeVehicleDataPacket(struct ProbeVehicleData msgStruct, char packetTypeDesignator[], char certificateName[])
{
  long pktHandle, certHdl;

  // initialize the packet
  pktHandle = C2xInitPacket("ProbeVehicleData", packetTypeDesignator);

  if (pktHandle != 0)
  {
    certHdl = C2xSecCertificateGetHandle(certificateName);  // get the certificate handle for the cert with name "certificateName"
    if (certHdl != 0) 
    {
      C2xSecPacketSetSignerHandle(pktHandle, certHdl); // set the certHdl to the packet
    }

    // create valid message and application data
    if (C2xCompletePacket(pktHandle) == 0) 
    {
      // copy application data to the application structure
      API_GetProbeVehicleDataParams(pktHandle, msgStruct);
    }
  }
  return pktHandle;
}
    

int GetProbeVehicleDataVehicleIDParams(LONG packetHandle, struct ProbeVehicleDataVehicleID value, char oldPath[])
{
  char newPath[300];
  char buffer[300];
  int result;

  result = 0;

  value.choice = C2xGetTokenInt(packetHandle, "ProbeVehicleData", oldPath);

  switch(value.choice)
  {
    case 0:
    {
      snprintf(newPath, elcount(newPath), "%s.%s", oldPath, "entityID");
      value.entityID.stringLength = C2xGetTokenData(packetHandle, "ProbeVehicleData", newPath, elcount(value.entityID.string), value.entityID.string);
      result = CheckLastError("ProbeVehicleData", gkFuncRefGet, result);
    }
    break;
    case 1:
    {
      snprintf(newPath, elcount(newPath), "%s.%s", oldPath, "stationID");
      value.stationID = C2xGetTokenInt64(packetHandle, "ProbeVehicleData", newPath);
      result = CheckLastError("ProbeVehicleData", gkFuncRefGet, result);
    }
    break;
  }
  return result;
}

int SetProbeVehicleDataVehicleIDParams(LONG packetHandle, struct ProbeVehicleDataVehicleID value, char oldPath[])
{
  char newPath[300];
  char buffer[300];
  int result;

  result = 0;

  switch(value.choice)
  {
    case 0:
    {
      snprintf(newPath, elcount(newPath), "%s.%s", oldPath, "entityID");
      C2xSetTokenData(packetHandle, "ProbeVehicleData", newPath, value.entityID.stringLength, value.entityID.string);
      result = CheckLastError("ProbeVehicleData", gkFuncRefGet, result);
    }
    break;
    case 1:
    {
      snprintf(newPath, elcount(newPath), "%s.%s", oldPath, "stationID");
      C2xSetTokenInt64(packetHandle, "ProbeVehicleData", newPath, value.stationID);
      result = CheckLastError("ProbeVehicleData", gkFuncRefGet, result);
    }
    break;
  }
  return result;
}

int GetProbeVehicleData_VehicleIdent_vehicleClassParams(LONG packetHandle, struct ProbeVehicleData_VehicleIdent_vehicleClass value, char oldPath[])
{
  char newPath[300];
  int result;

  result = 0;

  value.choice = C2xGetTokenInt(packetHandle, "ProbeVehicleData", oldPath);

  switch(value.choice)
  {
    case 0:
    {
      snprintf(newPath, elcount(newPath), "%s.%s", oldPath, "vGroup");
      value.vGroup = C2xGetTokenInt(packetHandle, "ProbeVehicleData", newPath);
      result = CheckLastError("ProbeVehicleData", gkFuncRefGet, result);
    }
    break;
    case 1:
    {
      snprintf(newPath, elcount(newPath), "%s.%s", oldPath, "rGroup");
      value.rGroup = C2xGetTokenInt(packetHandle, "ProbeVehicleData", newPath);
      result = CheckLastError("ProbeVehicleData", gkFuncRefGet, result);
    }
    break;
    case 2:
    {
      snprintf(newPath, elcount(newPath), "%s.%s", oldPath, "rEquip");
      value.rEquip = C2xGetTokenInt(packetHandle, "ProbeVehicleData", newPath);
      result = CheckLastError("ProbeVehicleData", gkFuncRefGet, result);
    }
    break;
  }
  return result;
}

int SetProbeVehicleData_VehicleIdent_vehicleClassParams(LONG packetHandle, struct ProbeVehicleData_VehicleIdent_vehicleClass value, char oldPath[])
{
  char newPath[300];
  int result;

  result = 0;

  switch(value.choice)
  {
    case 0:
    {
      snprintf(newPath, elcount(newPath), "%s.%s", oldPath, "vGroup");
      C2xSetTokenInt(packetHandle, "ProbeVehicleData", newPath, value.vGroup);
      result = CheckLastError("ProbeVehicleData", gkFuncRefGet, result);
    }
    break;
    case 1:
    {
      snprintf(newPath, elcount(newPath), "%s.%s", oldPath, "rGroup");
      C2xSetTokenInt(packetHandle, "ProbeVehicleData", newPath, value.rGroup);
      result = CheckLastError("ProbeVehicleData", gkFuncRefGet, result);
    }
    break;
    case 2:
    {
      snprintf(newPath, elcount(newPath), "%s.%s", oldPath, "rEquip");
      C2xSetTokenInt(packetHandle, "ProbeVehicleData", newPath, value.rEquip);
      result = CheckLastError("ProbeVehicleData", gkFuncRefGet, result);
    }
    break;
  }
  return result;
}

int GetProbeVehicleDataVehicleIdentParams(LONG packetHandle, struct ProbeVehicleDataVehicleIdent value, char oldPath[])
{
  char newPath[300];
  int result;

  result = 0;

  snprintf(newPath, elcount(newPath), "%s.%s", oldPath, "name");
  value.name.isValidFlag = C2xIsTokenAvailable(packetHandle, "ProbeVehicleData", newPath);
  if(value.name.isValidFlag==1)
  {
    value.name.stringLength = C2xGetTokenData(packetHandle, "ProbeVehicleData", newPath, elcount(value.name.string), value.name.string);
    result = CheckLastError("ProbeVehicleData", gkFuncRefGet, result);
  }
  snprintf(newPath, elcount(newPath), "%s.%s", oldPath, "vin");
  value.vin.isValidFlag = C2xIsTokenAvailable(packetHandle, "ProbeVehicleData", newPath);
  if(value.vin.isValidFlag==1)
  {
    value.vin.isValidFlag = 1;
    value.vin.stringLength = C2xGetTokenData(packetHandle, "ProbeVehicleData", newPath, elcount(value.vin.string), value.vin.string);
  }
  snprintf(newPath, elcount(newPath), "%s.%s", oldPath, "ownerCode");
  value.ownerCode.isValidFlag = C2xIsTokenAvailable(packetHandle, "ProbeVehicleData", newPath);
  if(value.ownerCode.isValidFlag==1)
  {
    value.ownerCode.stringLength = C2xGetTokenData(packetHandle, "ProbeVehicleData", newPath, elcount(value.ownerCode.string), value.ownerCode.string);
    result = CheckLastError("ProbeVehicleData", gkFuncRefGet, result);
  }
  snprintf(newPath, elcount(newPath), "%s.%s", oldPath, "id");
  value.id.isValidFlag = C2xIsTokenAvailable(packetHandle, "ProbeVehicleData", newPath);
  if(value.id.isValidFlag==1)
  {
    GetProbeVehicleDataVehicleIDParams(packetHandle, value.id, newPath);
    result = CheckLastError("ProbeVehicleData", gkFuncRefGet, result);
  }
  snprintf(newPath, elcount(newPath), "%s.%s", oldPath, "vehicleType");
  value.vehicleType.isValidFlag = C2xIsTokenAvailable(packetHandle, "ProbeVehicleData", newPath);
  if(value.vehicleType.isValidFlag==1)
  {
    value.vehicleType.value = C2xGetTokenInt(packetHandle, "ProbeVehicleData", newPath);
    result = CheckLastError("ProbeVehicleData", gkFuncRefGet, result);
  }
  snprintf(newPath, elcount(newPath), "%s.%s", oldPath, "vehicleClass");
  value.vehicleClass.isValidFlag = C2xIsTokenAvailable(packetHandle, "ProbeVehicleData", newPath);
  if(value.vehicleClass.isValidFlag==1)
  {
    GetProbeVehicleData_VehicleIdent_vehicleClassParams(packetHandle, value.vehicleClass, newPath);
    result = CheckLastError("ProbeVehicleData", gkFuncRefGet, result);
  }
  return result;
}

int SetProbeVehicleDataVehicleIdentParams(LONG packetHandle, struct ProbeVehicleDataVehicleIdent value, char oldPath[])
{
  char newPath[300];
  int result;

  result = 0;

  snprintf(newPath, elcount(newPath), "%s.%s", oldPath, "name");
  if(value.name.isValidFlag==1)
  {
    C2xSetTokenData(packetHandle, "ProbeVehicleData", newPath, value.name.stringLength, value.name.string);
    result = CheckLastError("ProbeVehicleData", gkFuncRefGet, result);
  }
  else
  {
    if( C2xIsTokenAvailable(packetHandle, "ProbeVehicleData", newPath) )
    {
      C2xRemoveToken(packetHandle, "ProbeVehicleData", newPath);
    }
  }

  snprintf(newPath, elcount(newPath), "%s.%s", oldPath, "vin");
  if(value.vin.isValidFlag==1)
  {
    C2xSetTokenData(packetHandle, "ProbeVehicleData", newPath, value.vin.stringLength, value.vin.string);
  }
  else
  {
    if( C2xIsTokenAvailable(packetHandle, "ProbeVehicleData", newPath) )
    {
      C2xRemoveToken(packetHandle, "ProbeVehicleData", newPath);
    }
  }

  snprintf(newPath, elcount(newPath), "%s.%s", oldPath, "ownerCode");
  if(value.ownerCode.isValidFlag==1)
  {
    C2xSetTokenData(packetHandle, "ProbeVehicleData", newPath, value.ownerCode.stringLength, value.ownerCode.string);
    result = CheckLastError("ProbeVehicleData", gkFuncRefGet, result);
  }
  else
  {
    if( C2xIsTokenAvailable(packetHandle, "ProbeVehicleData", newPath) )
    {
      C2xRemoveToken(packetHandle, "ProbeVehicleData", newPath);
    }
  }

  snprintf(newPath, elcount(newPath), "%s.%s", oldPath, "id");
  if(value.id.isValidFlag==1)
  {
    SetProbeVehicleDataVehicleIDParams(packetHandle, value.id, newPath);
    result = CheckLastError("ProbeVehicleData", gkFuncRefGet, result);
  }
  else
  {
    if( C2xIsTokenAvailable(packetHandle, "ProbeVehicleData", newPath) )
    {
      C2xRemoveToken(packetHandle, "ProbeVehicleData", newPath);
    }
  }

  snprintf(newPath, elcount(newPath), "%s.%s", oldPath, "vehicleType");
  if(value.vehicleType.isValidFlag==1)
  {
    C2xSetTokenInt(packetHandle, "ProbeVehicleData", newPath, value.vehicleType.value);
    result = CheckLastError("ProbeVehicleData", gkFuncRefGet, result);
  }
  else
  {
    if( C2xIsTokenAvailable(packetHandle, "ProbeVehicleData", newPath) )
    {
      C2xRemoveToken(packetHandle, "ProbeVehicleData", newPath);
    }
  }

  snprintf(newPath, elcount(newPath), "%s.%s", oldPath, "vehicleClass");
  if(value.vehicleClass.isValidFlag==1)
  {
    SetProbeVehicleData_VehicleIdent_vehicleClassParams(packetHandle, value.vehicleClass, newPath);
    result = CheckLastError("ProbeVehicleData", gkFuncRefGet, result);
  }
  else
  {
    if( C2xIsTokenAvailable(packetHandle, "ProbeVehicleData", newPath) )
    {
      C2xRemoveToken(packetHandle, "ProbeVehicleData", newPath);
    }
  }

  return result;
}

int GetProbeVehicleDataDDateTimeParams(LONG packetHandle, struct ProbeVehicleDataDDateTime value, char oldPath[])
{
  char newPath[300];
  int result;

  result = 0;

  snprintf(newPath, elcount(newPath), "%s.%s", oldPath, "year");
  value.year.isValidFlag = C2xIsTokenAvailable(packetHandle, "ProbeVehicleData", newPath);
  if(value.year.isValidFlag==1)
  {
    value.year.value = C2xGetTokenInt(packetHandle, "ProbeVehicleData", newPath);
    result = CheckLastError("ProbeVehicleData", gkFuncRefGet, result);
  }
  snprintf(newPath, elcount(newPath), "%s.%s", oldPath, "month");
  value.month.isValidFlag = C2xIsTokenAvailable(packetHandle, "ProbeVehicleData", newPath);
  if(value.month.isValidFlag==1)
  {
    value.month.value = C2xGetTokenInt(packetHandle, "ProbeVehicleData", newPath);
    result = CheckLastError("ProbeVehicleData", gkFuncRefGet, result);
  }
  snprintf(newPath, elcount(newPath), "%s.%s", oldPath, "day");
  value.day.isValidFlag = C2xIsTokenAvailable(packetHandle, "ProbeVehicleData", newPath);
  if(value.day.isValidFlag==1)
  {
    value.day.value = C2xGetTokenInt(packetHandle, "ProbeVehicleData", newPath);
    result = CheckLastError("ProbeVehicleData", gkFuncRefGet, result);
  }
  snprintf(newPath, elcount(newPath), "%s.%s", oldPath, "hour");
  value.hour.isValidFlag = C2xIsTokenAvailable(packetHandle, "ProbeVehicleData", newPath);
  if(value.hour.isValidFlag==1)
  {
    value.hour.value = C2xGetTokenInt(packetHandle, "ProbeVehicleData", newPath);
    result = CheckLastError("ProbeVehicleData", gkFuncRefGet, result);
  }
  snprintf(newPath, elcount(newPath), "%s.%s", oldPath, "minute");
  value.minute.isValidFlag = C2xIsTokenAvailable(packetHandle, "ProbeVehicleData", newPath);
  if(value.minute.isValidFlag==1)
  {
    value.minute.value = C2xGetTokenInt(packetHandle, "ProbeVehicleData", newPath);
    result = CheckLastError("ProbeVehicleData", gkFuncRefGet, result);
  }
  snprintf(newPath, elcount(newPath), "%s.%s", oldPath, "second");
  value.second.isValidFlag = C2xIsTokenAvailable(packetHandle, "ProbeVehicleData", newPath);
  if(value.second.isValidFlag==1)
  {
    value.second.value = C2xGetTokenInt(packetHandle, "ProbeVehicleData", newPath);
    result = CheckLastError("ProbeVehicleData", gkFuncRefGet, result);
  }
  snprintf(newPath, elcount(newPath), "%s.%s", oldPath, "offset");
  value.offset.isValidFlag = C2xIsTokenAvailable(packetHandle, "ProbeVehicleData", newPath);
  if(value.offset.isValidFlag==1)
  {
    value.offset.value = C2xGetTokenInt(packetHandle, "ProbeVehicleData", newPath);
    result = CheckLastError("ProbeVehicleData", gkFuncRefGet, result);
  }
  return result;
}

int SetProbeVehicleDataDDateTimeParams(LONG packetHandle, struct ProbeVehicleDataDDateTime value, char oldPath[])
{
  char newPath[300];
  int result;

  result = 0;

  snprintf(newPath, elcount(newPath), "%s.%s", oldPath, "year");
  if(value.year.isValidFlag==1)
  {
    C2xSetTokenInt(packetHandle, "ProbeVehicleData", newPath, value.year.value);
    result = CheckLastError("ProbeVehicleData", gkFuncRefGet, result);
  }
  else
  {
    if( C2xIsTokenAvailable(packetHandle, "ProbeVehicleData", newPath) )
    {
      C2xRemoveToken(packetHandle, "ProbeVehicleData", newPath);
    }
  }

  snprintf(newPath, elcount(newPath), "%s.%s", oldPath, "month");
  if(value.month.isValidFlag==1)
  {
    C2xSetTokenInt(packetHandle, "ProbeVehicleData", newPath, value.month.value);
    result = CheckLastError("ProbeVehicleData", gkFuncRefGet, result);
  }
  else
  {
    if( C2xIsTokenAvailable(packetHandle, "ProbeVehicleData", newPath) )
    {
      C2xRemoveToken(packetHandle, "ProbeVehicleData", newPath);
    }
  }

  snprintf(newPath, elcount(newPath), "%s.%s", oldPath, "day");
  if(value.day.isValidFlag==1)
  {
    C2xSetTokenInt(packetHandle, "ProbeVehicleData", newPath, value.day.value);
    result = CheckLastError("ProbeVehicleData", gkFuncRefGet, result);
  }
  else
  {
    if( C2xIsTokenAvailable(packetHandle, "ProbeVehicleData", newPath) )
    {
      C2xRemoveToken(packetHandle, "ProbeVehicleData", newPath);
    }
  }

  snprintf(newPath, elcount(newPath), "%s.%s", oldPath, "hour");
  if(value.hour.isValidFlag==1)
  {
    C2xSetTokenInt(packetHandle, "ProbeVehicleData", newPath, value.hour.value);
    result = CheckLastError("ProbeVehicleData", gkFuncRefGet, result);
  }
  else
  {
    if( C2xIsTokenAvailable(packetHandle, "ProbeVehicleData", newPath) )
    {
      C2xRemoveToken(packetHandle, "ProbeVehicleData", newPath);
    }
  }

  snprintf(newPath, elcount(newPath), "%s.%s", oldPath, "minute");
  if(value.minute.isValidFlag==1)
  {
    C2xSetTokenInt(packetHandle, "ProbeVehicleData", newPath, value.minute.value);
    result = CheckLastError("ProbeVehicleData", gkFuncRefGet, result);
  }
  else
  {
    if( C2xIsTokenAvailable(packetHandle, "ProbeVehicleData", newPath) )
    {
      C2xRemoveToken(packetHandle, "ProbeVehicleData", newPath);
    }
  }

  snprintf(newPath, elcount(newPath), "%s.%s", oldPath, "second");
  if(value.second.isValidFlag==1)
  {
    C2xSetTokenInt(packetHandle, "ProbeVehicleData", newPath, value.second.value);
    result = CheckLastError("ProbeVehicleData", gkFuncRefGet, result);
  }
  else
  {
    if( C2xIsTokenAvailable(packetHandle, "ProbeVehicleData", newPath) )
    {
      C2xRemoveToken(packetHandle, "ProbeVehicleData", newPath);
    }
  }

  snprintf(newPath, elcount(newPath), "%s.%s", oldPath, "offset");
  if(value.offset.isValidFlag==1)
  {
    C2xSetTokenInt(packetHandle, "ProbeVehicleData", newPath, value.offset.value);
    result = CheckLastError("ProbeVehicleData", gkFuncRefGet, result);
  }
  else
  {
    if( C2xIsTokenAvailable(packetHandle, "ProbeVehicleData", newPath) )
    {
      C2xRemoveToken(packetHandle, "ProbeVehicleData", newPath);
    }
  }

  return result;
}

int GetProbeVehicleDataTransmissionAndSpeedParams(LONG packetHandle, struct ProbeVehicleDataTransmissionAndSpeed value, char oldPath[])
{
  char newPath[300];
  int result;

  result = 0;

  snprintf(newPath, elcount(newPath), "%s.%s", oldPath, "transmisson");
  value.transmisson = C2xGetTokenInt(packetHandle, "ProbeVehicleData", newPath);
  result = CheckLastError("ProbeVehicleData", gkFuncRefGet, result);

  snprintf(newPath, elcount(newPath), "%s.%s", oldPath, "speed");
  value.speed = C2xGetTokenInt(packetHandle, "ProbeVehicleData", newPath);
  result = CheckLastError("ProbeVehicleData", gkFuncRefGet, result);

  return result;
}

int SetProbeVehicleDataTransmissionAndSpeedParams(LONG packetHandle, struct ProbeVehicleDataTransmissionAndSpeed value, char oldPath[])
{
  char newPath[300];
  int result;

  result = 0;

  snprintf(newPath, elcount(newPath), "%s.%s", oldPath, "transmisson");
  C2xSetTokenInt(packetHandle, "ProbeVehicleData", newPath, value.transmisson);
  result = CheckLastError("ProbeVehicleData", gkFuncRefGet, result);

  snprintf(newPath, elcount(newPath), "%s.%s", oldPath, "speed");
  C2xSetTokenInt(packetHandle, "ProbeVehicleData", newPath, value.speed);
  result = CheckLastError("ProbeVehicleData", gkFuncRefGet, result);

  return result;
}

int GetProbeVehicleDataPositionalAccuracyParams(LONG packetHandle, struct ProbeVehicleDataPositionalAccuracy value, char oldPath[])
{
  char newPath[300];
  int result;

  result = 0;

  snprintf(newPath, elcount(newPath), "%s.%s", oldPath, "semiMajor");
  value.semiMajor = C2xGetTokenInt(packetHandle, "ProbeVehicleData", newPath);
  result = CheckLastError("ProbeVehicleData", gkFuncRefGet, result);

  snprintf(newPath, elcount(newPath), "%s.%s", oldPath, "semiMinor");
  value.semiMinor = C2xGetTokenInt(packetHandle, "ProbeVehicleData", newPath);
  result = CheckLastError("ProbeVehicleData", gkFuncRefGet, result);

  snprintf(newPath, elcount(newPath), "%s.%s", oldPath, "orientation");
  value.orientation = C2xGetTokenInt(packetHandle, "ProbeVehicleData", newPath);
  result = CheckLastError("ProbeVehicleData", gkFuncRefGet, result);

  return result;
}

int SetProbeVehicleDataPositionalAccuracyParams(LONG packetHandle, struct ProbeVehicleDataPositionalAccuracy value, char oldPath[])
{
  char newPath[300];
  int result;

  result = 0;

  snprintf(newPath, elcount(newPath), "%s.%s", oldPath, "semiMajor");
  C2xSetTokenInt(packetHandle, "ProbeVehicleData", newPath, value.semiMajor);
  result = CheckLastError("ProbeVehicleData", gkFuncRefGet, result);

  snprintf(newPath, elcount(newPath), "%s.%s", oldPath, "semiMinor");
  C2xSetTokenInt(packetHandle, "ProbeVehicleData", newPath, value.semiMinor);
  result = CheckLastError("ProbeVehicleData", gkFuncRefGet, result);

  snprintf(newPath, elcount(newPath), "%s.%s", oldPath, "orientation");
  C2xSetTokenInt(packetHandle, "ProbeVehicleData", newPath, value.orientation);
  result = CheckLastError("ProbeVehicleData", gkFuncRefGet, result);

  return result;
}

int GetProbeVehicleDataPositionConfidenceSetParams(LONG packetHandle, struct ProbeVehicleDataPositionConfidenceSet value, char oldPath[])
{
  char newPath[300];
  int result;

  result = 0;

  snprintf(newPath, elcount(newPath), "%s.%s", oldPath, "pos");
  value.pos = C2xGetTokenInt(packetHandle, "ProbeVehicleData", newPath);
  result = CheckLastError("ProbeVehicleData", gkFuncRefGet, result);

  snprintf(newPath, elcount(newPath), "%s.%s", oldPath, "elevation");
  value.elevation = C2xGetTokenInt(packetHandle, "ProbeVehicleData", newPath);
  result = CheckLastError("ProbeVehicleData", gkFuncRefGet, result);

  return result;
}

int SetProbeVehicleDataPositionConfidenceSetParams(LONG packetHandle, struct ProbeVehicleDataPositionConfidenceSet value, char oldPath[])
{
  char newPath[300];
  int result;

  result = 0;

  snprintf(newPath, elcount(newPath), "%s.%s", oldPath, "pos");
  C2xSetTokenInt(packetHandle, "ProbeVehicleData", newPath, value.pos);
  result = CheckLastError("ProbeVehicleData", gkFuncRefGet, result);

  snprintf(newPath, elcount(newPath), "%s.%s", oldPath, "elevation");
  C2xSetTokenInt(packetHandle, "ProbeVehicleData", newPath, value.elevation);
  result = CheckLastError("ProbeVehicleData", gkFuncRefGet, result);

  return result;
}

int GetProbeVehicleDataSpeedandHeadingandThrottleConfidenceParams(LONG packetHandle, struct ProbeVehicleDataSpeedandHeadingandThrottleConfidence value, char oldPath[])
{
  char newPath[300];
  int result;

  result = 0;

  snprintf(newPath, elcount(newPath), "%s.%s", oldPath, "heading");
  value.heading = C2xGetTokenInt(packetHandle, "ProbeVehicleData", newPath);
  result = CheckLastError("ProbeVehicleData", gkFuncRefGet, result);

  snprintf(newPath, elcount(newPath), "%s.%s", oldPath, "speed");
  value.speed = C2xGetTokenInt(packetHandle, "ProbeVehicleData", newPath);
  result = CheckLastError("ProbeVehicleData", gkFuncRefGet, result);

  snprintf(newPath, elcount(newPath), "%s.%s", oldPath, "throttle");
  value.throttle = C2xGetTokenInt(packetHandle, "ProbeVehicleData", newPath);
  result = CheckLastError("ProbeVehicleData", gkFuncRefGet, result);

  return result;
}

int SetProbeVehicleDataSpeedandHeadingandThrottleConfidenceParams(LONG packetHandle, struct ProbeVehicleDataSpeedandHeadingandThrottleConfidence value, char oldPath[])
{
  char newPath[300];
  int result;

  result = 0;

  snprintf(newPath, elcount(newPath), "%s.%s", oldPath, "heading");
  C2xSetTokenInt(packetHandle, "ProbeVehicleData", newPath, value.heading);
  result = CheckLastError("ProbeVehicleData", gkFuncRefGet, result);

  snprintf(newPath, elcount(newPath), "%s.%s", oldPath, "speed");
  C2xSetTokenInt(packetHandle, "ProbeVehicleData", newPath, value.speed);
  result = CheckLastError("ProbeVehicleData", gkFuncRefGet, result);

  snprintf(newPath, elcount(newPath), "%s.%s", oldPath, "throttle");
  C2xSetTokenInt(packetHandle, "ProbeVehicleData", newPath, value.throttle);
  result = CheckLastError("ProbeVehicleData", gkFuncRefGet, result);

  return result;
}

int GetProbeVehicleDataFullPositionVectorParams(LONG packetHandle, struct ProbeVehicleDataFullPositionVector value, char oldPath[])
{
  char newPath[300];
  int result;

  result = 0;

  snprintf(newPath, elcount(newPath), "%s.%s", oldPath, "utcTime");
  value.utcTime.isValidFlag = C2xIsTokenAvailable(packetHandle, "ProbeVehicleData", newPath);
  if(value.utcTime.isValidFlag==1)
  {
    GetProbeVehicleDataDDateTimeParams(packetHandle, value.utcTime, newPath);
    result = CheckLastError("ProbeVehicleData", gkFuncRefGet, result);
  }
  snprintf(newPath, elcount(newPath), "%s.%s", oldPath, "lon");
  value.lon = C2xGetTokenInt(packetHandle, "ProbeVehicleData", newPath);
  result = CheckLastError("ProbeVehicleData", gkFuncRefGet, result);

  snprintf(newPath, elcount(newPath), "%s.%s", oldPath, "lat");
  value.lat = C2xGetTokenInt(packetHandle, "ProbeVehicleData", newPath);
  result = CheckLastError("ProbeVehicleData", gkFuncRefGet, result);

  snprintf(newPath, elcount(newPath), "%s.%s", oldPath, "elevation");
  value.elevation.isValidFlag = C2xIsTokenAvailable(packetHandle, "ProbeVehicleData", newPath);
  if(value.elevation.isValidFlag==1)
  {
    value.elevation.value = C2xGetTokenInt(packetHandle, "ProbeVehicleData", newPath);
    result = CheckLastError("ProbeVehicleData", gkFuncRefGet, result);
  }
  snprintf(newPath, elcount(newPath), "%s.%s", oldPath, "heading");
  value.heading.isValidFlag = C2xIsTokenAvailable(packetHandle, "ProbeVehicleData", newPath);
  if(value.heading.isValidFlag==1)
  {
    value.heading.value = C2xGetTokenInt(packetHandle, "ProbeVehicleData", newPath);
    result = CheckLastError("ProbeVehicleData", gkFuncRefGet, result);
  }
  snprintf(newPath, elcount(newPath), "%s.%s", oldPath, "speed");
  value.speed.isValidFlag = C2xIsTokenAvailable(packetHandle, "ProbeVehicleData", newPath);
  if(value.speed.isValidFlag==1)
  {
    GetProbeVehicleDataTransmissionAndSpeedParams(packetHandle, value.speed, newPath);
    result = CheckLastError("ProbeVehicleData", gkFuncRefGet, result);
  }
  snprintf(newPath, elcount(newPath), "%s.%s", oldPath, "posAccuracy");
  value.posAccuracy.isValidFlag = C2xIsTokenAvailable(packetHandle, "ProbeVehicleData", newPath);
  if(value.posAccuracy.isValidFlag==1)
  {
    GetProbeVehicleDataPositionalAccuracyParams(packetHandle, value.posAccuracy, newPath);
    result = CheckLastError("ProbeVehicleData", gkFuncRefGet, result);
  }
  snprintf(newPath, elcount(newPath), "%s.%s", oldPath, "timeConfidence");
  value.timeConfidence.isValidFlag = C2xIsTokenAvailable(packetHandle, "ProbeVehicleData", newPath);
  if(value.timeConfidence.isValidFlag==1)
  {
    value.timeConfidence.value = C2xGetTokenInt(packetHandle, "ProbeVehicleData", newPath);
    result = CheckLastError("ProbeVehicleData", gkFuncRefGet, result);
  }
  snprintf(newPath, elcount(newPath), "%s.%s", oldPath, "posConfidence");
  value.posConfidence.isValidFlag = C2xIsTokenAvailable(packetHandle, "ProbeVehicleData", newPath);
  if(value.posConfidence.isValidFlag==1)
  {
    GetProbeVehicleDataPositionConfidenceSetParams(packetHandle, value.posConfidence, newPath);
    result = CheckLastError("ProbeVehicleData", gkFuncRefGet, result);
  }
  snprintf(newPath, elcount(newPath), "%s.%s", oldPath, "speedConfidence");
  value.speedConfidence.isValidFlag = C2xIsTokenAvailable(packetHandle, "ProbeVehicleData", newPath);
  if(value.speedConfidence.isValidFlag==1)
  {
    GetProbeVehicleDataSpeedandHeadingandThrottleConfidenceParams(packetHandle, value.speedConfidence, newPath);
    result = CheckLastError("ProbeVehicleData", gkFuncRefGet, result);
  }
  return result;
}

int SetProbeVehicleDataFullPositionVectorParams(LONG packetHandle, struct ProbeVehicleDataFullPositionVector value, char oldPath[])
{
  char newPath[300];
  int result;

  result = 0;

  snprintf(newPath, elcount(newPath), "%s.%s", oldPath, "utcTime");
  if(value.utcTime.isValidFlag==1)
  {
    SetProbeVehicleDataDDateTimeParams(packetHandle, value.utcTime, newPath);
    result = CheckLastError("ProbeVehicleData", gkFuncRefGet, result);
  }
  else
  {
    if( C2xIsTokenAvailable(packetHandle, "ProbeVehicleData", newPath) )
    {
      C2xRemoveToken(packetHandle, "ProbeVehicleData", newPath);
    }
  }

  snprintf(newPath, elcount(newPath), "%s.%s", oldPath, "lon");
  C2xSetTokenInt(packetHandle, "ProbeVehicleData", newPath, value.lon);
  result = CheckLastError("ProbeVehicleData", gkFuncRefGet, result);

  snprintf(newPath, elcount(newPath), "%s.%s", oldPath, "lat");
  C2xSetTokenInt(packetHandle, "ProbeVehicleData", newPath, value.lat);
  result = CheckLastError("ProbeVehicleData", gkFuncRefGet, result);

  snprintf(newPath, elcount(newPath), "%s.%s", oldPath, "elevation");
  if(value.elevation.isValidFlag==1)
  {
    C2xSetTokenInt(packetHandle, "ProbeVehicleData", newPath, value.elevation.value);
    result = CheckLastError("ProbeVehicleData", gkFuncRefGet, result);
  }
  else
  {
    if( C2xIsTokenAvailable(packetHandle, "ProbeVehicleData", newPath) )
    {
      C2xRemoveToken(packetHandle, "ProbeVehicleData", newPath);
    }
  }

  snprintf(newPath, elcount(newPath), "%s.%s", oldPath, "heading");
  if(value.heading.isValidFlag==1)
  {
    C2xSetTokenInt(packetHandle, "ProbeVehicleData", newPath, value.heading.value);
    result = CheckLastError("ProbeVehicleData", gkFuncRefGet, result);
  }
  else
  {
    if( C2xIsTokenAvailable(packetHandle, "ProbeVehicleData", newPath) )
    {
      C2xRemoveToken(packetHandle, "ProbeVehicleData", newPath);
    }
  }

  snprintf(newPath, elcount(newPath), "%s.%s", oldPath, "speed");
  if(value.speed.isValidFlag==1)
  {
    SetProbeVehicleDataTransmissionAndSpeedParams(packetHandle, value.speed, newPath);
    result = CheckLastError("ProbeVehicleData", gkFuncRefGet, result);
  }
  else
  {
    if( C2xIsTokenAvailable(packetHandle, "ProbeVehicleData", newPath) )
    {
      C2xRemoveToken(packetHandle, "ProbeVehicleData", newPath);
    }
  }

  snprintf(newPath, elcount(newPath), "%s.%s", oldPath, "posAccuracy");
  if(value.posAccuracy.isValidFlag==1)
  {
    SetProbeVehicleDataPositionalAccuracyParams(packetHandle, value.posAccuracy, newPath);
    result = CheckLastError("ProbeVehicleData", gkFuncRefGet, result);
  }
  else
  {
    if( C2xIsTokenAvailable(packetHandle, "ProbeVehicleData", newPath) )
    {
      C2xRemoveToken(packetHandle, "ProbeVehicleData", newPath);
    }
  }

  snprintf(newPath, elcount(newPath), "%s.%s", oldPath, "timeConfidence");
  if(value.timeConfidence.isValidFlag==1)
  {
    C2xSetTokenInt(packetHandle, "ProbeVehicleData", newPath, value.timeConfidence.value);
    result = CheckLastError("ProbeVehicleData", gkFuncRefGet, result);
  }
  else
  {
    if( C2xIsTokenAvailable(packetHandle, "ProbeVehicleData", newPath) )
    {
      C2xRemoveToken(packetHandle, "ProbeVehicleData", newPath);
    }
  }

  snprintf(newPath, elcount(newPath), "%s.%s", oldPath, "posConfidence");
  if(value.posConfidence.isValidFlag==1)
  {
    SetProbeVehicleDataPositionConfidenceSetParams(packetHandle, value.posConfidence, newPath);
    result = CheckLastError("ProbeVehicleData", gkFuncRefGet, result);
  }
  else
  {
    if( C2xIsTokenAvailable(packetHandle, "ProbeVehicleData", newPath) )
    {
      C2xRemoveToken(packetHandle, "ProbeVehicleData", newPath);
    }
  }

  snprintf(newPath, elcount(newPath), "%s.%s", oldPath, "speedConfidence");
  if(value.speedConfidence.isValidFlag==1)
  {
    SetProbeVehicleDataSpeedandHeadingandThrottleConfidenceParams(packetHandle, value.speedConfidence, newPath);
    result = CheckLastError("ProbeVehicleData", gkFuncRefGet, result);
  }
  else
  {
    if( C2xIsTokenAvailable(packetHandle, "ProbeVehicleData", newPath) )
    {
      C2xRemoveToken(packetHandle, "ProbeVehicleData", newPath);
    }
  }

  return result;
}

int GetProbeVehicleDataRegionalExtensionVehicleClassificationParams(LONG packetHandle, struct ProbeVehicleDataRegionalExtensionVehicleClassification value, char oldPath[])
{
  char newPath[300];
  int result;

  result = 0;

  snprintf(newPath, elcount(newPath), "%s.%s", oldPath, "regionId");
  value.regionId = C2xGetTokenInt(packetHandle, "ProbeVehicleData", newPath);
  result = CheckLastError("ProbeVehicleData", gkFuncRefGet, result);

  return result;
}

int SetProbeVehicleDataRegionalExtensionVehicleClassificationParams(LONG packetHandle, struct ProbeVehicleDataRegionalExtensionVehicleClassification value, char oldPath[])
{
  char newPath[300];
  int result;

  result = 0;


  return result;
}

int GetProbeVehicleData_VehicleClassification_regionalParams(LONG packetHandle, struct ProbeVehicleData_VehicleClassification_regional value, char oldPath[])
{
  char newPath[300]; 
  int i;
  int result;

  result = 0;

  value.length = C2xGetTokenInt(packetHandle, "ProbeVehicleData", oldPath);
  if((result = CheckLastError("ProbeVehicleData", gkFuncRefGet, result))==0)
  {
    for(i=0; i<value.length; i++)
    {
      snprintf(newPath, elcount(newPath), "%s[%d]", oldPath, i);
      GetProbeVehicleDataRegionalExtensionVehicleClassificationParams(packetHandle, value.arrayValue[i], newPath);
      result = CheckLastError("ProbeVehicleData", gkFuncRefGet, result);
    }
  }
  return result;
}

int SetProbeVehicleData_VehicleClassification_regionalParams(LONG packetHandle, struct ProbeVehicleData_VehicleClassification_regional value, char oldPath[])
{
  char newPath[300]; 
  int i;
  int result;

  result = 0;

  C2xRemoveToken(packetHandle, "ProbeVehicleData", oldPath);
  for(i=0; i<value.length; i++)
  {
    snprintf(newPath, elcount(newPath), "%s[%d]", oldPath, i);
    SetProbeVehicleDataRegionalExtensionVehicleClassificationParams(packetHandle, value.arrayValue[i], newPath);
    result = CheckLastError("ProbeVehicleData", gkFuncRefGet, result);
  }
  return result;
}

int GetProbeVehicleDataVehicleClassificationParams(LONG packetHandle, struct ProbeVehicleDataVehicleClassification value, char oldPath[])
{
  char newPath[300];
  int result;

  result = 0;

  snprintf(newPath, elcount(newPath), "%s.%s", oldPath, "keyType");
  value.keyType.isValidFlag = C2xIsTokenAvailable(packetHandle, "ProbeVehicleData", newPath);
  if(value.keyType.isValidFlag==1)
  {
    value.keyType.value = C2xGetTokenInt(packetHandle, "ProbeVehicleData", newPath);
    result = CheckLastError("ProbeVehicleData", gkFuncRefGet, result);
  }
  snprintf(newPath, elcount(newPath), "%s.%s", oldPath, "role");
  value.role.isValidFlag = C2xIsTokenAvailable(packetHandle, "ProbeVehicleData", newPath);
  if(value.role.isValidFlag==1)
  {
    value.role.value = C2xGetTokenInt(packetHandle, "ProbeVehicleData", newPath);
    result = CheckLastError("ProbeVehicleData", gkFuncRefGet, result);
  }
  snprintf(newPath, elcount(newPath), "%s.%s", oldPath, "iso3883");
  value.iso3883.isValidFlag = C2xIsTokenAvailable(packetHandle, "ProbeVehicleData", newPath);
  if(value.iso3883.isValidFlag==1)
  {
    value.iso3883.value = C2xGetTokenInt(packetHandle, "ProbeVehicleData", newPath);
    result = CheckLastError("ProbeVehicleData", gkFuncRefGet, result);
  }
  snprintf(newPath, elcount(newPath), "%s.%s", oldPath, "hpmsType");
  value.hpmsType.isValidFlag = C2xIsTokenAvailable(packetHandle, "ProbeVehicleData", newPath);
  if(value.hpmsType.isValidFlag==1)
  {
    value.hpmsType.value = C2xGetTokenInt(packetHandle, "ProbeVehicleData", newPath);
    result = CheckLastError("ProbeVehicleData", gkFuncRefGet, result);
  }
  snprintf(newPath, elcount(newPath), "%s.%s", oldPath, "vehicleType");
  value.vehicleType.isValidFlag = C2xIsTokenAvailable(packetHandle, "ProbeVehicleData", newPath);
  if(value.vehicleType.isValidFlag==1)
  {
    value.vehicleType.value = C2xGetTokenInt(packetHandle, "ProbeVehicleData", newPath);
    result = CheckLastError("ProbeVehicleData", gkFuncRefGet, result);
  }
  snprintf(newPath, elcount(newPath), "%s.%s", oldPath, "responseEquip");
  value.responseEquip.isValidFlag = C2xIsTokenAvailable(packetHandle, "ProbeVehicleData", newPath);
  if(value.responseEquip.isValidFlag==1)
  {
    value.responseEquip.value = C2xGetTokenInt(packetHandle, "ProbeVehicleData", newPath);
    result = CheckLastError("ProbeVehicleData", gkFuncRefGet, result);
  }
  snprintf(newPath, elcount(newPath), "%s.%s", oldPath, "responderType");
  value.responderType.isValidFlag = C2xIsTokenAvailable(packetHandle, "ProbeVehicleData", newPath);
  if(value.responderType.isValidFlag==1)
  {
    value.responderType.value = C2xGetTokenInt(packetHandle, "ProbeVehicleData", newPath);
    result = CheckLastError("ProbeVehicleData", gkFuncRefGet, result);
  }
  snprintf(newPath, elcount(newPath), "%s.%s", oldPath, "fuelType");
  value.fuelType.isValidFlag = C2xIsTokenAvailable(packetHandle, "ProbeVehicleData", newPath);
  if(value.fuelType.isValidFlag==1)
  {
    value.fuelType.value = C2xGetTokenInt(packetHandle, "ProbeVehicleData", newPath);
    result = CheckLastError("ProbeVehicleData", gkFuncRefGet, result);
  }
  snprintf(newPath, elcount(newPath), "%s.%s", oldPath, "regional");
  value.regional.isValidFlag = C2xIsTokenAvailable(packetHandle, "ProbeVehicleData", newPath);
  if(value.regional.isValidFlag==1)
  {
    GetProbeVehicleData_VehicleClassification_regionalParams(packetHandle, value.regional, newPath);
    result = CheckLastError("ProbeVehicleData", gkFuncRefGet, result);
  }
  return result;
}

int SetProbeVehicleDataVehicleClassificationParams(LONG packetHandle, struct ProbeVehicleDataVehicleClassification value, char oldPath[])
{
  char newPath[300];
  int result;

  result = 0;

  snprintf(newPath, elcount(newPath), "%s.%s", oldPath, "keyType");
  if(value.keyType.isValidFlag==1)
  {
    C2xSetTokenInt(packetHandle, "ProbeVehicleData", newPath, value.keyType.value);
    result = CheckLastError("ProbeVehicleData", gkFuncRefGet, result);
  }
  else
  {
    if( C2xIsTokenAvailable(packetHandle, "ProbeVehicleData", newPath) )
    {
      C2xRemoveToken(packetHandle, "ProbeVehicleData", newPath);
    }
  }

  snprintf(newPath, elcount(newPath), "%s.%s", oldPath, "role");
  if(value.role.isValidFlag==1)
  {
    C2xSetTokenInt(packetHandle, "ProbeVehicleData", newPath, value.role.value);
    result = CheckLastError("ProbeVehicleData", gkFuncRefGet, result);
  }
  else
  {
    if( C2xIsTokenAvailable(packetHandle, "ProbeVehicleData", newPath) )
    {
      C2xRemoveToken(packetHandle, "ProbeVehicleData", newPath);
    }
  }

  snprintf(newPath, elcount(newPath), "%s.%s", oldPath, "iso3883");
  if(value.iso3883.isValidFlag==1)
  {
    C2xSetTokenInt(packetHandle, "ProbeVehicleData", newPath, value.iso3883.value);
    result = CheckLastError("ProbeVehicleData", gkFuncRefGet, result);
  }
  else
  {
    if( C2xIsTokenAvailable(packetHandle, "ProbeVehicleData", newPath) )
    {
      C2xRemoveToken(packetHandle, "ProbeVehicleData", newPath);
    }
  }

  snprintf(newPath, elcount(newPath), "%s.%s", oldPath, "hpmsType");
  if(value.hpmsType.isValidFlag==1)
  {
    C2xSetTokenInt(packetHandle, "ProbeVehicleData", newPath, value.hpmsType.value);
    result = CheckLastError("ProbeVehicleData", gkFuncRefGet, result);
  }
  else
  {
    if( C2xIsTokenAvailable(packetHandle, "ProbeVehicleData", newPath) )
    {
      C2xRemoveToken(packetHandle, "ProbeVehicleData", newPath);
    }
  }

  snprintf(newPath, elcount(newPath), "%s.%s", oldPath, "vehicleType");
  if(value.vehicleType.isValidFlag==1)
  {
    C2xSetTokenInt(packetHandle, "ProbeVehicleData", newPath, value.vehicleType.value);
    result = CheckLastError("ProbeVehicleData", gkFuncRefGet, result);
  }
  else
  {
    if( C2xIsTokenAvailable(packetHandle, "ProbeVehicleData", newPath) )
    {
      C2xRemoveToken(packetHandle, "ProbeVehicleData", newPath);
    }
  }

  snprintf(newPath, elcount(newPath), "%s.%s", oldPath, "responseEquip");
  if(value.responseEquip.isValidFlag==1)
  {
    C2xSetTokenInt(packetHandle, "ProbeVehicleData", newPath, value.responseEquip.value);
    result = CheckLastError("ProbeVehicleData", gkFuncRefGet, result);
  }
  else
  {
    if( C2xIsTokenAvailable(packetHandle, "ProbeVehicleData", newPath) )
    {
      C2xRemoveToken(packetHandle, "ProbeVehicleData", newPath);
    }
  }

  snprintf(newPath, elcount(newPath), "%s.%s", oldPath, "responderType");
  if(value.responderType.isValidFlag==1)
  {
    C2xSetTokenInt(packetHandle, "ProbeVehicleData", newPath, value.responderType.value);
    result = CheckLastError("ProbeVehicleData", gkFuncRefGet, result);
  }
  else
  {
    if( C2xIsTokenAvailable(packetHandle, "ProbeVehicleData", newPath) )
    {
      C2xRemoveToken(packetHandle, "ProbeVehicleData", newPath);
    }
  }

  snprintf(newPath, elcount(newPath), "%s.%s", oldPath, "fuelType");
  if(value.fuelType.isValidFlag==1)
  {
    C2xSetTokenInt(packetHandle, "ProbeVehicleData", newPath, value.fuelType.value);
    result = CheckLastError("ProbeVehicleData", gkFuncRefGet, result);
  }
  else
  {
    if( C2xIsTokenAvailable(packetHandle, "ProbeVehicleData", newPath) )
    {
      C2xRemoveToken(packetHandle, "ProbeVehicleData", newPath);
    }
  }

  snprintf(newPath, elcount(newPath), "%s.%s", oldPath, "regional");
  if(value.regional.isValidFlag==1)
  {
    SetProbeVehicleData_VehicleClassification_regionalParams(packetHandle, value.regional, newPath);
    result = CheckLastError("ProbeVehicleData", gkFuncRefGet, result);
  }
  else
  {
    if( C2xIsTokenAvailable(packetHandle, "ProbeVehicleData", newPath) )
    {
      C2xRemoveToken(packetHandle, "ProbeVehicleData", newPath);
    }
  }

  return result;
}

int GetProbeVehicleDataPathHistoryPointParams(LONG packetHandle, struct ProbeVehicleDataPathHistoryPoint value, char oldPath[])
{
  char newPath[300];
  int result;

  result = 0;

  snprintf(newPath, elcount(newPath), "%s.%s", oldPath, "latOffset");
  value.latOffset = C2xGetTokenInt(packetHandle, "ProbeVehicleData", newPath);
  result = CheckLastError("ProbeVehicleData", gkFuncRefGet, result);

  snprintf(newPath, elcount(newPath), "%s.%s", oldPath, "lonOffset");
  value.lonOffset = C2xGetTokenInt(packetHandle, "ProbeVehicleData", newPath);
  result = CheckLastError("ProbeVehicleData", gkFuncRefGet, result);

  snprintf(newPath, elcount(newPath), "%s.%s", oldPath, "elevationOffset");
  value.elevationOffset = C2xGetTokenInt(packetHandle, "ProbeVehicleData", newPath);
  result = CheckLastError("ProbeVehicleData", gkFuncRefGet, result);

  snprintf(newPath, elcount(newPath), "%s.%s", oldPath, "timeOffset");
  value.timeOffset = C2xGetTokenInt(packetHandle, "ProbeVehicleData", newPath);
  result = CheckLastError("ProbeVehicleData", gkFuncRefGet, result);

  snprintf(newPath, elcount(newPath), "%s.%s", oldPath, "speed");
  value.speed.isValidFlag = C2xIsTokenAvailable(packetHandle, "ProbeVehicleData", newPath);
  if(value.speed.isValidFlag==1)
  {
    value.speed.value = C2xGetTokenInt(packetHandle, "ProbeVehicleData", newPath);
    result = CheckLastError("ProbeVehicleData", gkFuncRefGet, result);
  }
  snprintf(newPath, elcount(newPath), "%s.%s", oldPath, "posAccuracy");
  value.posAccuracy.isValidFlag = C2xIsTokenAvailable(packetHandle, "ProbeVehicleData", newPath);
  if(value.posAccuracy.isValidFlag==1)
  {
    GetProbeVehicleDataPositionalAccuracyParams(packetHandle, value.posAccuracy, newPath);
    result = CheckLastError("ProbeVehicleData", gkFuncRefGet, result);
  }
  snprintf(newPath, elcount(newPath), "%s.%s", oldPath, "heading");
  value.heading.isValidFlag = C2xIsTokenAvailable(packetHandle, "ProbeVehicleData", newPath);
  if(value.heading.isValidFlag==1)
  {
    value.heading.value = C2xGetTokenInt(packetHandle, "ProbeVehicleData", newPath);
    result = CheckLastError("ProbeVehicleData", gkFuncRefGet, result);
  }
  return result;
}

int SetProbeVehicleDataPathHistoryPointParams(LONG packetHandle, struct ProbeVehicleDataPathHistoryPoint value, char oldPath[])
{
  char newPath[300];
  int result;

  result = 0;

  snprintf(newPath, elcount(newPath), "%s.%s", oldPath, "latOffset");
  C2xSetTokenInt(packetHandle, "ProbeVehicleData", newPath, value.latOffset);
  result = CheckLastError("ProbeVehicleData", gkFuncRefGet, result);

  snprintf(newPath, elcount(newPath), "%s.%s", oldPath, "lonOffset");
  C2xSetTokenInt(packetHandle, "ProbeVehicleData", newPath, value.lonOffset);
  result = CheckLastError("ProbeVehicleData", gkFuncRefGet, result);

  snprintf(newPath, elcount(newPath), "%s.%s", oldPath, "elevationOffset");
  C2xSetTokenInt(packetHandle, "ProbeVehicleData", newPath, value.elevationOffset);
  result = CheckLastError("ProbeVehicleData", gkFuncRefGet, result);

  snprintf(newPath, elcount(newPath), "%s.%s", oldPath, "timeOffset");
  C2xSetTokenInt(packetHandle, "ProbeVehicleData", newPath, value.timeOffset);
  result = CheckLastError("ProbeVehicleData", gkFuncRefGet, result);

  snprintf(newPath, elcount(newPath), "%s.%s", oldPath, "speed");
  if(value.speed.isValidFlag==1)
  {
    C2xSetTokenInt(packetHandle, "ProbeVehicleData", newPath, value.speed.value);
    result = CheckLastError("ProbeVehicleData", gkFuncRefGet, result);
  }
  else
  {
    if( C2xIsTokenAvailable(packetHandle, "ProbeVehicleData", newPath) )
    {
      C2xRemoveToken(packetHandle, "ProbeVehicleData", newPath);
    }
  }

  snprintf(newPath, elcount(newPath), "%s.%s", oldPath, "posAccuracy");
  if(value.posAccuracy.isValidFlag==1)
  {
    SetProbeVehicleDataPositionalAccuracyParams(packetHandle, value.posAccuracy, newPath);
    result = CheckLastError("ProbeVehicleData", gkFuncRefGet, result);
  }
  else
  {
    if( C2xIsTokenAvailable(packetHandle, "ProbeVehicleData", newPath) )
    {
      C2xRemoveToken(packetHandle, "ProbeVehicleData", newPath);
    }
  }

  snprintf(newPath, elcount(newPath), "%s.%s", oldPath, "heading");
  if(value.heading.isValidFlag==1)
  {
    C2xSetTokenInt(packetHandle, "ProbeVehicleData", newPath, value.heading.value);
    result = CheckLastError("ProbeVehicleData", gkFuncRefGet, result);
  }
  else
  {
    if( C2xIsTokenAvailable(packetHandle, "ProbeVehicleData", newPath) )
    {
      C2xRemoveToken(packetHandle, "ProbeVehicleData", newPath);
    }
  }

  return result;
}

int GetProbeVehicleDataPathHistoryPointListParams(LONG packetHandle, struct ProbeVehicleDataPathHistoryPointList value, char oldPath[])
{
  char newPath[300]; 
  int i;
  int result;

  result = 0;

  value.length = C2xGetTokenInt(packetHandle, "ProbeVehicleData", oldPath);
  if((result = CheckLastError("ProbeVehicleData", gkFuncRefGet, result))==0)
  {
    for(i=0; i<value.length; i++)
    {
      snprintf(newPath, elcount(newPath), "%s[%d]", oldPath, i);
      GetProbeVehicleDataPathHistoryPointParams(packetHandle, value.arrayValue[i], newPath);
      result = CheckLastError("ProbeVehicleData", gkFuncRefGet, result);
    }
  }
  return result;
}

int SetProbeVehicleDataPathHistoryPointListParams(LONG packetHandle, struct ProbeVehicleDataPathHistoryPointList value, char oldPath[])
{
  char newPath[300]; 
  int i;
  int result;

  result = 0;

  C2xRemoveToken(packetHandle, "ProbeVehicleData", oldPath);
  for(i=0; i<value.length; i++)
  {
    snprintf(newPath, elcount(newPath), "%s[%d]", oldPath, i);
    SetProbeVehicleDataPathHistoryPointParams(packetHandle, value.arrayValue[i], newPath);
    result = CheckLastError("ProbeVehicleData", gkFuncRefGet, result);
  }
  return result;
}

int GetProbeVehicleDataPathHistoryParams(LONG packetHandle, struct ProbeVehicleDataPathHistory value, char oldPath[])
{
  char newPath[300]; 
  int j; 
  int k;
  int result;

  result = 0;

  snprintf(newPath, elcount(newPath), "%s.%s", oldPath, "initialPosition");
  value.initialPosition.isValidFlag = C2xIsTokenAvailable(packetHandle, "ProbeVehicleData", newPath);
  if(value.initialPosition.isValidFlag==1)
  {
    GetProbeVehicleDataFullPositionVectorParams(packetHandle, value.initialPosition, newPath);
    result = CheckLastError("ProbeVehicleData", gkFuncRefGet, result);
  }
  snprintf(newPath, elcount(newPath), "%s.%s", oldPath, "currGNSSstatus");
  value.currGNSSstatus.isValidFlag = C2xIsTokenAvailable(packetHandle, "ProbeVehicleData", newPath);
  if(value.currGNSSstatus.isValidFlag==1)
  {
    value.currGNSSstatus.isValidFlag = 1;
    value.currGNSSstatus.stringLength = C2xGetTokenLengthBit(packetHandle, "ProbeVehicleData", newPath);
    if ((result = CheckLastError("ProbeVehicleData", gkFuncRefGet, result))==0)
    {
      if(value.currGNSSstatus.stringLength > 0)
      {
        for(j=0; j<value.currGNSSstatus.stringLength; j++)
        {
          if(C2xGetTokenBitOfBitString(packetHandle, "ProbeVehicleData", newPath, j) == 0)
          {
            value.currGNSSstatus.string[j] = '0';
          }
          else if(C2xGetTokenBitOfBitString(packetHandle, "ProbeVehicleData", newPath, j) == 1)
          {
            value.currGNSSstatus.string[j] = '1';
          }

          if(value.currGNSSstatus.stringLength == 1)
          {
            value.currGNSSstatus.string[1] = '0';
          }
          result = CheckLastError("ProbeVehicleData", gkFuncRefGet, result);
        }
      }
      else
      {
        for(k = value.currGNSSstatus.stringLength+1; k > -1; k--)
        {
          if(value.currGNSSstatus.string[k] == '1')
          {
            value.currGNSSstatus.string[k] = '0';
          }
        }
      }
    }

  }
  snprintf(newPath, elcount(newPath), "%s.%s", oldPath, "crumbData");
  GetProbeVehicleDataPathHistoryPointListParams(packetHandle, value.crumbData, newPath);
  result = CheckLastError("ProbeVehicleData", gkFuncRefGet, result);

  return result;
}

int SetProbeVehicleDataPathHistoryParams(LONG packetHandle, struct ProbeVehicleDataPathHistory value, char oldPath[])
{
  char newPath[300]; 
  int j;
  int result;

  result = 0;

  snprintf(newPath, elcount(newPath), "%s.%s", oldPath, "initialPosition");
  if(value.initialPosition.isValidFlag==1)
  {
    SetProbeVehicleDataFullPositionVectorParams(packetHandle, value.initialPosition, newPath);
    result = CheckLastError("ProbeVehicleData", gkFuncRefGet, result);
  }
  else
  {
    if( C2xIsTokenAvailable(packetHandle, "ProbeVehicleData", newPath) )
    {
      C2xRemoveToken(packetHandle, "ProbeVehicleData", newPath);
    }
  }

  snprintf(newPath, elcount(newPath), "%s.%s", oldPath, "currGNSSstatus");
  if(value.currGNSSstatus.isValidFlag==1)
  {
      for(j=0; j<value.currGNSSstatus.stringLength; j++)
      {
        if(value.currGNSSstatus.string[j] == '0')
        {
          C2xSetTokenBitOfBitString(packetHandle, "ProbeVehicleData", newPath, j, 0);
        }
        else
        {
          C2xSetTokenBitOfBitString(packetHandle, "ProbeVehicleData", newPath, j, 1);
        }
        result = CheckLastError("ProbeVehicleData", gkFuncRefGet, result);
      }
  }
  else
  {
    if( C2xIsTokenAvailable(packetHandle, "ProbeVehicleData", newPath) )
    {
      C2xRemoveToken(packetHandle, "ProbeVehicleData", newPath);
    }
  }

  snprintf(newPath, elcount(newPath), "%s.%s", oldPath, "crumbData");
  SetProbeVehicleDataPathHistoryPointListParams(packetHandle, value.crumbData, newPath);
  result = CheckLastError("ProbeVehicleData", gkFuncRefGet, result);

  return result;
}

int GetProbeVehicleDataPathPredictionParams(LONG packetHandle, struct ProbeVehicleDataPathPrediction value, char oldPath[])
{
  char newPath[300];
  int result;

  result = 0;

  snprintf(newPath, elcount(newPath), "%s.%s", oldPath, "radiusOfCurve");
  value.radiusOfCurve = C2xGetTokenInt(packetHandle, "ProbeVehicleData", newPath);
  result = CheckLastError("ProbeVehicleData", gkFuncRefGet, result);

  snprintf(newPath, elcount(newPath), "%s.%s", oldPath, "confidence");
  value.confidence = C2xGetTokenInt(packetHandle, "ProbeVehicleData", newPath);
  result = CheckLastError("ProbeVehicleData", gkFuncRefGet, result);

  return result;
}

int SetProbeVehicleDataPathPredictionParams(LONG packetHandle, struct ProbeVehicleDataPathPrediction value, char oldPath[])
{
  char newPath[300];
  int result;

  result = 0;

  snprintf(newPath, elcount(newPath), "%s.%s", oldPath, "radiusOfCurve");
  C2xSetTokenInt(packetHandle, "ProbeVehicleData", newPath, value.radiusOfCurve);
  result = CheckLastError("ProbeVehicleData", gkFuncRefGet, result);

  snprintf(newPath, elcount(newPath), "%s.%s", oldPath, "confidence");
  C2xSetTokenInt(packetHandle, "ProbeVehicleData", newPath, value.confidence);
  result = CheckLastError("ProbeVehicleData", gkFuncRefGet, result);

  return result;
}

int GetProbeVehicleDataVehicleSafetyExtensionsParams(LONG packetHandle, struct ProbeVehicleDataVehicleSafetyExtensions value, char oldPath[])
{
  char newPath[300]; 
  int j; 
  int k;
  int result;

  result = 0;

  snprintf(newPath, elcount(newPath), "%s.%s", oldPath, "events");
  value.events.isValidFlag = C2xIsTokenAvailable(packetHandle, "ProbeVehicleData", newPath);
  if(value.events.isValidFlag==1)
  {
    value.events.isValidFlag = 1;
    value.events.stringLength = C2xGetTokenLengthBit(packetHandle, "ProbeVehicleData", newPath);
    if ((result = CheckLastError("ProbeVehicleData", gkFuncRefGet, result))==0)
    {
      if(value.events.stringLength > 0)
      {
        for(j=0; j<value.events.stringLength; j++)
        {
          if(C2xGetTokenBitOfBitString(packetHandle, "ProbeVehicleData", newPath, j) == 0)
          {
            value.events.string[j] = '0';
          }
          else if(C2xGetTokenBitOfBitString(packetHandle, "ProbeVehicleData", newPath, j) == 1)
          {
            value.events.string[j] = '1';
          }

          if(value.events.stringLength == 1)
          {
            value.events.string[1] = '0';
          }
          result = CheckLastError("ProbeVehicleData", gkFuncRefGet, result);
        }
      }
      else
      {
        for(k = value.events.stringLength+1; k > -1; k--)
        {
          if(value.events.string[k] == '1')
          {
            value.events.string[k] = '0';
          }
        }
      }
    }

  }
  snprintf(newPath, elcount(newPath), "%s.%s", oldPath, "pathHistory");
  value.pathHistory.isValidFlag = C2xIsTokenAvailable(packetHandle, "ProbeVehicleData", newPath);
  if(value.pathHistory.isValidFlag==1)
  {
    GetProbeVehicleDataPathHistoryParams(packetHandle, value.pathHistory, newPath);
    result = CheckLastError("ProbeVehicleData", gkFuncRefGet, result);
  }
  snprintf(newPath, elcount(newPath), "%s.%s", oldPath, "pathPrediction");
  value.pathPrediction.isValidFlag = C2xIsTokenAvailable(packetHandle, "ProbeVehicleData", newPath);
  if(value.pathPrediction.isValidFlag==1)
  {
    GetProbeVehicleDataPathPredictionParams(packetHandle, value.pathPrediction, newPath);
    result = CheckLastError("ProbeVehicleData", gkFuncRefGet, result);
  }
  snprintf(newPath, elcount(newPath), "%s.%s", oldPath, "lights");
  value.lights.isValidFlag = C2xIsTokenAvailable(packetHandle, "ProbeVehicleData", newPath);
  if(value.lights.isValidFlag==1)
  {
    value.lights.isValidFlag = 1;
    value.lights.stringLength = C2xGetTokenLengthBit(packetHandle, "ProbeVehicleData", newPath);
    if ((result = CheckLastError("ProbeVehicleData", gkFuncRefGet, result))==0)
    {
      if(value.lights.stringLength > 0)
      {
        for(j=0; j<value.lights.stringLength; j++)
        {
          if(C2xGetTokenBitOfBitString(packetHandle, "ProbeVehicleData", newPath, j) == 0)
          {
            value.lights.string[j] = '0';
          }
          else if(C2xGetTokenBitOfBitString(packetHandle, "ProbeVehicleData", newPath, j) == 1)
          {
            value.lights.string[j] = '1';
          }

          if(value.lights.stringLength == 1)
          {
            value.lights.string[1] = '0';
          }
          result = CheckLastError("ProbeVehicleData", gkFuncRefGet, result);
        }
      }
      else
      {
        for(k = value.lights.stringLength+1; k > -1; k--)
        {
          if(value.lights.string[k] == '1')
          {
            value.lights.string[k] = '0';
          }
        }
      }
    }

  }
  return result;
}

int SetProbeVehicleDataVehicleSafetyExtensionsParams(LONG packetHandle, struct ProbeVehicleDataVehicleSafetyExtensions value, char oldPath[])
{
  char newPath[300]; 
  int j;
  int result;

  result = 0;

  snprintf(newPath, elcount(newPath), "%s.%s", oldPath, "events");
  if(value.events.isValidFlag==1)
  {
      for(j=0; j<value.events.stringLength; j++)
      {
        if(value.events.string[j] == '0')
        {
          C2xSetTokenBitOfBitString(packetHandle, "ProbeVehicleData", newPath, j, 0);
        }
        else
        {
          C2xSetTokenBitOfBitString(packetHandle, "ProbeVehicleData", newPath, j, 1);
        }
        result = CheckLastError("ProbeVehicleData", gkFuncRefGet, result);
      }
  }
  else
  {
    if( C2xIsTokenAvailable(packetHandle, "ProbeVehicleData", newPath) )
    {
      C2xRemoveToken(packetHandle, "ProbeVehicleData", newPath);
    }
  }

  snprintf(newPath, elcount(newPath), "%s.%s", oldPath, "pathHistory");
  if(value.pathHistory.isValidFlag==1)
  {
    SetProbeVehicleDataPathHistoryParams(packetHandle, value.pathHistory, newPath);
    result = CheckLastError("ProbeVehicleData", gkFuncRefGet, result);
  }
  else
  {
    if( C2xIsTokenAvailable(packetHandle, "ProbeVehicleData", newPath) )
    {
      C2xRemoveToken(packetHandle, "ProbeVehicleData", newPath);
    }
  }

  snprintf(newPath, elcount(newPath), "%s.%s", oldPath, "pathPrediction");
  if(value.pathPrediction.isValidFlag==1)
  {
    SetProbeVehicleDataPathPredictionParams(packetHandle, value.pathPrediction, newPath);
    result = CheckLastError("ProbeVehicleData", gkFuncRefGet, result);
  }
  else
  {
    if( C2xIsTokenAvailable(packetHandle, "ProbeVehicleData", newPath) )
    {
      C2xRemoveToken(packetHandle, "ProbeVehicleData", newPath);
    }
  }

  snprintf(newPath, elcount(newPath), "%s.%s", oldPath, "lights");
  if(value.lights.isValidFlag==1)
  {
      for(j=0; j<value.lights.stringLength; j++)
      {
        if(value.lights.string[j] == '0')
        {
          C2xSetTokenBitOfBitString(packetHandle, "ProbeVehicleData", newPath, j, 0);
        }
        else
        {
          C2xSetTokenBitOfBitString(packetHandle, "ProbeVehicleData", newPath, j, 1);
        }
        result = CheckLastError("ProbeVehicleData", gkFuncRefGet, result);
      }
  }
  else
  {
    if( C2xIsTokenAvailable(packetHandle, "ProbeVehicleData", newPath) )
    {
      C2xRemoveToken(packetHandle, "ProbeVehicleData", newPath);
    }
  }

  return result;
}

int GetProbeVehicleDataWiperSetParams(LONG packetHandle, struct ProbeVehicleDataWiperSet value, char oldPath[])
{
  char newPath[300];
  int result;

  result = 0;

  snprintf(newPath, elcount(newPath), "%s.%s", oldPath, "statusFront");
  value.statusFront = C2xGetTokenInt(packetHandle, "ProbeVehicleData", newPath);
  result = CheckLastError("ProbeVehicleData", gkFuncRefGet, result);

  snprintf(newPath, elcount(newPath), "%s.%s", oldPath, "rateFront");
  value.rateFront = C2xGetTokenInt(packetHandle, "ProbeVehicleData", newPath);
  result = CheckLastError("ProbeVehicleData", gkFuncRefGet, result);

  snprintf(newPath, elcount(newPath), "%s.%s", oldPath, "statusRear");
  value.statusRear.isValidFlag = C2xIsTokenAvailable(packetHandle, "ProbeVehicleData", newPath);
  if(value.statusRear.isValidFlag==1)
  {
    value.statusRear.value = C2xGetTokenInt(packetHandle, "ProbeVehicleData", newPath);
    result = CheckLastError("ProbeVehicleData", gkFuncRefGet, result);
  }
  snprintf(newPath, elcount(newPath), "%s.%s", oldPath, "rateRear");
  value.rateRear.isValidFlag = C2xIsTokenAvailable(packetHandle, "ProbeVehicleData", newPath);
  if(value.rateRear.isValidFlag==1)
  {
    value.rateRear.value = C2xGetTokenInt(packetHandle, "ProbeVehicleData", newPath);
    result = CheckLastError("ProbeVehicleData", gkFuncRefGet, result);
  }
  return result;
}

int SetProbeVehicleDataWiperSetParams(LONG packetHandle, struct ProbeVehicleDataWiperSet value, char oldPath[])
{
  char newPath[300];
  int result;

  result = 0;

  snprintf(newPath, elcount(newPath), "%s.%s", oldPath, "statusFront");
  C2xSetTokenInt(packetHandle, "ProbeVehicleData", newPath, value.statusFront);
  result = CheckLastError("ProbeVehicleData", gkFuncRefGet, result);

  snprintf(newPath, elcount(newPath), "%s.%s", oldPath, "rateFront");
  C2xSetTokenInt(packetHandle, "ProbeVehicleData", newPath, value.rateFront);
  result = CheckLastError("ProbeVehicleData", gkFuncRefGet, result);

  snprintf(newPath, elcount(newPath), "%s.%s", oldPath, "statusRear");
  if(value.statusRear.isValidFlag==1)
  {
    C2xSetTokenInt(packetHandle, "ProbeVehicleData", newPath, value.statusRear.value);
    result = CheckLastError("ProbeVehicleData", gkFuncRefGet, result);
  }
  else
  {
    if( C2xIsTokenAvailable(packetHandle, "ProbeVehicleData", newPath) )
    {
      C2xRemoveToken(packetHandle, "ProbeVehicleData", newPath);
    }
  }

  snprintf(newPath, elcount(newPath), "%s.%s", oldPath, "rateRear");
  if(value.rateRear.isValidFlag==1)
  {
    C2xSetTokenInt(packetHandle, "ProbeVehicleData", newPath, value.rateRear.value);
    result = CheckLastError("ProbeVehicleData", gkFuncRefGet, result);
  }
  else
  {
    if( C2xIsTokenAvailable(packetHandle, "ProbeVehicleData", newPath) )
    {
      C2xRemoveToken(packetHandle, "ProbeVehicleData", newPath);
    }
  }

  return result;
}

int GetProbeVehicleDataBrakeSystemStatusParams(LONG packetHandle, struct ProbeVehicleDataBrakeSystemStatus value, char oldPath[])
{
  char newPath[300]; 
  int j; 
  int k;
  int result;

  result = 0;

  snprintf(newPath, elcount(newPath), "%s.%s", oldPath, "wheelBrakes");
  value.wheelBrakes.isValidFlag = 1;
  value.wheelBrakes.stringLength = C2xGetTokenLengthBit(packetHandle, "ProbeVehicleData", newPath);
  if ((result = CheckLastError("ProbeVehicleData", gkFuncRefGet, result))==0)
  {
    if(value.wheelBrakes.stringLength > 0)
    {
      for(j=0; j<value.wheelBrakes.stringLength; j++)
      {
        if(C2xGetTokenBitOfBitString(packetHandle, "ProbeVehicleData", newPath, j) == 0)
        {
          value.wheelBrakes.string[j] = '0';
        }
        else if(C2xGetTokenBitOfBitString(packetHandle, "ProbeVehicleData", newPath, j) == 1)
        {
          value.wheelBrakes.string[j] = '1';
        }

        if(value.wheelBrakes.stringLength == 1)
        {
          value.wheelBrakes.string[1] = '0';
        }
        result = CheckLastError("ProbeVehicleData", gkFuncRefGet, result);
      }
    }
    else
    {
      for(k = value.wheelBrakes.stringLength+1; k > -1; k--)
      {
        if(value.wheelBrakes.string[k] == '1')
        {
          value.wheelBrakes.string[k] = '0';
        }
      }
    }
  }

  snprintf(newPath, elcount(newPath), "%s.%s", oldPath, "traction");
  value.traction = C2xGetTokenInt(packetHandle, "ProbeVehicleData", newPath);
  result = CheckLastError("ProbeVehicleData", gkFuncRefGet, result);

  snprintf(newPath, elcount(newPath), "%s.%s", oldPath, "antiLockBrakes");
  value.antiLockBrakes = C2xGetTokenInt(packetHandle, "ProbeVehicleData", newPath);
  result = CheckLastError("ProbeVehicleData", gkFuncRefGet, result);

  snprintf(newPath, elcount(newPath), "%s.%s", oldPath, "scs");
  value.scs = C2xGetTokenInt(packetHandle, "ProbeVehicleData", newPath);
  result = CheckLastError("ProbeVehicleData", gkFuncRefGet, result);

  snprintf(newPath, elcount(newPath), "%s.%s", oldPath, "brakeBoost");
  value.brakeBoost = C2xGetTokenInt(packetHandle, "ProbeVehicleData", newPath);
  result = CheckLastError("ProbeVehicleData", gkFuncRefGet, result);

  snprintf(newPath, elcount(newPath), "%s.%s", oldPath, "auxBrakes");
  value.auxBrakes = C2xGetTokenInt(packetHandle, "ProbeVehicleData", newPath);
  result = CheckLastError("ProbeVehicleData", gkFuncRefGet, result);

  return result;
}

int SetProbeVehicleDataBrakeSystemStatusParams(LONG packetHandle, struct ProbeVehicleDataBrakeSystemStatus value, char oldPath[])
{
  char newPath[300]; 
  int j;
  int result;

  result = 0;

  snprintf(newPath, elcount(newPath), "%s.%s", oldPath, "wheelBrakes");
    for(j=0; j<value.wheelBrakes.stringLength; j++)
    {
      if(value.wheelBrakes.string[j] == '0')
      {
        C2xSetTokenBitOfBitString(packetHandle, "ProbeVehicleData", newPath, j, 0);
      }
      else
      {
        C2xSetTokenBitOfBitString(packetHandle, "ProbeVehicleData", newPath, j, 1);
      }
      result = CheckLastError("ProbeVehicleData", gkFuncRefGet, result);
    }

  snprintf(newPath, elcount(newPath), "%s.%s", oldPath, "traction");
  C2xSetTokenInt(packetHandle, "ProbeVehicleData", newPath, value.traction);
  result = CheckLastError("ProbeVehicleData", gkFuncRefGet, result);

  snprintf(newPath, elcount(newPath), "%s.%s", oldPath, "antiLockBrakes");
  C2xSetTokenInt(packetHandle, "ProbeVehicleData", newPath, value.antiLockBrakes);
  result = CheckLastError("ProbeVehicleData", gkFuncRefGet, result);

  snprintf(newPath, elcount(newPath), "%s.%s", oldPath, "scs");
  C2xSetTokenInt(packetHandle, "ProbeVehicleData", newPath, value.scs);
  result = CheckLastError("ProbeVehicleData", gkFuncRefGet, result);

  snprintf(newPath, elcount(newPath), "%s.%s", oldPath, "brakeBoost");
  C2xSetTokenInt(packetHandle, "ProbeVehicleData", newPath, value.brakeBoost);
  result = CheckLastError("ProbeVehicleData", gkFuncRefGet, result);

  snprintf(newPath, elcount(newPath), "%s.%s", oldPath, "auxBrakes");
  C2xSetTokenInt(packetHandle, "ProbeVehicleData", newPath, value.auxBrakes);
  result = CheckLastError("ProbeVehicleData", gkFuncRefGet, result);

  return result;
}

int GetProbeVehicleData_VehicleStatus_steeringParams(LONG packetHandle, struct ProbeVehicleData_VehicleStatus_steering value, char oldPath[])
{
  char newPath[300];
  int result;

  result = 0;

  snprintf(newPath, elcount(newPath), "%s.%s", oldPath, "angle");
  value.angle = C2xGetTokenInt(packetHandle, "ProbeVehicleData", newPath);
  result = CheckLastError("ProbeVehicleData", gkFuncRefGet, result);

  snprintf(newPath, elcount(newPath), "%s.%s", oldPath, "confidence");
  value.confidence.isValidFlag = C2xIsTokenAvailable(packetHandle, "ProbeVehicleData", newPath);
  if(value.confidence.isValidFlag==1)
  {
    value.confidence.value = C2xGetTokenInt(packetHandle, "ProbeVehicleData", newPath);
    result = CheckLastError("ProbeVehicleData", gkFuncRefGet, result);
  }
  snprintf(newPath, elcount(newPath), "%s.%s", oldPath, "rate");
  value.rate.isValidFlag = C2xIsTokenAvailable(packetHandle, "ProbeVehicleData", newPath);
  if(value.rate.isValidFlag==1)
  {
    value.rate.value = C2xGetTokenInt(packetHandle, "ProbeVehicleData", newPath);
    result = CheckLastError("ProbeVehicleData", gkFuncRefGet, result);
  }
  snprintf(newPath, elcount(newPath), "%s.%s", oldPath, "wheels");
  value.wheels.isValidFlag = C2xIsTokenAvailable(packetHandle, "ProbeVehicleData", newPath);
  if(value.wheels.isValidFlag==1)
  {
    value.wheels.value = C2xGetTokenInt(packetHandle, "ProbeVehicleData", newPath);
    result = CheckLastError("ProbeVehicleData", gkFuncRefGet, result);
  }
  return result;
}

int SetProbeVehicleData_VehicleStatus_steeringParams(LONG packetHandle, struct ProbeVehicleData_VehicleStatus_steering value, char oldPath[])
{
  char newPath[300];
  int result;

  result = 0;

  snprintf(newPath, elcount(newPath), "%s.%s", oldPath, "angle");
  C2xSetTokenInt(packetHandle, "ProbeVehicleData", newPath, value.angle);
  result = CheckLastError("ProbeVehicleData", gkFuncRefGet, result);

  snprintf(newPath, elcount(newPath), "%s.%s", oldPath, "confidence");
  if(value.confidence.isValidFlag==1)
  {
    C2xSetTokenInt(packetHandle, "ProbeVehicleData", newPath, value.confidence.value);
    result = CheckLastError("ProbeVehicleData", gkFuncRefGet, result);
  }
  else
  {
    if( C2xIsTokenAvailable(packetHandle, "ProbeVehicleData", newPath) )
    {
      C2xRemoveToken(packetHandle, "ProbeVehicleData", newPath);
    }
  }

  snprintf(newPath, elcount(newPath), "%s.%s", oldPath, "rate");
  if(value.rate.isValidFlag==1)
  {
    C2xSetTokenInt(packetHandle, "ProbeVehicleData", newPath, value.rate.value);
    result = CheckLastError("ProbeVehicleData", gkFuncRefGet, result);
  }
  else
  {
    if( C2xIsTokenAvailable(packetHandle, "ProbeVehicleData", newPath) )
    {
      C2xRemoveToken(packetHandle, "ProbeVehicleData", newPath);
    }
  }

  snprintf(newPath, elcount(newPath), "%s.%s", oldPath, "wheels");
  if(value.wheels.isValidFlag==1)
  {
    C2xSetTokenInt(packetHandle, "ProbeVehicleData", newPath, value.wheels.value);
    result = CheckLastError("ProbeVehicleData", gkFuncRefGet, result);
  }
  else
  {
    if( C2xIsTokenAvailable(packetHandle, "ProbeVehicleData", newPath) )
    {
      C2xRemoveToken(packetHandle, "ProbeVehicleData", newPath);
    }
  }

  return result;
}

int GetProbeVehicleDataAccelerationSet4WayParams(LONG packetHandle, struct ProbeVehicleDataAccelerationSet4Way value, char oldPath[])
{
  char newPath[300];
  int result;

  result = 0;

  snprintf(newPath, elcount(newPath), "%s.%s", oldPath, "lon");
  value.lon = C2xGetTokenInt(packetHandle, "ProbeVehicleData", newPath);
  result = CheckLastError("ProbeVehicleData", gkFuncRefGet, result);

  snprintf(newPath, elcount(newPath), "%s.%s", oldPath, "lat");
  value.lat = C2xGetTokenInt(packetHandle, "ProbeVehicleData", newPath);
  result = CheckLastError("ProbeVehicleData", gkFuncRefGet, result);

  snprintf(newPath, elcount(newPath), "%s.%s", oldPath, "vert");
  value.vert = C2xGetTokenInt(packetHandle, "ProbeVehicleData", newPath);
  result = CheckLastError("ProbeVehicleData", gkFuncRefGet, result);

  snprintf(newPath, elcount(newPath), "%s.%s", oldPath, "yaw");
  value.yaw = C2xGetTokenInt(packetHandle, "ProbeVehicleData", newPath);
  result = CheckLastError("ProbeVehicleData", gkFuncRefGet, result);

  return result;
}

int SetProbeVehicleDataAccelerationSet4WayParams(LONG packetHandle, struct ProbeVehicleDataAccelerationSet4Way value, char oldPath[])
{
  char newPath[300];
  int result;

  result = 0;

  snprintf(newPath, elcount(newPath), "%s.%s", oldPath, "lon");
  C2xSetTokenInt(packetHandle, "ProbeVehicleData", newPath, value.lon);
  result = CheckLastError("ProbeVehicleData", gkFuncRefGet, result);

  snprintf(newPath, elcount(newPath), "%s.%s", oldPath, "lat");
  C2xSetTokenInt(packetHandle, "ProbeVehicleData", newPath, value.lat);
  result = CheckLastError("ProbeVehicleData", gkFuncRefGet, result);

  snprintf(newPath, elcount(newPath), "%s.%s", oldPath, "vert");
  C2xSetTokenInt(packetHandle, "ProbeVehicleData", newPath, value.vert);
  result = CheckLastError("ProbeVehicleData", gkFuncRefGet, result);

  snprintf(newPath, elcount(newPath), "%s.%s", oldPath, "yaw");
  C2xSetTokenInt(packetHandle, "ProbeVehicleData", newPath, value.yaw);
  result = CheckLastError("ProbeVehicleData", gkFuncRefGet, result);

  return result;
}

int GetProbeVehicleDataAccelSteerYawRateConfidenceParams(LONG packetHandle, struct ProbeVehicleDataAccelSteerYawRateConfidence value, char oldPath[])
{
  char newPath[300];
  int result;

  result = 0;

  snprintf(newPath, elcount(newPath), "%s.%s", oldPath, "yawRate");
  value.yawRate = C2xGetTokenInt(packetHandle, "ProbeVehicleData", newPath);
  result = CheckLastError("ProbeVehicleData", gkFuncRefGet, result);

  snprintf(newPath, elcount(newPath), "%s.%s", oldPath, "acceleration");
  value.acceleration = C2xGetTokenInt(packetHandle, "ProbeVehicleData", newPath);
  result = CheckLastError("ProbeVehicleData", gkFuncRefGet, result);

  snprintf(newPath, elcount(newPath), "%s.%s", oldPath, "steeringWheelAngle");
  value.steeringWheelAngle = C2xGetTokenInt(packetHandle, "ProbeVehicleData", newPath);
  result = CheckLastError("ProbeVehicleData", gkFuncRefGet, result);

  return result;
}

int SetProbeVehicleDataAccelSteerYawRateConfidenceParams(LONG packetHandle, struct ProbeVehicleDataAccelSteerYawRateConfidence value, char oldPath[])
{
  char newPath[300];
  int result;

  result = 0;

  snprintf(newPath, elcount(newPath), "%s.%s", oldPath, "yawRate");
  C2xSetTokenInt(packetHandle, "ProbeVehicleData", newPath, value.yawRate);
  result = CheckLastError("ProbeVehicleData", gkFuncRefGet, result);

  snprintf(newPath, elcount(newPath), "%s.%s", oldPath, "acceleration");
  C2xSetTokenInt(packetHandle, "ProbeVehicleData", newPath, value.acceleration);
  result = CheckLastError("ProbeVehicleData", gkFuncRefGet, result);

  snprintf(newPath, elcount(newPath), "%s.%s", oldPath, "steeringWheelAngle");
  C2xSetTokenInt(packetHandle, "ProbeVehicleData", newPath, value.steeringWheelAngle);
  result = CheckLastError("ProbeVehicleData", gkFuncRefGet, result);

  return result;
}

int GetProbeVehicleDataConfidenceSetParams(LONG packetHandle, struct ProbeVehicleDataConfidenceSet value, char oldPath[])
{
  char newPath[300];
  int result;

  result = 0;

  snprintf(newPath, elcount(newPath), "%s.%s", oldPath, "accelConfidence");
  value.accelConfidence.isValidFlag = C2xIsTokenAvailable(packetHandle, "ProbeVehicleData", newPath);
  if(value.accelConfidence.isValidFlag==1)
  {
    GetProbeVehicleDataAccelSteerYawRateConfidenceParams(packetHandle, value.accelConfidence, newPath);
    result = CheckLastError("ProbeVehicleData", gkFuncRefGet, result);
  }
  snprintf(newPath, elcount(newPath), "%s.%s", oldPath, "speedConfidence");
  value.speedConfidence.isValidFlag = C2xIsTokenAvailable(packetHandle, "ProbeVehicleData", newPath);
  if(value.speedConfidence.isValidFlag==1)
  {
    GetProbeVehicleDataSpeedandHeadingandThrottleConfidenceParams(packetHandle, value.speedConfidence, newPath);
    result = CheckLastError("ProbeVehicleData", gkFuncRefGet, result);
  }
  snprintf(newPath, elcount(newPath), "%s.%s", oldPath, "timeConfidence");
  value.timeConfidence.isValidFlag = C2xIsTokenAvailable(packetHandle, "ProbeVehicleData", newPath);
  if(value.timeConfidence.isValidFlag==1)
  {
    value.timeConfidence.value = C2xGetTokenInt(packetHandle, "ProbeVehicleData", newPath);
    result = CheckLastError("ProbeVehicleData", gkFuncRefGet, result);
  }
  snprintf(newPath, elcount(newPath), "%s.%s", oldPath, "posConfidence");
  value.posConfidence.isValidFlag = C2xIsTokenAvailable(packetHandle, "ProbeVehicleData", newPath);
  if(value.posConfidence.isValidFlag==1)
  {
    GetProbeVehicleDataPositionConfidenceSetParams(packetHandle, value.posConfidence, newPath);
    result = CheckLastError("ProbeVehicleData", gkFuncRefGet, result);
  }
  snprintf(newPath, elcount(newPath), "%s.%s", oldPath, "steerConfidence");
  value.steerConfidence.isValidFlag = C2xIsTokenAvailable(packetHandle, "ProbeVehicleData", newPath);
  if(value.steerConfidence.isValidFlag==1)
  {
    value.steerConfidence.value = C2xGetTokenInt(packetHandle, "ProbeVehicleData", newPath);
    result = CheckLastError("ProbeVehicleData", gkFuncRefGet, result);
  }
  snprintf(newPath, elcount(newPath), "%s.%s", oldPath, "headingConfidence");
  value.headingConfidence.isValidFlag = C2xIsTokenAvailable(packetHandle, "ProbeVehicleData", newPath);
  if(value.headingConfidence.isValidFlag==1)
  {
    value.headingConfidence.value = C2xGetTokenInt(packetHandle, "ProbeVehicleData", newPath);
    result = CheckLastError("ProbeVehicleData", gkFuncRefGet, result);
  }
  snprintf(newPath, elcount(newPath), "%s.%s", oldPath, "throttleConfidence");
  value.throttleConfidence.isValidFlag = C2xIsTokenAvailable(packetHandle, "ProbeVehicleData", newPath);
  if(value.throttleConfidence.isValidFlag==1)
  {
    value.throttleConfidence.value = C2xGetTokenInt(packetHandle, "ProbeVehicleData", newPath);
    result = CheckLastError("ProbeVehicleData", gkFuncRefGet, result);
  }
  return result;
}

int SetProbeVehicleDataConfidenceSetParams(LONG packetHandle, struct ProbeVehicleDataConfidenceSet value, char oldPath[])
{
  char newPath[300];
  int result;

  result = 0;

  snprintf(newPath, elcount(newPath), "%s.%s", oldPath, "accelConfidence");
  if(value.accelConfidence.isValidFlag==1)
  {
    SetProbeVehicleDataAccelSteerYawRateConfidenceParams(packetHandle, value.accelConfidence, newPath);
    result = CheckLastError("ProbeVehicleData", gkFuncRefGet, result);
  }
  else
  {
    if( C2xIsTokenAvailable(packetHandle, "ProbeVehicleData", newPath) )
    {
      C2xRemoveToken(packetHandle, "ProbeVehicleData", newPath);
    }
  }

  snprintf(newPath, elcount(newPath), "%s.%s", oldPath, "speedConfidence");
  if(value.speedConfidence.isValidFlag==1)
  {
    SetProbeVehicleDataSpeedandHeadingandThrottleConfidenceParams(packetHandle, value.speedConfidence, newPath);
    result = CheckLastError("ProbeVehicleData", gkFuncRefGet, result);
  }
  else
  {
    if( C2xIsTokenAvailable(packetHandle, "ProbeVehicleData", newPath) )
    {
      C2xRemoveToken(packetHandle, "ProbeVehicleData", newPath);
    }
  }

  snprintf(newPath, elcount(newPath), "%s.%s", oldPath, "timeConfidence");
  if(value.timeConfidence.isValidFlag==1)
  {
    C2xSetTokenInt(packetHandle, "ProbeVehicleData", newPath, value.timeConfidence.value);
    result = CheckLastError("ProbeVehicleData", gkFuncRefGet, result);
  }
  else
  {
    if( C2xIsTokenAvailable(packetHandle, "ProbeVehicleData", newPath) )
    {
      C2xRemoveToken(packetHandle, "ProbeVehicleData", newPath);
    }
  }

  snprintf(newPath, elcount(newPath), "%s.%s", oldPath, "posConfidence");
  if(value.posConfidence.isValidFlag==1)
  {
    SetProbeVehicleDataPositionConfidenceSetParams(packetHandle, value.posConfidence, newPath);
    result = CheckLastError("ProbeVehicleData", gkFuncRefGet, result);
  }
  else
  {
    if( C2xIsTokenAvailable(packetHandle, "ProbeVehicleData", newPath) )
    {
      C2xRemoveToken(packetHandle, "ProbeVehicleData", newPath);
    }
  }

  snprintf(newPath, elcount(newPath), "%s.%s", oldPath, "steerConfidence");
  if(value.steerConfidence.isValidFlag==1)
  {
    C2xSetTokenInt(packetHandle, "ProbeVehicleData", newPath, value.steerConfidence.value);
    result = CheckLastError("ProbeVehicleData", gkFuncRefGet, result);
  }
  else
  {
    if( C2xIsTokenAvailable(packetHandle, "ProbeVehicleData", newPath) )
    {
      C2xRemoveToken(packetHandle, "ProbeVehicleData", newPath);
    }
  }

  snprintf(newPath, elcount(newPath), "%s.%s", oldPath, "headingConfidence");
  if(value.headingConfidence.isValidFlag==1)
  {
    C2xSetTokenInt(packetHandle, "ProbeVehicleData", newPath, value.headingConfidence.value);
    result = CheckLastError("ProbeVehicleData", gkFuncRefGet, result);
  }
  else
  {
    if( C2xIsTokenAvailable(packetHandle, "ProbeVehicleData", newPath) )
    {
      C2xRemoveToken(packetHandle, "ProbeVehicleData", newPath);
    }
  }

  snprintf(newPath, elcount(newPath), "%s.%s", oldPath, "throttleConfidence");
  if(value.throttleConfidence.isValidFlag==1)
  {
    C2xSetTokenInt(packetHandle, "ProbeVehicleData", newPath, value.throttleConfidence.value);
    result = CheckLastError("ProbeVehicleData", gkFuncRefGet, result);
  }
  else
  {
    if( C2xIsTokenAvailable(packetHandle, "ProbeVehicleData", newPath) )
    {
      C2xRemoveToken(packetHandle, "ProbeVehicleData", newPath);
    }
  }

  return result;
}

int GetProbeVehicleData_VehicleStatus_accelSetsParams(LONG packetHandle, struct ProbeVehicleData_VehicleStatus_accelSets value, char oldPath[])
{
  char newPath[300]; 
  int j; 
  int k;
  int result;

  result = 0;

  snprintf(newPath, elcount(newPath), "%s.%s", oldPath, "accel4way");
  value.accel4way.isValidFlag = C2xIsTokenAvailable(packetHandle, "ProbeVehicleData", newPath);
  if(value.accel4way.isValidFlag==1)
  {
    GetProbeVehicleDataAccelerationSet4WayParams(packetHandle, value.accel4way, newPath);
    result = CheckLastError("ProbeVehicleData", gkFuncRefGet, result);
  }
  snprintf(newPath, elcount(newPath), "%s.%s", oldPath, "vertAccelThres");
  value.vertAccelThres.isValidFlag = C2xIsTokenAvailable(packetHandle, "ProbeVehicleData", newPath);
  if(value.vertAccelThres.isValidFlag==1)
  {
    value.vertAccelThres.isValidFlag = 1;
    value.vertAccelThres.stringLength = C2xGetTokenLengthBit(packetHandle, "ProbeVehicleData", newPath);
    if ((result = CheckLastError("ProbeVehicleData", gkFuncRefGet, result))==0)
    {
      if(value.vertAccelThres.stringLength > 0)
      {
        for(j=0; j<value.vertAccelThres.stringLength; j++)
        {
          if(C2xGetTokenBitOfBitString(packetHandle, "ProbeVehicleData", newPath, j) == 0)
          {
            value.vertAccelThres.string[j] = '0';
          }
          else if(C2xGetTokenBitOfBitString(packetHandle, "ProbeVehicleData", newPath, j) == 1)
          {
            value.vertAccelThres.string[j] = '1';
          }

          if(value.vertAccelThres.stringLength == 1)
          {
            value.vertAccelThres.string[1] = '0';
          }
          result = CheckLastError("ProbeVehicleData", gkFuncRefGet, result);
        }
      }
      else
      {
        for(k = value.vertAccelThres.stringLength+1; k > -1; k--)
        {
          if(value.vertAccelThres.string[k] == '1')
          {
            value.vertAccelThres.string[k] = '0';
          }
        }
      }
    }

  }
  snprintf(newPath, elcount(newPath), "%s.%s", oldPath, "yawRateCon");
  value.yawRateCon.isValidFlag = C2xIsTokenAvailable(packetHandle, "ProbeVehicleData", newPath);
  if(value.yawRateCon.isValidFlag==1)
  {
    value.yawRateCon.value = C2xGetTokenInt(packetHandle, "ProbeVehicleData", newPath);
    result = CheckLastError("ProbeVehicleData", gkFuncRefGet, result);
  }
  snprintf(newPath, elcount(newPath), "%s.%s", oldPath, "hozAccelCon");
  value.hozAccelCon.isValidFlag = C2xIsTokenAvailable(packetHandle, "ProbeVehicleData", newPath);
  if(value.hozAccelCon.isValidFlag==1)
  {
    value.hozAccelCon.value = C2xGetTokenInt(packetHandle, "ProbeVehicleData", newPath);
    result = CheckLastError("ProbeVehicleData", gkFuncRefGet, result);
  }
  snprintf(newPath, elcount(newPath), "%s.%s", oldPath, "confidenceSet");
  value.confidenceSet.isValidFlag = C2xIsTokenAvailable(packetHandle, "ProbeVehicleData", newPath);
  if(value.confidenceSet.isValidFlag==1)
  {
    GetProbeVehicleDataConfidenceSetParams(packetHandle, value.confidenceSet, newPath);
    result = CheckLastError("ProbeVehicleData", gkFuncRefGet, result);
  }
  return result;
}

int SetProbeVehicleData_VehicleStatus_accelSetsParams(LONG packetHandle, struct ProbeVehicleData_VehicleStatus_accelSets value, char oldPath[])
{
  char newPath[300]; 
  int j;
  int result;

  result = 0;

  snprintf(newPath, elcount(newPath), "%s.%s", oldPath, "accel4way");
  if(value.accel4way.isValidFlag==1)
  {
    SetProbeVehicleDataAccelerationSet4WayParams(packetHandle, value.accel4way, newPath);
    result = CheckLastError("ProbeVehicleData", gkFuncRefGet, result);
  }
  else
  {
    if( C2xIsTokenAvailable(packetHandle, "ProbeVehicleData", newPath) )
    {
      C2xRemoveToken(packetHandle, "ProbeVehicleData", newPath);
    }
  }

  snprintf(newPath, elcount(newPath), "%s.%s", oldPath, "vertAccelThres");
  if(value.vertAccelThres.isValidFlag==1)
  {
      for(j=0; j<value.vertAccelThres.stringLength; j++)
      {
        if(value.vertAccelThres.string[j] == '0')
        {
          C2xSetTokenBitOfBitString(packetHandle, "ProbeVehicleData", newPath, j, 0);
        }
        else
        {
          C2xSetTokenBitOfBitString(packetHandle, "ProbeVehicleData", newPath, j, 1);
        }
        result = CheckLastError("ProbeVehicleData", gkFuncRefGet, result);
      }
  }
  else
  {
    if( C2xIsTokenAvailable(packetHandle, "ProbeVehicleData", newPath) )
    {
      C2xRemoveToken(packetHandle, "ProbeVehicleData", newPath);
    }
  }

  snprintf(newPath, elcount(newPath), "%s.%s", oldPath, "yawRateCon");
  if(value.yawRateCon.isValidFlag==1)
  {
    C2xSetTokenInt(packetHandle, "ProbeVehicleData", newPath, value.yawRateCon.value);
    result = CheckLastError("ProbeVehicleData", gkFuncRefGet, result);
  }
  else
  {
    if( C2xIsTokenAvailable(packetHandle, "ProbeVehicleData", newPath) )
    {
      C2xRemoveToken(packetHandle, "ProbeVehicleData", newPath);
    }
  }

  snprintf(newPath, elcount(newPath), "%s.%s", oldPath, "hozAccelCon");
  if(value.hozAccelCon.isValidFlag==1)
  {
    C2xSetTokenInt(packetHandle, "ProbeVehicleData", newPath, value.hozAccelCon.value);
    result = CheckLastError("ProbeVehicleData", gkFuncRefGet, result);
  }
  else
  {
    if( C2xIsTokenAvailable(packetHandle, "ProbeVehicleData", newPath) )
    {
      C2xRemoveToken(packetHandle, "ProbeVehicleData", newPath);
    }
  }

  snprintf(newPath, elcount(newPath), "%s.%s", oldPath, "confidenceSet");
  if(value.confidenceSet.isValidFlag==1)
  {
    SetProbeVehicleDataConfidenceSetParams(packetHandle, value.confidenceSet, newPath);
    result = CheckLastError("ProbeVehicleData", gkFuncRefGet, result);
  }
  else
  {
    if( C2xIsTokenAvailable(packetHandle, "ProbeVehicleData", newPath) )
    {
      C2xRemoveToken(packetHandle, "ProbeVehicleData", newPath);
    }
  }

  return result;
}

int GetProbeVehicleData_VehicleStatus_objectParams(LONG packetHandle, struct ProbeVehicleData_VehicleStatus_object value, char oldPath[])
{
  char newPath[300];
  int result;

  result = 0;

  snprintf(newPath, elcount(newPath), "%s.%s", oldPath, "obDist");
  value.obDist = C2xGetTokenInt(packetHandle, "ProbeVehicleData", newPath);
  result = CheckLastError("ProbeVehicleData", gkFuncRefGet, result);

  snprintf(newPath, elcount(newPath), "%s.%s", oldPath, "obDirect");
  value.obDirect = C2xGetTokenInt(packetHandle, "ProbeVehicleData", newPath);
  result = CheckLastError("ProbeVehicleData", gkFuncRefGet, result);

  snprintf(newPath, elcount(newPath), "%s.%s", oldPath, "dateTime");
  GetProbeVehicleDataDDateTimeParams(packetHandle, value.dateTime, newPath);
  result = CheckLastError("ProbeVehicleData", gkFuncRefGet, result);

  return result;
}

int SetProbeVehicleData_VehicleStatus_objectParams(LONG packetHandle, struct ProbeVehicleData_VehicleStatus_object value, char oldPath[])
{
  char newPath[300];
  int result;

  result = 0;

  snprintf(newPath, elcount(newPath), "%s.%s", oldPath, "obDist");
  C2xSetTokenInt(packetHandle, "ProbeVehicleData", newPath, value.obDist);
  result = CheckLastError("ProbeVehicleData", gkFuncRefGet, result);

  snprintf(newPath, elcount(newPath), "%s.%s", oldPath, "obDirect");
  C2xSetTokenInt(packetHandle, "ProbeVehicleData", newPath, value.obDirect);
  result = CheckLastError("ProbeVehicleData", gkFuncRefGet, result);

  snprintf(newPath, elcount(newPath), "%s.%s", oldPath, "dateTime");
  SetProbeVehicleDataDDateTimeParams(packetHandle, value.dateTime, newPath);
  result = CheckLastError("ProbeVehicleData", gkFuncRefGet, result);

  return result;
}

int GetProbeVehicleDataBumperHeightsParams(LONG packetHandle, struct ProbeVehicleDataBumperHeights value, char oldPath[])
{
  char newPath[300];
  int result;

  result = 0;

  snprintf(newPath, elcount(newPath), "%s.%s", oldPath, "front");
  value.front = C2xGetTokenInt(packetHandle, "ProbeVehicleData", newPath);
  result = CheckLastError("ProbeVehicleData", gkFuncRefGet, result);

  snprintf(newPath, elcount(newPath), "%s.%s", oldPath, "rear");
  value.rear = C2xGetTokenInt(packetHandle, "ProbeVehicleData", newPath);
  result = CheckLastError("ProbeVehicleData", gkFuncRefGet, result);

  return result;
}

int SetProbeVehicleDataBumperHeightsParams(LONG packetHandle, struct ProbeVehicleDataBumperHeights value, char oldPath[])
{
  char newPath[300];
  int result;

  result = 0;

  snprintf(newPath, elcount(newPath), "%s.%s", oldPath, "front");
  C2xSetTokenInt(packetHandle, "ProbeVehicleData", newPath, value.front);
  result = CheckLastError("ProbeVehicleData", gkFuncRefGet, result);

  snprintf(newPath, elcount(newPath), "%s.%s", oldPath, "rear");
  C2xSetTokenInt(packetHandle, "ProbeVehicleData", newPath, value.rear);
  result = CheckLastError("ProbeVehicleData", gkFuncRefGet, result);

  return result;
}

int GetProbeVehicleData_VehicleStatus_vehicleDataParams(LONG packetHandle, struct ProbeVehicleData_VehicleStatus_vehicleData value, char oldPath[])
{
  char newPath[300];
  int result;

  result = 0;

  snprintf(newPath, elcount(newPath), "%s.%s", oldPath, "height");
  value.height = C2xGetTokenInt(packetHandle, "ProbeVehicleData", newPath);
  result = CheckLastError("ProbeVehicleData", gkFuncRefGet, result);

  snprintf(newPath, elcount(newPath), "%s.%s", oldPath, "bumpers");
  GetProbeVehicleDataBumperHeightsParams(packetHandle, value.bumpers, newPath);
  result = CheckLastError("ProbeVehicleData", gkFuncRefGet, result);

  snprintf(newPath, elcount(newPath), "%s.%s", oldPath, "mass");
  value.mass = C2xGetTokenInt(packetHandle, "ProbeVehicleData", newPath);
  result = CheckLastError("ProbeVehicleData", gkFuncRefGet, result);

  snprintf(newPath, elcount(newPath), "%s.%s", oldPath, "trailerWeight");
  value.trailerWeight = C2xGetTokenInt(packetHandle, "ProbeVehicleData", newPath);
  result = CheckLastError("ProbeVehicleData", gkFuncRefGet, result);

  snprintf(newPath, elcount(newPath), "%s.%s", oldPath, "type");
  value.type = C2xGetTokenInt(packetHandle, "ProbeVehicleData", newPath);
  result = CheckLastError("ProbeVehicleData", gkFuncRefGet, result);

  return result;
}

int SetProbeVehicleData_VehicleStatus_vehicleDataParams(LONG packetHandle, struct ProbeVehicleData_VehicleStatus_vehicleData value, char oldPath[])
{
  char newPath[300];
  int result;

  result = 0;

  snprintf(newPath, elcount(newPath), "%s.%s", oldPath, "height");
  C2xSetTokenInt(packetHandle, "ProbeVehicleData", newPath, value.height);
  result = CheckLastError("ProbeVehicleData", gkFuncRefGet, result);

  snprintf(newPath, elcount(newPath), "%s.%s", oldPath, "bumpers");
  SetProbeVehicleDataBumperHeightsParams(packetHandle, value.bumpers, newPath);
  result = CheckLastError("ProbeVehicleData", gkFuncRefGet, result);

  snprintf(newPath, elcount(newPath), "%s.%s", oldPath, "mass");
  C2xSetTokenInt(packetHandle, "ProbeVehicleData", newPath, value.mass);
  result = CheckLastError("ProbeVehicleData", gkFuncRefGet, result);

  snprintf(newPath, elcount(newPath), "%s.%s", oldPath, "trailerWeight");
  C2xSetTokenInt(packetHandle, "ProbeVehicleData", newPath, value.trailerWeight);
  result = CheckLastError("ProbeVehicleData", gkFuncRefGet, result);

  snprintf(newPath, elcount(newPath), "%s.%s", oldPath, "type");
  C2xSetTokenInt(packetHandle, "ProbeVehicleData", newPath, value.type);
  result = CheckLastError("ProbeVehicleData", gkFuncRefGet, result);

  return result;
}

int GetProbeVehicleDataTireDataParams(LONG packetHandle, struct ProbeVehicleDataTireData value, char oldPath[])
{
  char newPath[300];
  int result;

  result = 0;

  snprintf(newPath, elcount(newPath), "%s.%s", oldPath, "location");
  value.location.isValidFlag = C2xIsTokenAvailable(packetHandle, "ProbeVehicleData", newPath);
  if(value.location.isValidFlag==1)
  {
    value.location.value = C2xGetTokenInt(packetHandle, "ProbeVehicleData", newPath);
    result = CheckLastError("ProbeVehicleData", gkFuncRefGet, result);
  }
  snprintf(newPath, elcount(newPath), "%s.%s", oldPath, "pressure");
  value.pressure.isValidFlag = C2xIsTokenAvailable(packetHandle, "ProbeVehicleData", newPath);
  if(value.pressure.isValidFlag==1)
  {
    value.pressure.value = C2xGetTokenInt(packetHandle, "ProbeVehicleData", newPath);
    result = CheckLastError("ProbeVehicleData", gkFuncRefGet, result);
  }
  snprintf(newPath, elcount(newPath), "%s.%s", oldPath, "temp");
  value.temp.isValidFlag = C2xIsTokenAvailable(packetHandle, "ProbeVehicleData", newPath);
  if(value.temp.isValidFlag==1)
  {
    value.temp.value = C2xGetTokenInt(packetHandle, "ProbeVehicleData", newPath);
    result = CheckLastError("ProbeVehicleData", gkFuncRefGet, result);
  }
  snprintf(newPath, elcount(newPath), "%s.%s", oldPath, "wheelSensorStatus");
  value.wheelSensorStatus.isValidFlag = C2xIsTokenAvailable(packetHandle, "ProbeVehicleData", newPath);
  if(value.wheelSensorStatus.isValidFlag==1)
  {
    value.wheelSensorStatus.value = C2xGetTokenInt(packetHandle, "ProbeVehicleData", newPath);
    result = CheckLastError("ProbeVehicleData", gkFuncRefGet, result);
  }
  snprintf(newPath, elcount(newPath), "%s.%s", oldPath, "wheelEndElectFault");
  value.wheelEndElectFault.isValidFlag = C2xIsTokenAvailable(packetHandle, "ProbeVehicleData", newPath);
  if(value.wheelEndElectFault.isValidFlag==1)
  {
    value.wheelEndElectFault.value = C2xGetTokenInt(packetHandle, "ProbeVehicleData", newPath);
    result = CheckLastError("ProbeVehicleData", gkFuncRefGet, result);
  }
  snprintf(newPath, elcount(newPath), "%s.%s", oldPath, "leakageRate");
  value.leakageRate.isValidFlag = C2xIsTokenAvailable(packetHandle, "ProbeVehicleData", newPath);
  if(value.leakageRate.isValidFlag==1)
  {
    value.leakageRate.value = C2xGetTokenInt(packetHandle, "ProbeVehicleData", newPath);
    result = CheckLastError("ProbeVehicleData", gkFuncRefGet, result);
  }
  snprintf(newPath, elcount(newPath), "%s.%s", oldPath, "detection");
  value.detection.isValidFlag = C2xIsTokenAvailable(packetHandle, "ProbeVehicleData", newPath);
  if(value.detection.isValidFlag==1)
  {
    value.detection.value = C2xGetTokenInt(packetHandle, "ProbeVehicleData", newPath);
    result = CheckLastError("ProbeVehicleData", gkFuncRefGet, result);
  }
  return result;
}

int SetProbeVehicleDataTireDataParams(LONG packetHandle, struct ProbeVehicleDataTireData value, char oldPath[])
{
  char newPath[300];
  int result;

  result = 0;

  snprintf(newPath, elcount(newPath), "%s.%s", oldPath, "location");
  if(value.location.isValidFlag==1)
  {
    C2xSetTokenInt(packetHandle, "ProbeVehicleData", newPath, value.location.value);
    result = CheckLastError("ProbeVehicleData", gkFuncRefGet, result);
  }
  else
  {
    if( C2xIsTokenAvailable(packetHandle, "ProbeVehicleData", newPath) )
    {
      C2xRemoveToken(packetHandle, "ProbeVehicleData", newPath);
    }
  }

  snprintf(newPath, elcount(newPath), "%s.%s", oldPath, "pressure");
  if(value.pressure.isValidFlag==1)
  {
    C2xSetTokenInt(packetHandle, "ProbeVehicleData", newPath, value.pressure.value);
    result = CheckLastError("ProbeVehicleData", gkFuncRefGet, result);
  }
  else
  {
    if( C2xIsTokenAvailable(packetHandle, "ProbeVehicleData", newPath) )
    {
      C2xRemoveToken(packetHandle, "ProbeVehicleData", newPath);
    }
  }

  snprintf(newPath, elcount(newPath), "%s.%s", oldPath, "temp");
  if(value.temp.isValidFlag==1)
  {
    C2xSetTokenInt(packetHandle, "ProbeVehicleData", newPath, value.temp.value);
    result = CheckLastError("ProbeVehicleData", gkFuncRefGet, result);
  }
  else
  {
    if( C2xIsTokenAvailable(packetHandle, "ProbeVehicleData", newPath) )
    {
      C2xRemoveToken(packetHandle, "ProbeVehicleData", newPath);
    }
  }

  snprintf(newPath, elcount(newPath), "%s.%s", oldPath, "wheelSensorStatus");
  if(value.wheelSensorStatus.isValidFlag==1)
  {
    C2xSetTokenInt(packetHandle, "ProbeVehicleData", newPath, value.wheelSensorStatus.value);
    result = CheckLastError("ProbeVehicleData", gkFuncRefGet, result);
  }
  else
  {
    if( C2xIsTokenAvailable(packetHandle, "ProbeVehicleData", newPath) )
    {
      C2xRemoveToken(packetHandle, "ProbeVehicleData", newPath);
    }
  }

  snprintf(newPath, elcount(newPath), "%s.%s", oldPath, "wheelEndElectFault");
  if(value.wheelEndElectFault.isValidFlag==1)
  {
    C2xSetTokenInt(packetHandle, "ProbeVehicleData", newPath, value.wheelEndElectFault.value);
    result = CheckLastError("ProbeVehicleData", gkFuncRefGet, result);
  }
  else
  {
    if( C2xIsTokenAvailable(packetHandle, "ProbeVehicleData", newPath) )
    {
      C2xRemoveToken(packetHandle, "ProbeVehicleData", newPath);
    }
  }

  snprintf(newPath, elcount(newPath), "%s.%s", oldPath, "leakageRate");
  if(value.leakageRate.isValidFlag==1)
  {
    C2xSetTokenInt(packetHandle, "ProbeVehicleData", newPath, value.leakageRate.value);
    result = CheckLastError("ProbeVehicleData", gkFuncRefGet, result);
  }
  else
  {
    if( C2xIsTokenAvailable(packetHandle, "ProbeVehicleData", newPath) )
    {
      C2xRemoveToken(packetHandle, "ProbeVehicleData", newPath);
    }
  }

  snprintf(newPath, elcount(newPath), "%s.%s", oldPath, "detection");
  if(value.detection.isValidFlag==1)
  {
    C2xSetTokenInt(packetHandle, "ProbeVehicleData", newPath, value.detection.value);
    result = CheckLastError("ProbeVehicleData", gkFuncRefGet, result);
  }
  else
  {
    if( C2xIsTokenAvailable(packetHandle, "ProbeVehicleData", newPath) )
    {
      C2xRemoveToken(packetHandle, "ProbeVehicleData", newPath);
    }
  }

  return result;
}

int GetProbeVehicleDataTireDataListParams(LONG packetHandle, struct ProbeVehicleDataTireDataList value, char oldPath[])
{
  char newPath[300]; 
  int i;
  int result;

  result = 0;

  value.length = C2xGetTokenInt(packetHandle, "ProbeVehicleData", oldPath);
  if((result = CheckLastError("ProbeVehicleData", gkFuncRefGet, result))==0)
  {
    for(i=0; i<value.length; i++)
    {
      snprintf(newPath, elcount(newPath), "%s[%d]", oldPath, i);
      GetProbeVehicleDataTireDataParams(packetHandle, value.arrayValue[i], newPath);
      result = CheckLastError("ProbeVehicleData", gkFuncRefGet, result);
    }
  }
  return result;
}

int SetProbeVehicleDataTireDataListParams(LONG packetHandle, struct ProbeVehicleDataTireDataList value, char oldPath[])
{
  char newPath[300]; 
  int i;
  int result;

  result = 0;

  C2xRemoveToken(packetHandle, "ProbeVehicleData", oldPath);
  for(i=0; i<value.length; i++)
  {
    snprintf(newPath, elcount(newPath), "%s[%d]", oldPath, i);
    SetProbeVehicleDataTireDataParams(packetHandle, value.arrayValue[i], newPath);
    result = CheckLastError("ProbeVehicleData", gkFuncRefGet, result);
  }
  return result;
}

int GetProbeVehicleDataAxleWeightSetParams(LONG packetHandle, struct ProbeVehicleDataAxleWeightSet value, char oldPath[])
{
  char newPath[300];
  int result;

  result = 0;

  snprintf(newPath, elcount(newPath), "%s.%s", oldPath, "location");
  value.location.isValidFlag = C2xIsTokenAvailable(packetHandle, "ProbeVehicleData", newPath);
  if(value.location.isValidFlag==1)
  {
    value.location.value = C2xGetTokenInt(packetHandle, "ProbeVehicleData", newPath);
    result = CheckLastError("ProbeVehicleData", gkFuncRefGet, result);
  }
  snprintf(newPath, elcount(newPath), "%s.%s", oldPath, "weight");
  value.weight.isValidFlag = C2xIsTokenAvailable(packetHandle, "ProbeVehicleData", newPath);
  if(value.weight.isValidFlag==1)
  {
    value.weight.value = C2xGetTokenInt(packetHandle, "ProbeVehicleData", newPath);
    result = CheckLastError("ProbeVehicleData", gkFuncRefGet, result);
  }
  return result;
}

int SetProbeVehicleDataAxleWeightSetParams(LONG packetHandle, struct ProbeVehicleDataAxleWeightSet value, char oldPath[])
{
  char newPath[300];
  int result;

  result = 0;

  snprintf(newPath, elcount(newPath), "%s.%s", oldPath, "location");
  if(value.location.isValidFlag==1)
  {
    C2xSetTokenInt(packetHandle, "ProbeVehicleData", newPath, value.location.value);
    result = CheckLastError("ProbeVehicleData", gkFuncRefGet, result);
  }
  else
  {
    if( C2xIsTokenAvailable(packetHandle, "ProbeVehicleData", newPath) )
    {
      C2xRemoveToken(packetHandle, "ProbeVehicleData", newPath);
    }
  }

  snprintf(newPath, elcount(newPath), "%s.%s", oldPath, "weight");
  if(value.weight.isValidFlag==1)
  {
    C2xSetTokenInt(packetHandle, "ProbeVehicleData", newPath, value.weight.value);
    result = CheckLastError("ProbeVehicleData", gkFuncRefGet, result);
  }
  else
  {
    if( C2xIsTokenAvailable(packetHandle, "ProbeVehicleData", newPath) )
    {
      C2xRemoveToken(packetHandle, "ProbeVehicleData", newPath);
    }
  }

  return result;
}

int GetProbeVehicleDataAxleWeightListParams(LONG packetHandle, struct ProbeVehicleDataAxleWeightList value, char oldPath[])
{
  char newPath[300]; 
  int i;
  int result;

  result = 0;

  value.length = C2xGetTokenInt(packetHandle, "ProbeVehicleData", oldPath);
  if((result = CheckLastError("ProbeVehicleData", gkFuncRefGet, result))==0)
  {
    for(i=0; i<value.length; i++)
    {
      snprintf(newPath, elcount(newPath), "%s[%d]", oldPath, i);
      GetProbeVehicleDataAxleWeightSetParams(packetHandle, value.arrayValue[i], newPath);
      result = CheckLastError("ProbeVehicleData", gkFuncRefGet, result);
    }
  }
  return result;
}

int SetProbeVehicleDataAxleWeightListParams(LONG packetHandle, struct ProbeVehicleDataAxleWeightList value, char oldPath[])
{
  char newPath[300]; 
  int i;
  int result;

  result = 0;

  C2xRemoveToken(packetHandle, "ProbeVehicleData", oldPath);
  for(i=0; i<value.length; i++)
  {
    snprintf(newPath, elcount(newPath), "%s[%d]", oldPath, i);
    SetProbeVehicleDataAxleWeightSetParams(packetHandle, value.arrayValue[i], newPath);
    result = CheckLastError("ProbeVehicleData", gkFuncRefGet, result);
  }
  return result;
}

int GetProbeVehicleDataJ1939dataParams(LONG packetHandle, struct ProbeVehicleDataJ1939data value, char oldPath[])
{
  char newPath[300];
  int result;

  result = 0;

  snprintf(newPath, elcount(newPath), "%s.%s", oldPath, "tires");
  value.tires.isValidFlag = C2xIsTokenAvailable(packetHandle, "ProbeVehicleData", newPath);
  if(value.tires.isValidFlag==1)
  {
    GetProbeVehicleDataTireDataListParams(packetHandle, value.tires, newPath);
    result = CheckLastError("ProbeVehicleData", gkFuncRefGet, result);
  }
  snprintf(newPath, elcount(newPath), "%s.%s", oldPath, "axles");
  value.axles.isValidFlag = C2xIsTokenAvailable(packetHandle, "ProbeVehicleData", newPath);
  if(value.axles.isValidFlag==1)
  {
    GetProbeVehicleDataAxleWeightListParams(packetHandle, value.axles, newPath);
    result = CheckLastError("ProbeVehicleData", gkFuncRefGet, result);
  }
  snprintf(newPath, elcount(newPath), "%s.%s", oldPath, "trailerWeight");
  value.trailerWeight.isValidFlag = C2xIsTokenAvailable(packetHandle, "ProbeVehicleData", newPath);
  if(value.trailerWeight.isValidFlag==1)
  {
    value.trailerWeight.value = C2xGetTokenInt(packetHandle, "ProbeVehicleData", newPath);
    result = CheckLastError("ProbeVehicleData", gkFuncRefGet, result);
  }
  snprintf(newPath, elcount(newPath), "%s.%s", oldPath, "cargoWeight");
  value.cargoWeight.isValidFlag = C2xIsTokenAvailable(packetHandle, "ProbeVehicleData", newPath);
  if(value.cargoWeight.isValidFlag==1)
  {
    value.cargoWeight.value = C2xGetTokenInt(packetHandle, "ProbeVehicleData", newPath);
    result = CheckLastError("ProbeVehicleData", gkFuncRefGet, result);
  }
  snprintf(newPath, elcount(newPath), "%s.%s", oldPath, "steeringAxleTemperature");
  value.steeringAxleTemperature.isValidFlag = C2xIsTokenAvailable(packetHandle, "ProbeVehicleData", newPath);
  if(value.steeringAxleTemperature.isValidFlag==1)
  {
    value.steeringAxleTemperature.value = C2xGetTokenInt(packetHandle, "ProbeVehicleData", newPath);
    result = CheckLastError("ProbeVehicleData", gkFuncRefGet, result);
  }
  snprintf(newPath, elcount(newPath), "%s.%s", oldPath, "driveAxleLocation");
  value.driveAxleLocation.isValidFlag = C2xIsTokenAvailable(packetHandle, "ProbeVehicleData", newPath);
  if(value.driveAxleLocation.isValidFlag==1)
  {
    value.driveAxleLocation.value = C2xGetTokenInt(packetHandle, "ProbeVehicleData", newPath);
    result = CheckLastError("ProbeVehicleData", gkFuncRefGet, result);
  }
  snprintf(newPath, elcount(newPath), "%s.%s", oldPath, "driveAxleLiftAirPressure");
  value.driveAxleLiftAirPressure.isValidFlag = C2xIsTokenAvailable(packetHandle, "ProbeVehicleData", newPath);
  if(value.driveAxleLiftAirPressure.isValidFlag==1)
  {
    value.driveAxleLiftAirPressure.value = C2xGetTokenInt(packetHandle, "ProbeVehicleData", newPath);
    result = CheckLastError("ProbeVehicleData", gkFuncRefGet, result);
  }
  snprintf(newPath, elcount(newPath), "%s.%s", oldPath, "driveAxleTemperature");
  value.driveAxleTemperature.isValidFlag = C2xIsTokenAvailable(packetHandle, "ProbeVehicleData", newPath);
  if(value.driveAxleTemperature.isValidFlag==1)
  {
    value.driveAxleTemperature.value = C2xGetTokenInt(packetHandle, "ProbeVehicleData", newPath);
    result = CheckLastError("ProbeVehicleData", gkFuncRefGet, result);
  }
  snprintf(newPath, elcount(newPath), "%s.%s", oldPath, "driveAxleLubePressure");
  value.driveAxleLubePressure.isValidFlag = C2xIsTokenAvailable(packetHandle, "ProbeVehicleData", newPath);
  if(value.driveAxleLubePressure.isValidFlag==1)
  {
    value.driveAxleLubePressure.value = C2xGetTokenInt(packetHandle, "ProbeVehicleData", newPath);
    result = CheckLastError("ProbeVehicleData", gkFuncRefGet, result);
  }
  snprintf(newPath, elcount(newPath), "%s.%s", oldPath, "steeringAxleLubePressure");
  value.steeringAxleLubePressure.isValidFlag = C2xIsTokenAvailable(packetHandle, "ProbeVehicleData", newPath);
  if(value.steeringAxleLubePressure.isValidFlag==1)
  {
    value.steeringAxleLubePressure.value = C2xGetTokenInt(packetHandle, "ProbeVehicleData", newPath);
    result = CheckLastError("ProbeVehicleData", gkFuncRefGet, result);
  }
  return result;
}

int SetProbeVehicleDataJ1939dataParams(LONG packetHandle, struct ProbeVehicleDataJ1939data value, char oldPath[])
{
  char newPath[300];
  int result;

  result = 0;

  snprintf(newPath, elcount(newPath), "%s.%s", oldPath, "tires");
  if(value.tires.isValidFlag==1)
  {
    SetProbeVehicleDataTireDataListParams(packetHandle, value.tires, newPath);
    result = CheckLastError("ProbeVehicleData", gkFuncRefGet, result);
  }
  else
  {
    if( C2xIsTokenAvailable(packetHandle, "ProbeVehicleData", newPath) )
    {
      C2xRemoveToken(packetHandle, "ProbeVehicleData", newPath);
    }
  }

  snprintf(newPath, elcount(newPath), "%s.%s", oldPath, "axles");
  if(value.axles.isValidFlag==1)
  {
    SetProbeVehicleDataAxleWeightListParams(packetHandle, value.axles, newPath);
    result = CheckLastError("ProbeVehicleData", gkFuncRefGet, result);
  }
  else
  {
    if( C2xIsTokenAvailable(packetHandle, "ProbeVehicleData", newPath) )
    {
      C2xRemoveToken(packetHandle, "ProbeVehicleData", newPath);
    }
  }

  snprintf(newPath, elcount(newPath), "%s.%s", oldPath, "trailerWeight");
  if(value.trailerWeight.isValidFlag==1)
  {
    C2xSetTokenInt(packetHandle, "ProbeVehicleData", newPath, value.trailerWeight.value);
    result = CheckLastError("ProbeVehicleData", gkFuncRefGet, result);
  }
  else
  {
    if( C2xIsTokenAvailable(packetHandle, "ProbeVehicleData", newPath) )
    {
      C2xRemoveToken(packetHandle, "ProbeVehicleData", newPath);
    }
  }

  snprintf(newPath, elcount(newPath), "%s.%s", oldPath, "cargoWeight");
  if(value.cargoWeight.isValidFlag==1)
  {
    C2xSetTokenInt(packetHandle, "ProbeVehicleData", newPath, value.cargoWeight.value);
    result = CheckLastError("ProbeVehicleData", gkFuncRefGet, result);
  }
  else
  {
    if( C2xIsTokenAvailable(packetHandle, "ProbeVehicleData", newPath) )
    {
      C2xRemoveToken(packetHandle, "ProbeVehicleData", newPath);
    }
  }

  snprintf(newPath, elcount(newPath), "%s.%s", oldPath, "steeringAxleTemperature");
  if(value.steeringAxleTemperature.isValidFlag==1)
  {
    C2xSetTokenInt(packetHandle, "ProbeVehicleData", newPath, value.steeringAxleTemperature.value);
    result = CheckLastError("ProbeVehicleData", gkFuncRefGet, result);
  }
  else
  {
    if( C2xIsTokenAvailable(packetHandle, "ProbeVehicleData", newPath) )
    {
      C2xRemoveToken(packetHandle, "ProbeVehicleData", newPath);
    }
  }

  snprintf(newPath, elcount(newPath), "%s.%s", oldPath, "driveAxleLocation");
  if(value.driveAxleLocation.isValidFlag==1)
  {
    C2xSetTokenInt(packetHandle, "ProbeVehicleData", newPath, value.driveAxleLocation.value);
    result = CheckLastError("ProbeVehicleData", gkFuncRefGet, result);
  }
  else
  {
    if( C2xIsTokenAvailable(packetHandle, "ProbeVehicleData", newPath) )
    {
      C2xRemoveToken(packetHandle, "ProbeVehicleData", newPath);
    }
  }

  snprintf(newPath, elcount(newPath), "%s.%s", oldPath, "driveAxleLiftAirPressure");
  if(value.driveAxleLiftAirPressure.isValidFlag==1)
  {
    C2xSetTokenInt(packetHandle, "ProbeVehicleData", newPath, value.driveAxleLiftAirPressure.value);
    result = CheckLastError("ProbeVehicleData", gkFuncRefGet, result);
  }
  else
  {
    if( C2xIsTokenAvailable(packetHandle, "ProbeVehicleData", newPath) )
    {
      C2xRemoveToken(packetHandle, "ProbeVehicleData", newPath);
    }
  }

  snprintf(newPath, elcount(newPath), "%s.%s", oldPath, "driveAxleTemperature");
  if(value.driveAxleTemperature.isValidFlag==1)
  {
    C2xSetTokenInt(packetHandle, "ProbeVehicleData", newPath, value.driveAxleTemperature.value);
    result = CheckLastError("ProbeVehicleData", gkFuncRefGet, result);
  }
  else
  {
    if( C2xIsTokenAvailable(packetHandle, "ProbeVehicleData", newPath) )
    {
      C2xRemoveToken(packetHandle, "ProbeVehicleData", newPath);
    }
  }

  snprintf(newPath, elcount(newPath), "%s.%s", oldPath, "driveAxleLubePressure");
  if(value.driveAxleLubePressure.isValidFlag==1)
  {
    C2xSetTokenInt(packetHandle, "ProbeVehicleData", newPath, value.driveAxleLubePressure.value);
    result = CheckLastError("ProbeVehicleData", gkFuncRefGet, result);
  }
  else
  {
    if( C2xIsTokenAvailable(packetHandle, "ProbeVehicleData", newPath) )
    {
      C2xRemoveToken(packetHandle, "ProbeVehicleData", newPath);
    }
  }

  snprintf(newPath, elcount(newPath), "%s.%s", oldPath, "steeringAxleLubePressure");
  if(value.steeringAxleLubePressure.isValidFlag==1)
  {
    C2xSetTokenInt(packetHandle, "ProbeVehicleData", newPath, value.steeringAxleLubePressure.value);
    result = CheckLastError("ProbeVehicleData", gkFuncRefGet, result);
  }
  else
  {
    if( C2xIsTokenAvailable(packetHandle, "ProbeVehicleData", newPath) )
    {
      C2xRemoveToken(packetHandle, "ProbeVehicleData", newPath);
    }
  }

  return result;
}

int GetProbeVehicleData_VehicleStatus_weatherReportParams(LONG packetHandle, struct ProbeVehicleData_VehicleStatus_weatherReport value, char oldPath[])
{
  char newPath[300];
  int result;

  result = 0;

  snprintf(newPath, elcount(newPath), "%s.%s", oldPath, "isRaining");
  value.isRaining = C2xGetTokenInt(packetHandle, "ProbeVehicleData", newPath);
  result = CheckLastError("ProbeVehicleData", gkFuncRefGet, result);

  snprintf(newPath, elcount(newPath), "%s.%s", oldPath, "rainRate");
  value.rainRate.isValidFlag = C2xIsTokenAvailable(packetHandle, "ProbeVehicleData", newPath);
  if(value.rainRate.isValidFlag==1)
  {
    value.rainRate.value = C2xGetTokenInt(packetHandle, "ProbeVehicleData", newPath);
    result = CheckLastError("ProbeVehicleData", gkFuncRefGet, result);
  }
  snprintf(newPath, elcount(newPath), "%s.%s", oldPath, "precipSituation");
  value.precipSituation.isValidFlag = C2xIsTokenAvailable(packetHandle, "ProbeVehicleData", newPath);
  if(value.precipSituation.isValidFlag==1)
  {
    value.precipSituation.value = C2xGetTokenInt(packetHandle, "ProbeVehicleData", newPath);
    result = CheckLastError("ProbeVehicleData", gkFuncRefGet, result);
  }
  snprintf(newPath, elcount(newPath), "%s.%s", oldPath, "solarRadiation");
  value.solarRadiation.isValidFlag = C2xIsTokenAvailable(packetHandle, "ProbeVehicleData", newPath);
  if(value.solarRadiation.isValidFlag==1)
  {
    value.solarRadiation.value = C2xGetTokenInt(packetHandle, "ProbeVehicleData", newPath);
    result = CheckLastError("ProbeVehicleData", gkFuncRefGet, result);
  }
  snprintf(newPath, elcount(newPath), "%s.%s", oldPath, "friction");
  value.friction.isValidFlag = C2xIsTokenAvailable(packetHandle, "ProbeVehicleData", newPath);
  if(value.friction.isValidFlag==1)
  {
    value.friction.value = C2xGetTokenInt(packetHandle, "ProbeVehicleData", newPath);
    result = CheckLastError("ProbeVehicleData", gkFuncRefGet, result);
  }
  return result;
}

int SetProbeVehicleData_VehicleStatus_weatherReportParams(LONG packetHandle, struct ProbeVehicleData_VehicleStatus_weatherReport value, char oldPath[])
{
  char newPath[300];
  int result;

  result = 0;

  snprintf(newPath, elcount(newPath), "%s.%s", oldPath, "isRaining");
  C2xSetTokenInt(packetHandle, "ProbeVehicleData", newPath, value.isRaining);
  result = CheckLastError("ProbeVehicleData", gkFuncRefGet, result);

  snprintf(newPath, elcount(newPath), "%s.%s", oldPath, "rainRate");
  if(value.rainRate.isValidFlag==1)
  {
    C2xSetTokenInt(packetHandle, "ProbeVehicleData", newPath, value.rainRate.value);
    result = CheckLastError("ProbeVehicleData", gkFuncRefGet, result);
  }
  else
  {
    if( C2xIsTokenAvailable(packetHandle, "ProbeVehicleData", newPath) )
    {
      C2xRemoveToken(packetHandle, "ProbeVehicleData", newPath);
    }
  }

  snprintf(newPath, elcount(newPath), "%s.%s", oldPath, "precipSituation");
  if(value.precipSituation.isValidFlag==1)
  {
    C2xSetTokenInt(packetHandle, "ProbeVehicleData", newPath, value.precipSituation.value);
    result = CheckLastError("ProbeVehicleData", gkFuncRefGet, result);
  }
  else
  {
    if( C2xIsTokenAvailable(packetHandle, "ProbeVehicleData", newPath) )
    {
      C2xRemoveToken(packetHandle, "ProbeVehicleData", newPath);
    }
  }

  snprintf(newPath, elcount(newPath), "%s.%s", oldPath, "solarRadiation");
  if(value.solarRadiation.isValidFlag==1)
  {
    C2xSetTokenInt(packetHandle, "ProbeVehicleData", newPath, value.solarRadiation.value);
    result = CheckLastError("ProbeVehicleData", gkFuncRefGet, result);
  }
  else
  {
    if( C2xIsTokenAvailable(packetHandle, "ProbeVehicleData", newPath) )
    {
      C2xRemoveToken(packetHandle, "ProbeVehicleData", newPath);
    }
  }

  snprintf(newPath, elcount(newPath), "%s.%s", oldPath, "friction");
  if(value.friction.isValidFlag==1)
  {
    C2xSetTokenInt(packetHandle, "ProbeVehicleData", newPath, value.friction.value);
    result = CheckLastError("ProbeVehicleData", gkFuncRefGet, result);
  }
  else
  {
    if( C2xIsTokenAvailable(packetHandle, "ProbeVehicleData", newPath) )
    {
      C2xRemoveToken(packetHandle, "ProbeVehicleData", newPath);
    }
  }

  return result;
}

int GetProbeVehicleDataVehicleStatusParams(LONG packetHandle, struct ProbeVehicleDataVehicleStatus value, char oldPath[])
{
  char newPath[300]; 
  int j; 
  int k;
  int result;

  result = 0;

  snprintf(newPath, elcount(newPath), "%s.%s", oldPath, "lights");
  value.lights.isValidFlag = C2xIsTokenAvailable(packetHandle, "ProbeVehicleData", newPath);
  if(value.lights.isValidFlag==1)
  {
    value.lights.isValidFlag = 1;
    value.lights.stringLength = C2xGetTokenLengthBit(packetHandle, "ProbeVehicleData", newPath);
    if ((result = CheckLastError("ProbeVehicleData", gkFuncRefGet, result))==0)
    {
      if(value.lights.stringLength > 0)
      {
        for(j=0; j<value.lights.stringLength; j++)
        {
          if(C2xGetTokenBitOfBitString(packetHandle, "ProbeVehicleData", newPath, j) == 0)
          {
            value.lights.string[j] = '0';
          }
          else if(C2xGetTokenBitOfBitString(packetHandle, "ProbeVehicleData", newPath, j) == 1)
          {
            value.lights.string[j] = '1';
          }

          if(value.lights.stringLength == 1)
          {
            value.lights.string[1] = '0';
          }
          result = CheckLastError("ProbeVehicleData", gkFuncRefGet, result);
        }
      }
      else
      {
        for(k = value.lights.stringLength+1; k > -1; k--)
        {
          if(value.lights.string[k] == '1')
          {
            value.lights.string[k] = '0';
          }
        }
      }
    }

  }
  snprintf(newPath, elcount(newPath), "%s.%s", oldPath, "lightBar");
  value.lightBar.isValidFlag = C2xIsTokenAvailable(packetHandle, "ProbeVehicleData", newPath);
  if(value.lightBar.isValidFlag==1)
  {
    value.lightBar.value = C2xGetTokenInt(packetHandle, "ProbeVehicleData", newPath);
    result = CheckLastError("ProbeVehicleData", gkFuncRefGet, result);
  }
  snprintf(newPath, elcount(newPath), "%s.%s", oldPath, "wipers");
  value.wipers.isValidFlag = C2xIsTokenAvailable(packetHandle, "ProbeVehicleData", newPath);
  if(value.wipers.isValidFlag==1)
  {
    GetProbeVehicleDataWiperSetParams(packetHandle, value.wipers, newPath);
    result = CheckLastError("ProbeVehicleData", gkFuncRefGet, result);
  }
  snprintf(newPath, elcount(newPath), "%s.%s", oldPath, "brakeStatus");
  value.brakeStatus.isValidFlag = C2xIsTokenAvailable(packetHandle, "ProbeVehicleData", newPath);
  if(value.brakeStatus.isValidFlag==1)
  {
    GetProbeVehicleDataBrakeSystemStatusParams(packetHandle, value.brakeStatus, newPath);
    result = CheckLastError("ProbeVehicleData", gkFuncRefGet, result);
  }
  snprintf(newPath, elcount(newPath), "%s.%s", oldPath, "brakePressure");
  value.brakePressure.isValidFlag = C2xIsTokenAvailable(packetHandle, "ProbeVehicleData", newPath);
  if(value.brakePressure.isValidFlag==1)
  {
    value.brakePressure.value = C2xGetTokenInt(packetHandle, "ProbeVehicleData", newPath);
    result = CheckLastError("ProbeVehicleData", gkFuncRefGet, result);
  }
  snprintf(newPath, elcount(newPath), "%s.%s", oldPath, "roadFriction");
  value.roadFriction.isValidFlag = C2xIsTokenAvailable(packetHandle, "ProbeVehicleData", newPath);
  if(value.roadFriction.isValidFlag==1)
  {
    value.roadFriction.value = C2xGetTokenInt(packetHandle, "ProbeVehicleData", newPath);
    result = CheckLastError("ProbeVehicleData", gkFuncRefGet, result);
  }
  snprintf(newPath, elcount(newPath), "%s.%s", oldPath, "sunData");
  value.sunData.isValidFlag = C2xIsTokenAvailable(packetHandle, "ProbeVehicleData", newPath);
  if(value.sunData.isValidFlag==1)
  {
    value.sunData.value = C2xGetTokenInt(packetHandle, "ProbeVehicleData", newPath);
    result = CheckLastError("ProbeVehicleData", gkFuncRefGet, result);
  }
  snprintf(newPath, elcount(newPath), "%s.%s", oldPath, "rainData");
  value.rainData.isValidFlag = C2xIsTokenAvailable(packetHandle, "ProbeVehicleData", newPath);
  if(value.rainData.isValidFlag==1)
  {
    value.rainData.value = C2xGetTokenInt(packetHandle, "ProbeVehicleData", newPath);
    result = CheckLastError("ProbeVehicleData", gkFuncRefGet, result);
  }
  snprintf(newPath, elcount(newPath), "%s.%s", oldPath, "airTemp");
  value.airTemp.isValidFlag = C2xIsTokenAvailable(packetHandle, "ProbeVehicleData", newPath);
  if(value.airTemp.isValidFlag==1)
  {
    value.airTemp.value = C2xGetTokenInt(packetHandle, "ProbeVehicleData", newPath);
    result = CheckLastError("ProbeVehicleData", gkFuncRefGet, result);
  }
  snprintf(newPath, elcount(newPath), "%s.%s", oldPath, "airPres");
  value.airPres.isValidFlag = C2xIsTokenAvailable(packetHandle, "ProbeVehicleData", newPath);
  if(value.airPres.isValidFlag==1)
  {
    value.airPres.value = C2xGetTokenInt(packetHandle, "ProbeVehicleData", newPath);
    result = CheckLastError("ProbeVehicleData", gkFuncRefGet, result);
  }
  snprintf(newPath, elcount(newPath), "%s.%s", oldPath, "steering");
  value.steering.isValidFlag = C2xIsTokenAvailable(packetHandle, "ProbeVehicleData", newPath);
  if(value.steering.isValidFlag==1)
  {
    GetProbeVehicleData_VehicleStatus_steeringParams(packetHandle, value.steering, newPath);
    result = CheckLastError("ProbeVehicleData", gkFuncRefGet, result);
  }
  snprintf(newPath, elcount(newPath), "%s.%s", oldPath, "accelSets");
  value.accelSets.isValidFlag = C2xIsTokenAvailable(packetHandle, "ProbeVehicleData", newPath);
  if(value.accelSets.isValidFlag==1)
  {
    GetProbeVehicleData_VehicleStatus_accelSetsParams(packetHandle, value.accelSets, newPath);
    result = CheckLastError("ProbeVehicleData", gkFuncRefGet, result);
  }
  snprintf(newPath, elcount(newPath), "%s.%s", oldPath, "object");
  value.object.isValidFlag = C2xIsTokenAvailable(packetHandle, "ProbeVehicleData", newPath);
  if(value.object.isValidFlag==1)
  {
    GetProbeVehicleData_VehicleStatus_objectParams(packetHandle, value.object, newPath);
    result = CheckLastError("ProbeVehicleData", gkFuncRefGet, result);
  }
  snprintf(newPath, elcount(newPath), "%s.%s", oldPath, "fullPos");
  value.fullPos.isValidFlag = C2xIsTokenAvailable(packetHandle, "ProbeVehicleData", newPath);
  if(value.fullPos.isValidFlag==1)
  {
    GetProbeVehicleDataFullPositionVectorParams(packetHandle, value.fullPos, newPath);
    result = CheckLastError("ProbeVehicleData", gkFuncRefGet, result);
  }
  snprintf(newPath, elcount(newPath), "%s.%s", oldPath, "throttlePos");
  value.throttlePos.isValidFlag = C2xIsTokenAvailable(packetHandle, "ProbeVehicleData", newPath);
  if(value.throttlePos.isValidFlag==1)
  {
    value.throttlePos.value = C2xGetTokenInt(packetHandle, "ProbeVehicleData", newPath);
    result = CheckLastError("ProbeVehicleData", gkFuncRefGet, result);
  }
  snprintf(newPath, elcount(newPath), "%s.%s", oldPath, "speedHeadC");
  value.speedHeadC.isValidFlag = C2xIsTokenAvailable(packetHandle, "ProbeVehicleData", newPath);
  if(value.speedHeadC.isValidFlag==1)
  {
    GetProbeVehicleDataSpeedandHeadingandThrottleConfidenceParams(packetHandle, value.speedHeadC, newPath);
    result = CheckLastError("ProbeVehicleData", gkFuncRefGet, result);
  }
  snprintf(newPath, elcount(newPath), "%s.%s", oldPath, "speedC");
  value.speedC.isValidFlag = C2xIsTokenAvailable(packetHandle, "ProbeVehicleData", newPath);
  if(value.speedC.isValidFlag==1)
  {
    value.speedC.value = C2xGetTokenInt(packetHandle, "ProbeVehicleData", newPath);
    result = CheckLastError("ProbeVehicleData", gkFuncRefGet, result);
  }
  snprintf(newPath, elcount(newPath), "%s.%s", oldPath, "vehicleData");
  value.vehicleData.isValidFlag = C2xIsTokenAvailable(packetHandle, "ProbeVehicleData", newPath);
  if(value.vehicleData.isValidFlag==1)
  {
    GetProbeVehicleData_VehicleStatus_vehicleDataParams(packetHandle, value.vehicleData, newPath);
    result = CheckLastError("ProbeVehicleData", gkFuncRefGet, result);
  }
  snprintf(newPath, elcount(newPath), "%s.%s", oldPath, "vehicleIdent");
  value.vehicleIdent.isValidFlag = C2xIsTokenAvailable(packetHandle, "ProbeVehicleData", newPath);
  if(value.vehicleIdent.isValidFlag==1)
  {
    GetProbeVehicleDataVehicleIdentParams(packetHandle, value.vehicleIdent, newPath);
    result = CheckLastError("ProbeVehicleData", gkFuncRefGet, result);
  }
  snprintf(newPath, elcount(newPath), "%s.%s", oldPath, "j1939data");
  value.j1939data.isValidFlag = C2xIsTokenAvailable(packetHandle, "ProbeVehicleData", newPath);
  if(value.j1939data.isValidFlag==1)
  {
    GetProbeVehicleDataJ1939dataParams(packetHandle, value.j1939data, newPath);
    result = CheckLastError("ProbeVehicleData", gkFuncRefGet, result);
  }
  snprintf(newPath, elcount(newPath), "%s.%s", oldPath, "weatherReport");
  value.weatherReport.isValidFlag = C2xIsTokenAvailable(packetHandle, "ProbeVehicleData", newPath);
  if(value.weatherReport.isValidFlag==1)
  {
    GetProbeVehicleData_VehicleStatus_weatherReportParams(packetHandle, value.weatherReport, newPath);
    result = CheckLastError("ProbeVehicleData", gkFuncRefGet, result);
  }
  snprintf(newPath, elcount(newPath), "%s.%s", oldPath, "gnssStatus");
  value.gnssStatus.isValidFlag = C2xIsTokenAvailable(packetHandle, "ProbeVehicleData", newPath);
  if(value.gnssStatus.isValidFlag==1)
  {
    value.gnssStatus.isValidFlag = 1;
    value.gnssStatus.stringLength = C2xGetTokenLengthBit(packetHandle, "ProbeVehicleData", newPath);
    if ((result = CheckLastError("ProbeVehicleData", gkFuncRefGet, result))==0)
    {
      if(value.gnssStatus.stringLength > 0)
      {
        for(j=0; j<value.gnssStatus.stringLength; j++)
        {
          if(C2xGetTokenBitOfBitString(packetHandle, "ProbeVehicleData", newPath, j) == 0)
          {
            value.gnssStatus.string[j] = '0';
          }
          else if(C2xGetTokenBitOfBitString(packetHandle, "ProbeVehicleData", newPath, j) == 1)
          {
            value.gnssStatus.string[j] = '1';
          }

          if(value.gnssStatus.stringLength == 1)
          {
            value.gnssStatus.string[1] = '0';
          }
          result = CheckLastError("ProbeVehicleData", gkFuncRefGet, result);
        }
      }
      else
      {
        for(k = value.gnssStatus.stringLength+1; k > -1; k--)
        {
          if(value.gnssStatus.string[k] == '1')
          {
            value.gnssStatus.string[k] = '0';
          }
        }
      }
    }

  }
  return result;
}

int SetProbeVehicleDataVehicleStatusParams(LONG packetHandle, struct ProbeVehicleDataVehicleStatus value, char oldPath[])
{
  char newPath[300]; 
  int j;
  int result;

  result = 0;

  snprintf(newPath, elcount(newPath), "%s.%s", oldPath, "lights");
  if(value.lights.isValidFlag==1)
  {
      for(j=0; j<value.lights.stringLength; j++)
      {
        if(value.lights.string[j] == '0')
        {
          C2xSetTokenBitOfBitString(packetHandle, "ProbeVehicleData", newPath, j, 0);
        }
        else
        {
          C2xSetTokenBitOfBitString(packetHandle, "ProbeVehicleData", newPath, j, 1);
        }
        result = CheckLastError("ProbeVehicleData", gkFuncRefGet, result);
      }
  }
  else
  {
    if( C2xIsTokenAvailable(packetHandle, "ProbeVehicleData", newPath) )
    {
      C2xRemoveToken(packetHandle, "ProbeVehicleData", newPath);
    }
  }

  snprintf(newPath, elcount(newPath), "%s.%s", oldPath, "lightBar");
  if(value.lightBar.isValidFlag==1)
  {
    C2xSetTokenInt(packetHandle, "ProbeVehicleData", newPath, value.lightBar.value);
    result = CheckLastError("ProbeVehicleData", gkFuncRefGet, result);
  }
  else
  {
    if( C2xIsTokenAvailable(packetHandle, "ProbeVehicleData", newPath) )
    {
      C2xRemoveToken(packetHandle, "ProbeVehicleData", newPath);
    }
  }

  snprintf(newPath, elcount(newPath), "%s.%s", oldPath, "wipers");
  if(value.wipers.isValidFlag==1)
  {
    SetProbeVehicleDataWiperSetParams(packetHandle, value.wipers, newPath);
    result = CheckLastError("ProbeVehicleData", gkFuncRefGet, result);
  }
  else
  {
    if( C2xIsTokenAvailable(packetHandle, "ProbeVehicleData", newPath) )
    {
      C2xRemoveToken(packetHandle, "ProbeVehicleData", newPath);
    }
  }

  snprintf(newPath, elcount(newPath), "%s.%s", oldPath, "brakeStatus");
  if(value.brakeStatus.isValidFlag==1)
  {
    SetProbeVehicleDataBrakeSystemStatusParams(packetHandle, value.brakeStatus, newPath);
    result = CheckLastError("ProbeVehicleData", gkFuncRefGet, result);
  }
  else
  {
    if( C2xIsTokenAvailable(packetHandle, "ProbeVehicleData", newPath) )
    {
      C2xRemoveToken(packetHandle, "ProbeVehicleData", newPath);
    }
  }

  snprintf(newPath, elcount(newPath), "%s.%s", oldPath, "brakePressure");
  if(value.brakePressure.isValidFlag==1)
  {
    C2xSetTokenInt(packetHandle, "ProbeVehicleData", newPath, value.brakePressure.value);
    result = CheckLastError("ProbeVehicleData", gkFuncRefGet, result);
  }
  else
  {
    if( C2xIsTokenAvailable(packetHandle, "ProbeVehicleData", newPath) )
    {
      C2xRemoveToken(packetHandle, "ProbeVehicleData", newPath);
    }
  }

  snprintf(newPath, elcount(newPath), "%s.%s", oldPath, "roadFriction");
  if(value.roadFriction.isValidFlag==1)
  {
    C2xSetTokenInt(packetHandle, "ProbeVehicleData", newPath, value.roadFriction.value);
    result = CheckLastError("ProbeVehicleData", gkFuncRefGet, result);
  }
  else
  {
    if( C2xIsTokenAvailable(packetHandle, "ProbeVehicleData", newPath) )
    {
      C2xRemoveToken(packetHandle, "ProbeVehicleData", newPath);
    }
  }

  snprintf(newPath, elcount(newPath), "%s.%s", oldPath, "sunData");
  if(value.sunData.isValidFlag==1)
  {
    C2xSetTokenInt(packetHandle, "ProbeVehicleData", newPath, value.sunData.value);
    result = CheckLastError("ProbeVehicleData", gkFuncRefGet, result);
  }
  else
  {
    if( C2xIsTokenAvailable(packetHandle, "ProbeVehicleData", newPath) )
    {
      C2xRemoveToken(packetHandle, "ProbeVehicleData", newPath);
    }
  }

  snprintf(newPath, elcount(newPath), "%s.%s", oldPath, "rainData");
  if(value.rainData.isValidFlag==1)
  {
    C2xSetTokenInt(packetHandle, "ProbeVehicleData", newPath, value.rainData.value);
    result = CheckLastError("ProbeVehicleData", gkFuncRefGet, result);
  }
  else
  {
    if( C2xIsTokenAvailable(packetHandle, "ProbeVehicleData", newPath) )
    {
      C2xRemoveToken(packetHandle, "ProbeVehicleData", newPath);
    }
  }

  snprintf(newPath, elcount(newPath), "%s.%s", oldPath, "airTemp");
  if(value.airTemp.isValidFlag==1)
  {
    C2xSetTokenInt(packetHandle, "ProbeVehicleData", newPath, value.airTemp.value);
    result = CheckLastError("ProbeVehicleData", gkFuncRefGet, result);
  }
  else
  {
    if( C2xIsTokenAvailable(packetHandle, "ProbeVehicleData", newPath) )
    {
      C2xRemoveToken(packetHandle, "ProbeVehicleData", newPath);
    }
  }

  snprintf(newPath, elcount(newPath), "%s.%s", oldPath, "airPres");
  if(value.airPres.isValidFlag==1)
  {
    C2xSetTokenInt(packetHandle, "ProbeVehicleData", newPath, value.airPres.value);
    result = CheckLastError("ProbeVehicleData", gkFuncRefGet, result);
  }
  else
  {
    if( C2xIsTokenAvailable(packetHandle, "ProbeVehicleData", newPath) )
    {
      C2xRemoveToken(packetHandle, "ProbeVehicleData", newPath);
    }
  }

  snprintf(newPath, elcount(newPath), "%s.%s", oldPath, "steering");
  if(value.steering.isValidFlag==1)
  {
    SetProbeVehicleData_VehicleStatus_steeringParams(packetHandle, value.steering, newPath);
    result = CheckLastError("ProbeVehicleData", gkFuncRefGet, result);
  }
  else
  {
    if( C2xIsTokenAvailable(packetHandle, "ProbeVehicleData", newPath) )
    {
      C2xRemoveToken(packetHandle, "ProbeVehicleData", newPath);
    }
  }

  snprintf(newPath, elcount(newPath), "%s.%s", oldPath, "accelSets");
  if(value.accelSets.isValidFlag==1)
  {
    SetProbeVehicleData_VehicleStatus_accelSetsParams(packetHandle, value.accelSets, newPath);
    result = CheckLastError("ProbeVehicleData", gkFuncRefGet, result);
  }
  else
  {
    if( C2xIsTokenAvailable(packetHandle, "ProbeVehicleData", newPath) )
    {
      C2xRemoveToken(packetHandle, "ProbeVehicleData", newPath);
    }
  }

  snprintf(newPath, elcount(newPath), "%s.%s", oldPath, "object");
  if(value.object.isValidFlag==1)
  {
    SetProbeVehicleData_VehicleStatus_objectParams(packetHandle, value.object, newPath);
    result = CheckLastError("ProbeVehicleData", gkFuncRefGet, result);
  }
  else
  {
    if( C2xIsTokenAvailable(packetHandle, "ProbeVehicleData", newPath) )
    {
      C2xRemoveToken(packetHandle, "ProbeVehicleData", newPath);
    }
  }

  snprintf(newPath, elcount(newPath), "%s.%s", oldPath, "fullPos");
  if(value.fullPos.isValidFlag==1)
  {
    SetProbeVehicleDataFullPositionVectorParams(packetHandle, value.fullPos, newPath);
    result = CheckLastError("ProbeVehicleData", gkFuncRefGet, result);
  }
  else
  {
    if( C2xIsTokenAvailable(packetHandle, "ProbeVehicleData", newPath) )
    {
      C2xRemoveToken(packetHandle, "ProbeVehicleData", newPath);
    }
  }

  snprintf(newPath, elcount(newPath), "%s.%s", oldPath, "throttlePos");
  if(value.throttlePos.isValidFlag==1)
  {
    C2xSetTokenInt(packetHandle, "ProbeVehicleData", newPath, value.throttlePos.value);
    result = CheckLastError("ProbeVehicleData", gkFuncRefGet, result);
  }
  else
  {
    if( C2xIsTokenAvailable(packetHandle, "ProbeVehicleData", newPath) )
    {
      C2xRemoveToken(packetHandle, "ProbeVehicleData", newPath);
    }
  }

  snprintf(newPath, elcount(newPath), "%s.%s", oldPath, "speedHeadC");
  if(value.speedHeadC.isValidFlag==1)
  {
    SetProbeVehicleDataSpeedandHeadingandThrottleConfidenceParams(packetHandle, value.speedHeadC, newPath);
    result = CheckLastError("ProbeVehicleData", gkFuncRefGet, result);
  }
  else
  {
    if( C2xIsTokenAvailable(packetHandle, "ProbeVehicleData", newPath) )
    {
      C2xRemoveToken(packetHandle, "ProbeVehicleData", newPath);
    }
  }

  snprintf(newPath, elcount(newPath), "%s.%s", oldPath, "speedC");
  if(value.speedC.isValidFlag==1)
  {
    C2xSetTokenInt(packetHandle, "ProbeVehicleData", newPath, value.speedC.value);
    result = CheckLastError("ProbeVehicleData", gkFuncRefGet, result);
  }
  else
  {
    if( C2xIsTokenAvailable(packetHandle, "ProbeVehicleData", newPath) )
    {
      C2xRemoveToken(packetHandle, "ProbeVehicleData", newPath);
    }
  }

  snprintf(newPath, elcount(newPath), "%s.%s", oldPath, "vehicleData");
  if(value.vehicleData.isValidFlag==1)
  {
    SetProbeVehicleData_VehicleStatus_vehicleDataParams(packetHandle, value.vehicleData, newPath);
    result = CheckLastError("ProbeVehicleData", gkFuncRefGet, result);
  }
  else
  {
    if( C2xIsTokenAvailable(packetHandle, "ProbeVehicleData", newPath) )
    {
      C2xRemoveToken(packetHandle, "ProbeVehicleData", newPath);
    }
  }

  snprintf(newPath, elcount(newPath), "%s.%s", oldPath, "vehicleIdent");
  if(value.vehicleIdent.isValidFlag==1)
  {
    SetProbeVehicleDataVehicleIdentParams(packetHandle, value.vehicleIdent, newPath);
    result = CheckLastError("ProbeVehicleData", gkFuncRefGet, result);
  }
  else
  {
    if( C2xIsTokenAvailable(packetHandle, "ProbeVehicleData", newPath) )
    {
      C2xRemoveToken(packetHandle, "ProbeVehicleData", newPath);
    }
  }

  snprintf(newPath, elcount(newPath), "%s.%s", oldPath, "j1939data");
  if(value.j1939data.isValidFlag==1)
  {
    SetProbeVehicleDataJ1939dataParams(packetHandle, value.j1939data, newPath);
    result = CheckLastError("ProbeVehicleData", gkFuncRefGet, result);
  }
  else
  {
    if( C2xIsTokenAvailable(packetHandle, "ProbeVehicleData", newPath) )
    {
      C2xRemoveToken(packetHandle, "ProbeVehicleData", newPath);
    }
  }

  snprintf(newPath, elcount(newPath), "%s.%s", oldPath, "weatherReport");
  if(value.weatherReport.isValidFlag==1)
  {
    SetProbeVehicleData_VehicleStatus_weatherReportParams(packetHandle, value.weatherReport, newPath);
    result = CheckLastError("ProbeVehicleData", gkFuncRefGet, result);
  }
  else
  {
    if( C2xIsTokenAvailable(packetHandle, "ProbeVehicleData", newPath) )
    {
      C2xRemoveToken(packetHandle, "ProbeVehicleData", newPath);
    }
  }

  snprintf(newPath, elcount(newPath), "%s.%s", oldPath, "gnssStatus");
  if(value.gnssStatus.isValidFlag==1)
  {
      for(j=0; j<value.gnssStatus.stringLength; j++)
      {
        if(value.gnssStatus.string[j] == '0')
        {
          C2xSetTokenBitOfBitString(packetHandle, "ProbeVehicleData", newPath, j, 0);
        }
        else
        {
          C2xSetTokenBitOfBitString(packetHandle, "ProbeVehicleData", newPath, j, 1);
        }
        result = CheckLastError("ProbeVehicleData", gkFuncRefGet, result);
      }
  }
  else
  {
    if( C2xIsTokenAvailable(packetHandle, "ProbeVehicleData", newPath) )
    {
      C2xRemoveToken(packetHandle, "ProbeVehicleData", newPath);
    }
  }

  return result;
}

int GetProbeVehicleDataSnapshotParams(LONG packetHandle, struct ProbeVehicleDataSnapshot value, char oldPath[])
{
  char newPath[300];
  int result;

  result = 0;

  snprintf(newPath, elcount(newPath), "%s.%s", oldPath, "thePosition");
  GetProbeVehicleDataFullPositionVectorParams(packetHandle, value.thePosition, newPath);
  result = CheckLastError("ProbeVehicleData", gkFuncRefGet, result);

  snprintf(newPath, elcount(newPath), "%s.%s", oldPath, "safetyExt");
  value.safetyExt.isValidFlag = C2xIsTokenAvailable(packetHandle, "ProbeVehicleData", newPath);
  if(value.safetyExt.isValidFlag==1)
  {
    GetProbeVehicleDataVehicleSafetyExtensionsParams(packetHandle, value.safetyExt, newPath);
    result = CheckLastError("ProbeVehicleData", gkFuncRefGet, result);
  }
  snprintf(newPath, elcount(newPath), "%s.%s", oldPath, "dataSet");
  value.dataSet.isValidFlag = C2xIsTokenAvailable(packetHandle, "ProbeVehicleData", newPath);
  if(value.dataSet.isValidFlag==1)
  {
    GetProbeVehicleDataVehicleStatusParams(packetHandle, value.dataSet, newPath);
    result = CheckLastError("ProbeVehicleData", gkFuncRefGet, result);
  }
  return result;
}

int SetProbeVehicleDataSnapshotParams(LONG packetHandle, struct ProbeVehicleDataSnapshot value, char oldPath[])
{
  char newPath[300];
  int result;

  result = 0;

  snprintf(newPath, elcount(newPath), "%s.%s", oldPath, "thePosition");
  SetProbeVehicleDataFullPositionVectorParams(packetHandle, value.thePosition, newPath);
  result = CheckLastError("ProbeVehicleData", gkFuncRefGet, result);

  snprintf(newPath, elcount(newPath), "%s.%s", oldPath, "safetyExt");
  if(value.safetyExt.isValidFlag==1)
  {
    SetProbeVehicleDataVehicleSafetyExtensionsParams(packetHandle, value.safetyExt, newPath);
    result = CheckLastError("ProbeVehicleData", gkFuncRefGet, result);
  }
  else
  {
    if( C2xIsTokenAvailable(packetHandle, "ProbeVehicleData", newPath) )
    {
      C2xRemoveToken(packetHandle, "ProbeVehicleData", newPath);
    }
  }

  snprintf(newPath, elcount(newPath), "%s.%s", oldPath, "dataSet");
  if(value.dataSet.isValidFlag==1)
  {
    SetProbeVehicleDataVehicleStatusParams(packetHandle, value.dataSet, newPath);
    result = CheckLastError("ProbeVehicleData", gkFuncRefGet, result);
  }
  else
  {
    if( C2xIsTokenAvailable(packetHandle, "ProbeVehicleData", newPath) )
    {
      C2xRemoveToken(packetHandle, "ProbeVehicleData", newPath);
    }
  }

  return result;
}

int GetProbeVehicleData_ProbeVehicleData_snapshotsParams(LONG packetHandle, struct ProbeVehicleData_ProbeVehicleData_snapshots value, char oldPath[])
{
  char newPath[300]; 
  int i;
  int result;

  result = 0;

  value.length = C2xGetTokenInt(packetHandle, "ProbeVehicleData", oldPath);
  if((result = CheckLastError("ProbeVehicleData", gkFuncRefGet, result))==0)
  {
    for(i=0; i<value.length; i++)
    {
      snprintf(newPath, elcount(newPath), "%s[%d]", oldPath, i);
      GetProbeVehicleDataSnapshotParams(packetHandle, value.arrayValue[i], newPath);
      result = CheckLastError("ProbeVehicleData", gkFuncRefGet, result);
    }
  }
  return result;
}

int SetProbeVehicleData_ProbeVehicleData_snapshotsParams(LONG packetHandle, struct ProbeVehicleData_ProbeVehicleData_snapshots value, char oldPath[])
{
  char newPath[300]; 
  int i;
  int result;

  result = 0;

  C2xRemoveToken(packetHandle, "ProbeVehicleData", oldPath);
  for(i=0; i<value.length; i++)
  {
    snprintf(newPath, elcount(newPath), "%s[%d]", oldPath, i);
    SetProbeVehicleDataSnapshotParams(packetHandle, value.arrayValue[i], newPath);
    result = CheckLastError("ProbeVehicleData", gkFuncRefGet, result);
  }
  return result;
}

int GetProbeVehicleDataRegionalExtensionProbeVehicleDataParams(LONG packetHandle, struct ProbeVehicleDataRegionalExtensionProbeVehicleData value, char oldPath[])
{
  char newPath[300];
  int result;

  result = 0;

  snprintf(newPath, elcount(newPath), "%s.%s", oldPath, "regionId");
  value.regionId = C2xGetTokenInt(packetHandle, "ProbeVehicleData", newPath);
  result = CheckLastError("ProbeVehicleData", gkFuncRefGet, result);

  return result;
}

int SetProbeVehicleDataRegionalExtensionProbeVehicleDataParams(LONG packetHandle, struct ProbeVehicleDataRegionalExtensionProbeVehicleData value, char oldPath[])
{
  char newPath[300];
  int result;

  result = 0;


  return result;
}

int GetProbeVehicleData_ProbeVehicleData_regionalParams(LONG packetHandle, struct ProbeVehicleData_ProbeVehicleData_regional value, char oldPath[])
{
  char newPath[300]; 
  int i;
  int result;

  result = 0;

  value.length = C2xGetTokenInt(packetHandle, "ProbeVehicleData", oldPath);
  if((result = CheckLastError("ProbeVehicleData", gkFuncRefGet, result))==0)
  {
    for(i=0; i<value.length; i++)
    {
      snprintf(newPath, elcount(newPath), "%s[%d]", oldPath, i);
      GetProbeVehicleDataRegionalExtensionProbeVehicleDataParams(packetHandle, value.arrayValue[i], newPath);
      result = CheckLastError("ProbeVehicleData", gkFuncRefGet, result);
    }
  }
  return result;
}

int SetProbeVehicleData_ProbeVehicleData_regionalParams(LONG packetHandle, struct ProbeVehicleData_ProbeVehicleData_regional value, char oldPath[])
{
  char newPath[300]; 
  int i;
  int result;

  result = 0;

  C2xRemoveToken(packetHandle, "ProbeVehicleData", oldPath);
  for(i=0; i<value.length; i++)
  {
    snprintf(newPath, elcount(newPath), "%s[%d]", oldPath, i);
    SetProbeVehicleDataRegionalExtensionProbeVehicleDataParams(packetHandle, value.arrayValue[i], newPath);
    result = CheckLastError("ProbeVehicleData", gkFuncRefGet, result);
  }
  return result;
}

int GetProbeVehicleDataPVDParams(LONG packetHandle, struct ProbeVehicleDataPVD value, char oldPath[])
{
  char newPath[300];
  int result;

  result = 0;

  snprintf(newPath, elcount(newPath), "%s.%s", oldPath, "timeStamp");
  value.timeStamp.isValidFlag = C2xIsTokenAvailable(packetHandle, "ProbeVehicleData", newPath);
  if(value.timeStamp.isValidFlag==1)
  {
    value.timeStamp.value = C2xGetTokenInt(packetHandle, "ProbeVehicleData", newPath);
    result = CheckLastError("ProbeVehicleData", gkFuncRefGet, result);
  }
  snprintf(newPath, elcount(newPath), "%s.%s", oldPath, "segNum");
  value.segNum.isValidFlag = C2xIsTokenAvailable(packetHandle, "ProbeVehicleData", newPath);
  if(value.segNum.isValidFlag==1)
  {
    value.segNum.value = C2xGetTokenInt(packetHandle, "ProbeVehicleData", newPath);
    result = CheckLastError("ProbeVehicleData", gkFuncRefGet, result);
  }
  snprintf(newPath, elcount(newPath), "%s.%s", oldPath, "probeID");
  value.probeID.isValidFlag = C2xIsTokenAvailable(packetHandle, "ProbeVehicleData", newPath);
  if(value.probeID.isValidFlag==1)
  {
    GetProbeVehicleDataVehicleIdentParams(packetHandle, value.probeID, newPath);
    result = CheckLastError("ProbeVehicleData", gkFuncRefGet, result);
  }
  snprintf(newPath, elcount(newPath), "%s.%s", oldPath, "startVector");
  GetProbeVehicleDataFullPositionVectorParams(packetHandle, value.startVector, newPath);
  result = CheckLastError("ProbeVehicleData", gkFuncRefGet, result);

  snprintf(newPath, elcount(newPath), "%s.%s", oldPath, "vehicleType");
  GetProbeVehicleDataVehicleClassificationParams(packetHandle, value.vehicleType, newPath);
  result = CheckLastError("ProbeVehicleData", gkFuncRefGet, result);

  snprintf(newPath, elcount(newPath), "%s.%s", oldPath, "snapshots");
  GetProbeVehicleData_ProbeVehicleData_snapshotsParams(packetHandle, value.snapshots, newPath);
  result = CheckLastError("ProbeVehicleData", gkFuncRefGet, result);

  snprintf(newPath, elcount(newPath), "%s.%s", oldPath, "regional");
  value.regional.isValidFlag = C2xIsTokenAvailable(packetHandle, "ProbeVehicleData", newPath);
  if(value.regional.isValidFlag==1)
  {
    GetProbeVehicleData_ProbeVehicleData_regionalParams(packetHandle, value.regional, newPath);
    result = CheckLastError("ProbeVehicleData", gkFuncRefGet, result);
  }
  return result;
}

int SetProbeVehicleDataPVDParams(LONG packetHandle, struct ProbeVehicleDataPVD value, char oldPath[])
{
  char newPath[300];
  int result;

  result = 0;

  snprintf(newPath, elcount(newPath), "%s.%s", oldPath, "timeStamp");
  if(value.timeStamp.isValidFlag==1)
  {
    C2xSetTokenInt(packetHandle, "ProbeVehicleData", newPath, value.timeStamp.value);
    result = CheckLastError("ProbeVehicleData", gkFuncRefGet, result);
  }
  else
  {
    if( C2xIsTokenAvailable(packetHandle, "ProbeVehicleData", newPath) )
    {
      C2xRemoveToken(packetHandle, "ProbeVehicleData", newPath);
    }
  }

  snprintf(newPath, elcount(newPath), "%s.%s", oldPath, "segNum");
  if(value.segNum.isValidFlag==1)
  {
    C2xSetTokenInt(packetHandle, "ProbeVehicleData", newPath, value.segNum.value);
    result = CheckLastError("ProbeVehicleData", gkFuncRefGet, result);
  }
  else
  {
    if( C2xIsTokenAvailable(packetHandle, "ProbeVehicleData", newPath) )
    {
      C2xRemoveToken(packetHandle, "ProbeVehicleData", newPath);
    }
  }

  snprintf(newPath, elcount(newPath), "%s.%s", oldPath, "probeID");
  if(value.probeID.isValidFlag==1)
  {
    SetProbeVehicleDataVehicleIdentParams(packetHandle, value.probeID, newPath);
    result = CheckLastError("ProbeVehicleData", gkFuncRefGet, result);
  }
  else
  {
    if( C2xIsTokenAvailable(packetHandle, "ProbeVehicleData", newPath) )
    {
      C2xRemoveToken(packetHandle, "ProbeVehicleData", newPath);
    }
  }

  snprintf(newPath, elcount(newPath), "%s.%s", oldPath, "startVector");
  SetProbeVehicleDataFullPositionVectorParams(packetHandle, value.startVector, newPath);
  result = CheckLastError("ProbeVehicleData", gkFuncRefGet, result);

  snprintf(newPath, elcount(newPath), "%s.%s", oldPath, "vehicleType");
  SetProbeVehicleDataVehicleClassificationParams(packetHandle, value.vehicleType, newPath);
  result = CheckLastError("ProbeVehicleData", gkFuncRefGet, result);

  snprintf(newPath, elcount(newPath), "%s.%s", oldPath, "snapshots");
  SetProbeVehicleData_ProbeVehicleData_snapshotsParams(packetHandle, value.snapshots, newPath);
  result = CheckLastError("ProbeVehicleData", gkFuncRefGet, result);

  snprintf(newPath, elcount(newPath), "%s.%s", oldPath, "regional");
  if(value.regional.isValidFlag==1)
  {
    SetProbeVehicleData_ProbeVehicleData_regionalParams(packetHandle, value.regional, newPath);
    result = CheckLastError("ProbeVehicleData", gkFuncRefGet, result);
  }
  else
  {
    if( C2xIsTokenAvailable(packetHandle, "ProbeVehicleData", newPath) )
    {
      C2xRemoveToken(packetHandle, "ProbeVehicleData", newPath);
    }
  }

  return result;
}

int GetProbeVehicleDataMESSAGE_ID_AND_TYPEParams(LONG packetHandle, WORD tableKey, struct ProbeVehicleDataMESSAGE_ID_AND_TYPE value, char oldPath[])
{
  char newPath[300];
  int result;

  result = 0;

  switch(tableKey)
  {
    case 26:
    {
      snprintf(newPath, elcount(newPath), "%s.%s", oldPath, "probeVehicleData");
      GetProbeVehicleDataPVDParams(packetHandle, value.probeVehicleData, newPath);
      result = CheckLastError("ProbeVehicleData", gkFuncRefGet, result);
    }
    break;
  }
  return result;
}

int SetProbeVehicleDataMESSAGE_ID_AND_TYPEParams(LONG packetHandle, WORD tableKey, struct ProbeVehicleDataMESSAGE_ID_AND_TYPE value, char oldPath[])
{
  char newPath[300];
  int result;

  result = 0;

  switch(tableKey)
  {
    case 26:
    {
      snprintf(newPath, elcount(newPath), "%s.%s", oldPath, "probeVehicleData");
      SetProbeVehicleDataPVDParams(packetHandle, value.probeVehicleData, newPath);
      result = CheckLastError("ProbeVehicleData", gkFuncRefGet, result);
    }
    break;
  }
  return result;
}

int API_GetProbeVehicleDataParams(LONG packetHandle, struct ProbeVehicleData value)
{
  int result;
  result = 0;

  value.messageId = C2xGetTokenInt(packetHandle, "ProbeVehicleData", "messageId");
  result = CheckLastError("ProbeVehicleData", gkFuncRefGet, result);

  GetProbeVehicleDataMESSAGE_ID_AND_TYPEParams(packetHandle, value.messageId, value.value, "value");
  result = CheckLastError("ProbeVehicleData", gkFuncRefGet, result);

  return result;
}

int API_SetProbeVehicleDataParams(LONG packetHandle, struct ProbeVehicleData value)
{
  int result;
  result = 0;

  value.messageId = 26;

  SetProbeVehicleDataMESSAGE_ID_AND_TYPEParams(packetHandle, value.messageId, value.value, "value");
  result = CheckLastError("ProbeVehicleData", gkFuncRefGet, result);

  return result;
}

