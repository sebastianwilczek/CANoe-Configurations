/*@!Encoding:1252*/
/*
//  (c) Vector Informatik GmbH. All rights reserved.
//
//  This file contains definitions of structs and methods that may be used
//  to set and get the values of an ASN.1 defined packet's payload.
//
//  //This example demonstrates how to set a packet's payload:
//  LONG packetHandle;
//  struct NMEA_Corrections payload;
//  //you need to set the values of the variable "payload" yourself
//  packetHandle = API_InitNMEA_CorrectionsPacket();
//  if (packetHandle!=0) {
//    if (API_SetNMEA_CorrectionsParams(packetHandle, payload)==0) {
//      if (C2xCompletePacket(packetHandle)==0) {
//        C2xOutputPacket(packetHandle);
//      }
//    }
//  }
//                                                                             */
includes
{

}
variables
{
    struct NMEA_CorrectionsNMEA_Payload {
        INT isValidFlag;   // necessary if this struct is used as an optional field of a SEQUENCE
        CHAR string[1024];
        INT  stringLength;
    };
    
    struct NMEA_CorrectionsREG_EXT_ID_AND_TYPE_Empty {
    };
    
    struct NMEA_CorrectionsRegionalExtensionNMEAcorrections {
        INT isValidFlag;   // necessary if this struct is used as an optional field of a SEQUENCE
        BYTE regionId;  // INTEGER, 0..255, noRegion(0), addGrpA(1), addGrpB(2), addGrpC(3);
        struct NMEA_CorrectionsREG_EXT_ID_AND_TYPE_Empty regExtValue;  // TABLE;
    };
    
    struct NMEA_Corrections_NMEAcorrections_regional {
        INT isValidFlag;   // necessary if this struct is used as an optional field of a SEQUENCE
        INT length;
        struct NMEA_CorrectionsRegionalExtensionNMEAcorrections arrayValue[4];  // SEQUENCE;
    };
    
    struct NMEA_CorrectionsNMEAcorrections {
        INT isValidFlag;   // necessary if this struct is used as an optional field of a SEQUENCE
        struct OPT_DWORD_ASN timeStamp;  // INTEGER, OPTIONAL, 0..527040;
        struct OPT_ENUM_ASN rev;  // ENUMERATED, OPTIONAL, unknown(0), reserved(1), rev1(2), rev2(3), rev3(4), rev4(5), rev5(6);
        struct OPT_WORD_ASN msg;  // INTEGER, OPTIONAL, 0..32767;
        struct OPT_WORD_ASN wdCount;  // INTEGER, OPTIONAL, 0..1023;
        struct NMEA_CorrectionsNMEA_Payload payload;  // OCTETSTRING;
        struct NMEA_Corrections_NMEAcorrections_regional regional;  // SEQUENCEOF, OPTIONAL;
    };
    
    struct NMEA_CorrectionsMESSAGE_ID_AND_TYPE {
        struct NMEA_CorrectionsNMEAcorrections nmeaCorrections;  // SEQUENCE;
    };
    
    struct NMEA_Corrections {
        INT isValidFlag;   // necessary if this struct is used as an optional field of a SEQUENCE
        WORD messageId;  // INTEGER, 0..32767, reservedMessageId_D(0), alaCarteMessage_D(1), basicSafetyMessage_D(2), basicSafetyMessageVerbose_D(3), commonSafetyRequest_D(4), emergencyVehicleAlert_D(5), intersectionCollision_D(6), mapData_D(7), nmeaCorrections_D(8), probeDataManagement_D(9), probeVehicleData_D(10), roadSideAlert_D(11), rtcmCorrections_D(12), signalPhaseAndTimingMessage_D(13), signalRequestMessage_D(14), signalStatusMessage_D(15), travelerInformation_D(16), uperFrame_D(17), mapData(18), signalPhaseAndTimingMessage(19), basicSafetyMessage(20), commonSafetyRequest(21), emergencyVehicleAlert(22), intersectionCollision(23), nmeaCorrections(24), probeDataManagement(25), probeVehicleData(26), roadSideAlert(27), rtcmCorrections(28), signalRequestMessage(29), signalStatusMessage(30), travelerInformation(31), personalSafetyMessage(32), testMessage00(240), testMessage01(241), testMessage02(242), testMessage03(243), testMessage04(244), testMessage05(245), testMessage06(246), testMessage07(247), testMessage08(248), testMessage09(249), testMessage10(250), testMessage11(251), testMessage12(252), testMessage13(253), testMessage14(254), testMessage15(255);
        struct NMEA_CorrectionsMESSAGE_ID_AND_TYPE value;  // TABLE;
    };
    
}

/*
// init function to create a simple packet handle
*/ 
LONG API_InitNMEA_CorrectionsPacket()
{
  return C2xInitPacket("NMEA_Corrections"); 
}

/*
// init function to create a simple packet handle and
// initialize the struct with valid data
*/ 
LONG API_InitNMEA_CorrectionsPacket(struct NMEA_Corrections msgStruct)
{
  long pktHandle;

  pktHandle = API_InitNMEA_CorrectionsPacket();

  if (pktHandle != 0)
  {
    // create valid message and application data
    if (C2xCompletePacket(pktHandle) == 0) 
    {
      API_GetNMEA_CorrectionsParams(pktHandle, msgStruct);
    }
  }
  return pktHandle;
}

/*
// init function to create a packet with security layer and
// initialize the struct with valid data
*/ 
LONG API_InitNMEA_CorrectionsPacket(struct NMEA_Corrections msgStruct, char packetTypeDesignator[], char certificateName[])
{
  long pktHandle, certHdl;

  // initialize the packet
  pktHandle = C2xInitPacket("NMEA_Corrections", packetTypeDesignator);

  if (pktHandle != 0)
  {
    certHdl = C2xSecCertificateGetHandle(certificateName);  // get the certificate handle for the cert with name "certificateName"
    if (certHdl != 0) 
    {
      C2xSecPacketSetSignerHandle(pktHandle, certHdl); // set the certHdl to the packet
    }

    // create valid message and application data
    if (C2xCompletePacket(pktHandle) == 0) 
    {
      // copy application data to the application structure
      API_GetNMEA_CorrectionsParams(pktHandle, msgStruct);
    }
  }
  return pktHandle;
}
    

int GetNMEA_CorrectionsRegionalExtensionNMEAcorrectionsParams(LONG packetHandle, struct NMEA_CorrectionsRegionalExtensionNMEAcorrections value, char oldPath[])
{
  char newPath[300];
  int result;

  result = 0;

  snprintf(newPath, elcount(newPath), "%s.%s", oldPath, "regionId");
  value.regionId = C2xGetTokenInt(packetHandle, "NMEA_Corrections", newPath);
  result = CheckLastError("NMEA_Corrections", gkFuncRefGet, result);

  return result;
}

int SetNMEA_CorrectionsRegionalExtensionNMEAcorrectionsParams(LONG packetHandle, struct NMEA_CorrectionsRegionalExtensionNMEAcorrections value, char oldPath[])
{
  char newPath[300];
  int result;

  result = 0;


  return result;
}

int GetNMEA_Corrections_NMEAcorrections_regionalParams(LONG packetHandle, struct NMEA_Corrections_NMEAcorrections_regional value, char oldPath[])
{
  char newPath[300]; 
  int i;
  int result;

  result = 0;

  value.length = C2xGetTokenInt(packetHandle, "NMEA_Corrections", oldPath);
  if((result = CheckLastError("NMEA_Corrections", gkFuncRefGet, result))==0)
  {
    for(i=0; i<value.length; i++)
    {
      snprintf(newPath, elcount(newPath), "%s[%d]", oldPath, i);
      GetNMEA_CorrectionsRegionalExtensionNMEAcorrectionsParams(packetHandle, value.arrayValue[i], newPath);
      result = CheckLastError("NMEA_Corrections", gkFuncRefGet, result);
    }
  }
  return result;
}

int SetNMEA_Corrections_NMEAcorrections_regionalParams(LONG packetHandle, struct NMEA_Corrections_NMEAcorrections_regional value, char oldPath[])
{
  char newPath[300]; 
  int i;
  int result;

  result = 0;

  C2xRemoveToken(packetHandle, "NMEA_Corrections", oldPath);
  for(i=0; i<value.length; i++)
  {
    snprintf(newPath, elcount(newPath), "%s[%d]", oldPath, i);
    SetNMEA_CorrectionsRegionalExtensionNMEAcorrectionsParams(packetHandle, value.arrayValue[i], newPath);
    result = CheckLastError("NMEA_Corrections", gkFuncRefGet, result);
  }
  return result;
}

int GetNMEA_CorrectionsNMEAcorrectionsParams(LONG packetHandle, struct NMEA_CorrectionsNMEAcorrections value, char oldPath[])
{
  char newPath[300];
  int result;

  result = 0;

  snprintf(newPath, elcount(newPath), "%s.%s", oldPath, "timeStamp");
  value.timeStamp.isValidFlag = C2xIsTokenAvailable(packetHandle, "NMEA_Corrections", newPath);
  if(value.timeStamp.isValidFlag==1)
  {
    value.timeStamp.value = C2xGetTokenInt(packetHandle, "NMEA_Corrections", newPath);
    result = CheckLastError("NMEA_Corrections", gkFuncRefGet, result);
  }
  snprintf(newPath, elcount(newPath), "%s.%s", oldPath, "rev");
  value.rev.isValidFlag = C2xIsTokenAvailable(packetHandle, "NMEA_Corrections", newPath);
  if(value.rev.isValidFlag==1)
  {
    value.rev.value = C2xGetTokenInt(packetHandle, "NMEA_Corrections", newPath);
    result = CheckLastError("NMEA_Corrections", gkFuncRefGet, result);
  }
  snprintf(newPath, elcount(newPath), "%s.%s", oldPath, "msg");
  value.msg.isValidFlag = C2xIsTokenAvailable(packetHandle, "NMEA_Corrections", newPath);
  if(value.msg.isValidFlag==1)
  {
    value.msg.value = C2xGetTokenInt(packetHandle, "NMEA_Corrections", newPath);
    result = CheckLastError("NMEA_Corrections", gkFuncRefGet, result);
  }
  snprintf(newPath, elcount(newPath), "%s.%s", oldPath, "wdCount");
  value.wdCount.isValidFlag = C2xIsTokenAvailable(packetHandle, "NMEA_Corrections", newPath);
  if(value.wdCount.isValidFlag==1)
  {
    value.wdCount.value = C2xGetTokenInt(packetHandle, "NMEA_Corrections", newPath);
    result = CheckLastError("NMEA_Corrections", gkFuncRefGet, result);
  }
  snprintf(newPath, elcount(newPath), "%s.%s", oldPath, "payload");
  value.payload.stringLength = C2xGetTokenData(packetHandle, "NMEA_Corrections", newPath, elcount(value.payload.string), value.payload.string);
  snprintf(newPath, elcount(newPath), "%s.%s", oldPath, "regional");
  value.regional.isValidFlag = C2xIsTokenAvailable(packetHandle, "NMEA_Corrections", newPath);
  if(value.regional.isValidFlag==1)
  {
    GetNMEA_Corrections_NMEAcorrections_regionalParams(packetHandle, value.regional, newPath);
    result = CheckLastError("NMEA_Corrections", gkFuncRefGet, result);
  }
  return result;
}

int SetNMEA_CorrectionsNMEAcorrectionsParams(LONG packetHandle, struct NMEA_CorrectionsNMEAcorrections value, char oldPath[])
{
  char newPath[300];
  int result;

  result = 0;

  snprintf(newPath, elcount(newPath), "%s.%s", oldPath, "timeStamp");
  if(value.timeStamp.isValidFlag==1)
  {
    C2xSetTokenInt(packetHandle, "NMEA_Corrections", newPath, value.timeStamp.value);
    result = CheckLastError("NMEA_Corrections", gkFuncRefGet, result);
  }
  else
  {
    if( C2xIsTokenAvailable(packetHandle, "NMEA_Corrections", newPath) )
    {
      C2xRemoveToken(packetHandle, "NMEA_Corrections", newPath);
    }
  }

  snprintf(newPath, elcount(newPath), "%s.%s", oldPath, "rev");
  if(value.rev.isValidFlag==1)
  {
    C2xSetTokenInt(packetHandle, "NMEA_Corrections", newPath, value.rev.value);
    result = CheckLastError("NMEA_Corrections", gkFuncRefGet, result);
  }
  else
  {
    if( C2xIsTokenAvailable(packetHandle, "NMEA_Corrections", newPath) )
    {
      C2xRemoveToken(packetHandle, "NMEA_Corrections", newPath);
    }
  }

  snprintf(newPath, elcount(newPath), "%s.%s", oldPath, "msg");
  if(value.msg.isValidFlag==1)
  {
    C2xSetTokenInt(packetHandle, "NMEA_Corrections", newPath, value.msg.value);
    result = CheckLastError("NMEA_Corrections", gkFuncRefGet, result);
  }
  else
  {
    if( C2xIsTokenAvailable(packetHandle, "NMEA_Corrections", newPath) )
    {
      C2xRemoveToken(packetHandle, "NMEA_Corrections", newPath);
    }
  }

  snprintf(newPath, elcount(newPath), "%s.%s", oldPath, "wdCount");
  if(value.wdCount.isValidFlag==1)
  {
    C2xSetTokenInt(packetHandle, "NMEA_Corrections", newPath, value.wdCount.value);
    result = CheckLastError("NMEA_Corrections", gkFuncRefGet, result);
  }
  else
  {
    if( C2xIsTokenAvailable(packetHandle, "NMEA_Corrections", newPath) )
    {
      C2xRemoveToken(packetHandle, "NMEA_Corrections", newPath);
    }
  }

  snprintf(newPath, elcount(newPath), "%s.%s", oldPath, "payload");
  C2xSetTokenData(packetHandle, "NMEA_Corrections", newPath, value.payload.stringLength, value.payload.string);

  snprintf(newPath, elcount(newPath), "%s.%s", oldPath, "regional");
  if(value.regional.isValidFlag==1)
  {
    SetNMEA_Corrections_NMEAcorrections_regionalParams(packetHandle, value.regional, newPath);
    result = CheckLastError("NMEA_Corrections", gkFuncRefGet, result);
  }
  else
  {
    if( C2xIsTokenAvailable(packetHandle, "NMEA_Corrections", newPath) )
    {
      C2xRemoveToken(packetHandle, "NMEA_Corrections", newPath);
    }
  }

  return result;
}

int GetNMEA_CorrectionsMESSAGE_ID_AND_TYPEParams(LONG packetHandle, WORD tableKey, struct NMEA_CorrectionsMESSAGE_ID_AND_TYPE value, char oldPath[])
{
  char newPath[300];
  int result;

  result = 0;

  switch(tableKey)
  {
    case 24:
    {
      snprintf(newPath, elcount(newPath), "%s.%s", oldPath, "nmeaCorrections");
      GetNMEA_CorrectionsNMEAcorrectionsParams(packetHandle, value.nmeaCorrections, newPath);
      result = CheckLastError("NMEA_Corrections", gkFuncRefGet, result);
    }
    break;
  }
  return result;
}

int SetNMEA_CorrectionsMESSAGE_ID_AND_TYPEParams(LONG packetHandle, WORD tableKey, struct NMEA_CorrectionsMESSAGE_ID_AND_TYPE value, char oldPath[])
{
  char newPath[300];
  int result;

  result = 0;

  switch(tableKey)
  {
    case 24:
    {
      snprintf(newPath, elcount(newPath), "%s.%s", oldPath, "nmeaCorrections");
      SetNMEA_CorrectionsNMEAcorrectionsParams(packetHandle, value.nmeaCorrections, newPath);
      result = CheckLastError("NMEA_Corrections", gkFuncRefGet, result);
    }
    break;
  }
  return result;
}

int API_GetNMEA_CorrectionsParams(LONG packetHandle, struct NMEA_Corrections value)
{
  int result;
  result = 0;

  value.messageId = C2xGetTokenInt(packetHandle, "NMEA_Corrections", "messageId");
  result = CheckLastError("NMEA_Corrections", gkFuncRefGet, result);

  GetNMEA_CorrectionsMESSAGE_ID_AND_TYPEParams(packetHandle, value.messageId, value.value, "value");
  result = CheckLastError("NMEA_Corrections", gkFuncRefGet, result);

  return result;
}

int API_SetNMEA_CorrectionsParams(LONG packetHandle, struct NMEA_Corrections value)
{
  int result;
  result = 0;

  value.messageId = 24;

  SetNMEA_CorrectionsMESSAGE_ID_AND_TYPEParams(packetHandle, value.messageId, value.value, "value");
  result = CheckLastError("NMEA_Corrections", gkFuncRefGet, result);

  return result;
}

