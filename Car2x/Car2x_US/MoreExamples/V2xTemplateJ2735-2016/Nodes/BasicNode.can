/*@!Encoding:1252*/
includes
{
  #include "..\DataSources_Templates\ASNV_Template_BasicSafetyMessage.cin"
//  #include "..\DataSources_Templates\ASNV_Template_CommonSafetyRequest.cin"
//  #include "..\DataSources_Templates\ASNV_Template_EmergencyVehicleAlert.cin"
//  #include "..\DataSources_Templates\ASNV_Template_IntersectionCollision.cin"
//  #include "..\DataSources_Templates\ASNV_Template_MAP.cin"
//  #include "..\DataSources_Templates\ASNV_Template_NMEA_Corrections.cin"
//  #include "..\DataSources_Templates\ASNV_Template_PersonalSafetyMessage.cin"
//  #include "..\DataSources_Templates\ASNV_Template_ProbeDataManagement.cin"
//  #include "..\DataSources_Templates\ASNV_Template_ProbeVehicleData.cin"
//  #include "..\DataSources_Templates\ASNV_Template_RoadSideAlert.cin"
//  #include "..\DataSources_Templates\ASNV_Template_RTCM_Corrections.cin"
//  #include "..\DataSources_Templates\ASNV_Template_SignalRequestMessage.cin"
//  #include "..\DataSources_Templates\ASNV_Template_SignalStatusMessage.cin"
//  #include "..\DataSources_Templates\ASNV_Template_SPAT.cin"
//  #include "..\DataSources_Templates\ASNV_Template_TravelerInformation.cin"
//  #include "..\DataSources_Templates\ASNV_Template_WSA.cin"
}

// On start, callback functions for the most common application message BasicSafetyMessage are registered.
// It is possible to do the same with the other application messages if needed.
on start
{
  enum CallbackType { OnRx, PreTx };
  
  C2xRegisterCallback(OnRx,  "OnRxBSM",    "BasicSafetyMessage");
  C2xRegisterCallback(PreTx, "OnPreTxBSM", "BasicSafetyMessage");
}

// Callback function on receiving BSM messages
void OnRxBSM(long channel, long dir, long radioChannel, long signalStrength, long signalQuality, long packet)
{

}

// Callback function before sending BSM messages from IL
void OnPreTxBSM(LONG packet)
{

}