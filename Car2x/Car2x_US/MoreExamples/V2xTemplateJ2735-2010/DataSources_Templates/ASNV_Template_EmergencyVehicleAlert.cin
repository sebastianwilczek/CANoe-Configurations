/*@!Encoding:1252*/
/*
//  (c) Vector Informatik GmbH. All rights reserved.
//
//  This file contains definitions of structs and methods that may be used
//  to set and get the values of an ASN.1 defined packet's payload.
//
//  //This example demonstrates how to set a packet's payload:
//  LONG packetHandle;
//  struct EmergencyVehicleAlert payload;
//  //you need to set the values of the variable "payload" yourself
//  packetHandle = API_InitEmergencyVehicleAlertPacket();
//  if (packetHandle!=0) {
//    if (API_SetEmergencyVehicleAlertParams(packetHandle, payload)==0) {
//      if (C2xCompletePacket(packetHandle)==0) {
//        C2xOutputPacket(packetHandle);
//      }
//    }
//  }
//                                                                             */
includes
{

}
variables
{
    struct EmergencyVehicleAlert_Blob_TemporaryID {
        INT isValidFlag;   // necessary if this struct is used as an optional field of a SEQUENCE
        DWORD temporaryID;  // INTEGER, 0..4294967295;
    };
    
    struct EmergencyVehicleAlertTemporaryID {
        INT isValidFlag;   // necessary if this struct is used as an optional field of a SEQUENCE
        CHAR string[5];
        INT  stringLength;
        struct EmergencyVehicleAlert_Blob_TemporaryID _Blob_TemporaryID;  // SEQUENCE;
    };
    
    struct EmergencyVehicleAlert_RoadSideAlert_description {
        INT isValidFlag;   // necessary if this struct is used as an optional field of a SEQUENCE
        INT length;
        DWORD arrayValue[8];  // INTEGER, 0..65565, stopped_traffic(257), stop_and_go_traffic(258), slow_traffic(259), heavy_traffic(260), traffic_building(261), long_queues(262), traffic_congestion(263), traffic_lighter_than_normal(264), traffic_heavier_than_normal(265), traffic_much_heavier_than_normal(266), current_speed(267), speed_limit(268), travel_time(269), merging_traffic(272), traffic_flowing_freely(379), traffic_easing(380), traffic_returned_to_normal(381), no_problems_to_report(382), traffic_congestion_cleared(383), accident(513), serious_accident(514), injury_accident(515), minor_accident(516), multi_vehicle_accident(517), numerous_accidents(518), accident_involving_a_bicycle(519), accident_involving_a_bus(520), accident_involving_a_motorcycle(521), accident_involving_a_pedestrian(522), accident_involving_a_train(523), accident_involving_a_truck(524), accident_involving_a_semi_trailer(562), accident_involving_hazardous_materials(525), earlier_accident(526), medical_emergency(527), secondary_accident(528), rescue_and_recovery_work_REMOVED(529), accident_investigation_work(530), incident(531), stalled_vehicle(532), abandoned_vehicle(533), disabled_vehicle(534), disabled_truck(535), disabled_semi_trailer(536), disabled_bus(537), disabled_train(538), vehicle_spun_out(539), vehicle_on_fire(540), vehicle_in_water(541), vehicles_slowing_to_look_at_accident(542), jackknifed_semi_trailer(543), jackknifed_trailer_home(544), jackknifed_trailer(545), spillage_occurring_from_moving_vehicle(546), acid_spill(547), chemical_spill(548), fuel_spill(549), hazardous_materials_spill(550), oil_spill(551), spilled_load(552), toxic_spill(553), overturned_vehicle(554), overturned_truck(555), overturned_semi_trailer(556), overturned_bus(557), derailed_train(558), stuck_vehicle(559), truck_stuck_under_bridge(560), bus_stuck_under_bridge(561), accident_cleared(638), incident_cleared(639), closed_to_traffic(769), closed(770), closed_ahead(771), closed_intermittently(772), closed_for_repairs(773), closed_for_the_season(774), blocked(775), blocked_ahead(776), reduced_to_one_lane(777), reduced_to_two_lanes(778), reduced_to_three_lanes(779), collapse(780), out(781), open_to_traffic(891), open(892), reopened_to_traffic(893), clearing(894), cleared_from_road(895), road_construction(1025), major_road_construction(1026), long_term_road_construction(1027), construction_work(1028), paving_operations(1029), work_in_the_median(1030), road_reconstruction(1031), opposing_traffic(1032), narrow_lanes(1033), construction_traffic_merging(1034), single_line_traffic_alternating_directions(1035), road_maintenance_operations(1036), road_marking_operations(1037), road_widening(1061), cracks(1052), crack_REMOVE(1058), bumps(1053), drop_off(1059), storm_drain(1054), bridge_maintenance_operations(1038), bridge_construction(1039), bridge_demolition_work(1040), seismic_retrofit(1060), overgrown_grass(1055), overgrown_brushshrubs(1056), overgrown_trees(1057), blasting(1041), avalanche_control_activities(1042), water_main_work(1043), gas_main_work(1044), work_on_underground_cables(1045), work_on_underground_services(1046), new_road_construction_layout(1047), new_road_layout(1048), temporary_lane_markings(1049), temporary_traffic_lights(1050), emergency_maintenance(1051), utiltity_work(1062), road_maintenance_cleared(1146), normal_road_layout_restored(1147), road_work_clearance_in_progress(1148), road_construction_cleared(1149), normal_traffic_lanes_restored(1150), road_work_cleared(1151), obstruction_on_roadway(1281), object_on_roadway(1282), objects_falling_from_moving_vehicle(1283), debris_on_roadway(1284), storm_damage(1285), people_on_roadway(1286), bicyclists_on_roadway(1287), sightseers_obstructing_access(1288), large_numbers_of_visitors(1289), animal_on_roadway(1290), large_animal_on_roadway(1291), herd_of_animals_on_roadway(1292), animal_struck(1293), advertising_signs(1315), fallen_trees(1294), over_turned_trees(1311), tree_limbs(1312), utility_pole_down(1314), downed_power_lines(1295), downed_cables(1296), subsidence(1297), road_surface_collapse(1298), frost_jacking(1317), frost_heave(1316), pavement_buckled(1299), pothole(1300), flooding(1301), broken_water_main(1302), collapsed_sewer(1303), wash_out(1319), washboard(1318), sewer_overflow(1304), gas_leak(1305), snowmelt(1306), mudslide(1307), avalanche(1308), rockfall(1309), landslide(1310), clearance_work(1406), obstruction_cleared(1407), delays(1537), short_delays(1538), long_delays(1539), very_long_delays(1540), delays_of_uncertain_duration(1541), delayed_until_further_notice(1542), busy(1543), very_busy(1544), crowded(1545), overcrowded(1546), cancellations(1547), route_cancelled_and_no_replacement(1548), service_cancelled(1549), service_suspended(1550), service_withdrawn(1551), service_fully_booked(1552), all_services_fully_booked(1553), next_departure(1554), next_arrival(1555), very_frequent_service(1556), frequent_service(1557), fairly_frequent_service(1558), regular_service(1559), irregular_service(1560), not_operating(1561), system_busy(1562), system_very_busy(1563), system_crowded(1564), system_overcrowded(1565), deleted_travel_time(1566), headway(1567), extra_services_in_operation(1568), delays_clearing(1660), delays_cleared(1661), normal_services_resumed(1662), operating(1663), vehicle_traveling_wrong_way(1793), reckless_driver(1794), prohibited_vehicle_on_roadway(1795), emergency_vehicles_on_roadway(1796), high_speed_emergency_vehicles(1797), high_speed_chase(1798), dangerous_vehicle_warning_cleared(1918), emergency_vehicle_warning_cleared(1919), abnormal_load(2049), wide_load(2050), long_load(2051), slow_vehicle(2052), farm_equipment(2053), horse_drawn_vehicles(2054), overheight_load(2055), overweight_load(2056), tracked_vehicle(2057), vehicle_carrying_hazardous_materials(2058), slow_moving_maintenance_vehicle(2059), convoy(2060), military_convoy(2061), refugee_convoy(2062), motorcade(2063), mobile_situation_repositioning(2064), winter_maintenance_vehicles(2065), snowplows(2066), slow_moving_maintenance_vehicle_warning_cleared(2172), exceptional_load_warning_cleared(2173), hazardous_load_warning_cleared(2174), convoy_cleared(2175), lane_control_signs_not_working(2305), lane_control_signs_working_incorrectly(2306), lane_control_signs_operating(2307), variable_message_signs_not_working(2308), variable_message_signs_working_incorrectly(2309), variable_message_signs_operating(2310), emergency_telephones_not_working(2311), emergency_telephone_number_not_working(2312), traffic_lights_not_working(2313), traffic_lights_working_incorrectly(2314), ramp_control_signals_not_working(2315), ramp_control_signals_working_incorrectly(2316), temporary_traffic_lights_not_working(2317), temporary_traffic_lights_working_incorrectly(2318), traffic_signal_control_computer_not_working(2319), traffic_signal_timings_changed(2320), overheight_warning_system_triggered(2321), equipment_failure(2322), railroad_crossing_equipment_failure(2323), tunnel_ventilation_not_working(2324), power_failure(2325), widespread_power_outages(2326), technical_problems(2327), sign_down(2328), lines_in_road_faded(2329), damaged_light_standard(2330), traffic_signal_stuck_on_flash(2331), guide_rail(2332), fencing(2333), light_standard_hanging_by_wires(2334), call_box(2335), signal_cabinet(2336), detector(2337), improper_use_of_State_vehicle_or_equipment(2338), bulb_out(2339), not_yet_operational(2340), not_yet_installed(2341), electronic_signs_repaired(2428), emergency_call_facilities_restored(2429), traffic_signals_repaired(2430), railroad_crossing_equipment_now_working_normally(2431), restrictions(2561), ramp_restrictions(2562), truck_restriction(2563), speed_restriction(2564), noise_restriction(2565), traffic_regulations_have_been_changed(2566), local_access_only(2567), no_trailers(2568), no_high_profile_vehicles(2569), hazardous_materials_truck_restriction(2570), no_through_traffic(2571), no_motor_vehicles(2572), width_limit(2573), height_limit(2574), length_limit(2575), axle_load_limit(2576), gross_weight_limit(2577), axle_count_limit(2578), carpool_lane_available(2579), carpool_restrictions_changed(2580), hOV_2_no_single_occupant_vehicles(2581), hOV_3_no_vehicles_with_less_than_three_occupants(2582), bus_lane_available_for_all_vehicles(2583), truck_lane_available_for_all_vehicles(2584), permits_call_in_basis(2585), permits_temporarily_closed(2586), permits_closed(2587), road_use_permits_required(2588), permits_open(2675), restrictions_for_high_profile_vehicles_lifted(2676), width_limit_lifted(2677), height_limit_lifted(2678), length_limit_lifted(2679), axle_load_limit_lifted(2680), weight_limit_lifted(2681), axle_count_limit_lifted(2682), carpool_restrictions_lifted(2683), lane_restrictions_lifted(2684), ramp_restrictions_lifted(2685), motor_vehicle_restrictions_lifted(2686), restrictions_lifted(2687), unconfirmed_report(2817), initial_response_en_route(2818), follow_up_response_en_route(2819), initial_response_on_scene(2820), follow_up_response_on_scene(2821), confirmed_report(2822), scene_is_unsecured_at_this_time(2823), response_scene_secured(2824), rescue_and_recovery_work_in_progress(2825), extraction_in_progress(2826), clearance_work_in_progress(2827), body_removal_operations(2828), fire_containment_contained(2829), fire_containment_not_contained(2830), event_cleared(2831), traffic_clearing(2832), incident_closed(2833), flash_flood(3073), major_flood(3074), reservoir_failure(3075), levee_failure(3076), tsunami(3077), tidal_wave(3078), volcanic_eruption(3079), ash_fall(3080), lava_flow(3081), serious_fire(3082), forest_fire(3083), wildfire(3084), building_fire(3085), brush_fire(3086), grass_fire(3087), fire_danger_extreme(3088), fire_danger_very_high(3089), fire_danger_high(3090), fire_danger_medium(3091), fire_danger_low(3092), earthquake_damage(3093), air_crash(3094), rail_crash(3095), toxic_release(3096), toxic_leak(3097), radioactive_release(3098), radiation_hazard(3099), reactor_leakage(3100), explosion(3101), major_hazardous_materials_fire(3102), major_hazardous_materials_release(3103), disaster_cleared(3199), assault(3329), crime(3330), robbery(3331), fare_dispute(3332), shooting(3333), gunfire_on_roadway(3334), suicide(3335), fight(3336), gang_fight(3337), person_harassment(3338), person_injured(3339), sick_customer(3363), unruly_passenger(3340), person_intoxicated(3341), crowd_control_problem(3342), demonstration(3343), march(3344), public_disturbance(3345), riot(3346), civil_unrest(3347), civil_emergency(3348), strike(3349), public_transit_strike(3350), stampede(3351), teargas_used(3352), security_alert(3353), security_incident(3354), checkpoint(3355), bomb_alert(3356), terrorist_incident(3357), high_velocity_shell_fire(3358), explosives_in_use(3359), air_raid(3360), weapons_of_mass_destruction_threat(3361), military_operations(3362), security_problem_cleared(3454), traffic_disturbance_cleared(3455), sports_event(3585), game(3586), tournament(3587), track_and_field_event(3588), baseball_game(3589), basketball_game(3590), boxing_match(3591), football_game(3592), soccer_game(3593), golf_tournament(3594), hockey_game(3595), tennis_tournament(3596), wrestling_match(3597), road_race(3598), automobile_race(3599), bicycle_race(3600), race_event(3601), marathon(3602), horse_show(3603), rodeo(3604), water_sports_event(3605), winter_sports_event(3606), skating_event(3607), dog_sled_race(3608), sporting_event_ended(3711), major_event(3841), airshow(3842), hot_air_ballooning(3843), concert(3844), state_occasion(3845), vIP_visit(3846), show(3847), festival(3848), exhibition(3849), performing_arts(3850), outdoor_market(3851), fair(3852), carnival(3853), fireworks_display(3854), trade_expo(3855), movie_filming(3856), presidential_visit(3857), parade(3858), procession(3859), funeral_procession(3860), crowd(3861), holiday_traffic_crowds(3862), event_ended(3967), normal_parking_restrictions_lifted(4097), parking_meter_restrictions_lifted(4098), special_parking_restrictions_in_force(4099), full_parking_lot(4100), full_parking_garage(4101), all_parking_lots_full(4102), no_parking_spaces_available(4103), only_a_few_spaces_available(4104), spaces_available(4105), no_parking(4106), parking_on_one_side_of_street_only(4107), parking_on_both_sides_of_street(4108), parallel_parking_only(4109), parking_meters_not_available(4110), use_of_parking_meters_restricted(4111), event_parking(4112), handicapped_parking(4113), long_term_parking(4114), overnight_parking(4115), short_term_parking(4116), parking_by_permit_only(4117), emergency_parking_only(4118), emergency_stopping_only(4119), parking(4120), stopping(4121), standing(4122), tow_away_zone(4123), school_zone(4124), speed_zone(4125), loading_zone(4126), state_law(4127), van_accessible(4128), special_parking_restrictions_lifted(4222), no_parking_information_available(4223), information_available_on_radio(4353), information_available_on_TV(4354), call_to_get_information(4355), information_available_via_Internet(4356), test_message(4357), no_information_available(4358), null_description(4359), police_assistance(4361), police_monitor_CB(4362), emergency_notification(4363), in_emergency_dial_911(4364), travel_Info_call_511(4365), car_pool_information(4366), information_service_resumed(4478), information_service_is_being_suspended(4360), message_canceled(4479), overcast(4609), cloudy(4610), mostly_cloudy(4611), partly_cloudy(4612), partly_sunny(4613), mostly_sunny(4614), sunny(4615), fair_skies(4616), clear_skies(4617), mostly_clear(4618), mostly_dry(4619), dry(4620), uV_index_very_high(4621), uV_index_high(4622), uV_index_moderate(4623), uV_index_low(4624), uV_index_very_low(4625), barometric_pressure(4626), ozone_alert(4627), lighting_unknown(4628), artificial_exterior_light(4629), artificial_interior_light(4630), darkness(4631), dusk(4632), dawn(4633), moonlight(4634), daylight(4635), weather_forecast_withdrawn(4735), severe_weather(4865), blizzard(4866), heavy_snow(4867), snow(4868), light_snow(4869), snow_showers(4870), winter_storm(4871), ice_glaze(4872), heavy_frost(4873), frost(4874), ice_storm(4875), sleet(4876), rain_and_snow_mixed(4877), rain_changing_to_snow(4878), damaging_hail(4879), hail(4880), thunderstorms(4881), thundershowers(4882), extremely_heavy_downpour(4883), heavy_rain(4884), rain(4885), light_rain(4886), drizzle(4887), showers(4888), dew(4889), precipitation_cleared(4991), tornado(5121), hurricane(5122), hurricane_force_winds(5123), tropical_storm(5124), gale_force_winds(5125), storm_force_winds(5126), strong_winds(5127), moderate_winds(5128), light_winds(5129), calm(5130), gusty_winds(5131), crosswinds(5132), windy(5133), strong_winds_have_eased(5246), strong_wind_forecast_withdrawn(5247), dense_fog(5377), fog(5378), patchy_fog(5379), freezing_fog(5380), ice_fog(5405), mist(5381), haze(5382), visibility_reduced(5383), visibility_blocked(5404), white_out(5384), blowing_snow(5385), smoke_hazard(5386), spray_hazard(5387), low_sun_glare(5388), snow_glare(5389), blowing_dust(5390), blowing_sand(5391), dust_storms(5392), sandstorms(5393), air_quality_good(5394), air_quality_fair(5395), air_quality_poor(5396), air_quality_very_poor(5397), severe_exhaust_pollution(5398), smog_alert(5399), pollen_count_high(5400), pollen_count_medium(5401), pollen_count_low(5402), swarms_of_insects(5403), fog_clearing(5499), visibility_improved(5500), fog_forecast_withdrawn(5501), pollution_alert_ended(5502), air_quality_improved(5503), maximum_temperature(5633), temperature(5634), minimum_temperature(5635), current_temperature(5636), heat_index(5637), extreme_heat(5638), hot(5639), hotter(5640), heat(5641), warmer(5642), warm(5643), mild(5644), cool(5645), cooler(5646), cold(5647), colder(5648), very_cold(5649), extreme_cold(5650), wind_chill(5651), dewpoint(5652), relative_humidity(5653), temperatures_close_to_the_seasonal_norm(5758), less_extreme_temperatures(5759), impassable(5889), almost_impassable(5890), passable_with_care(5891), passable(5892), surface_water_hazard(5893), danger_of_hydroplaning(5894), wet_pavement(5895), treated_pavement(5896), slippery(5897), low_ground_clearance(5938), at_grade_level_crossnig(5937), mud_on_roadway(5898), leaves_on_roadway(5899), loose_sand_on_roadway(5900), loose_gravel(5901), fuel_on_roadway(5902), oil_on_roadway(5903), road_surface_in_poor_condition(5904), melting_tar(5905), uneven_lanes(5935), rough_road(5931), rough_crossing(5936), ice(5906), icy_patches(5907), black_ice(5908), ice_pellets_on_roadway(5909), ice_build_up(5910), freezing_rain(5911), wet_and_icy_roads(5912), slush(5914), melting_snow(5913), frozen_slush(5915), snow_on_roadway(5916), packed_snow(5917), packed_snow_patches(5918), plowed_snow(5919), wet_snow(5920), fresh_snow(5921), powder_snow(5922), granular_snow(5923), frozen_snow(5924), crusted_snow(5925), deep_snow(5926), snow_drifts(5927), drifting_snow(5928), expected_snow_accumulation(5929), current_snow_accumulation(5930), sand(5932), gravel(5933), paved(5934), dry_pavement(6011), snow_cleared(6012), pavement_conditions_improved(6013), skid_hazard_reduced(6014), pavement_conditions_cleared(6015), winter_equipment_recommended(6145), winter_equipment_required(6146), snow_chains_recommended(6147), snow_chains_required(6148), snow_chains_prohibited(6149), studded_tires_prohibited(6150), snow_tires_recommended(6151), snow_tires_required(6152), four_wheel_drive_recommended(6153), four_wheel_drive_required(6154), snow_tires_or_chains_recommended(6155), snow_tires_or_chains_required(6156), winter_driving_requirements_lifted(6271), driving_conditions_good(6401), driving_conditions_fair(6402), difficult_driving_conditions(6403), very_difficult_driving_conditions(6404), hazardous_driving_conditions(6405), extremely_hazardous_driving_conditions(6406), why_not_ride_share(6657), is_this_your_no_ride_day(6658), why_not_use_transit(6659), why_not_park_and_ride(6660), why_not_try_paratransit(6661), why_not_travel_by_rail(6662), why_not_use_the_subway(6663), why_not_try_rapid_transit(6664), why_not_travel_by_bus(6665), your_parking_ticket_covers_the_return_ride(6666), avoid_the_rush_hour(6667), do_not_allow_unnecessary_gaps(6668), follow_the_vehicle_in_front_smoothly(6669), do_not_slow_down_unnecessarily(6670), watch_for_muggers(6671), watch_for_pickpockets(6672), watch_for_thieves(6673), sorry_for_any_delay(6674), thank_you_for_your_understanding(6675), we_appreciate_your_patience(6676), we_are_grateful_for_your_cooperation(6677), share_the_road(6678), risk(6913), watch(6914), warning(6915), alert(6916), danger(6917), danger_of_explosion(6918), danger_of_fire(6919), extra_police_patrols_in_operation(6920), look_out_for_vehicles_stopped_under_bridges(6921), increased_risk_of_accident(6922), rescue_and_recovery_work_in_progress_at_sceneREMOVED(6923), police_at_scene(6924), emergency_vehicles_at_scene(6925), traffic_being_directed_around_accident_area(6926), police_directing_traffic(6927), rescue_workers_directing_traffic(6928), repairs_in_progress(6929), pilot_car_in_operation(6930), look_out_for_flagger(6931), look_out_for_workers(6952), police_checks_in_operation(6932), truck_check_point(6937), lockdown(6935), security_check_point(6936), single_occupancy_vehicle_check_point(6938), mandatory_speed_limit_in_force(6933), speed_limit_in_force_for_heavy_vehicles(6934), behind_you(6950), ride_with_traffic(6953), look(6939), photo_enforced(6940), traffic_signs(6951), traffic_laws(6941), use_low_gear(6942), bridge_ices_before_road(6943), speed_checked_by_radar(6944), speed_checked_by_aircraft(6945), fines(6946), fines_higher(6947), fines_doubled(6948), fines_tripled(6949), warning_canceled(7034), watch_canceled(7035), alert_canceled(7036), ended(7037), cleared(7038), canceled(7039), drive_carefully(7169), drive_with_extreme_caution(7170), approach_with_care(7171), keep_your_distance(7172), increase_normal_following_distance(7173), test_your_brakes(7174), cross_intersection_with_care(7175), pass_with_care(7176), pass(7200), use_low_beam_headlights(7177), use_fog_lights(7178), use_hazard_warning_lights(7179), do_not_leave_your_vehicle(7180), leave_your_vehicle_and_proceed_to_next_safe_place(7181), turn_off_engine(7182), close_all_windows_turn_off_heater_air_conditioner_and_vents(7183), turn_off_air_conditioner_to_prevent_engine_overheating(7184), turn_off_mobile_phones_and_two_way_radios(7185), prepare_to_stop(7186), be_prepared_to_stop(7201), stop_at_next_rest_area(7187), stop_at_next_safe_place(7188), only_travel_if_absolutely_necessary(7189), drive_to_another_service_area(7190), use_through_traffic_lanes(7191), use_local_traffic_lanes(7192), use_left_hand_parallel_roadway(7193), use_right_hand_parallel_roadway(7194), use_heavy_vehicle_lane(7195), observe_recommended_speed(7196), signals_sequenced_for_speed(7202), maintain_top_safe_speed(7203), facing_traffic(7197), push_button(7198), to_cross_street(7199), keep_to_the_right(7425), keep_to_the_left(7426), use_right_lane(7427), use_left_lane(7428), stay_in_lane(7450), merge(7451), heavy_vehicles_use_right_lane(7429), heavy_vehicles_use_left_lane(7430), observe_signals(7431), observe_signs(7432), no_passing(7433), no_smoking(7434), no_open_flames(7435), use_shoulder_as_lane(7436), do_not_drive_on_the_shoulder(7437), allow_emergency_vehicles_to_pass(7438), clear_a_lane_for_emergency_vehicles(7439), pull_over_to_the_edge_of_the_roadway(7440), wait_for_escort_vehicle(7441), in_emergency_wait_for_police_patrol(7442), reduce_your_speed(7443), observe_speed_limits(7444), check_point(7445), entry_requirements(7446), insurance_requirements(7447), firearms_requirements(7448), pet_requirements(7449), slower_traffic_keep_right(7452), keep_off(7453), shoulder_travel_no_longer_allowed(7547), above(7681), below(7682), in(7683), around(7684), after(7685), before(7686), at(7687), on(7688), near(7689), from_the(7690), terminal(7691), falling_slowly(7692), falling(7693), falling_quickly(7694), rising_slowly(7695), rising(7696), rising_quickly(7697), steady(7698), likely(7699), changing_to(7700), mostly(7701), partly(7702), minus(7703), weather_ended(7704), expected(7705), low(7706), mid(7707), high(7708), upper(7709), unseasonably(7710), reported(7711), advice(7712), due_to(7713), proceed_to(7714), transferred_to(7715), use(7716), affecting(7717), blocking(7718), connecting(7719), finished(7720), for(7721), or(7722), and(7723), later(7724), level(7725), shortly(7726), soon(7727), service(7728), graffiti(7733), damaged(7729), out_of_order(7730), on_State_right_of_way(7732), found_property(7734), vandalism(7731), begin_time(7735), added(7736), end_time(7737), no(7738), do_not(7739), block(7740), except(7741), day(7742), night(7743), any_time(7744), has(7745), must(7757), may_have(7746), may_excced(7759), only(7747), lifted(7748), empty(7749), turning(7750), u_turn(7751), wait_for(7752), when_flashing(7753), duration(7754), cross(7755), when_wet(7756), oncoming(7758), to_request(7760), exempt(7761), skewed(7762), when_children_are_present(7763), on_bridges(7937), in_tunnels(7938), entering_or_leaving_tunnels(7939), on_ramps(7940), in_road_construction_area(7941), around_a_curve(7942), on_curve(8026), on_tracks(8009), in_street(8025), shoulder(8027), on_minor_roads(7943), in_the_opposing_lanes(7944), adjacent_to_roadway(7945), across_tracks(8024), on_bend(7946), intersection(8032), entire_intersection(7947), in_the_median(7948), moved_to_side_of_road(7949), moved_to_shoulder(7950), on_the_roadway(7951), dip(8010), traffic_circle(8011), crossover(8028), cross_road(8029), side_road(8030), to(8014), by(8015), through(8016), area_of(8017), under(8018), over(8019), from(8020), approaching(8021), entering_at(8022), exiting_at(8023), in_shaded_areas(7952), in_low_lying_areas(7953), in_the_downtown_area(7954), in_the_inner_city_area(7955), in_parts(7956), in_some_places(7957), in_the_ditch(7958), in_the_valley(7959), on_hill_top(7960), near_the_foothills(7961), at_high_altitudes(7962), near_the_lake(7963), near_the_shore(7964), nearby_basin(8008), over_the_crest_of_a_hill(7965), other_than_on_the_roadway(7966), near_the_beach(7967), near_beach_access_point(7968), mountain_pass(8006), lower_level(7969), upper_level(7970), airport(7971), concourse(7972), gate(7973), baggage_claim(7974), customs_point(7975), reservation_center(8007), station(7976), platform(7977), dock(7978), depot(7979), ev_charging_point(7980), information_welcome_point(7981), at_rest_area(7982), at_service_area(7983), at_weigh_station(7984), roadside_park(8033), picnic_areas(7985), rest_area(7986), service_stations(7987), toilets(7988), bus_stop(8031), park_and_ride_lot(8012), on_the_right(7989), on_the_left(7990), in_the_center(7991), in_the_opposite_direction(7992), cross_traffic(7993), northbound_traffic(7994), eastbound_traffic(7995), southbound_traffic(7996), westbound_traffic(7997), north(7998), south(7999), east(8000), west(8001), northeast(8002), northwest(8003), southeast(8004), southwest(8005), all_roadways(8193), through_lanes(8194), left_lane(8195), right_lane(8196), center_lane(8197), middle_lanes(8198), middle_two_lanes(8199), right_turning_lanes(8200), left_turning_lanes(8201), upper_deck_lanes(8236), lower_deck_lanes(8237), reversible_lanes(8238), right_exit_lanes(8239), left_exit_lanes(8240), right_merging_lanes(8241), left_merging_lanes(8242), right_exit_ramp(8202), right_second_exit_ramp(8243), right_entrance_ramp(8203), right_second_entrance_ramp(8245), left_exit_ramp(8204), left_second_exit_ramp(8244), left_entrance_ramp(8205), left_second_entrance_ramp(8246), escape_ramp(8234), hard_shoulder(8206), soft_shoulder(8207), right_shoulder(8208), left_shoulder(8209), median(8252), sidewalk(8251), highways(8235), right_hand_parallel_lanes(8210), left_hand_parallel_lanes(8211), connecting_lanes(8212), express_lanes(8213), local_lanes(8214), toll_lanes(8215), electronic_toll_lanes(8216), toll_plaza(8217), inspection_lane(8218), hOV_lanes(8219), bus_lanes(8220), carpool_lanes(8221), truck_lanes(8222), emergency_lanes(8223), passing_lanes(8224), climbing_lanes(8225), slow_lane(8226), service_road(8227), cycle_lane(8228), tracks(8250), bridge(8229), overpass(8230), elevated_lanes(8231), underpass(8232), tunnel(8233), all_exit_lanes(8247), all_entry_lanes(8248), either_shoulder(8249), shoulder_work(8253), detour_where_possible(8449), no_detour_available(8450), follow_signs(8451), follow_detour_signs(8452), follow_special_detour_markers(8453), do_not_follow_detour_signs(8454), detour_in_operation(8455), follow_local_detour(8456), compulsory_detour_in_operation(8457), no_suitable_detour_available(8458), detour_is_no_longer_recommended(8459), local_drivers_are_recommended_to_avoid_the_area(8460), trucks_are_recommended_to_avoid_the_area(8461), consider_alternate_route(8462), consider_alternate_parking(8463), consider_alternate_destination(8464), consider_alternate_area(8465), snow_route(8466), emergency_snow_route(8467), evacuation_route(8468), truck_route(8469), hazardous_materials_route(8470), detour(8471), square_feet(8705), square_meters(8706), acres(8707), hectares(8708), inches(8709), feet(8710), mile(8711), miles(8712), nautical_miles(8713), millimeters(8714), meters(8715), kilometer(8716), kilometers(8717), feet_per_second(8718), meters_per_second(8719), mPH(8720), kPH(8721), knots(8722), elevation(8766), aM(8723), pM(8724), holiday(8726), seconds(8727), minutes(8728), hours(8729), days(8730), weeks(8731), months(8732), other_times(8767), xSunday(8758), xMonday(8759), xTuesday(8760), xWednesday(8761), xThursday(8762), xFriday(8763), xSaturday(8764), weekdays(8765), weekends(8725), degrees(8733), degrees_Celsius(8734), degrees_Fahrenheit(8735), grams(8736), kilograms(8737), ounces(8738), pounds(8739), tons(8740), fluid_ounces(8741), gallons(8742), milliliters(8743), liters(8744), kilograms_per_lane_mile(8745), tons_per_lane_mile(8746), dollar(8747), percent(8748), grade(8757), time_delimiter(8749), dollars(8750), flight_number(8751), person_people(8752), response_plan(8753), placard_type(8754), placard_number(8755), fM(8756), travel(8961), transit(8962), bus(8963), trolleybus(8964), rail(8965), commuter_rail(8966), subway(8967), rapid_transit(8968), light_rail(8969), streetcar(8970), dial_a_ride(8971), park_and_ride(8972), shuttle(8973), free_shuttle(8974), airport_shuttle(8975), taxies(8976), ferry(8977), passenger_ferry(8978), vehicle_ferry(8979), aerial_tramway(8980), automated_guideway(8981), cable_cars(8982), monorail(8983), air_travel(8984), hitch_hitching(8985), walk(8986), all_vehicles(9217), bicycles(9218), motorcycles(9219), cars(9220), light_vehicles(9221), cars_and_light_vehicles(9222), cars_with_trailers(9223), cars_with_recreational_trailers(9224), vehicles_with_trailers(9225), heavy_vehicles(9226), trucks(9227), buses(9228), articulated_buses(9229), school_buses(9230), vehicles_with_semi_trailers(9231), vehicles_with_double_trailers(9232), high_profile_vehicles(9233), wide_vehicles(9234), long_vehicles(9235), hazardous_loads(9236), exceptional_loads(9237), abnormal_loads(9238), convoys(9239), maintenance_vehicles(9240), delivery_vehicles(9241), vehicles_with_even_numbered_license_plates(9242), vehicles_with_odd_numbered_license_plates(9243), vehicles_with_parking_permits(9244), vehicles_with_catalytic_converters(9245), vehicles_without_catalytic_converters(9246), gas_powered_vehicles(9247), diesel_powered_vehicles(9248), lPG_vehicles(9249), military_convoys(9250), military_vehicles(9251), electric_powered_vehicles(9252), hybrid_powered_vehicles(9253), inherently_low_emisson_vehicles(9254), commerical_vehicles(9255), runaway_vehicles(9256), vehicles_with_lugs(9257), motor_driven_cycles(9258), recreational_vehicles(9259), non_motorized_vehicles(9260), traffic(9261), through_traffic(9473), holiday_traffic(9474), residents(9475), visitors(9476), long_distance_traffic(9477), local_traffic(9478), regional_traffic(9479), arrivals(9480), departures(9481), airline_travelers(9482), commuter_airline_travelers(9483), domestic_airline_travelers(9484), international_airline_travelers(9485), pedestrians(9486), bicyclists(9487), emergency_vehicle_units(9729), federal_law_enforcement_units(9730), state_police_units(9731), county_police_units(9732), local_police_units(9733), ambulance_units(9734), rescue_units(9735), fire_units(9736), hAZMAT_units(9737), light_tow_unit(9738), heavy_tow_unit(9739), private_tow_units(9743), freeway_service_patrols(9740), transportation_response_units(9741), private_contractor_response_units(9742), ground_fire_suppression(9985), heavy_ground_equipment(9986), aircraft(9988), marine_equipment(9989), support_equipment(9990), medical_rescue_unit(9991), other(9993), ground_fire_suppression_other(9994), engine(9995), truck_or_aerial(9996), quint(9997), tanker_pumper_combination(9998), brush_truck(10000), aircraft_rescue_firefighting(10001), heavy_ground_equipment_other(10004), dozer_or_plow(10005), tractor(10006), tanker_or_tender(10008), aircraft_other(10024), aircraft_fixed_wing_tanker(10025), helitanker(10026), helicopter(10027), marine_equipment_other(10034), fire_boat_with_pump(10035), boat_no_pump(10036), support_apparatus_other(10044), breathing_apparatus_support(10045), light_and_air_unit(10046), medical_rescue_unit_other(10054), rescue_unit(10055), urban_search_rescue_unit(10056), high_angle_rescue(10057), crash_fire_rescue(10058), bLS_unit(10059), aLS_unit(10060), mobile_command_post(10075), chief_officer_car(10076), hAZMAT_unit(10077), type_i_hand_crew(10078), type_ii_hand_crew(10079), privately_owned_vehicle(10083), other_apparatus_resource(10084), ambulance(10085), bomb_squad_van(10086), combine_harvester(10087), construction_vehicle(10088), farm_tractor(10089), grass_cutting_machines(10090), hAZMAT_containment_tow(10091), heavy_tow(10092), light_tow(10094), flatbed_tow(10114), hedge_cutting_machines(10093), mobile_crane(10095), refuse_collection_vehicle(10096), resurfacing_vehicle(10097), road_sweeper(10098), roadside_litter_collection_crews(10099), survey_crews(10115), salvage_vehicle(10100), sand_truck(10101), snowplow(10102), steam_roller(10103), swat_team_van(10104), track_laying_vehicle(10105), unknown_vehicle(10106), white_lining_vehicle(10107), dump_truck(10108), supervisor_vehicle(10109), snow_blower(10110), rotary_snow_blower(10111), road_grader(10112), steam_truck(10113), unknown_status(10240), ready_for_use(10241), working_normally(10242), working_autonomously(10243), working_incorrectly(10244), not_working(10245), normal_maintenance(10246), in_route_to_use(10247), returning_from_use(10248), out_of_service(10249), off_duty(10250), on_patrol(10251), on_call(10252), on_break(10253), mandatory_time_off(10254), low_on_fuel(10255), low_on_water(10256), low_charge(10257), missing(10258), none(10496), light_pole(10497), utiltity_pole(10498), gantry_way(10499), sign_support(10500), signal_pole(10501), signage_public(10502), signage_private(10503), overhead_sign(10568), ground_sign(10569), cones(10504), cones_post_type(10505), cones_glue_post(10506), cones_other(10507), barriers(10508), barrier_Aframe(10509), barriers_heavy_duty(10510), barricade_type_III(10511), barricade_small(10512), solid_barrier(10565), moveable_barrier(10566), barricade_lights(10513), beacon(10514), t_stand(10515), a_stand(10516), drums(10517), sand_barrel(10567), impact_attenuator(10518), barricade_tape(10519), safety_fence(10520), temp_pavement_markings(10521), speed_bumps(10522), temp_curbs(10523), parking_blocks(10524), signboard_fixed(10525), signboard_portable(10526), stripe(10572), island(10573), har(10527), har_AM(10528), har_FM(10529), har_DSRC(10530), traffic_light(10531), lane_control_signal(10532), traffic_detector(10533), vehicle_detector(10534), system_alarm(10535), arrow_board(10536), fixed_VMS(10537), mobile_VMS(10538), ramp_control(10539), gate_control(10540), temporary_traffic_light(10541), over_height_warning_system(10542), over_weight_warning_system(10543), emergency_telephones(10544), railroad_crossing_equipment(10545), tunnel_ventilation(10546), ccTV(10547), environmental_sensor(10548), emergency_signal(10570), countdown_pedestrian_sign(10571), switch(10549), signal(10550), third_rail(10551), overhead_power(10552), concrete_tie(10553), wooden_tie(10554), manhole_cover(10559), culvert(10560), escalator(10555), elevator(10556), snow_poles(10561), track(10557), guide_poles(10562), drawbridge(10558), expansion_joint(10563), shifted_plate(10564), unknown_transit_problem(10753), sleeping_customer(10754), assault_on_passenger(10755), assault_on_employee(10756), broken_seat(10757), bus_alarm(10758), crime_or_drug_deal(10759), eating_on_board(10760), equipment_problem_with_air_conditioning(10761), equipment_problem_with_air_system(10762), equipment_problem_with_brakes(10763), equipment_problem_with_chassis_or_suspension(10764), equipment_problem_with_cooling_system(10765), equipment_problem_with_doors(10766), equipment_problem_with_electrical(10767), equipment_problem_with_engine(10768), equipment_problem_with_exterior_or_body(10769), equipment_problem_with_fare_collection(10770), equipment_problem_with_fuel_or_exhaust(10771), equipment_problem_with_horn(10772), equipment_problem_with_interior(10773), equipment_problem_with_liftkneeling(10774), equipment_problem_with_lights(10775), equipment_problem_with_lubrication(10776), equipment_problem_with_radio_or_communication(10777), equipment_problem_with_signs(10778), equipment_problem_with_steering(10779), equipment_problem_with_tires(10780), equipment_problem_with_transmission(10781), equipment_problem_with_unknown_alarm(10782), equipment_problem_with_wipers(10783), fare_dispute_expired_pass(10784), fare_dispute_expired_transfer(10785), fare_dispute_expired_upgrade(10786), fare_dispute_other(10787), fare_dispute_refuses_to_pay(10788), lift_passenger_cycle_completed(10789), lift_passenger_ready_to_alight(10790), lift_passenger_ready_to_board(10791), lost_article(10792), objects_thrown(10793), passenger_accident_alighting(10794), passenger_accident_boarding(10795), passenger_accident_fallen_on_board(10796), passenger_load(10797), passenger_accident_other(10798), passenger_sick_or_injured(10799), right_of_way(10800), theft(10801), theft_of_service(10802), waiting_to_get_relief_for_schedule_break(10803), waiting_to_get_relief_after_run_is_finished(10804), waiting_to_provide_relief(10805), unknown_object(11009), tire(11010), rim(11011), retread(11012), trash(11013), cargo(11014), diesel(11015), gasoline(11016), anti_freeze(11017), propane_gas(11061), alternative_fuel(11060), seat_belts(11018), litter_container(11019), all_Terrain_vehicle(11020), seaplane(11021), chairlift(11022), fishing_pier(11023), telephone(11025), railroad_cross_buck(11024), horn(11048), train(11047), deer(11049), horse(11051), cattle(11050), golf_cart(11052), services(11056), motorist_services(11059), food_services(11053), roadside_table(11055), ambulance_staging_point(11054), fallout(11026), medical(11027), chemical(11028), welfare(11029), decontamination(11063), evacuation(11030), registration(11062), emergency(11064), left_arrow_signal(11031), ahead_arrow_signal(11032), right_arrow_signal(11033), green_light_signal(11034), green_arrow_signal(11035), yellow_light_signal(11036), yellow_arrow_signal(11037), red_light_signal(11038), red_arrow_signal(11039), extended_green_signal(11040), advance_arrow_signal(11041), pedestrian_Signal_Stop(11042), pedestrian_Signal_Caution(11043), pedestrian_Signal_Walk(11044), pedestrian_Signal_Light(11045), pedestrian_Signal_Time_Display(11046), prohibit_None_Allowed_LU_LT_L45_S_R45_RT_RU(11264), prohibit_RU_Allowed_LU_LT_L45_S_R45_RT(11265), prohibit_RT_Allowed_LU_LT_L45_S_R45_RU(11266), prohibit_RT_RU_Allowed_LU_LT_L45_S_R45(11267), prohibit_R45_Allowed_LU_LT_L45_S_RT_RU(11268), prohibit_R45_RU_Allowed_LU_LT_L45_S_RT(11269), prohibit_R45_RT_Allowed_LU_LT_L45_S_RU(11270), prohibit_R45_RT_RU_Allowed_LU_LT_L45_S(11271), prohibit_S_Allowed_LU_LT_L45_R45_RT_RU(11272), prohibit_S_RU_Allowed_LU_LT_L45_R45_RT(11273), prohibit_S_RT_Allowed_LU_LT_L45_R45_RU(11274), prohibit_S_RT_RU_Allowed_LU_LT_L45_R45(11275), prohibit_S_R45_Allowed_LU_LT_L45_RT_RU(11276), prohibit_S_R45_RU_Allowed_LU_LT_L45_RT(11277), prohibit_S_R45_RT_Allowed_LU_LT_L45_RU(11278), prohibit_S_R45_RT_RU_Allowed_LU_LT_L45(11279), prohibit_L45_Allowed_LU_LT_S_R45_RT_RU(11280), prohibit_L45_RU_Allowed_LU_LT_S_R45_RT(11281), prohibit_L45_RT_Allowed_LU_LT_S_R45_RU(11282), prohibit_L45_RT_RU_Allowed_LU_LT_S_R45(11283), prohibit_L45_R45_Allowed_LU_LT_S_RT_RU(11284), prohibit_L45_R45_RU_Allowed_LU_LT_S_RT(11285), prohibit_L45_R45_RT_Allowed_LU_LT_S_RU(11286), prohibit_L45_R45_RT_RU_Allowed_LU_LT_S(11287), prohibit_L45_S_Allowed_LU_LT_R45_RT_RU(11288), prohibit_L45_S_RU_Allowed_LU_LT_R45_RT(11289), prohibit_L45_S_RT_Allowed_LU_LT_R45_RU(11290), prohibit_L45_S_RT_RU_Allowed_LU_LT_R45(11291), prohibit_L45_S_R45_Allowed_LU_LT_RT_RU(11292), prohibit_L45_S_R45_RU_Allowed_LU_LT_RT(11293), prohibit_L45_S_R45_RT_Allowed_LU_LT_RU(11294), prohibit_L45_S_R45_RT_RU_Allowed_LU_LT(11295), prohibit_LT_Allowed_LU_L45_S_R45_RT_RU(11296), prohibit_LT_RU_Allowed_LU_L45_S_R45_RT(11297), prohibit_LT_RT_Allowed_LU_L45_S_R45_RU(11298), prohibit_LT_RT_RU_Allowed_LU_L45_S_R45(11299), prohibit_LT_R45_Allowed_LU_L45_S_RT_RU(11300), prohibit_LT_R45_RU_Allowed_LU_L45_S_RT(11301), prohibit_LT_R45_RT_Allowed_LU_L45_S_RU(11302), prohibit_LT_R45_RT_RU_Allowed_LU_L45_S(11303), prohibit_LT_S_Allowed_LU_L45_R45_RT_RU(11304), prohibit_LT_S_RU_Allowed_LU_L45_R45_RT(11305), prohibit_LT_S_RT_Allowed_LU_L45_R45_RU(11306), prohibit_LT_S_RT_RU_Allowed_LU_L45_R45(11307), prohibit_LT_S_R45_Allowed_LU_L45_RT_RU(11308), prohibit_LT_S_R45_RU_Allowed_LU_L45_RT(11309), prohibit_LT_S_R45_RT_Allowed_LU_L45_RU(11310), prohibit_LT_S_R45_RT_RU_Allowed_LU_L45(11311), prohibit_LT_L45_Allowed_LU_S_R45_RT_RU(11312), prohibit_LT_L45_RU_Allowed_LU_S_R45_RT(11313), prohibit_LT_L45_RT_Allowed_LU_S_R45_RU(11314), prohibit_LT_L45_RT_RU_Allowed_LU_S_R45(11315), prohibit_LT_L45_R45_Allowed_LU_S_RT_RU(11316), prohibit_LT_L45_R45_RU_Allowed_LU_S_RT(11317), prohibit_LT_L45_R45_RT_Allowed_LU_S_RU(11318), prohibit_LT_L45_R45_RT_RU_Allowed_LU_S(11319), prohibit_LT_L45_S_Allowed_LU_R45_RT_RU(11320), prohibit_LT_L45_S_RU_Allowed_LU_R45_RT(11321), prohibit_LT_L45_S_RT_Allowed_LU_R45_RU(11322), prohibit_LT_L45_S_RT_RU_Allowed_LU_R45(11323), prohibit_LT_L45_S_R45_Allowed_LU_RT_RU(11324), prohibit_LT_L45_S_R45_RU_Allowed_LU_RT(11325), prohibit_LT_L45_S_R45_RT_Allowed_LU_RU(11326), prohibit_LT_L45_S_R45_RT_RU_Allowed_LU(11327), prohibit_LU_Allowed_LT_L45_S_R45_RT_RU(11328), prohibit_LU_RU_Allowed_LT_L45_S_R45_RT(11329), prohibit_LU_RT_Allowed_LT_L45_S_R45_RU(11330), prohibit_LU_RT_RU_Allowed_LT_L45_S_R45(11331), prohibit_LU_R45_Allowed_LT_L45_S_RT_RU(11332), prohibit_LU_R45_RU_Allowed_LT_L45_S_RT(11333), prohibit_LU_R45_RT_Allowed_LT_L45_S_RU(11334), prohibit_LU_R45_RT_RU_Allowed_LT_L45_S(11335), prohibit_LU_S_Allowed_LT_L45_R45_RT_RU(11336), prohibit_LU_S_RU_Allowed_LT_L45_R45_RT(11337), prohibit_LU_S_RT_Allowed_LT_L45_R45_RU(11338), prohibit_LU_S_RT_RU_Allowed_LT_L45_R45(11339), prohibit_LU_S_R45_Allowed_LT_L45_RT_RU(11340), prohibit_LU_S_R45_RU_Allowed_LT_L45_RT(11341), prohibit_LU_S_R45_RT_Allowed_LT_L45_RU(11342), prohibit_LU_S_R45_RT_RU_Allowed_LT_L45(11343), prohibit_LU_L45_Allowed_LT_S_R45_RT_RU(11344), prohibit_LU_L45_RU_Allowed_LT_S_R45_RT(11345), prohibit_LU_L45_RT_Allowed_LT_S_R45_RU(11346), prohibit_LU_L45_RT_RU_Allowed_LT_S_R45(11347), prohibit_LU_L45_R45_Allowed_LT_S_RT_RU(11348), prohibit_LU_L45_R45_RU_Allowed_LT_S_RT(11349), prohibit_LU_L45_R45_RT_Allowed_LT_S_RU(11350), prohibit_LU_L45_R45_RT_RU_Allowed_LT_S(11351), prohibit_LU_L45_S_Allowed_LT_R45_RT_RU(11352), prohibit_LU_L45_S_RU_Allowed_LT_R45_RT(11353), prohibit_LU_L45_S_RT_Allowed_LT_R45_RU(11354), prohibit_LU_L45_S_RT_RU_Allowed_LT_R45(11355), prohibit_LU_L45_S_R45_Allowed_LT_RT_RU(11356), prohibit_LU_L45_S_R45_RU_Allowed_LT_RT(11357), prohibit_LU_L45_S_R45_RT_Allowed_LT_RU(11358), prohibit_LU_L45_S_R45_RT_RU_Allowed_LT(11359), prohibit_LU_LT_Allowed_L45_S_R45_RT_RU(11360), prohibit_LU_LT_RU_Allowed_L45_S_R45_RT(11361), prohibit_LU_LT_RT_Allowed_L45_S_R45_RU(11362), prohibit_LU_LT_RT_RU_Allowed_L45_S_R45(11363), prohibit_LU_LT_R45_Allowed_L45_S_RT_RU(11364), prohibit_LU_LT_R45_RU_Allowed_L45_S_RT(11365), prohibit_LU_LT_R45_RT_Allowed_L45_S_RU(11366), prohibit_LU_LT_R45_RT_RU_Allowed_L45_S(11367), prohibit_LU_LT_S_Allowed_L45_R45_RT_RU(11368), prohibit_LU_LT_S_RU_Allowed_L45_R45_RT(11369), prohibit_LU_LT_S_RT_Allowed_L45_R45_RU(11370), prohibit_LU_LT_S_RT_RU_Allowed_L45_R45(11371), prohibit_LU_LT_S_R45_Allowed_L45_RT_RU(11372), prohibit_LU_LT_S_R45_RU_Allowed_L45_RT(11373), prohibit_LU_LT_S_R45_RT_Allowed_L45_RU(11374), prohibit_LU_LT_S_R45_RT_RU_Allowed_L45(11375), prohibit_LU_LT_L45_Allowed_S_R45_RT_RU(11376), prohibit_LU_LT_L45_RU_Allowed_S_R45_RT(11377), prohibit_LU_LT_L45_RT_Allowed_S_R45_RU(11378), prohibit_LU_LT_L45_RT_RU_Allowed_S_R45(11379), prohibit_LU_LT_L45_R45_Allowed_S_RT_RU(11380), prohibit_LU_LT_L45_R45_RU_Allowed_S_RT(11381), prohibit_LU_LT_L45_R45_RT_Allowed_S_RU(11382), prohibit_LU_LT_L45_R45_RT_RU_Allowed_S(11383), prohibit_LU_LT_L45_S_Allowed_R45_RT_RU(11384), prohibit_LU_LT_L45_S_RU_Allowed_R45_RT(11385), prohibit_LU_LT_L45_S_RT_Allowed_R45_RU(11386), prohibit_LU_LT_L45_S_RT_RU_Allowed_R45(11387), prohibit_LU_LT_L45_S_R45_Allowed_RT_RU(11388), prohibit_LU_LT_L45_S_R45_RU_Allowed_RT(11389), prohibit_LU_LT_L45_S_R45_RT_Allowed_RU(11390), prohibit_LU_LT_L45_S_R45_RT_RU_Allowed_None(11391), n1_16th(11521), n1_10th(11522), n1_8th(11523), n1_4th(11524), n1_3rd(11525), n1_2(11526), n3_4(11527), n300(11531), n350(11532), n400(11533), n450(11534), n500(11535), n550(11536), n600(11537), n650(11538), n700(11539), n750(11540), n800(11541), n850(11542), n900(11543), n950(11544), n1000(11545), n1100(11546), n1200(11547), n1300(11548), n1400(11549), n1500(11550), n1600(11551), n1700(11552), n1800(11553), n1900(11554), n2000(11555), n2100(11556), n2200(11557), n2300(11558), n2400(11559), n2500(11560), n2600(11561), n2700(11562), n2800(11563), n2900(11564), n3000(11565), n3500(11566), n4000(11567), n4500(11568), n5000(11569), n5500(11570), n6000(11571), n6500(11572), n7000(11573), n7500(11574), n8000(11575), n8500(11576), n9000(11577), n9500(11578), n10000(11579), n11000(11580), n12000(11581), n13000(11582), n14000(11583), n15000(11584), n16000(11585), n17000(11586), n18000(11587), n19000(11588), n20000(11589), n21000(11590), n22000(11591), n23000(11592), n24000(11593), n25000(11594), n26000(11595), n27000(11596), n28000(11597), n29000(11598), n30000(11599), n35000(11600), n40000(11601), n45000(11602), n50000(11603), n55000(11604), n60000(11605), n65000(11606), n70000(11607), n75000(11608), n80000(11609), n85000(11610), n90000(11611), n95000(11612), n100000(11613), name_follows(11777), freeway(11778), us_Route(11779), state_Route(11780), interstate(11781), business_Loop(11782), spur(11797), juncton(11798), alternative(11783), county_Route(11784), forest_Route(11785), farm_to_Market_Route(11786), eisenhower_Interstate_System(11787), americas_Byways(11788), national_Network_Route(11789), scenic_Area(11790), parking_Area(11791), weight_Station(11792), road(11793), exit(11794), historical_route(11795), state_line(11796), bicyle_route(11799), bicyle_interstate_route(11800), national_park(11801), bear_veiwing_area(12033), deer_viewing_area(12034), drinking_water(12035), environmental_study_area(12036), falling_rocks(12037), firearms(12038), leashed_pets(12039), point_of_interest(12040), smoking(12041), dog(12042), tent_camping(12043), trailer_camping(12044), first_aid(12045), handicapped(12046), mechanic(12047), trailer_sanitary_station(12048), viewing_area(12049), scenic_overlook(12095), campfire(12050), locker(12051), sleeping(12052), trail(12053), climbing(12054), rock_climbing(12055), hunting(12056), playground(12057), rock_collecting(12058), spelunking(12059), bicycle_trail(12060), hiking_trail(12061), horse_trail(12062), trail_interpretive_auto(12063), trail_interpretive_pedestrian(12064), trail_road_for_4WD_vehicles(12065), trail_for_trail_bikes(12066), archer(12067), hang_glider(12068), boat_tours(12069), canoeing(12070), diving(12071), scuba_diving(12072), fishing(12073), marine_recreation_area(12074), motorboating(12075), boat_ramp(12076), rowboating(12077), sailboating(12078), water_skiing(12079), surfing(12080), swimming(12081), wading(12082), hand_launch(12083), kayak(12084), wind_surf(12085), ice_skating(12086), ski_jumping(12087), bobbing(12088), cross_country_skiing(12089), downhill_skiing(12090), sledding(12091), snowmobiling(12092), snowshoeing(12093), winter_recreation_area(12094), regulatory_sign(12289), warning_sign(12290), information_sign(12291), construction_sign(12292), guide_sign(12293), stop(12294), yield(12295), caution(12330), temporary(12331), to_oncoming_traffic(12296), four_way(12297), all_way(12298), one_way(12329), zone(12299), narrows(12300), widens(12301), reduced(12302), combined(12303), minimum(12304), maximum(12305), divided_road(12306), double_arrow(12307), dead_end(12308), no_outlet(12309), wrong_way(12310), do_not_enter(12314), chevron(12313), t_intersection_to_the_side(12315), t_intersection_oncoming(12316), y_intersection_to_the_side(12317), y_intersection_oncoming(12318), four_way_divided_highway_crossing(12319), t_way_divided_highway_crossing(12320), light_rail_divided_highway_crossing(12321), light_rail_t_divided_highway_crossing(12322), side_road_to_right(12323), side_road_to_left(12324), side_road_to_right_at_angle(12325), side_road_to_left_at_angle(12326), entering_roadway_merge(12327), entering_roadway_added_lane(12328), n1(12545), n2(12546), n3(12547), n4(12548), n5(12549), n6(12550), n7(12551), n8(12552), n9(12553), n10(12554), n11(12555), n12(12556), n13(12557), n14(12558), n15(12559), n16(12560), n17(12561), n18(12562), n19(12563), n20(12564), n21(12565), n22(12566), n23(12567), n24(12568), n25(12569), n26(12570), n27(12571), n28(12572), n29(12573), n30(12574), n31(12575), n32(12576), n33(12577), n34(12578), n35(12579), n36(12580), n37(12581), n38(12582), n39(12583), n40(12584), n41(12585), n42(12586), n43(12587), n44(12588), n45(12589), n46(12590), n47(12591), n48(12592), n49(12593), n50(12594), n51(12595), n52(12596), n53(12597), n54(12598), n55(12599), n56(12600), n57(12601), n58(12602), n59(12603), n60(12604), n61(12605), n62(12606), n63(12607), n64(12608), n65(12609), n66(12610), n67(12611), n68(12612), n69(12613), n70(12614), n71(12615), n72(12616), n73(12617), n74(12618), n75(12619), n76(12620), n77(12621), n78(12622), n79(12623), n80(12624), n81(12625), n82(12626), n83(12627), n84(12628), n85(12629), n86(12630), n87(12631), n88(12632), n89(12633), n90(12634), n91(12635), n92(12636), n93(12637), n94(12638), n95(12639), n96(12640), n97(12641), n98(12642), n99(12643), n100(12644), n101(12645), n102(12646), n103(12647), n104(12648), n105(12649), n106(12650), n107(12651), n108(12652), n109(12653), n110(12654), n111(12655), n112(12656), n113(12657), n114(12658), n115(12659), n116(12660), n117(12661), n118(12662), n119(12663), n120(12664), n121(12665), n122(12666), n123(12667), n124(12668), n125(12669), n126(12670), n127(12671), n128(12672), n129(12673), n130(12674), n131(12675), n132(12676), n133(12677), n134(12678), n135(12679), n136(12680), n137(12681), n138(12682), n139(12683), n140(12684), n141(12685), n142(12686), n143(12687), n144(12688), n145(12689), n146(12690), n147(12691), n148(12692), n149(12693), n150(12694), n151(12695), n152(12696), n153(12697), n154(12698), n155(12699), n156(12700), n157(12701), n158(12702), n159(12703), n160(12704), n161(12705), n162(12706), n163(12707), n164(12708), n165(12709), n166(12710), n167(12711), n168(12712), n169(12713), n170(12714), n171(12715), n172(12716), n173(12717), n174(12718), n175(12719), n176(12720), n177(12721), n178(12722), n179(12723), n180(12724), n181(12725), n182(12726), n183(12727), n184(12728), n185(12729), n186(12730), n187(12731), n188(12732), n189(12733), n190(12734), n191(12735), n192(12736), n193(12737), n194(12738), n195(12739), n196(12740), n197(12741), n198(12742), n199(12743), n200(12744), n201(12745), n202(12746), n203(12747), n204(12748), n205(12749), n206(12750), n207(12751), n208(12752), n209(12753), n210(12754), n211(12755), n212(12756), n213(12757), n214(12758), n215(12759), n216(12760), n217(12761), n218(12762), n219(12763), n220(12764), n221(12765), n222(12766), n223(12767), n224(12768), n225(12769), n226(12770), n227(12771), n228(12772), n229(12773), n230(12774), n231(12775), n232(12776), n233(12777), n234(12778), n235(12779), n236(12780), n237(12781), n238(12782), n239(12783), n240(12784), n241(12785), n242(12786), n243(12787), n244(12788), n245(12789), n246(12790), n247(12791), n248(12792), n249(12793), n250(12794), n251(12795), n252(12796), n253(12797), n254(12798), n255(12799), alabama(12801), alaska(12802), american_Samoa(12803), arizona(12804), arkansas(12805), california(12806), colorado(12807), connecticut(12808), delaware(12809), district_of_Columbia(12810), florida(12811), georgia(12812), guam(12813), hawaii(12814), idaho(12815), illinois(12816), indiana(12817), iowa(12818), kansas(12819), kentucky(12820), louisiana(12821), maine(12822), maryland(12823), massachusetts(12824), michigan(12825), minnesota(12826), mississippi(12827), missouri(12828), montana(12829), nebraska(12830), nevada(12831), new_Hampshire(12832), new_Jersey(12833), new_Mexico(12834), new_York(12835), north_Carolina(12836), north_Dakota(12837), northern_Marianas_Islands(12838), ohio(12839), oklahoma(12840), oregon(12841), pennsylvania(12842), puerto_rico(12843), rhode_Island(12844), south_Carolina(12845), south_Dakota(12846), tennessee(12847), texas(12848), utah(12849), vermont(12850), virginia(12851), virgin_Islands(12852), washington(12853), west_Virginia(12854), wisconsin(12855), wyoming(12856), rest_room(13057), mens_rest_room(13058), womens_rest_room(13059), family_rest_room(13060), dam(13061), fish_hatchery(13062), information(13063), lighthouse(13064), lookout_tower(13065), ranger_station(13066), grocery_store(13068), lodging(13069), post_office(13070), picnic_shelter(13072), group_camping(13073), group_picnicking(13074), n24_hour_pharmacy(13075), kennel(13076), laundry_facilities(13077), shower_facilities(13078), amphitheater(13079), stable(13080), hospital(13081), emergency_medical_service_point(13082), library(13083), recycling_collection_center(13084), school(13085), alley(13313), annex(13314), arcade(13315), avenue(13316), bayoo(13317), beach(13318), bend(13319), bluff(13320), bottom(13321), boulevard(13322), branch(13323), nbridge(13324), brook(13325), burg(13326), bypass(13327), camp(13328), canyon(13329), cape(13330), causeway(13331), nCenter(13332), circle(13333), cliff(13334), club(13335), common(13336), corner(13337), course(13338), court(13339), cove(13340), creek(13341), crescent(13342), crest(13343), nCrossing(13344), crossroad(13345), curve(13346), dale(13347), nDam(13348), divide(13349), drive(13350), estate(13351), expressway(13352), extension(13353), fall(13354), nFerry(13355), field(13356), flat(13357), ford(13358), forest(13359), forge(13360), fork(13361), fort(13362), nFreeway(13363), garden(13364), gateway(13365), glen(13366), green(13367), grove(13368), harbor(13369), haven(13370), heights(13371), highway(13372), nHill(13373), hollow(13374), inlet(13375), nIsland(13376), isle(13377), nJunction(13378), key(13379), knoll(13380), lake(13381), land(13382), landing(13383), nLane(13384), light(13385), loaf(13386), lock(13387), lodge(13388), loop(13389), mall(13390), manor(13391), meadow(13392), mews(13393), mill(13394), mission(13395), motorway(13396), mount(13397), mountain(13398), neck(13399), orchard(13400), oval(13401), nOverpass(13402), park(13403), parkway(13404), nPass(13405), passage(13406), path(13407), pike(13408), pine(13409), plains(13410), plaza(13411), point(13412), port(13413), prairie(13414), radial(13415), ramp(13416), ranch(13417), rapid(13418), rest(13419), ridge(13420), river(13421), nRoad(13422), route(13423), row(13424), rue(13425), run(13426), shoal(13427), shore(13428), skyway(13429), spring(13430), nSpur(13431), square(13432), nStation(13433), stravenue(13434), stream(13435), street(13436), summit(13437), terrace(13438), throughway(13439), trace(13440), nTrack(13441), trafficway(13442), nTrail(13443), xTunnel(13444), turnpike(13445), nUnderpass(13446), union(13447), valley(13448), viaduct(13449), view(13450), village(13451), ville(13452), vista(13453), nWalk(13454), wall(13455), way(13456), well(13457), ahead(13569), here(13570), here_to(13571), here_to_alley(13572), here_to_corner(13573), here_to_sign(13574), between_signs(13575), between(13633), this_side_of_street(13576), this_side_of_sign(13577), right(13579), left(13580), begin_point(13581), next(13582), starting_start(13611), ends_end(13583), other_Side(13584), crossing(13585), crosswalks(13586), center_strip(13587), lane(13588), shelter(13634), center(13635), hill(13589), both_ways_left_and_right(13590), both_ways_45_degree_angle_tilting_right(13591), both_ways_45_degree_angle_tilting_left(13592), both_directions_of_travel(13593), left_arrow(13610), left_turn(13594), left_45_degree_arrow(13595), left_45_degree_turn(13596), ahead_and_to_the_left(13597), ahead_and_to_the_left_at_a_45_degree_angle(13598), right_arrow(13609), right_turn(13599), right_45_degree_arrow(13600), right_45_degree_turn(13601), ahead_and_to_the_right(13602), ahead_and_to_the_right_at_a_45_degree_angle(13603), downward_left_45_degree(13604), downward_right_45_degree(13605), downward_left_and_right_45_degree(13606), reverse_turn_to_right(13636), reverse_turn_to_left(13637), reverse_curve_to_right(13638), reverse_curve_to_left(13639), two_lane_reverse_curve_to_right(13623), two_lane_reverse_curve_to_left(13624), three_lane_reverse_curve_to_right(13625), three_lane_reverse_curve_to_left(13626), winding_road_to_right(13640), winding_road_to_left(13641), chevron_right(13613), chevron_left(13614), right_turn_with_junction(13615), left_turn_with_junction(13616), hairpin_right(13617), hairpin_left(13618), truck_rollover_right(13619), truck_rollover_left(13620), n270_degreee_turn_right(13621), n270_degreee_turn_left(13622), double_reverse_curve_to_right(13627), double_reverse_curve_to_left(13628), two_lane_double_reverse_curve_to_right(13629), two_lane_double_reverse_curve_to_left(13630), three_lane_double_reverse_curve_to_right(13631), three_lane_double_reverse_curve_to_left(13632);
    };
    
    struct EmergencyVehicleAlert_Blob_Priority {
        INT isValidFlag;   // necessary if this struct is used as an optional field of a SEQUENCE
        BYTE priority;  // INTEGER, 0..255;
    };
    
    struct EmergencyVehicleAlertPriority {
        INT isValidFlag;   // necessary if this struct is used as an optional field of a SEQUENCE
        CHAR string[2];
        INT  stringLength;
        struct EmergencyVehicleAlert_Blob_Priority _Blob_Priority;  // SEQUENCE;
    };
    
    struct EmergencyVehicleAlertHeadingSlice {
        INT isValidFlag;   // necessary if this struct is used as an optional field of a SEQUENCE
        CHAR string[3];
        INT  stringLength;
    };
    
    struct EmergencyVehicleAlertDDateTime {
        INT isValidFlag;   // necessary if this struct is used as an optional field of a SEQUENCE
        struct OPT_WORD_ASN year;  // INTEGER, OPTIONAL, 0..9999;
        struct OPT_BYTE_ASN month;  // INTEGER, OPTIONAL, 0..15;
        struct OPT_BYTE_ASN day;  // INTEGER, OPTIONAL, 0..31;
        struct OPT_BYTE_ASN hour;  // INTEGER, OPTIONAL, 0..31;
        struct OPT_BYTE_ASN minute;  // INTEGER, OPTIONAL, 0..63;
        struct OPT_WORD_ASN second;  // INTEGER, OPTIONAL, 0..65535;
    };
    
    struct EmergencyVehicleAlertElevation {
        INT isValidFlag;   // necessary if this struct is used as an optional field of a SEQUENCE
        CHAR string[3];
        INT  stringLength;
        WORD _Blob_Elevation;  // INTEGER, 0..65535;
    };
    
    struct EmergencyVehicleAlert_Blob_TransmissionAndSpeed {
        INT isValidFlag;   // necessary if this struct is used as an optional field of a SEQUENCE
        BYTE transmissionState;  // INTEGER, 0..7, neutral(0), park(1), forwardGears(2), reverseGears(3), reserved1(4), reserved2(5), reserved3(6), unavailable(7);
        WORD speed;  // INTEGER, 0..8191;
    };
    
    struct EmergencyVehicleAlertTransmissionAndSpeed {
        INT isValidFlag;   // necessary if this struct is used as an optional field of a SEQUENCE
        CHAR string[3];
        INT  stringLength;
        struct EmergencyVehicleAlert_Blob_TransmissionAndSpeed _Blob_TransmissionAndSpeed;  // SEQUENCE;
    };
    
    struct EmergencyVehicleAlert_Blob_PositionalAccuracy {
        INT isValidFlag;   // necessary if this struct is used as an optional field of a SEQUENCE
        BYTE accuracySemiMajor;  // INTEGER, 0..255;
        BYTE accuracySemiMinor;  // INTEGER, 0..255;
        WORD accuracyOrientation;  // INTEGER, 0..65535;
    };
    
    struct EmergencyVehicleAlertPositionalAccuracy {
        INT isValidFlag;   // necessary if this struct is used as an optional field of a SEQUENCE
        CHAR string[5];
        INT  stringLength;
        struct EmergencyVehicleAlert_Blob_PositionalAccuracy _Blob_PositionalAccuracy;  // SEQUENCE;
    };
    
    struct EmergencyVehicleAlert_Blob_PositionConfidenceSet {
        INT isValidFlag;   // necessary if this struct is used as an optional field of a SEQUENCE
        BYTE positionConfidence;  // INTEGER, 0..15, unavailable(0), a500m(1), a200m(2), a100m(3), a50m(4), a20m(5), a10m(6), a5m(7), a2m(8), a1m(9), a50cm(10), a20cm(11), a10cm(12), a5cm(13), a2cm(14), a1cm(15);
        BYTE elevationConfidence;  // INTEGER, 0..15, unavailable(0), elev_500_00(1), elev_200_00(2), elev_100_00(3), elev_050_00(4), elev_020_00(5), elev_010_00(6), elev_005_00(7), elev_002_00(8), elev_001_00(9), elev_000_50(10), elev_000_20(11), elev_000_10(12), elev_000_05(13), elev_000_02(14), elev_000_01(15);
    };
    
    struct EmergencyVehicleAlertPositionConfidenceSet {
        INT isValidFlag;   // necessary if this struct is used as an optional field of a SEQUENCE
        CHAR string[2];
        INT  stringLength;
        struct EmergencyVehicleAlert_Blob_PositionConfidenceSet _Blob_PositionConfidenceSet;  // SEQUENCE;
    };
    
    struct EmergencyVehicleAlert_Blob_SpeedandHeadingandThrottleConfidence {
        INT isValidFlag;   // necessary if this struct is used as an optional field of a SEQUENCE
        BYTE headingConfidence;  // INTEGER, 0..7, unavailable(0), prec45deg(1), prec10deg(2), prec05deg(3), prec01deg(4), prec0_1deg(5), prec0_05deg(6), prec0_01deg(7);
        BYTE speedConfidence;  // INTEGER, 0..7, unavailable(0), prec100ms(1), prec10ms(2), prec5ms(3), prec1ms(4), prec0_1ms(5), prec0_05ms(6), prec0_01ms(7);
        BYTE throttleConfidence;  // INTEGER, 0..3, unavailable(0), prec10percent(1), prec1percent(2), prec0_5percent(3);
    };
    
    struct EmergencyVehicleAlertSpeedandHeadingandThrottleConfidence {
        INT isValidFlag;   // necessary if this struct is used as an optional field of a SEQUENCE
        CHAR string[2];
        INT  stringLength;
        struct EmergencyVehicleAlert_Blob_SpeedandHeadingandThrottleConfidence _Blob_SpeedandHeadingandThrottleConfidence;  // SEQUENCE;
    };
    
    struct EmergencyVehicleAlertFullPositionVector {
        INT isValidFlag;   // necessary if this struct is used as an optional field of a SEQUENCE
        struct EmergencyVehicleAlertDDateTime utcTime;  // SEQUENCE, OPTIONAL;
        LONG lon;  // INTEGER, -1799999999..1800000001;
        LONG lat;  // INTEGER, -900000000..900000001;
        struct EmergencyVehicleAlertElevation elevation;  // OCTETSTRING, OPTIONAL;
        struct OPT_WORD_ASN heading;  // INTEGER, OPTIONAL, 0..28800;
        struct EmergencyVehicleAlertTransmissionAndSpeed speed;  // OCTETSTRING, OPTIONAL;
        struct EmergencyVehicleAlertPositionalAccuracy posAccuracy;  // OCTETSTRING, OPTIONAL;
        struct OPT_ENUM_ASN timeConfidence;  // ENUMERATED, OPTIONAL, unavailable(0), time_100_000(1), time_050_000(2), time_020_000(3), time_010_000(4), time_002_000(5), time_001_000(6), time_000_500(7), time_000_200(8), time_000_100(9), time_000_050(10), time_000_020(11), time_000_010(12), time_000_005(13), time_000_002(14), time_000_001(15), time_000_000_5(16), time_000_000_2(17), time_000_000_1(18), time_000_000_05(19), time_000_000_02(20), time_000_000_01(21), time_000_000_005(22), time_000_000_002(23), time_000_000_001(24), time_000_000_000_5(25), time_000_000_000_2(26), time_000_000_000_1(27), time_000_000_000_05(28), time_000_000_000_02(29), time_000_000_000_01(30), time_000_000_000_005(31), time_000_000_000_002(32), time_000_000_000_001(33), time_000_000_000_000_5(34), time_000_000_000_000_2(35), time_000_000_000_000_1(36), time_000_000_000_000_05(37), time_000_000_000_000_02(38), time_000_000_000_000_01(39);
        struct EmergencyVehicleAlertPositionConfidenceSet posConfidence;  // OCTETSTRING, OPTIONAL;
        struct EmergencyVehicleAlertSpeedandHeadingandThrottleConfidence speedConfidence;  // OCTETSTRING, OPTIONAL;
    };
    
    struct EmergencyVehicleAlert_Blob_FurtherInfoID {
        INT isValidFlag;   // necessary if this struct is used as an optional field of a SEQUENCE
        WORD temporaryID;  // INTEGER, 0..65535;
    };
    
    struct EmergencyVehicleAlertFurtherInfoID {
        INT isValidFlag;   // necessary if this struct is used as an optional field of a SEQUENCE
        CHAR string[3];
        INT  stringLength;
        struct EmergencyVehicleAlert_Blob_FurtherInfoID _Blob_FurtherInfoID;  // SEQUENCE;
    };
    
    struct EmergencyVehicleAlert_Blob_MsgCRC {
        INT isValidFlag;   // necessary if this struct is used as an optional field of a SEQUENCE
        WORD msgCRC;  // INTEGER, 0..65535;
    };
    
    struct EmergencyVehicleAlertMsgCRC {
        INT isValidFlag;   // necessary if this struct is used as an optional field of a SEQUENCE
        CHAR string[3];
        INT  stringLength;
        struct EmergencyVehicleAlert_Blob_MsgCRC _Blob_MsgCRC;  // SEQUENCE;
    };
    
    struct EmergencyVehicleAlertRoadSideAlert {
        INT isValidFlag;   // necessary if this struct is used as an optional field of a SEQUENCE
        INT msgID;  // ENUMERATED, reserved(0), alaCarteMessage(1), basicSafetyMessage(2), basicSafetyMessageVerbose(3), commonSafetyRequest(4), emergencyVehicleAlert(5), intersectionCollisionAlert(6), mapData(7), nmeaCorrections(8), probeDataManagement(9), probeVehicleData(10), roadSideAlert(11), rtcmCorrections(12), signalPhaseAndTimingMessage(13), signalRequestMessage(14), signalStatusMessage(15), travelerInformation(16);
        BYTE msgCnt;  // INTEGER, 0..127;
        DWORD typeEvent;  // INTEGER, 0..65565, stopped_traffic(257), stop_and_go_traffic(258), slow_traffic(259), heavy_traffic(260), traffic_building(261), long_queues(262), traffic_congestion(263), traffic_lighter_than_normal(264), traffic_heavier_than_normal(265), traffic_much_heavier_than_normal(266), current_speed(267), speed_limit(268), travel_time(269), merging_traffic(272), traffic_flowing_freely(379), traffic_easing(380), traffic_returned_to_normal(381), no_problems_to_report(382), traffic_congestion_cleared(383), accident(513), serious_accident(514), injury_accident(515), minor_accident(516), multi_vehicle_accident(517), numerous_accidents(518), accident_involving_a_bicycle(519), accident_involving_a_bus(520), accident_involving_a_motorcycle(521), accident_involving_a_pedestrian(522), accident_involving_a_train(523), accident_involving_a_truck(524), accident_involving_a_semi_trailer(562), accident_involving_hazardous_materials(525), earlier_accident(526), medical_emergency(527), secondary_accident(528), rescue_and_recovery_work_REMOVED(529), accident_investigation_work(530), incident(531), stalled_vehicle(532), abandoned_vehicle(533), disabled_vehicle(534), disabled_truck(535), disabled_semi_trailer(536), disabled_bus(537), disabled_train(538), vehicle_spun_out(539), vehicle_on_fire(540), vehicle_in_water(541), vehicles_slowing_to_look_at_accident(542), jackknifed_semi_trailer(543), jackknifed_trailer_home(544), jackknifed_trailer(545), spillage_occurring_from_moving_vehicle(546), acid_spill(547), chemical_spill(548), fuel_spill(549), hazardous_materials_spill(550), oil_spill(551), spilled_load(552), toxic_spill(553), overturned_vehicle(554), overturned_truck(555), overturned_semi_trailer(556), overturned_bus(557), derailed_train(558), stuck_vehicle(559), truck_stuck_under_bridge(560), bus_stuck_under_bridge(561), accident_cleared(638), incident_cleared(639), closed_to_traffic(769), closed(770), closed_ahead(771), closed_intermittently(772), closed_for_repairs(773), closed_for_the_season(774), blocked(775), blocked_ahead(776), reduced_to_one_lane(777), reduced_to_two_lanes(778), reduced_to_three_lanes(779), collapse(780), out(781), open_to_traffic(891), open(892), reopened_to_traffic(893), clearing(894), cleared_from_road(895), road_construction(1025), major_road_construction(1026), long_term_road_construction(1027), construction_work(1028), paving_operations(1029), work_in_the_median(1030), road_reconstruction(1031), opposing_traffic(1032), narrow_lanes(1033), construction_traffic_merging(1034), single_line_traffic_alternating_directions(1035), road_maintenance_operations(1036), road_marking_operations(1037), road_widening(1061), cracks(1052), crack_REMOVE(1058), bumps(1053), drop_off(1059), storm_drain(1054), bridge_maintenance_operations(1038), bridge_construction(1039), bridge_demolition_work(1040), seismic_retrofit(1060), overgrown_grass(1055), overgrown_brushshrubs(1056), overgrown_trees(1057), blasting(1041), avalanche_control_activities(1042), water_main_work(1043), gas_main_work(1044), work_on_underground_cables(1045), work_on_underground_services(1046), new_road_construction_layout(1047), new_road_layout(1048), temporary_lane_markings(1049), temporary_traffic_lights(1050), emergency_maintenance(1051), utiltity_work(1062), road_maintenance_cleared(1146), normal_road_layout_restored(1147), road_work_clearance_in_progress(1148), road_construction_cleared(1149), normal_traffic_lanes_restored(1150), road_work_cleared(1151), obstruction_on_roadway(1281), object_on_roadway(1282), objects_falling_from_moving_vehicle(1283), debris_on_roadway(1284), storm_damage(1285), people_on_roadway(1286), bicyclists_on_roadway(1287), sightseers_obstructing_access(1288), large_numbers_of_visitors(1289), animal_on_roadway(1290), large_animal_on_roadway(1291), herd_of_animals_on_roadway(1292), animal_struck(1293), advertising_signs(1315), fallen_trees(1294), over_turned_trees(1311), tree_limbs(1312), utility_pole_down(1314), downed_power_lines(1295), downed_cables(1296), subsidence(1297), road_surface_collapse(1298), frost_jacking(1317), frost_heave(1316), pavement_buckled(1299), pothole(1300), flooding(1301), broken_water_main(1302), collapsed_sewer(1303), wash_out(1319), washboard(1318), sewer_overflow(1304), gas_leak(1305), snowmelt(1306), mudslide(1307), avalanche(1308), rockfall(1309), landslide(1310), clearance_work(1406), obstruction_cleared(1407), delays(1537), short_delays(1538), long_delays(1539), very_long_delays(1540), delays_of_uncertain_duration(1541), delayed_until_further_notice(1542), busy(1543), very_busy(1544), crowded(1545), overcrowded(1546), cancellations(1547), route_cancelled_and_no_replacement(1548), service_cancelled(1549), service_suspended(1550), service_withdrawn(1551), service_fully_booked(1552), all_services_fully_booked(1553), next_departure(1554), next_arrival(1555), very_frequent_service(1556), frequent_service(1557), fairly_frequent_service(1558), regular_service(1559), irregular_service(1560), not_operating(1561), system_busy(1562), system_very_busy(1563), system_crowded(1564), system_overcrowded(1565), deleted_travel_time(1566), headway(1567), extra_services_in_operation(1568), delays_clearing(1660), delays_cleared(1661), normal_services_resumed(1662), operating(1663), vehicle_traveling_wrong_way(1793), reckless_driver(1794), prohibited_vehicle_on_roadway(1795), emergency_vehicles_on_roadway(1796), high_speed_emergency_vehicles(1797), high_speed_chase(1798), dangerous_vehicle_warning_cleared(1918), emergency_vehicle_warning_cleared(1919), abnormal_load(2049), wide_load(2050), long_load(2051), slow_vehicle(2052), farm_equipment(2053), horse_drawn_vehicles(2054), overheight_load(2055), overweight_load(2056), tracked_vehicle(2057), vehicle_carrying_hazardous_materials(2058), slow_moving_maintenance_vehicle(2059), convoy(2060), military_convoy(2061), refugee_convoy(2062), motorcade(2063), mobile_situation_repositioning(2064), winter_maintenance_vehicles(2065), snowplows(2066), slow_moving_maintenance_vehicle_warning_cleared(2172), exceptional_load_warning_cleared(2173), hazardous_load_warning_cleared(2174), convoy_cleared(2175), lane_control_signs_not_working(2305), lane_control_signs_working_incorrectly(2306), lane_control_signs_operating(2307), variable_message_signs_not_working(2308), variable_message_signs_working_incorrectly(2309), variable_message_signs_operating(2310), emergency_telephones_not_working(2311), emergency_telephone_number_not_working(2312), traffic_lights_not_working(2313), traffic_lights_working_incorrectly(2314), ramp_control_signals_not_working(2315), ramp_control_signals_working_incorrectly(2316), temporary_traffic_lights_not_working(2317), temporary_traffic_lights_working_incorrectly(2318), traffic_signal_control_computer_not_working(2319), traffic_signal_timings_changed(2320), overheight_warning_system_triggered(2321), equipment_failure(2322), railroad_crossing_equipment_failure(2323), tunnel_ventilation_not_working(2324), power_failure(2325), widespread_power_outages(2326), technical_problems(2327), sign_down(2328), lines_in_road_faded(2329), damaged_light_standard(2330), traffic_signal_stuck_on_flash(2331), guide_rail(2332), fencing(2333), light_standard_hanging_by_wires(2334), call_box(2335), signal_cabinet(2336), detector(2337), improper_use_of_State_vehicle_or_equipment(2338), bulb_out(2339), not_yet_operational(2340), not_yet_installed(2341), electronic_signs_repaired(2428), emergency_call_facilities_restored(2429), traffic_signals_repaired(2430), railroad_crossing_equipment_now_working_normally(2431), restrictions(2561), ramp_restrictions(2562), truck_restriction(2563), speed_restriction(2564), noise_restriction(2565), traffic_regulations_have_been_changed(2566), local_access_only(2567), no_trailers(2568), no_high_profile_vehicles(2569), hazardous_materials_truck_restriction(2570), no_through_traffic(2571), no_motor_vehicles(2572), width_limit(2573), height_limit(2574), length_limit(2575), axle_load_limit(2576), gross_weight_limit(2577), axle_count_limit(2578), carpool_lane_available(2579), carpool_restrictions_changed(2580), hOV_2_no_single_occupant_vehicles(2581), hOV_3_no_vehicles_with_less_than_three_occupants(2582), bus_lane_available_for_all_vehicles(2583), truck_lane_available_for_all_vehicles(2584), permits_call_in_basis(2585), permits_temporarily_closed(2586), permits_closed(2587), road_use_permits_required(2588), permits_open(2675), restrictions_for_high_profile_vehicles_lifted(2676), width_limit_lifted(2677), height_limit_lifted(2678), length_limit_lifted(2679), axle_load_limit_lifted(2680), weight_limit_lifted(2681), axle_count_limit_lifted(2682), carpool_restrictions_lifted(2683), lane_restrictions_lifted(2684), ramp_restrictions_lifted(2685), motor_vehicle_restrictions_lifted(2686), restrictions_lifted(2687), unconfirmed_report(2817), initial_response_en_route(2818), follow_up_response_en_route(2819), initial_response_on_scene(2820), follow_up_response_on_scene(2821), confirmed_report(2822), scene_is_unsecured_at_this_time(2823), response_scene_secured(2824), rescue_and_recovery_work_in_progress(2825), extraction_in_progress(2826), clearance_work_in_progress(2827), body_removal_operations(2828), fire_containment_contained(2829), fire_containment_not_contained(2830), event_cleared(2831), traffic_clearing(2832), incident_closed(2833), flash_flood(3073), major_flood(3074), reservoir_failure(3075), levee_failure(3076), tsunami(3077), tidal_wave(3078), volcanic_eruption(3079), ash_fall(3080), lava_flow(3081), serious_fire(3082), forest_fire(3083), wildfire(3084), building_fire(3085), brush_fire(3086), grass_fire(3087), fire_danger_extreme(3088), fire_danger_very_high(3089), fire_danger_high(3090), fire_danger_medium(3091), fire_danger_low(3092), earthquake_damage(3093), air_crash(3094), rail_crash(3095), toxic_release(3096), toxic_leak(3097), radioactive_release(3098), radiation_hazard(3099), reactor_leakage(3100), explosion(3101), major_hazardous_materials_fire(3102), major_hazardous_materials_release(3103), disaster_cleared(3199), assault(3329), crime(3330), robbery(3331), fare_dispute(3332), shooting(3333), gunfire_on_roadway(3334), suicide(3335), fight(3336), gang_fight(3337), person_harassment(3338), person_injured(3339), sick_customer(3363), unruly_passenger(3340), person_intoxicated(3341), crowd_control_problem(3342), demonstration(3343), march(3344), public_disturbance(3345), riot(3346), civil_unrest(3347), civil_emergency(3348), strike(3349), public_transit_strike(3350), stampede(3351), teargas_used(3352), security_alert(3353), security_incident(3354), checkpoint(3355), bomb_alert(3356), terrorist_incident(3357), high_velocity_shell_fire(3358), explosives_in_use(3359), air_raid(3360), weapons_of_mass_destruction_threat(3361), military_operations(3362), security_problem_cleared(3454), traffic_disturbance_cleared(3455), sports_event(3585), game(3586), tournament(3587), track_and_field_event(3588), baseball_game(3589), basketball_game(3590), boxing_match(3591), football_game(3592), soccer_game(3593), golf_tournament(3594), hockey_game(3595), tennis_tournament(3596), wrestling_match(3597), road_race(3598), automobile_race(3599), bicycle_race(3600), race_event(3601), marathon(3602), horse_show(3603), rodeo(3604), water_sports_event(3605), winter_sports_event(3606), skating_event(3607), dog_sled_race(3608), sporting_event_ended(3711), major_event(3841), airshow(3842), hot_air_ballooning(3843), concert(3844), state_occasion(3845), vIP_visit(3846), show(3847), festival(3848), exhibition(3849), performing_arts(3850), outdoor_market(3851), fair(3852), carnival(3853), fireworks_display(3854), trade_expo(3855), movie_filming(3856), presidential_visit(3857), parade(3858), procession(3859), funeral_procession(3860), crowd(3861), holiday_traffic_crowds(3862), event_ended(3967), normal_parking_restrictions_lifted(4097), parking_meter_restrictions_lifted(4098), special_parking_restrictions_in_force(4099), full_parking_lot(4100), full_parking_garage(4101), all_parking_lots_full(4102), no_parking_spaces_available(4103), only_a_few_spaces_available(4104), spaces_available(4105), no_parking(4106), parking_on_one_side_of_street_only(4107), parking_on_both_sides_of_street(4108), parallel_parking_only(4109), parking_meters_not_available(4110), use_of_parking_meters_restricted(4111), event_parking(4112), handicapped_parking(4113), long_term_parking(4114), overnight_parking(4115), short_term_parking(4116), parking_by_permit_only(4117), emergency_parking_only(4118), emergency_stopping_only(4119), parking(4120), stopping(4121), standing(4122), tow_away_zone(4123), school_zone(4124), speed_zone(4125), loading_zone(4126), state_law(4127), van_accessible(4128), special_parking_restrictions_lifted(4222), no_parking_information_available(4223), information_available_on_radio(4353), information_available_on_TV(4354), call_to_get_information(4355), information_available_via_Internet(4356), test_message(4357), no_information_available(4358), null_description(4359), police_assistance(4361), police_monitor_CB(4362), emergency_notification(4363), in_emergency_dial_911(4364), travel_Info_call_511(4365), car_pool_information(4366), information_service_resumed(4478), information_service_is_being_suspended(4360), message_canceled(4479), overcast(4609), cloudy(4610), mostly_cloudy(4611), partly_cloudy(4612), partly_sunny(4613), mostly_sunny(4614), sunny(4615), fair_skies(4616), clear_skies(4617), mostly_clear(4618), mostly_dry(4619), dry(4620), uV_index_very_high(4621), uV_index_high(4622), uV_index_moderate(4623), uV_index_low(4624), uV_index_very_low(4625), barometric_pressure(4626), ozone_alert(4627), lighting_unknown(4628), artificial_exterior_light(4629), artificial_interior_light(4630), darkness(4631), dusk(4632), dawn(4633), moonlight(4634), daylight(4635), weather_forecast_withdrawn(4735), severe_weather(4865), blizzard(4866), heavy_snow(4867), snow(4868), light_snow(4869), snow_showers(4870), winter_storm(4871), ice_glaze(4872), heavy_frost(4873), frost(4874), ice_storm(4875), sleet(4876), rain_and_snow_mixed(4877), rain_changing_to_snow(4878), damaging_hail(4879), hail(4880), thunderstorms(4881), thundershowers(4882), extremely_heavy_downpour(4883), heavy_rain(4884), rain(4885), light_rain(4886), drizzle(4887), showers(4888), dew(4889), precipitation_cleared(4991), tornado(5121), hurricane(5122), hurricane_force_winds(5123), tropical_storm(5124), gale_force_winds(5125), storm_force_winds(5126), strong_winds(5127), moderate_winds(5128), light_winds(5129), calm(5130), gusty_winds(5131), crosswinds(5132), windy(5133), strong_winds_have_eased(5246), strong_wind_forecast_withdrawn(5247), dense_fog(5377), fog(5378), patchy_fog(5379), freezing_fog(5380), ice_fog(5405), mist(5381), haze(5382), visibility_reduced(5383), visibility_blocked(5404), white_out(5384), blowing_snow(5385), smoke_hazard(5386), spray_hazard(5387), low_sun_glare(5388), snow_glare(5389), blowing_dust(5390), blowing_sand(5391), dust_storms(5392), sandstorms(5393), air_quality_good(5394), air_quality_fair(5395), air_quality_poor(5396), air_quality_very_poor(5397), severe_exhaust_pollution(5398), smog_alert(5399), pollen_count_high(5400), pollen_count_medium(5401), pollen_count_low(5402), swarms_of_insects(5403), fog_clearing(5499), visibility_improved(5500), fog_forecast_withdrawn(5501), pollution_alert_ended(5502), air_quality_improved(5503), maximum_temperature(5633), temperature(5634), minimum_temperature(5635), current_temperature(5636), heat_index(5637), extreme_heat(5638), hot(5639), hotter(5640), heat(5641), warmer(5642), warm(5643), mild(5644), cool(5645), cooler(5646), cold(5647), colder(5648), very_cold(5649), extreme_cold(5650), wind_chill(5651), dewpoint(5652), relative_humidity(5653), temperatures_close_to_the_seasonal_norm(5758), less_extreme_temperatures(5759), impassable(5889), almost_impassable(5890), passable_with_care(5891), passable(5892), surface_water_hazard(5893), danger_of_hydroplaning(5894), wet_pavement(5895), treated_pavement(5896), slippery(5897), low_ground_clearance(5938), at_grade_level_crossnig(5937), mud_on_roadway(5898), leaves_on_roadway(5899), loose_sand_on_roadway(5900), loose_gravel(5901), fuel_on_roadway(5902), oil_on_roadway(5903), road_surface_in_poor_condition(5904), melting_tar(5905), uneven_lanes(5935), rough_road(5931), rough_crossing(5936), ice(5906), icy_patches(5907), black_ice(5908), ice_pellets_on_roadway(5909), ice_build_up(5910), freezing_rain(5911), wet_and_icy_roads(5912), slush(5914), melting_snow(5913), frozen_slush(5915), snow_on_roadway(5916), packed_snow(5917), packed_snow_patches(5918), plowed_snow(5919), wet_snow(5920), fresh_snow(5921), powder_snow(5922), granular_snow(5923), frozen_snow(5924), crusted_snow(5925), deep_snow(5926), snow_drifts(5927), drifting_snow(5928), expected_snow_accumulation(5929), current_snow_accumulation(5930), sand(5932), gravel(5933), paved(5934), dry_pavement(6011), snow_cleared(6012), pavement_conditions_improved(6013), skid_hazard_reduced(6014), pavement_conditions_cleared(6015), winter_equipment_recommended(6145), winter_equipment_required(6146), snow_chains_recommended(6147), snow_chains_required(6148), snow_chains_prohibited(6149), studded_tires_prohibited(6150), snow_tires_recommended(6151), snow_tires_required(6152), four_wheel_drive_recommended(6153), four_wheel_drive_required(6154), snow_tires_or_chains_recommended(6155), snow_tires_or_chains_required(6156), winter_driving_requirements_lifted(6271), driving_conditions_good(6401), driving_conditions_fair(6402), difficult_driving_conditions(6403), very_difficult_driving_conditions(6404), hazardous_driving_conditions(6405), extremely_hazardous_driving_conditions(6406), why_not_ride_share(6657), is_this_your_no_ride_day(6658), why_not_use_transit(6659), why_not_park_and_ride(6660), why_not_try_paratransit(6661), why_not_travel_by_rail(6662), why_not_use_the_subway(6663), why_not_try_rapid_transit(6664), why_not_travel_by_bus(6665), your_parking_ticket_covers_the_return_ride(6666), avoid_the_rush_hour(6667), do_not_allow_unnecessary_gaps(6668), follow_the_vehicle_in_front_smoothly(6669), do_not_slow_down_unnecessarily(6670), watch_for_muggers(6671), watch_for_pickpockets(6672), watch_for_thieves(6673), sorry_for_any_delay(6674), thank_you_for_your_understanding(6675), we_appreciate_your_patience(6676), we_are_grateful_for_your_cooperation(6677), share_the_road(6678), risk(6913), watch(6914), warning(6915), alert(6916), danger(6917), danger_of_explosion(6918), danger_of_fire(6919), extra_police_patrols_in_operation(6920), look_out_for_vehicles_stopped_under_bridges(6921), increased_risk_of_accident(6922), rescue_and_recovery_work_in_progress_at_sceneREMOVED(6923), police_at_scene(6924), emergency_vehicles_at_scene(6925), traffic_being_directed_around_accident_area(6926), police_directing_traffic(6927), rescue_workers_directing_traffic(6928), repairs_in_progress(6929), pilot_car_in_operation(6930), look_out_for_flagger(6931), look_out_for_workers(6952), police_checks_in_operation(6932), truck_check_point(6937), lockdown(6935), security_check_point(6936), single_occupancy_vehicle_check_point(6938), mandatory_speed_limit_in_force(6933), speed_limit_in_force_for_heavy_vehicles(6934), behind_you(6950), ride_with_traffic(6953), look(6939), photo_enforced(6940), traffic_signs(6951), traffic_laws(6941), use_low_gear(6942), bridge_ices_before_road(6943), speed_checked_by_radar(6944), speed_checked_by_aircraft(6945), fines(6946), fines_higher(6947), fines_doubled(6948), fines_tripled(6949), warning_canceled(7034), watch_canceled(7035), alert_canceled(7036), ended(7037), cleared(7038), canceled(7039), drive_carefully(7169), drive_with_extreme_caution(7170), approach_with_care(7171), keep_your_distance(7172), increase_normal_following_distance(7173), test_your_brakes(7174), cross_intersection_with_care(7175), pass_with_care(7176), pass(7200), use_low_beam_headlights(7177), use_fog_lights(7178), use_hazard_warning_lights(7179), do_not_leave_your_vehicle(7180), leave_your_vehicle_and_proceed_to_next_safe_place(7181), turn_off_engine(7182), close_all_windows_turn_off_heater_air_conditioner_and_vents(7183), turn_off_air_conditioner_to_prevent_engine_overheating(7184), turn_off_mobile_phones_and_two_way_radios(7185), prepare_to_stop(7186), be_prepared_to_stop(7201), stop_at_next_rest_area(7187), stop_at_next_safe_place(7188), only_travel_if_absolutely_necessary(7189), drive_to_another_service_area(7190), use_through_traffic_lanes(7191), use_local_traffic_lanes(7192), use_left_hand_parallel_roadway(7193), use_right_hand_parallel_roadway(7194), use_heavy_vehicle_lane(7195), observe_recommended_speed(7196), signals_sequenced_for_speed(7202), maintain_top_safe_speed(7203), facing_traffic(7197), push_button(7198), to_cross_street(7199), keep_to_the_right(7425), keep_to_the_left(7426), use_right_lane(7427), use_left_lane(7428), stay_in_lane(7450), merge(7451), heavy_vehicles_use_right_lane(7429), heavy_vehicles_use_left_lane(7430), observe_signals(7431), observe_signs(7432), no_passing(7433), no_smoking(7434), no_open_flames(7435), use_shoulder_as_lane(7436), do_not_drive_on_the_shoulder(7437), allow_emergency_vehicles_to_pass(7438), clear_a_lane_for_emergency_vehicles(7439), pull_over_to_the_edge_of_the_roadway(7440), wait_for_escort_vehicle(7441), in_emergency_wait_for_police_patrol(7442), reduce_your_speed(7443), observe_speed_limits(7444), check_point(7445), entry_requirements(7446), insurance_requirements(7447), firearms_requirements(7448), pet_requirements(7449), slower_traffic_keep_right(7452), keep_off(7453), shoulder_travel_no_longer_allowed(7547), above(7681), below(7682), in(7683), around(7684), after(7685), before(7686), at(7687), on(7688), near(7689), from_the(7690), terminal(7691), falling_slowly(7692), falling(7693), falling_quickly(7694), rising_slowly(7695), rising(7696), rising_quickly(7697), steady(7698), likely(7699), changing_to(7700), mostly(7701), partly(7702), minus(7703), weather_ended(7704), expected(7705), low(7706), mid(7707), high(7708), upper(7709), unseasonably(7710), reported(7711), advice(7712), due_to(7713), proceed_to(7714), transferred_to(7715), use(7716), affecting(7717), blocking(7718), connecting(7719), finished(7720), for(7721), or(7722), and(7723), later(7724), level(7725), shortly(7726), soon(7727), service(7728), graffiti(7733), damaged(7729), out_of_order(7730), on_State_right_of_way(7732), found_property(7734), vandalism(7731), begin_time(7735), added(7736), end_time(7737), no(7738), do_not(7739), block(7740), except(7741), day(7742), night(7743), any_time(7744), has(7745), must(7757), may_have(7746), may_excced(7759), only(7747), lifted(7748), empty(7749), turning(7750), u_turn(7751), wait_for(7752), when_flashing(7753), duration(7754), cross(7755), when_wet(7756), oncoming(7758), to_request(7760), exempt(7761), skewed(7762), when_children_are_present(7763), on_bridges(7937), in_tunnels(7938), entering_or_leaving_tunnels(7939), on_ramps(7940), in_road_construction_area(7941), around_a_curve(7942), on_curve(8026), on_tracks(8009), in_street(8025), shoulder(8027), on_minor_roads(7943), in_the_opposing_lanes(7944), adjacent_to_roadway(7945), across_tracks(8024), on_bend(7946), intersection(8032), entire_intersection(7947), in_the_median(7948), moved_to_side_of_road(7949), moved_to_shoulder(7950), on_the_roadway(7951), dip(8010), traffic_circle(8011), crossover(8028), cross_road(8029), side_road(8030), to(8014), by(8015), through(8016), area_of(8017), under(8018), over(8019), from(8020), approaching(8021), entering_at(8022), exiting_at(8023), in_shaded_areas(7952), in_low_lying_areas(7953), in_the_downtown_area(7954), in_the_inner_city_area(7955), in_parts(7956), in_some_places(7957), in_the_ditch(7958), in_the_valley(7959), on_hill_top(7960), near_the_foothills(7961), at_high_altitudes(7962), near_the_lake(7963), near_the_shore(7964), nearby_basin(8008), over_the_crest_of_a_hill(7965), other_than_on_the_roadway(7966), near_the_beach(7967), near_beach_access_point(7968), mountain_pass(8006), lower_level(7969), upper_level(7970), airport(7971), concourse(7972), gate(7973), baggage_claim(7974), customs_point(7975), reservation_center(8007), station(7976), platform(7977), dock(7978), depot(7979), ev_charging_point(7980), information_welcome_point(7981), at_rest_area(7982), at_service_area(7983), at_weigh_station(7984), roadside_park(8033), picnic_areas(7985), rest_area(7986), service_stations(7987), toilets(7988), bus_stop(8031), park_and_ride_lot(8012), on_the_right(7989), on_the_left(7990), in_the_center(7991), in_the_opposite_direction(7992), cross_traffic(7993), northbound_traffic(7994), eastbound_traffic(7995), southbound_traffic(7996), westbound_traffic(7997), north(7998), south(7999), east(8000), west(8001), northeast(8002), northwest(8003), southeast(8004), southwest(8005), all_roadways(8193), through_lanes(8194), left_lane(8195), right_lane(8196), center_lane(8197), middle_lanes(8198), middle_two_lanes(8199), right_turning_lanes(8200), left_turning_lanes(8201), upper_deck_lanes(8236), lower_deck_lanes(8237), reversible_lanes(8238), right_exit_lanes(8239), left_exit_lanes(8240), right_merging_lanes(8241), left_merging_lanes(8242), right_exit_ramp(8202), right_second_exit_ramp(8243), right_entrance_ramp(8203), right_second_entrance_ramp(8245), left_exit_ramp(8204), left_second_exit_ramp(8244), left_entrance_ramp(8205), left_second_entrance_ramp(8246), escape_ramp(8234), hard_shoulder(8206), soft_shoulder(8207), right_shoulder(8208), left_shoulder(8209), median(8252), sidewalk(8251), highways(8235), right_hand_parallel_lanes(8210), left_hand_parallel_lanes(8211), connecting_lanes(8212), express_lanes(8213), local_lanes(8214), toll_lanes(8215), electronic_toll_lanes(8216), toll_plaza(8217), inspection_lane(8218), hOV_lanes(8219), bus_lanes(8220), carpool_lanes(8221), truck_lanes(8222), emergency_lanes(8223), passing_lanes(8224), climbing_lanes(8225), slow_lane(8226), service_road(8227), cycle_lane(8228), tracks(8250), bridge(8229), overpass(8230), elevated_lanes(8231), underpass(8232), tunnel(8233), all_exit_lanes(8247), all_entry_lanes(8248), either_shoulder(8249), shoulder_work(8253), detour_where_possible(8449), no_detour_available(8450), follow_signs(8451), follow_detour_signs(8452), follow_special_detour_markers(8453), do_not_follow_detour_signs(8454), detour_in_operation(8455), follow_local_detour(8456), compulsory_detour_in_operation(8457), no_suitable_detour_available(8458), detour_is_no_longer_recommended(8459), local_drivers_are_recommended_to_avoid_the_area(8460), trucks_are_recommended_to_avoid_the_area(8461), consider_alternate_route(8462), consider_alternate_parking(8463), consider_alternate_destination(8464), consider_alternate_area(8465), snow_route(8466), emergency_snow_route(8467), evacuation_route(8468), truck_route(8469), hazardous_materials_route(8470), detour(8471), square_feet(8705), square_meters(8706), acres(8707), hectares(8708), inches(8709), feet(8710), mile(8711), miles(8712), nautical_miles(8713), millimeters(8714), meters(8715), kilometer(8716), kilometers(8717), feet_per_second(8718), meters_per_second(8719), mPH(8720), kPH(8721), knots(8722), elevation(8766), aM(8723), pM(8724), holiday(8726), seconds(8727), minutes(8728), hours(8729), days(8730), weeks(8731), months(8732), other_times(8767), xSunday(8758), xMonday(8759), xTuesday(8760), xWednesday(8761), xThursday(8762), xFriday(8763), xSaturday(8764), weekdays(8765), weekends(8725), degrees(8733), degrees_Celsius(8734), degrees_Fahrenheit(8735), grams(8736), kilograms(8737), ounces(8738), pounds(8739), tons(8740), fluid_ounces(8741), gallons(8742), milliliters(8743), liters(8744), kilograms_per_lane_mile(8745), tons_per_lane_mile(8746), dollar(8747), percent(8748), grade(8757), time_delimiter(8749), dollars(8750), flight_number(8751), person_people(8752), response_plan(8753), placard_type(8754), placard_number(8755), fM(8756), travel(8961), transit(8962), bus(8963), trolleybus(8964), rail(8965), commuter_rail(8966), subway(8967), rapid_transit(8968), light_rail(8969), streetcar(8970), dial_a_ride(8971), park_and_ride(8972), shuttle(8973), free_shuttle(8974), airport_shuttle(8975), taxies(8976), ferry(8977), passenger_ferry(8978), vehicle_ferry(8979), aerial_tramway(8980), automated_guideway(8981), cable_cars(8982), monorail(8983), air_travel(8984), hitch_hitching(8985), walk(8986), all_vehicles(9217), bicycles(9218), motorcycles(9219), cars(9220), light_vehicles(9221), cars_and_light_vehicles(9222), cars_with_trailers(9223), cars_with_recreational_trailers(9224), vehicles_with_trailers(9225), heavy_vehicles(9226), trucks(9227), buses(9228), articulated_buses(9229), school_buses(9230), vehicles_with_semi_trailers(9231), vehicles_with_double_trailers(9232), high_profile_vehicles(9233), wide_vehicles(9234), long_vehicles(9235), hazardous_loads(9236), exceptional_loads(9237), abnormal_loads(9238), convoys(9239), maintenance_vehicles(9240), delivery_vehicles(9241), vehicles_with_even_numbered_license_plates(9242), vehicles_with_odd_numbered_license_plates(9243), vehicles_with_parking_permits(9244), vehicles_with_catalytic_converters(9245), vehicles_without_catalytic_converters(9246), gas_powered_vehicles(9247), diesel_powered_vehicles(9248), lPG_vehicles(9249), military_convoys(9250), military_vehicles(9251), electric_powered_vehicles(9252), hybrid_powered_vehicles(9253), inherently_low_emisson_vehicles(9254), commerical_vehicles(9255), runaway_vehicles(9256), vehicles_with_lugs(9257), motor_driven_cycles(9258), recreational_vehicles(9259), non_motorized_vehicles(9260), traffic(9261), through_traffic(9473), holiday_traffic(9474), residents(9475), visitors(9476), long_distance_traffic(9477), local_traffic(9478), regional_traffic(9479), arrivals(9480), departures(9481), airline_travelers(9482), commuter_airline_travelers(9483), domestic_airline_travelers(9484), international_airline_travelers(9485), pedestrians(9486), bicyclists(9487), emergency_vehicle_units(9729), federal_law_enforcement_units(9730), state_police_units(9731), county_police_units(9732), local_police_units(9733), ambulance_units(9734), rescue_units(9735), fire_units(9736), hAZMAT_units(9737), light_tow_unit(9738), heavy_tow_unit(9739), private_tow_units(9743), freeway_service_patrols(9740), transportation_response_units(9741), private_contractor_response_units(9742), ground_fire_suppression(9985), heavy_ground_equipment(9986), aircraft(9988), marine_equipment(9989), support_equipment(9990), medical_rescue_unit(9991), other(9993), ground_fire_suppression_other(9994), engine(9995), truck_or_aerial(9996), quint(9997), tanker_pumper_combination(9998), brush_truck(10000), aircraft_rescue_firefighting(10001), heavy_ground_equipment_other(10004), dozer_or_plow(10005), tractor(10006), tanker_or_tender(10008), aircraft_other(10024), aircraft_fixed_wing_tanker(10025), helitanker(10026), helicopter(10027), marine_equipment_other(10034), fire_boat_with_pump(10035), boat_no_pump(10036), support_apparatus_other(10044), breathing_apparatus_support(10045), light_and_air_unit(10046), medical_rescue_unit_other(10054), rescue_unit(10055), urban_search_rescue_unit(10056), high_angle_rescue(10057), crash_fire_rescue(10058), bLS_unit(10059), aLS_unit(10060), mobile_command_post(10075), chief_officer_car(10076), hAZMAT_unit(10077), type_i_hand_crew(10078), type_ii_hand_crew(10079), privately_owned_vehicle(10083), other_apparatus_resource(10084), ambulance(10085), bomb_squad_van(10086), combine_harvester(10087), construction_vehicle(10088), farm_tractor(10089), grass_cutting_machines(10090), hAZMAT_containment_tow(10091), heavy_tow(10092), light_tow(10094), flatbed_tow(10114), hedge_cutting_machines(10093), mobile_crane(10095), refuse_collection_vehicle(10096), resurfacing_vehicle(10097), road_sweeper(10098), roadside_litter_collection_crews(10099), survey_crews(10115), salvage_vehicle(10100), sand_truck(10101), snowplow(10102), steam_roller(10103), swat_team_van(10104), track_laying_vehicle(10105), unknown_vehicle(10106), white_lining_vehicle(10107), dump_truck(10108), supervisor_vehicle(10109), snow_blower(10110), rotary_snow_blower(10111), road_grader(10112), steam_truck(10113), unknown_status(10240), ready_for_use(10241), working_normally(10242), working_autonomously(10243), working_incorrectly(10244), not_working(10245), normal_maintenance(10246), in_route_to_use(10247), returning_from_use(10248), out_of_service(10249), off_duty(10250), on_patrol(10251), on_call(10252), on_break(10253), mandatory_time_off(10254), low_on_fuel(10255), low_on_water(10256), low_charge(10257), missing(10258), none(10496), light_pole(10497), utiltity_pole(10498), gantry_way(10499), sign_support(10500), signal_pole(10501), signage_public(10502), signage_private(10503), overhead_sign(10568), ground_sign(10569), cones(10504), cones_post_type(10505), cones_glue_post(10506), cones_other(10507), barriers(10508), barrier_Aframe(10509), barriers_heavy_duty(10510), barricade_type_III(10511), barricade_small(10512), solid_barrier(10565), moveable_barrier(10566), barricade_lights(10513), beacon(10514), t_stand(10515), a_stand(10516), drums(10517), sand_barrel(10567), impact_attenuator(10518), barricade_tape(10519), safety_fence(10520), temp_pavement_markings(10521), speed_bumps(10522), temp_curbs(10523), parking_blocks(10524), signboard_fixed(10525), signboard_portable(10526), stripe(10572), island(10573), har(10527), har_AM(10528), har_FM(10529), har_DSRC(10530), traffic_light(10531), lane_control_signal(10532), traffic_detector(10533), vehicle_detector(10534), system_alarm(10535), arrow_board(10536), fixed_VMS(10537), mobile_VMS(10538), ramp_control(10539), gate_control(10540), temporary_traffic_light(10541), over_height_warning_system(10542), over_weight_warning_system(10543), emergency_telephones(10544), railroad_crossing_equipment(10545), tunnel_ventilation(10546), ccTV(10547), environmental_sensor(10548), emergency_signal(10570), countdown_pedestrian_sign(10571), switch(10549), signal(10550), third_rail(10551), overhead_power(10552), concrete_tie(10553), wooden_tie(10554), manhole_cover(10559), culvert(10560), escalator(10555), elevator(10556), snow_poles(10561), track(10557), guide_poles(10562), drawbridge(10558), expansion_joint(10563), shifted_plate(10564), unknown_transit_problem(10753), sleeping_customer(10754), assault_on_passenger(10755), assault_on_employee(10756), broken_seat(10757), bus_alarm(10758), crime_or_drug_deal(10759), eating_on_board(10760), equipment_problem_with_air_conditioning(10761), equipment_problem_with_air_system(10762), equipment_problem_with_brakes(10763), equipment_problem_with_chassis_or_suspension(10764), equipment_problem_with_cooling_system(10765), equipment_problem_with_doors(10766), equipment_problem_with_electrical(10767), equipment_problem_with_engine(10768), equipment_problem_with_exterior_or_body(10769), equipment_problem_with_fare_collection(10770), equipment_problem_with_fuel_or_exhaust(10771), equipment_problem_with_horn(10772), equipment_problem_with_interior(10773), equipment_problem_with_liftkneeling(10774), equipment_problem_with_lights(10775), equipment_problem_with_lubrication(10776), equipment_problem_with_radio_or_communication(10777), equipment_problem_with_signs(10778), equipment_problem_with_steering(10779), equipment_problem_with_tires(10780), equipment_problem_with_transmission(10781), equipment_problem_with_unknown_alarm(10782), equipment_problem_with_wipers(10783), fare_dispute_expired_pass(10784), fare_dispute_expired_transfer(10785), fare_dispute_expired_upgrade(10786), fare_dispute_other(10787), fare_dispute_refuses_to_pay(10788), lift_passenger_cycle_completed(10789), lift_passenger_ready_to_alight(10790), lift_passenger_ready_to_board(10791), lost_article(10792), objects_thrown(10793), passenger_accident_alighting(10794), passenger_accident_boarding(10795), passenger_accident_fallen_on_board(10796), passenger_load(10797), passenger_accident_other(10798), passenger_sick_or_injured(10799), right_of_way(10800), theft(10801), theft_of_service(10802), waiting_to_get_relief_for_schedule_break(10803), waiting_to_get_relief_after_run_is_finished(10804), waiting_to_provide_relief(10805), unknown_object(11009), tire(11010), rim(11011), retread(11012), trash(11013), cargo(11014), diesel(11015), gasoline(11016), anti_freeze(11017), propane_gas(11061), alternative_fuel(11060), seat_belts(11018), litter_container(11019), all_Terrain_vehicle(11020), seaplane(11021), chairlift(11022), fishing_pier(11023), telephone(11025), railroad_cross_buck(11024), horn(11048), train(11047), deer(11049), horse(11051), cattle(11050), golf_cart(11052), services(11056), motorist_services(11059), food_services(11053), roadside_table(11055), ambulance_staging_point(11054), fallout(11026), medical(11027), chemical(11028), welfare(11029), decontamination(11063), evacuation(11030), registration(11062), emergency(11064), left_arrow_signal(11031), ahead_arrow_signal(11032), right_arrow_signal(11033), green_light_signal(11034), green_arrow_signal(11035), yellow_light_signal(11036), yellow_arrow_signal(11037), red_light_signal(11038), red_arrow_signal(11039), extended_green_signal(11040), advance_arrow_signal(11041), pedestrian_Signal_Stop(11042), pedestrian_Signal_Caution(11043), pedestrian_Signal_Walk(11044), pedestrian_Signal_Light(11045), pedestrian_Signal_Time_Display(11046), prohibit_None_Allowed_LU_LT_L45_S_R45_RT_RU(11264), prohibit_RU_Allowed_LU_LT_L45_S_R45_RT(11265), prohibit_RT_Allowed_LU_LT_L45_S_R45_RU(11266), prohibit_RT_RU_Allowed_LU_LT_L45_S_R45(11267), prohibit_R45_Allowed_LU_LT_L45_S_RT_RU(11268), prohibit_R45_RU_Allowed_LU_LT_L45_S_RT(11269), prohibit_R45_RT_Allowed_LU_LT_L45_S_RU(11270), prohibit_R45_RT_RU_Allowed_LU_LT_L45_S(11271), prohibit_S_Allowed_LU_LT_L45_R45_RT_RU(11272), prohibit_S_RU_Allowed_LU_LT_L45_R45_RT(11273), prohibit_S_RT_Allowed_LU_LT_L45_R45_RU(11274), prohibit_S_RT_RU_Allowed_LU_LT_L45_R45(11275), prohibit_S_R45_Allowed_LU_LT_L45_RT_RU(11276), prohibit_S_R45_RU_Allowed_LU_LT_L45_RT(11277), prohibit_S_R45_RT_Allowed_LU_LT_L45_RU(11278), prohibit_S_R45_RT_RU_Allowed_LU_LT_L45(11279), prohibit_L45_Allowed_LU_LT_S_R45_RT_RU(11280), prohibit_L45_RU_Allowed_LU_LT_S_R45_RT(11281), prohibit_L45_RT_Allowed_LU_LT_S_R45_RU(11282), prohibit_L45_RT_RU_Allowed_LU_LT_S_R45(11283), prohibit_L45_R45_Allowed_LU_LT_S_RT_RU(11284), prohibit_L45_R45_RU_Allowed_LU_LT_S_RT(11285), prohibit_L45_R45_RT_Allowed_LU_LT_S_RU(11286), prohibit_L45_R45_RT_RU_Allowed_LU_LT_S(11287), prohibit_L45_S_Allowed_LU_LT_R45_RT_RU(11288), prohibit_L45_S_RU_Allowed_LU_LT_R45_RT(11289), prohibit_L45_S_RT_Allowed_LU_LT_R45_RU(11290), prohibit_L45_S_RT_RU_Allowed_LU_LT_R45(11291), prohibit_L45_S_R45_Allowed_LU_LT_RT_RU(11292), prohibit_L45_S_R45_RU_Allowed_LU_LT_RT(11293), prohibit_L45_S_R45_RT_Allowed_LU_LT_RU(11294), prohibit_L45_S_R45_RT_RU_Allowed_LU_LT(11295), prohibit_LT_Allowed_LU_L45_S_R45_RT_RU(11296), prohibit_LT_RU_Allowed_LU_L45_S_R45_RT(11297), prohibit_LT_RT_Allowed_LU_L45_S_R45_RU(11298), prohibit_LT_RT_RU_Allowed_LU_L45_S_R45(11299), prohibit_LT_R45_Allowed_LU_L45_S_RT_RU(11300), prohibit_LT_R45_RU_Allowed_LU_L45_S_RT(11301), prohibit_LT_R45_RT_Allowed_LU_L45_S_RU(11302), prohibit_LT_R45_RT_RU_Allowed_LU_L45_S(11303), prohibit_LT_S_Allowed_LU_L45_R45_RT_RU(11304), prohibit_LT_S_RU_Allowed_LU_L45_R45_RT(11305), prohibit_LT_S_RT_Allowed_LU_L45_R45_RU(11306), prohibit_LT_S_RT_RU_Allowed_LU_L45_R45(11307), prohibit_LT_S_R45_Allowed_LU_L45_RT_RU(11308), prohibit_LT_S_R45_RU_Allowed_LU_L45_RT(11309), prohibit_LT_S_R45_RT_Allowed_LU_L45_RU(11310), prohibit_LT_S_R45_RT_RU_Allowed_LU_L45(11311), prohibit_LT_L45_Allowed_LU_S_R45_RT_RU(11312), prohibit_LT_L45_RU_Allowed_LU_S_R45_RT(11313), prohibit_LT_L45_RT_Allowed_LU_S_R45_RU(11314), prohibit_LT_L45_RT_RU_Allowed_LU_S_R45(11315), prohibit_LT_L45_R45_Allowed_LU_S_RT_RU(11316), prohibit_LT_L45_R45_RU_Allowed_LU_S_RT(11317), prohibit_LT_L45_R45_RT_Allowed_LU_S_RU(11318), prohibit_LT_L45_R45_RT_RU_Allowed_LU_S(11319), prohibit_LT_L45_S_Allowed_LU_R45_RT_RU(11320), prohibit_LT_L45_S_RU_Allowed_LU_R45_RT(11321), prohibit_LT_L45_S_RT_Allowed_LU_R45_RU(11322), prohibit_LT_L45_S_RT_RU_Allowed_LU_R45(11323), prohibit_LT_L45_S_R45_Allowed_LU_RT_RU(11324), prohibit_LT_L45_S_R45_RU_Allowed_LU_RT(11325), prohibit_LT_L45_S_R45_RT_Allowed_LU_RU(11326), prohibit_LT_L45_S_R45_RT_RU_Allowed_LU(11327), prohibit_LU_Allowed_LT_L45_S_R45_RT_RU(11328), prohibit_LU_RU_Allowed_LT_L45_S_R45_RT(11329), prohibit_LU_RT_Allowed_LT_L45_S_R45_RU(11330), prohibit_LU_RT_RU_Allowed_LT_L45_S_R45(11331), prohibit_LU_R45_Allowed_LT_L45_S_RT_RU(11332), prohibit_LU_R45_RU_Allowed_LT_L45_S_RT(11333), prohibit_LU_R45_RT_Allowed_LT_L45_S_RU(11334), prohibit_LU_R45_RT_RU_Allowed_LT_L45_S(11335), prohibit_LU_S_Allowed_LT_L45_R45_RT_RU(11336), prohibit_LU_S_RU_Allowed_LT_L45_R45_RT(11337), prohibit_LU_S_RT_Allowed_LT_L45_R45_RU(11338), prohibit_LU_S_RT_RU_Allowed_LT_L45_R45(11339), prohibit_LU_S_R45_Allowed_LT_L45_RT_RU(11340), prohibit_LU_S_R45_RU_Allowed_LT_L45_RT(11341), prohibit_LU_S_R45_RT_Allowed_LT_L45_RU(11342), prohibit_LU_S_R45_RT_RU_Allowed_LT_L45(11343), prohibit_LU_L45_Allowed_LT_S_R45_RT_RU(11344), prohibit_LU_L45_RU_Allowed_LT_S_R45_RT(11345), prohibit_LU_L45_RT_Allowed_LT_S_R45_RU(11346), prohibit_LU_L45_RT_RU_Allowed_LT_S_R45(11347), prohibit_LU_L45_R45_Allowed_LT_S_RT_RU(11348), prohibit_LU_L45_R45_RU_Allowed_LT_S_RT(11349), prohibit_LU_L45_R45_RT_Allowed_LT_S_RU(11350), prohibit_LU_L45_R45_RT_RU_Allowed_LT_S(11351), prohibit_LU_L45_S_Allowed_LT_R45_RT_RU(11352), prohibit_LU_L45_S_RU_Allowed_LT_R45_RT(11353), prohibit_LU_L45_S_RT_Allowed_LT_R45_RU(11354), prohibit_LU_L45_S_RT_RU_Allowed_LT_R45(11355), prohibit_LU_L45_S_R45_Allowed_LT_RT_RU(11356), prohibit_LU_L45_S_R45_RU_Allowed_LT_RT(11357), prohibit_LU_L45_S_R45_RT_Allowed_LT_RU(11358), prohibit_LU_L45_S_R45_RT_RU_Allowed_LT(11359), prohibit_LU_LT_Allowed_L45_S_R45_RT_RU(11360), prohibit_LU_LT_RU_Allowed_L45_S_R45_RT(11361), prohibit_LU_LT_RT_Allowed_L45_S_R45_RU(11362), prohibit_LU_LT_RT_RU_Allowed_L45_S_R45(11363), prohibit_LU_LT_R45_Allowed_L45_S_RT_RU(11364), prohibit_LU_LT_R45_RU_Allowed_L45_S_RT(11365), prohibit_LU_LT_R45_RT_Allowed_L45_S_RU(11366), prohibit_LU_LT_R45_RT_RU_Allowed_L45_S(11367), prohibit_LU_LT_S_Allowed_L45_R45_RT_RU(11368), prohibit_LU_LT_S_RU_Allowed_L45_R45_RT(11369), prohibit_LU_LT_S_RT_Allowed_L45_R45_RU(11370), prohibit_LU_LT_S_RT_RU_Allowed_L45_R45(11371), prohibit_LU_LT_S_R45_Allowed_L45_RT_RU(11372), prohibit_LU_LT_S_R45_RU_Allowed_L45_RT(11373), prohibit_LU_LT_S_R45_RT_Allowed_L45_RU(11374), prohibit_LU_LT_S_R45_RT_RU_Allowed_L45(11375), prohibit_LU_LT_L45_Allowed_S_R45_RT_RU(11376), prohibit_LU_LT_L45_RU_Allowed_S_R45_RT(11377), prohibit_LU_LT_L45_RT_Allowed_S_R45_RU(11378), prohibit_LU_LT_L45_RT_RU_Allowed_S_R45(11379), prohibit_LU_LT_L45_R45_Allowed_S_RT_RU(11380), prohibit_LU_LT_L45_R45_RU_Allowed_S_RT(11381), prohibit_LU_LT_L45_R45_RT_Allowed_S_RU(11382), prohibit_LU_LT_L45_R45_RT_RU_Allowed_S(11383), prohibit_LU_LT_L45_S_Allowed_R45_RT_RU(11384), prohibit_LU_LT_L45_S_RU_Allowed_R45_RT(11385), prohibit_LU_LT_L45_S_RT_Allowed_R45_RU(11386), prohibit_LU_LT_L45_S_RT_RU_Allowed_R45(11387), prohibit_LU_LT_L45_S_R45_Allowed_RT_RU(11388), prohibit_LU_LT_L45_S_R45_RU_Allowed_RT(11389), prohibit_LU_LT_L45_S_R45_RT_Allowed_RU(11390), prohibit_LU_LT_L45_S_R45_RT_RU_Allowed_None(11391), n1_16th(11521), n1_10th(11522), n1_8th(11523), n1_4th(11524), n1_3rd(11525), n1_2(11526), n3_4(11527), n300(11531), n350(11532), n400(11533), n450(11534), n500(11535), n550(11536), n600(11537), n650(11538), n700(11539), n750(11540), n800(11541), n850(11542), n900(11543), n950(11544), n1000(11545), n1100(11546), n1200(11547), n1300(11548), n1400(11549), n1500(11550), n1600(11551), n1700(11552), n1800(11553), n1900(11554), n2000(11555), n2100(11556), n2200(11557), n2300(11558), n2400(11559), n2500(11560), n2600(11561), n2700(11562), n2800(11563), n2900(11564), n3000(11565), n3500(11566), n4000(11567), n4500(11568), n5000(11569), n5500(11570), n6000(11571), n6500(11572), n7000(11573), n7500(11574), n8000(11575), n8500(11576), n9000(11577), n9500(11578), n10000(11579), n11000(11580), n12000(11581), n13000(11582), n14000(11583), n15000(11584), n16000(11585), n17000(11586), n18000(11587), n19000(11588), n20000(11589), n21000(11590), n22000(11591), n23000(11592), n24000(11593), n25000(11594), n26000(11595), n27000(11596), n28000(11597), n29000(11598), n30000(11599), n35000(11600), n40000(11601), n45000(11602), n50000(11603), n55000(11604), n60000(11605), n65000(11606), n70000(11607), n75000(11608), n80000(11609), n85000(11610), n90000(11611), n95000(11612), n100000(11613), name_follows(11777), freeway(11778), us_Route(11779), state_Route(11780), interstate(11781), business_Loop(11782), spur(11797), juncton(11798), alternative(11783), county_Route(11784), forest_Route(11785), farm_to_Market_Route(11786), eisenhower_Interstate_System(11787), americas_Byways(11788), national_Network_Route(11789), scenic_Area(11790), parking_Area(11791), weight_Station(11792), road(11793), exit(11794), historical_route(11795), state_line(11796), bicyle_route(11799), bicyle_interstate_route(11800), national_park(11801), bear_veiwing_area(12033), deer_viewing_area(12034), drinking_water(12035), environmental_study_area(12036), falling_rocks(12037), firearms(12038), leashed_pets(12039), point_of_interest(12040), smoking(12041), dog(12042), tent_camping(12043), trailer_camping(12044), first_aid(12045), handicapped(12046), mechanic(12047), trailer_sanitary_station(12048), viewing_area(12049), scenic_overlook(12095), campfire(12050), locker(12051), sleeping(12052), trail(12053), climbing(12054), rock_climbing(12055), hunting(12056), playground(12057), rock_collecting(12058), spelunking(12059), bicycle_trail(12060), hiking_trail(12061), horse_trail(12062), trail_interpretive_auto(12063), trail_interpretive_pedestrian(12064), trail_road_for_4WD_vehicles(12065), trail_for_trail_bikes(12066), archer(12067), hang_glider(12068), boat_tours(12069), canoeing(12070), diving(12071), scuba_diving(12072), fishing(12073), marine_recreation_area(12074), motorboating(12075), boat_ramp(12076), rowboating(12077), sailboating(12078), water_skiing(12079), surfing(12080), swimming(12081), wading(12082), hand_launch(12083), kayak(12084), wind_surf(12085), ice_skating(12086), ski_jumping(12087), bobbing(12088), cross_country_skiing(12089), downhill_skiing(12090), sledding(12091), snowmobiling(12092), snowshoeing(12093), winter_recreation_area(12094), regulatory_sign(12289), warning_sign(12290), information_sign(12291), construction_sign(12292), guide_sign(12293), stop(12294), yield(12295), caution(12330), temporary(12331), to_oncoming_traffic(12296), four_way(12297), all_way(12298), one_way(12329), zone(12299), narrows(12300), widens(12301), reduced(12302), combined(12303), minimum(12304), maximum(12305), divided_road(12306), double_arrow(12307), dead_end(12308), no_outlet(12309), wrong_way(12310), do_not_enter(12314), chevron(12313), t_intersection_to_the_side(12315), t_intersection_oncoming(12316), y_intersection_to_the_side(12317), y_intersection_oncoming(12318), four_way_divided_highway_crossing(12319), t_way_divided_highway_crossing(12320), light_rail_divided_highway_crossing(12321), light_rail_t_divided_highway_crossing(12322), side_road_to_right(12323), side_road_to_left(12324), side_road_to_right_at_angle(12325), side_road_to_left_at_angle(12326), entering_roadway_merge(12327), entering_roadway_added_lane(12328), n1(12545), n2(12546), n3(12547), n4(12548), n5(12549), n6(12550), n7(12551), n8(12552), n9(12553), n10(12554), n11(12555), n12(12556), n13(12557), n14(12558), n15(12559), n16(12560), n17(12561), n18(12562), n19(12563), n20(12564), n21(12565), n22(12566), n23(12567), n24(12568), n25(12569), n26(12570), n27(12571), n28(12572), n29(12573), n30(12574), n31(12575), n32(12576), n33(12577), n34(12578), n35(12579), n36(12580), n37(12581), n38(12582), n39(12583), n40(12584), n41(12585), n42(12586), n43(12587), n44(12588), n45(12589), n46(12590), n47(12591), n48(12592), n49(12593), n50(12594), n51(12595), n52(12596), n53(12597), n54(12598), n55(12599), n56(12600), n57(12601), n58(12602), n59(12603), n60(12604), n61(12605), n62(12606), n63(12607), n64(12608), n65(12609), n66(12610), n67(12611), n68(12612), n69(12613), n70(12614), n71(12615), n72(12616), n73(12617), n74(12618), n75(12619), n76(12620), n77(12621), n78(12622), n79(12623), n80(12624), n81(12625), n82(12626), n83(12627), n84(12628), n85(12629), n86(12630), n87(12631), n88(12632), n89(12633), n90(12634), n91(12635), n92(12636), n93(12637), n94(12638), n95(12639), n96(12640), n97(12641), n98(12642), n99(12643), n100(12644), n101(12645), n102(12646), n103(12647), n104(12648), n105(12649), n106(12650), n107(12651), n108(12652), n109(12653), n110(12654), n111(12655), n112(12656), n113(12657), n114(12658), n115(12659), n116(12660), n117(12661), n118(12662), n119(12663), n120(12664), n121(12665), n122(12666), n123(12667), n124(12668), n125(12669), n126(12670), n127(12671), n128(12672), n129(12673), n130(12674), n131(12675), n132(12676), n133(12677), n134(12678), n135(12679), n136(12680), n137(12681), n138(12682), n139(12683), n140(12684), n141(12685), n142(12686), n143(12687), n144(12688), n145(12689), n146(12690), n147(12691), n148(12692), n149(12693), n150(12694), n151(12695), n152(12696), n153(12697), n154(12698), n155(12699), n156(12700), n157(12701), n158(12702), n159(12703), n160(12704), n161(12705), n162(12706), n163(12707), n164(12708), n165(12709), n166(12710), n167(12711), n168(12712), n169(12713), n170(12714), n171(12715), n172(12716), n173(12717), n174(12718), n175(12719), n176(12720), n177(12721), n178(12722), n179(12723), n180(12724), n181(12725), n182(12726), n183(12727), n184(12728), n185(12729), n186(12730), n187(12731), n188(12732), n189(12733), n190(12734), n191(12735), n192(12736), n193(12737), n194(12738), n195(12739), n196(12740), n197(12741), n198(12742), n199(12743), n200(12744), n201(12745), n202(12746), n203(12747), n204(12748), n205(12749), n206(12750), n207(12751), n208(12752), n209(12753), n210(12754), n211(12755), n212(12756), n213(12757), n214(12758), n215(12759), n216(12760), n217(12761), n218(12762), n219(12763), n220(12764), n221(12765), n222(12766), n223(12767), n224(12768), n225(12769), n226(12770), n227(12771), n228(12772), n229(12773), n230(12774), n231(12775), n232(12776), n233(12777), n234(12778), n235(12779), n236(12780), n237(12781), n238(12782), n239(12783), n240(12784), n241(12785), n242(12786), n243(12787), n244(12788), n245(12789), n246(12790), n247(12791), n248(12792), n249(12793), n250(12794), n251(12795), n252(12796), n253(12797), n254(12798), n255(12799), alabama(12801), alaska(12802), american_Samoa(12803), arizona(12804), arkansas(12805), california(12806), colorado(12807), connecticut(12808), delaware(12809), district_of_Columbia(12810), florida(12811), georgia(12812), guam(12813), hawaii(12814), idaho(12815), illinois(12816), indiana(12817), iowa(12818), kansas(12819), kentucky(12820), louisiana(12821), maine(12822), maryland(12823), massachusetts(12824), michigan(12825), minnesota(12826), mississippi(12827), missouri(12828), montana(12829), nebraska(12830), nevada(12831), new_Hampshire(12832), new_Jersey(12833), new_Mexico(12834), new_York(12835), north_Carolina(12836), north_Dakota(12837), northern_Marianas_Islands(12838), ohio(12839), oklahoma(12840), oregon(12841), pennsylvania(12842), puerto_rico(12843), rhode_Island(12844), south_Carolina(12845), south_Dakota(12846), tennessee(12847), texas(12848), utah(12849), vermont(12850), virginia(12851), virgin_Islands(12852), washington(12853), west_Virginia(12854), wisconsin(12855), wyoming(12856), rest_room(13057), mens_rest_room(13058), womens_rest_room(13059), family_rest_room(13060), dam(13061), fish_hatchery(13062), information(13063), lighthouse(13064), lookout_tower(13065), ranger_station(13066), grocery_store(13068), lodging(13069), post_office(13070), picnic_shelter(13072), group_camping(13073), group_picnicking(13074), n24_hour_pharmacy(13075), kennel(13076), laundry_facilities(13077), shower_facilities(13078), amphitheater(13079), stable(13080), hospital(13081), emergency_medical_service_point(13082), library(13083), recycling_collection_center(13084), school(13085), alley(13313), annex(13314), arcade(13315), avenue(13316), bayoo(13317), beach(13318), bend(13319), bluff(13320), bottom(13321), boulevard(13322), branch(13323), nbridge(13324), brook(13325), burg(13326), bypass(13327), camp(13328), canyon(13329), cape(13330), causeway(13331), nCenter(13332), circle(13333), cliff(13334), club(13335), common(13336), corner(13337), course(13338), court(13339), cove(13340), creek(13341), crescent(13342), crest(13343), nCrossing(13344), crossroad(13345), curve(13346), dale(13347), nDam(13348), divide(13349), drive(13350), estate(13351), expressway(13352), extension(13353), fall(13354), nFerry(13355), field(13356), flat(13357), ford(13358), forest(13359), forge(13360), fork(13361), fort(13362), nFreeway(13363), garden(13364), gateway(13365), glen(13366), green(13367), grove(13368), harbor(13369), haven(13370), heights(13371), highway(13372), nHill(13373), hollow(13374), inlet(13375), nIsland(13376), isle(13377), nJunction(13378), key(13379), knoll(13380), lake(13381), land(13382), landing(13383), nLane(13384), light(13385), loaf(13386), lock(13387), lodge(13388), loop(13389), mall(13390), manor(13391), meadow(13392), mews(13393), mill(13394), mission(13395), motorway(13396), mount(13397), mountain(13398), neck(13399), orchard(13400), oval(13401), nOverpass(13402), park(13403), parkway(13404), nPass(13405), passage(13406), path(13407), pike(13408), pine(13409), plains(13410), plaza(13411), point(13412), port(13413), prairie(13414), radial(13415), ramp(13416), ranch(13417), rapid(13418), rest(13419), ridge(13420), river(13421), nRoad(13422), route(13423), row(13424), rue(13425), run(13426), shoal(13427), shore(13428), skyway(13429), spring(13430), nSpur(13431), square(13432), nStation(13433), stravenue(13434), stream(13435), street(13436), summit(13437), terrace(13438), throughway(13439), trace(13440), nTrack(13441), trafficway(13442), nTrail(13443), xTunnel(13444), turnpike(13445), nUnderpass(13446), union(13447), valley(13448), viaduct(13449), view(13450), village(13451), ville(13452), vista(13453), nWalk(13454), wall(13455), way(13456), well(13457), ahead(13569), here(13570), here_to(13571), here_to_alley(13572), here_to_corner(13573), here_to_sign(13574), between_signs(13575), between(13633), this_side_of_street(13576), this_side_of_sign(13577), right(13579), left(13580), begin_point(13581), next(13582), starting_start(13611), ends_end(13583), other_Side(13584), crossing(13585), crosswalks(13586), center_strip(13587), lane(13588), shelter(13634), center(13635), hill(13589), both_ways_left_and_right(13590), both_ways_45_degree_angle_tilting_right(13591), both_ways_45_degree_angle_tilting_left(13592), both_directions_of_travel(13593), left_arrow(13610), left_turn(13594), left_45_degree_arrow(13595), left_45_degree_turn(13596), ahead_and_to_the_left(13597), ahead_and_to_the_left_at_a_45_degree_angle(13598), right_arrow(13609), right_turn(13599), right_45_degree_arrow(13600), right_45_degree_turn(13601), ahead_and_to_the_right(13602), ahead_and_to_the_right_at_a_45_degree_angle(13603), downward_left_45_degree(13604), downward_right_45_degree(13605), downward_left_and_right_45_degree(13606), reverse_turn_to_right(13636), reverse_turn_to_left(13637), reverse_curve_to_right(13638), reverse_curve_to_left(13639), two_lane_reverse_curve_to_right(13623), two_lane_reverse_curve_to_left(13624), three_lane_reverse_curve_to_right(13625), three_lane_reverse_curve_to_left(13626), winding_road_to_right(13640), winding_road_to_left(13641), chevron_right(13613), chevron_left(13614), right_turn_with_junction(13615), left_turn_with_junction(13616), hairpin_right(13617), hairpin_left(13618), truck_rollover_right(13619), truck_rollover_left(13620), n270_degreee_turn_right(13621), n270_degreee_turn_left(13622), double_reverse_curve_to_right(13627), double_reverse_curve_to_left(13628), two_lane_double_reverse_curve_to_right(13629), two_lane_double_reverse_curve_to_left(13630), three_lane_double_reverse_curve_to_right(13631), three_lane_double_reverse_curve_to_left(13632);
        struct EmergencyVehicleAlert_RoadSideAlert_description description;  // SEQUENCEOF, OPTIONAL;
        struct EmergencyVehicleAlertPriority priority;  // OCTETSTRING, OPTIONAL;
        struct EmergencyVehicleAlertHeadingSlice heading;  // OCTETSTRING, OPTIONAL;
        struct OPT_ENUM_ASN extent;  // ENUMERATED, OPTIONAL, useInstantlyOnly(0), useFor3meters(1), useFor10meters(2), useFor50meters(3), useFor100meters(4), useFor500meters(5), useFor1000meters(6), useFor5000meters(7), useFor10000meters(8), useFor50000meters(9), useFor100000meters(10), forever(127);
        struct EmergencyVehicleAlertFullPositionVector positon;  // SEQUENCE, OPTIONAL;
        struct EmergencyVehicleAlertFurtherInfoID furtherInfoID;  // OCTETSTRING, OPTIONAL;
        struct EmergencyVehicleAlertMsgCRC crc;  // OCTETSTRING;
    };
    
    struct EmergencyVehicleAlert {
        INT isValidFlag;   // necessary if this struct is used as an optional field of a SEQUENCE
        INT msgID;  // ENUMERATED, reserved(0), alaCarteMessage(1), basicSafetyMessage(2), basicSafetyMessageVerbose(3), commonSafetyRequest(4), emergencyVehicleAlert(5), intersectionCollisionAlert(6), mapData(7), nmeaCorrections(8), probeDataManagement(9), probeVehicleData(10), roadSideAlert(11), rtcmCorrections(12), signalPhaseAndTimingMessage(13), signalRequestMessage(14), signalStatusMessage(15), travelerInformation(16);
        struct EmergencyVehicleAlertTemporaryID id;  // OCTETSTRING, OPTIONAL;
        struct EmergencyVehicleAlertRoadSideAlert rsaMsg;  // SEQUENCE;
        struct OPT_ENUM_ASN responseType;  // ENUMERATED, OPTIONAL, notInUseOrNotEquipped(0), emergency(1), nonEmergency(2), pursuit(3);
        struct OPT_BYTE_ASN details;  // INTEGER, OPTIONAL, 0..63;
        struct OPT_BYTE_ASN mass;  // INTEGER, OPTIONAL, 1..127;
        struct OPT_ENUM_ASN basicType;  // ENUMERATED, OPTIONAL, none(0), unknown(1), special(2), moto(3), car(4), carOther(5), bus(6), axleCnt2(7), axleCnt3(8), axleCnt4(9), axleCnt4Trailer(10), axleCnt5Trailer(11), axleCnt6Trailer(12), axleCnt5MultiTrailer(13), axleCnt6MultiTrailer(14), axleCnt7MultiTrailer(15);
        struct OPT_ENUM_ASN vehicleType;  // ENUMERATED, OPTIONAL, all_vehicles(9217), bicycles(9218), motorcycles(9219), cars(9220), light_vehicles(9221), cars_and_light_vehicles(9222), cars_with_trailers(9223), cars_with_recreational_trailers(9224), vehicles_with_trailers(9225), heavy_vehicles(9226), trucks(9227), buses(9228), articulated_buses(9229), school_buses(9230), vehicles_with_semi_trailers(9231), vehicles_with_double_trailers(9232), high_profile_vehicles(9233), wide_vehicles(9234), long_vehicles(9235), hazardous_loads(9236), exceptional_loads(9237), abnormal_loads(9238), convoys(9239), maintenance_vehicles(9240), delivery_vehicles(9241), vehicles_with_even_numbered_license_plates(9242), vehicles_with_odd_numbered_license_plates(9243), vehicles_with_parking_permits(9244), vehicles_with_catalytic_converters(9245), vehicles_without_catalytic_converters(9246), gas_powered_vehicles(9247), diesel_powered_vehicles(9248), lPG_vehicles(9249), military_convoys(9250), military_vehicles(9251);
        struct OPT_ENUM_ASN responseEquip;  // ENUMERATED, OPTIONAL, ground_fire_suppression(9985), heavy_ground_equipment(9986), aircraft(9988), marine_equipment(9989), support_equipment(9990), medical_rescue_unit(9991), other(9993), ground_fire_suppression_other(9994), engine(9995), truck_or_aerial(9996), quint(9997), tanker_pumper_combination(9998), brush_truck(10000), aircraft_rescue_firefighting(10001), heavy_ground_equipment_other(10004), dozer_or_plow(10005), tractor(10006), tanker_or_tender(10008), aircraft_other(10024), aircraft_fixed_wing_tanker(10025), helitanker(10026), helicopter(10027), marine_equipment_other(10034), fire_boat_with_pump(10035), boat_no_pump(10036), support_apparatus_other(10044), breathing_apparatus_support(10045), light_and_air_unit(10046), medical_rescue_unit_other(10054), rescue_unit(10055), urban_search_rescue_unit(10056), high_angle_rescue(10057), crash_fire_rescue(10058), bLS_unit(10059), aLS_unit(10060), mobile_command_post(10075), chief_officer_car(10076), hAZMAT_unit(10077), type_i_hand_crew(10078), type_ii_hand_crew(10079), privately_owned_vehicle(10083), other_apparatus_resource(10084), ambulance(10085), bomb_squad_van(10086), combine_harvester(10087), construction_vehicle(10088), farm_tractor(10089), grass_cutting_machines(10090), hAZMAT_containment_tow(10091), heavy_tow(10092), light_tow(10094), flatbed_tow(10114), hedge_cutting_machines(10093), mobile_crane(10095), refuse_collection_vehicle(10096), resurfacing_vehicle(10097), road_sweeper(10098), roadside_litter_collection_crews(10099), salvage_vehicle(10100), sand_truck(10101), snowplow(10102), steam_roller(10103), swat_team_van(10104), track_laying_vehicle(10105), unknown_vehicle(10106), white_lining_vehicle(10107), dump_truck(10108), supervisor_vehicle(10109), snow_blower(10110), rotary_snow_blower(10111), road_grader(10112), steam_truck(10113);
        struct OPT_ENUM_ASN responderType;  // ENUMERATED, OPTIONAL, emergency_vehicle_units(9729), federal_law_enforcement_units(9730), state_police_units(9731), county_police_units(9732), local_police_units(9733), ambulance_units(9734), rescue_units(9735), fire_units(9736), hAZMAT_units(9737), light_tow_unit(9738), heavy_tow_unit(9739), freeway_service_patrols(9740), transportation_response_units(9741), private_contractor_response_units(9742);
        struct EmergencyVehicleAlertMsgCRC crc;  // OCTETSTRING;
    };
    
}

/*
// init function to create a simple packet handle
*/ 
LONG API_InitEmergencyVehicleAlertPacket()
{
  return C2xInitPacket("EmergencyVehicleAlert"); 
}

/*
// init function to create a simple packet handle and
// initialize the struct with valid data
*/ 
LONG API_InitEmergencyVehicleAlertPacket(struct EmergencyVehicleAlert msgStruct)
{
  long pktHandle;

  pktHandle = API_InitEmergencyVehicleAlertPacket();

  if (pktHandle != 0)
  {
    // create valid message and application data
    if (C2xCompletePacket(pktHandle) == 0) 
    {
      API_GetEmergencyVehicleAlertParams(pktHandle, msgStruct);
    }
  }
  return pktHandle;
}

/*
// init function to create a packet with security layer and
// initialize the struct with valid data
*/ 
LONG API_InitEmergencyVehicleAlertPacket(struct EmergencyVehicleAlert msgStruct, char packetTypeDesignator[], char certificateName[])
{
  long pktHandle, certHdl;

  // initialize the packet
  pktHandle = C2xInitPacket("EmergencyVehicleAlert", packetTypeDesignator);

  if (pktHandle != 0)
  {
    certHdl = C2xSecCertificateGetHandle(certificateName);  // get the certificate handle for the cert with name "certificateName"
    if (certHdl != 0) 
    {
      C2xSecPacketSetSignerHandle(pktHandle, certHdl); // set the certHdl to the packet
    }

    // create valid message and application data
    if (C2xCompletePacket(pktHandle) == 0) 
    {
      // copy application data to the application structure
      API_GetEmergencyVehicleAlertParams(pktHandle, msgStruct);
    }
  }
  return pktHandle;
}
    

int GetEmergencyVehicleAlert_Blob_TemporaryIDParams(LONG packetHandle, struct EmergencyVehicleAlert_Blob_TemporaryID value, char oldPath[])
{
  char newPath[300];
  int result;

  result = 0;

  snprintf(newPath, elcount(newPath), "%s.%s", oldPath, "temporaryID");
  value.temporaryID = C2xGetTokenInt64(packetHandle, "EmergencyVehicleAlert", newPath);
  result = CheckLastError("EmergencyVehicleAlert", gkFuncRefGet, result);

  return result;
}

int SetEmergencyVehicleAlert_Blob_TemporaryIDParams(LONG packetHandle, struct EmergencyVehicleAlert_Blob_TemporaryID value, char oldPath[])
{
  char newPath[300];
  int result;

  result = 0;

  snprintf(newPath, elcount(newPath), "%s.%s", oldPath, "temporaryID");
  C2xSetTokenInt64(packetHandle, "EmergencyVehicleAlert", newPath, value.temporaryID);
  result = CheckLastError("EmergencyVehicleAlert", gkFuncRefGet, result);

  return result;
}

int GetEmergencyVehicleAlertTemporaryIDParams(LONG packetHandle, struct EmergencyVehicleAlertTemporaryID value, char oldPath[])
{
  char newPath[300];
  int result;

  result = 0;

  snprintf(newPath, elcount(newPath), "%s.%s", oldPath, "_Blob_TemporaryID");
  GetEmergencyVehicleAlert_Blob_TemporaryIDParams(packetHandle, value._Blob_TemporaryID, newPath);
  result = CheckLastError("EmergencyVehicleAlert", gkFuncRefGet, result);

  return result;
}

int SetEmergencyVehicleAlertTemporaryIDParams(LONG packetHandle, struct EmergencyVehicleAlertTemporaryID value, char oldPath[])
{
  char newPath[300];
  int result;

  result = 0;

  snprintf(newPath, elcount(newPath), "%s.%s", oldPath, "_Blob_TemporaryID");
  SetEmergencyVehicleAlert_Blob_TemporaryIDParams(packetHandle, value._Blob_TemporaryID, newPath);
  result = CheckLastError("EmergencyVehicleAlert", gkFuncRefGet, result);

  return result;
}

int GetEmergencyVehicleAlert_RoadSideAlert_descriptionParams(LONG packetHandle, struct EmergencyVehicleAlert_RoadSideAlert_description value, char oldPath[])
{
  char newPath[300]; 
  int i;
  int result;

  result = 0;

  value.length = C2xGetTokenInt(packetHandle, "EmergencyVehicleAlert", oldPath);
  if((result = CheckLastError("EmergencyVehicleAlert", gkFuncRefGet, result))==0)
  {
    for(i=0; i<value.length; i++)
    {
      snprintf(newPath, elcount(newPath), "%s[%d]", oldPath, i);
      value.arrayValue[i] = C2xGetTokenInt64(packetHandle, "EmergencyVehicleAlert", newPath);
      result = CheckLastError("EmergencyVehicleAlert", gkFuncRefGet, result);
    }
  }
  return result;
}

int SetEmergencyVehicleAlert_RoadSideAlert_descriptionParams(LONG packetHandle, struct EmergencyVehicleAlert_RoadSideAlert_description value, char oldPath[])
{
  char newPath[300]; 
  int i;
  int result;

  result = 0;

  C2xRemoveToken(packetHandle, "EmergencyVehicleAlert", oldPath);
  for(i=0; i<value.length; i++)
  {
    snprintf(newPath, elcount(newPath), "%s[%d]", oldPath, i);
    C2xSetTokenInt64(packetHandle, "EmergencyVehicleAlert", newPath, value.arrayValue[i]);
    result = CheckLastError("EmergencyVehicleAlert", gkFuncRefGet, result);
  }
  return result;
}

int GetEmergencyVehicleAlert_Blob_PriorityParams(LONG packetHandle, struct EmergencyVehicleAlert_Blob_Priority value, char oldPath[])
{
  char newPath[300];
  int result;

  result = 0;

  snprintf(newPath, elcount(newPath), "%s.%s", oldPath, "priority");
  value.priority = C2xGetTokenInt(packetHandle, "EmergencyVehicleAlert", newPath);
  result = CheckLastError("EmergencyVehicleAlert", gkFuncRefGet, result);

  return result;
}

int SetEmergencyVehicleAlert_Blob_PriorityParams(LONG packetHandle, struct EmergencyVehicleAlert_Blob_Priority value, char oldPath[])
{
  char newPath[300];
  int result;

  result = 0;

  snprintf(newPath, elcount(newPath), "%s.%s", oldPath, "priority");
  C2xSetTokenInt(packetHandle, "EmergencyVehicleAlert", newPath, value.priority);
  result = CheckLastError("EmergencyVehicleAlert", gkFuncRefGet, result);

  return result;
}

int GetEmergencyVehicleAlertPriorityParams(LONG packetHandle, struct EmergencyVehicleAlertPriority value, char oldPath[])
{
  char newPath[300];
  int result;

  result = 0;

  snprintf(newPath, elcount(newPath), "%s.%s", oldPath, "_Blob_Priority");
  GetEmergencyVehicleAlert_Blob_PriorityParams(packetHandle, value._Blob_Priority, newPath);
  result = CheckLastError("EmergencyVehicleAlert", gkFuncRefGet, result);

  return result;
}

int SetEmergencyVehicleAlertPriorityParams(LONG packetHandle, struct EmergencyVehicleAlertPriority value, char oldPath[])
{
  char newPath[300];
  int result;

  result = 0;

  snprintf(newPath, elcount(newPath), "%s.%s", oldPath, "_Blob_Priority");
  SetEmergencyVehicleAlert_Blob_PriorityParams(packetHandle, value._Blob_Priority, newPath);
  result = CheckLastError("EmergencyVehicleAlert", gkFuncRefGet, result);

  return result;
}

int GetEmergencyVehicleAlertDDateTimeParams(LONG packetHandle, struct EmergencyVehicleAlertDDateTime value, char oldPath[])
{
  char newPath[300];
  int result;

  result = 0;

  snprintf(newPath, elcount(newPath), "%s.%s", oldPath, "year");
  value.year.isValidFlag = C2xIsTokenAvailable(packetHandle, "EmergencyVehicleAlert", newPath);
  if(value.year.isValidFlag==1)
  {
    value.year.value = C2xGetTokenInt(packetHandle, "EmergencyVehicleAlert", newPath);
    result = CheckLastError("EmergencyVehicleAlert", gkFuncRefGet, result);
  }
  snprintf(newPath, elcount(newPath), "%s.%s", oldPath, "month");
  value.month.isValidFlag = C2xIsTokenAvailable(packetHandle, "EmergencyVehicleAlert", newPath);
  if(value.month.isValidFlag==1)
  {
    value.month.value = C2xGetTokenInt(packetHandle, "EmergencyVehicleAlert", newPath);
    result = CheckLastError("EmergencyVehicleAlert", gkFuncRefGet, result);
  }
  snprintf(newPath, elcount(newPath), "%s.%s", oldPath, "day");
  value.day.isValidFlag = C2xIsTokenAvailable(packetHandle, "EmergencyVehicleAlert", newPath);
  if(value.day.isValidFlag==1)
  {
    value.day.value = C2xGetTokenInt(packetHandle, "EmergencyVehicleAlert", newPath);
    result = CheckLastError("EmergencyVehicleAlert", gkFuncRefGet, result);
  }
  snprintf(newPath, elcount(newPath), "%s.%s", oldPath, "hour");
  value.hour.isValidFlag = C2xIsTokenAvailable(packetHandle, "EmergencyVehicleAlert", newPath);
  if(value.hour.isValidFlag==1)
  {
    value.hour.value = C2xGetTokenInt(packetHandle, "EmergencyVehicleAlert", newPath);
    result = CheckLastError("EmergencyVehicleAlert", gkFuncRefGet, result);
  }
  snprintf(newPath, elcount(newPath), "%s.%s", oldPath, "minute");
  value.minute.isValidFlag = C2xIsTokenAvailable(packetHandle, "EmergencyVehicleAlert", newPath);
  if(value.minute.isValidFlag==1)
  {
    value.minute.value = C2xGetTokenInt(packetHandle, "EmergencyVehicleAlert", newPath);
    result = CheckLastError("EmergencyVehicleAlert", gkFuncRefGet, result);
  }
  snprintf(newPath, elcount(newPath), "%s.%s", oldPath, "second");
  value.second.isValidFlag = C2xIsTokenAvailable(packetHandle, "EmergencyVehicleAlert", newPath);
  if(value.second.isValidFlag==1)
  {
    value.second.value = C2xGetTokenInt(packetHandle, "EmergencyVehicleAlert", newPath);
    result = CheckLastError("EmergencyVehicleAlert", gkFuncRefGet, result);
  }
  return result;
}

int SetEmergencyVehicleAlertDDateTimeParams(LONG packetHandle, struct EmergencyVehicleAlertDDateTime value, char oldPath[])
{
  char newPath[300];
  int result;

  result = 0;

  snprintf(newPath, elcount(newPath), "%s.%s", oldPath, "year");
  if(value.year.isValidFlag==1)
  {
    C2xSetTokenInt(packetHandle, "EmergencyVehicleAlert", newPath, value.year.value);
    result = CheckLastError("EmergencyVehicleAlert", gkFuncRefGet, result);
  }
  else
  {
    if( C2xIsTokenAvailable(packetHandle, "EmergencyVehicleAlert", newPath) )
    {
      C2xRemoveToken(packetHandle, "EmergencyVehicleAlert", newPath);
    }
  }

  snprintf(newPath, elcount(newPath), "%s.%s", oldPath, "month");
  if(value.month.isValidFlag==1)
  {
    C2xSetTokenInt(packetHandle, "EmergencyVehicleAlert", newPath, value.month.value);
    result = CheckLastError("EmergencyVehicleAlert", gkFuncRefGet, result);
  }
  else
  {
    if( C2xIsTokenAvailable(packetHandle, "EmergencyVehicleAlert", newPath) )
    {
      C2xRemoveToken(packetHandle, "EmergencyVehicleAlert", newPath);
    }
  }

  snprintf(newPath, elcount(newPath), "%s.%s", oldPath, "day");
  if(value.day.isValidFlag==1)
  {
    C2xSetTokenInt(packetHandle, "EmergencyVehicleAlert", newPath, value.day.value);
    result = CheckLastError("EmergencyVehicleAlert", gkFuncRefGet, result);
  }
  else
  {
    if( C2xIsTokenAvailable(packetHandle, "EmergencyVehicleAlert", newPath) )
    {
      C2xRemoveToken(packetHandle, "EmergencyVehicleAlert", newPath);
    }
  }

  snprintf(newPath, elcount(newPath), "%s.%s", oldPath, "hour");
  if(value.hour.isValidFlag==1)
  {
    C2xSetTokenInt(packetHandle, "EmergencyVehicleAlert", newPath, value.hour.value);
    result = CheckLastError("EmergencyVehicleAlert", gkFuncRefGet, result);
  }
  else
  {
    if( C2xIsTokenAvailable(packetHandle, "EmergencyVehicleAlert", newPath) )
    {
      C2xRemoveToken(packetHandle, "EmergencyVehicleAlert", newPath);
    }
  }

  snprintf(newPath, elcount(newPath), "%s.%s", oldPath, "minute");
  if(value.minute.isValidFlag==1)
  {
    C2xSetTokenInt(packetHandle, "EmergencyVehicleAlert", newPath, value.minute.value);
    result = CheckLastError("EmergencyVehicleAlert", gkFuncRefGet, result);
  }
  else
  {
    if( C2xIsTokenAvailable(packetHandle, "EmergencyVehicleAlert", newPath) )
    {
      C2xRemoveToken(packetHandle, "EmergencyVehicleAlert", newPath);
    }
  }

  snprintf(newPath, elcount(newPath), "%s.%s", oldPath, "second");
  if(value.second.isValidFlag==1)
  {
    C2xSetTokenInt(packetHandle, "EmergencyVehicleAlert", newPath, value.second.value);
    result = CheckLastError("EmergencyVehicleAlert", gkFuncRefGet, result);
  }
  else
  {
    if( C2xIsTokenAvailable(packetHandle, "EmergencyVehicleAlert", newPath) )
    {
      C2xRemoveToken(packetHandle, "EmergencyVehicleAlert", newPath);
    }
  }

  return result;
}

int GetEmergencyVehicleAlertElevationParams(LONG packetHandle, struct EmergencyVehicleAlertElevation value, char oldPath[])
{
  char newPath[300];
  int result;

  result = 0;

  snprintf(newPath, elcount(newPath), "%s.%s", oldPath, "_Blob_Elevation");
  value._Blob_Elevation = C2xGetTokenInt(packetHandle, "EmergencyVehicleAlert", newPath);
  result = CheckLastError("EmergencyVehicleAlert", gkFuncRefGet, result);

  return result;
}

int SetEmergencyVehicleAlertElevationParams(LONG packetHandle, struct EmergencyVehicleAlertElevation value, char oldPath[])
{
  char newPath[300];
  int result;

  result = 0;

  snprintf(newPath, elcount(newPath), "%s.%s", oldPath, "_Blob_Elevation");
  C2xSetTokenInt(packetHandle, "EmergencyVehicleAlert", newPath, value._Blob_Elevation);
  result = CheckLastError("EmergencyVehicleAlert", gkFuncRefGet, result);

  return result;
}

int GetEmergencyVehicleAlert_Blob_TransmissionAndSpeedParams(LONG packetHandle, struct EmergencyVehicleAlert_Blob_TransmissionAndSpeed value, char oldPath[])
{
  char newPath[300];
  int result;

  result = 0;

  snprintf(newPath, elcount(newPath), "%s.%s", oldPath, "transmissionState");
  value.transmissionState = C2xGetTokenInt(packetHandle, "EmergencyVehicleAlert", newPath);
  result = CheckLastError("EmergencyVehicleAlert", gkFuncRefGet, result);

  snprintf(newPath, elcount(newPath), "%s.%s", oldPath, "speed");
  value.speed = C2xGetTokenInt(packetHandle, "EmergencyVehicleAlert", newPath);
  result = CheckLastError("EmergencyVehicleAlert", gkFuncRefGet, result);

  return result;
}

int SetEmergencyVehicleAlert_Blob_TransmissionAndSpeedParams(LONG packetHandle, struct EmergencyVehicleAlert_Blob_TransmissionAndSpeed value, char oldPath[])
{
  char newPath[300];
  int result;

  result = 0;

  snprintf(newPath, elcount(newPath), "%s.%s", oldPath, "transmissionState");
  C2xSetTokenInt(packetHandle, "EmergencyVehicleAlert", newPath, value.transmissionState);
  result = CheckLastError("EmergencyVehicleAlert", gkFuncRefGet, result);

  snprintf(newPath, elcount(newPath), "%s.%s", oldPath, "speed");
  C2xSetTokenInt(packetHandle, "EmergencyVehicleAlert", newPath, value.speed);
  result = CheckLastError("EmergencyVehicleAlert", gkFuncRefGet, result);

  return result;
}

int GetEmergencyVehicleAlertTransmissionAndSpeedParams(LONG packetHandle, struct EmergencyVehicleAlertTransmissionAndSpeed value, char oldPath[])
{
  char newPath[300];
  int result;

  result = 0;

  snprintf(newPath, elcount(newPath), "%s.%s", oldPath, "_Blob_TransmissionAndSpeed");
  GetEmergencyVehicleAlert_Blob_TransmissionAndSpeedParams(packetHandle, value._Blob_TransmissionAndSpeed, newPath);
  result = CheckLastError("EmergencyVehicleAlert", gkFuncRefGet, result);

  return result;
}

int SetEmergencyVehicleAlertTransmissionAndSpeedParams(LONG packetHandle, struct EmergencyVehicleAlertTransmissionAndSpeed value, char oldPath[])
{
  char newPath[300];
  int result;

  result = 0;

  snprintf(newPath, elcount(newPath), "%s.%s", oldPath, "_Blob_TransmissionAndSpeed");
  SetEmergencyVehicleAlert_Blob_TransmissionAndSpeedParams(packetHandle, value._Blob_TransmissionAndSpeed, newPath);
  result = CheckLastError("EmergencyVehicleAlert", gkFuncRefGet, result);

  return result;
}

int GetEmergencyVehicleAlert_Blob_PositionalAccuracyParams(LONG packetHandle, struct EmergencyVehicleAlert_Blob_PositionalAccuracy value, char oldPath[])
{
  char newPath[300];
  int result;

  result = 0;

  snprintf(newPath, elcount(newPath), "%s.%s", oldPath, "accuracySemiMajor");
  value.accuracySemiMajor = C2xGetTokenInt(packetHandle, "EmergencyVehicleAlert", newPath);
  result = CheckLastError("EmergencyVehicleAlert", gkFuncRefGet, result);

  snprintf(newPath, elcount(newPath), "%s.%s", oldPath, "accuracySemiMinor");
  value.accuracySemiMinor = C2xGetTokenInt(packetHandle, "EmergencyVehicleAlert", newPath);
  result = CheckLastError("EmergencyVehicleAlert", gkFuncRefGet, result);

  snprintf(newPath, elcount(newPath), "%s.%s", oldPath, "accuracyOrientation");
  value.accuracyOrientation = C2xGetTokenInt(packetHandle, "EmergencyVehicleAlert", newPath);
  result = CheckLastError("EmergencyVehicleAlert", gkFuncRefGet, result);

  return result;
}

int SetEmergencyVehicleAlert_Blob_PositionalAccuracyParams(LONG packetHandle, struct EmergencyVehicleAlert_Blob_PositionalAccuracy value, char oldPath[])
{
  char newPath[300];
  int result;

  result = 0;

  snprintf(newPath, elcount(newPath), "%s.%s", oldPath, "accuracySemiMajor");
  C2xSetTokenInt(packetHandle, "EmergencyVehicleAlert", newPath, value.accuracySemiMajor);
  result = CheckLastError("EmergencyVehicleAlert", gkFuncRefGet, result);

  snprintf(newPath, elcount(newPath), "%s.%s", oldPath, "accuracySemiMinor");
  C2xSetTokenInt(packetHandle, "EmergencyVehicleAlert", newPath, value.accuracySemiMinor);
  result = CheckLastError("EmergencyVehicleAlert", gkFuncRefGet, result);

  snprintf(newPath, elcount(newPath), "%s.%s", oldPath, "accuracyOrientation");
  C2xSetTokenInt(packetHandle, "EmergencyVehicleAlert", newPath, value.accuracyOrientation);
  result = CheckLastError("EmergencyVehicleAlert", gkFuncRefGet, result);

  return result;
}

int GetEmergencyVehicleAlertPositionalAccuracyParams(LONG packetHandle, struct EmergencyVehicleAlertPositionalAccuracy value, char oldPath[])
{
  char newPath[300];
  int result;

  result = 0;

  snprintf(newPath, elcount(newPath), "%s.%s", oldPath, "_Blob_PositionalAccuracy");
  GetEmergencyVehicleAlert_Blob_PositionalAccuracyParams(packetHandle, value._Blob_PositionalAccuracy, newPath);
  result = CheckLastError("EmergencyVehicleAlert", gkFuncRefGet, result);

  return result;
}

int SetEmergencyVehicleAlertPositionalAccuracyParams(LONG packetHandle, struct EmergencyVehicleAlertPositionalAccuracy value, char oldPath[])
{
  char newPath[300];
  int result;

  result = 0;

  snprintf(newPath, elcount(newPath), "%s.%s", oldPath, "_Blob_PositionalAccuracy");
  SetEmergencyVehicleAlert_Blob_PositionalAccuracyParams(packetHandle, value._Blob_PositionalAccuracy, newPath);
  result = CheckLastError("EmergencyVehicleAlert", gkFuncRefGet, result);

  return result;
}

int GetEmergencyVehicleAlert_Blob_PositionConfidenceSetParams(LONG packetHandle, struct EmergencyVehicleAlert_Blob_PositionConfidenceSet value, char oldPath[])
{
  char newPath[300];
  int result;

  result = 0;

  snprintf(newPath, elcount(newPath), "%s.%s", oldPath, "positionConfidence");
  value.positionConfidence = C2xGetTokenInt(packetHandle, "EmergencyVehicleAlert", newPath);
  result = CheckLastError("EmergencyVehicleAlert", gkFuncRefGet, result);

  snprintf(newPath, elcount(newPath), "%s.%s", oldPath, "elevationConfidence");
  value.elevationConfidence = C2xGetTokenInt(packetHandle, "EmergencyVehicleAlert", newPath);
  result = CheckLastError("EmergencyVehicleAlert", gkFuncRefGet, result);

  return result;
}

int SetEmergencyVehicleAlert_Blob_PositionConfidenceSetParams(LONG packetHandle, struct EmergencyVehicleAlert_Blob_PositionConfidenceSet value, char oldPath[])
{
  char newPath[300];
  int result;

  result = 0;

  snprintf(newPath, elcount(newPath), "%s.%s", oldPath, "positionConfidence");
  C2xSetTokenInt(packetHandle, "EmergencyVehicleAlert", newPath, value.positionConfidence);
  result = CheckLastError("EmergencyVehicleAlert", gkFuncRefGet, result);

  snprintf(newPath, elcount(newPath), "%s.%s", oldPath, "elevationConfidence");
  C2xSetTokenInt(packetHandle, "EmergencyVehicleAlert", newPath, value.elevationConfidence);
  result = CheckLastError("EmergencyVehicleAlert", gkFuncRefGet, result);

  return result;
}

int GetEmergencyVehicleAlertPositionConfidenceSetParams(LONG packetHandle, struct EmergencyVehicleAlertPositionConfidenceSet value, char oldPath[])
{
  char newPath[300];
  int result;

  result = 0;

  snprintf(newPath, elcount(newPath), "%s.%s", oldPath, "_Blob_PositionConfidenceSet");
  GetEmergencyVehicleAlert_Blob_PositionConfidenceSetParams(packetHandle, value._Blob_PositionConfidenceSet, newPath);
  result = CheckLastError("EmergencyVehicleAlert", gkFuncRefGet, result);

  return result;
}

int SetEmergencyVehicleAlertPositionConfidenceSetParams(LONG packetHandle, struct EmergencyVehicleAlertPositionConfidenceSet value, char oldPath[])
{
  char newPath[300];
  int result;

  result = 0;

  snprintf(newPath, elcount(newPath), "%s.%s", oldPath, "_Blob_PositionConfidenceSet");
  SetEmergencyVehicleAlert_Blob_PositionConfidenceSetParams(packetHandle, value._Blob_PositionConfidenceSet, newPath);
  result = CheckLastError("EmergencyVehicleAlert", gkFuncRefGet, result);

  return result;
}

int GetEmergencyVehicleAlert_Blob_SpeedandHeadingandThrottleConfidenceParams(LONG packetHandle, struct EmergencyVehicleAlert_Blob_SpeedandHeadingandThrottleConfidence value, char oldPath[])
{
  char newPath[300];
  int result;

  result = 0;

  snprintf(newPath, elcount(newPath), "%s.%s", oldPath, "headingConfidence");
  value.headingConfidence = C2xGetTokenInt(packetHandle, "EmergencyVehicleAlert", newPath);
  result = CheckLastError("EmergencyVehicleAlert", gkFuncRefGet, result);

  snprintf(newPath, elcount(newPath), "%s.%s", oldPath, "speedConfidence");
  value.speedConfidence = C2xGetTokenInt(packetHandle, "EmergencyVehicleAlert", newPath);
  result = CheckLastError("EmergencyVehicleAlert", gkFuncRefGet, result);

  snprintf(newPath, elcount(newPath), "%s.%s", oldPath, "throttleConfidence");
  value.throttleConfidence = C2xGetTokenInt(packetHandle, "EmergencyVehicleAlert", newPath);
  result = CheckLastError("EmergencyVehicleAlert", gkFuncRefGet, result);

  return result;
}

int SetEmergencyVehicleAlert_Blob_SpeedandHeadingandThrottleConfidenceParams(LONG packetHandle, struct EmergencyVehicleAlert_Blob_SpeedandHeadingandThrottleConfidence value, char oldPath[])
{
  char newPath[300];
  int result;

  result = 0;

  snprintf(newPath, elcount(newPath), "%s.%s", oldPath, "headingConfidence");
  C2xSetTokenInt(packetHandle, "EmergencyVehicleAlert", newPath, value.headingConfidence);
  result = CheckLastError("EmergencyVehicleAlert", gkFuncRefGet, result);

  snprintf(newPath, elcount(newPath), "%s.%s", oldPath, "speedConfidence");
  C2xSetTokenInt(packetHandle, "EmergencyVehicleAlert", newPath, value.speedConfidence);
  result = CheckLastError("EmergencyVehicleAlert", gkFuncRefGet, result);

  snprintf(newPath, elcount(newPath), "%s.%s", oldPath, "throttleConfidence");
  C2xSetTokenInt(packetHandle, "EmergencyVehicleAlert", newPath, value.throttleConfidence);
  result = CheckLastError("EmergencyVehicleAlert", gkFuncRefGet, result);

  return result;
}

int GetEmergencyVehicleAlertSpeedandHeadingandThrottleConfidenceParams(LONG packetHandle, struct EmergencyVehicleAlertSpeedandHeadingandThrottleConfidence value, char oldPath[])
{
  char newPath[300];
  int result;

  result = 0;

  snprintf(newPath, elcount(newPath), "%s.%s", oldPath, "_Blob_SpeedandHeadingandThrottleConfidence");
  GetEmergencyVehicleAlert_Blob_SpeedandHeadingandThrottleConfidenceParams(packetHandle, value._Blob_SpeedandHeadingandThrottleConfidence, newPath);
  result = CheckLastError("EmergencyVehicleAlert", gkFuncRefGet, result);

  return result;
}

int SetEmergencyVehicleAlertSpeedandHeadingandThrottleConfidenceParams(LONG packetHandle, struct EmergencyVehicleAlertSpeedandHeadingandThrottleConfidence value, char oldPath[])
{
  char newPath[300];
  int result;

  result = 0;

  snprintf(newPath, elcount(newPath), "%s.%s", oldPath, "_Blob_SpeedandHeadingandThrottleConfidence");
  SetEmergencyVehicleAlert_Blob_SpeedandHeadingandThrottleConfidenceParams(packetHandle, value._Blob_SpeedandHeadingandThrottleConfidence, newPath);
  result = CheckLastError("EmergencyVehicleAlert", gkFuncRefGet, result);

  return result;
}

int GetEmergencyVehicleAlertFullPositionVectorParams(LONG packetHandle, struct EmergencyVehicleAlertFullPositionVector value, char oldPath[])
{
  char newPath[300];
  int result;

  result = 0;

  snprintf(newPath, elcount(newPath), "%s.%s", oldPath, "utcTime");
  value.utcTime.isValidFlag = C2xIsTokenAvailable(packetHandle, "EmergencyVehicleAlert", newPath);
  if(value.utcTime.isValidFlag==1)
  {
    GetEmergencyVehicleAlertDDateTimeParams(packetHandle, value.utcTime, newPath);
    result = CheckLastError("EmergencyVehicleAlert", gkFuncRefGet, result);
  }
  snprintf(newPath, elcount(newPath), "%s.%s", oldPath, "lon");
  value.lon = C2xGetTokenInt(packetHandle, "EmergencyVehicleAlert", newPath);
  result = CheckLastError("EmergencyVehicleAlert", gkFuncRefGet, result);

  snprintf(newPath, elcount(newPath), "%s.%s", oldPath, "lat");
  value.lat = C2xGetTokenInt(packetHandle, "EmergencyVehicleAlert", newPath);
  result = CheckLastError("EmergencyVehicleAlert", gkFuncRefGet, result);

  snprintf(newPath, elcount(newPath), "%s.%s", oldPath, "elevation");
  value.elevation.isValidFlag = C2xIsTokenAvailable(packetHandle, "EmergencyVehicleAlert", newPath);
  if(value.elevation.isValidFlag==1)
  {
    value.elevation.isValidFlag = 1;
    value.elevation.stringLength = C2xGetTokenData(packetHandle, "EmergencyVehicleAlert", newPath, elcount(value.elevation.string), value.elevation.string);
  }
  snprintf(newPath, elcount(newPath), "%s.%s", oldPath, "heading");
  value.heading.isValidFlag = C2xIsTokenAvailable(packetHandle, "EmergencyVehicleAlert", newPath);
  if(value.heading.isValidFlag==1)
  {
    value.heading.value = C2xGetTokenInt(packetHandle, "EmergencyVehicleAlert", newPath);
    result = CheckLastError("EmergencyVehicleAlert", gkFuncRefGet, result);
  }
  snprintf(newPath, elcount(newPath), "%s.%s", oldPath, "speed");
  value.speed.isValidFlag = C2xIsTokenAvailable(packetHandle, "EmergencyVehicleAlert", newPath);
  if(value.speed.isValidFlag==1)
  {
    value.speed.isValidFlag = 1;
    value.speed.stringLength = C2xGetTokenData(packetHandle, "EmergencyVehicleAlert", newPath, elcount(value.speed.string), value.speed.string);
  }
  snprintf(newPath, elcount(newPath), "%s.%s", oldPath, "posAccuracy");
  value.posAccuracy.isValidFlag = C2xIsTokenAvailable(packetHandle, "EmergencyVehicleAlert", newPath);
  if(value.posAccuracy.isValidFlag==1)
  {
    value.posAccuracy.isValidFlag = 1;
    value.posAccuracy.stringLength = C2xGetTokenData(packetHandle, "EmergencyVehicleAlert", newPath, elcount(value.posAccuracy.string), value.posAccuracy.string);
  }
  snprintf(newPath, elcount(newPath), "%s.%s", oldPath, "timeConfidence");
  value.timeConfidence.isValidFlag = C2xIsTokenAvailable(packetHandle, "EmergencyVehicleAlert", newPath);
  if(value.timeConfidence.isValidFlag==1)
  {
    value.timeConfidence.value = C2xGetTokenInt(packetHandle, "EmergencyVehicleAlert", newPath);
    result = CheckLastError("EmergencyVehicleAlert", gkFuncRefGet, result);
  }
  snprintf(newPath, elcount(newPath), "%s.%s", oldPath, "posConfidence");
  value.posConfidence.isValidFlag = C2xIsTokenAvailable(packetHandle, "EmergencyVehicleAlert", newPath);
  if(value.posConfidence.isValidFlag==1)
  {
    value.posConfidence.isValidFlag = 1;
    value.posConfidence.stringLength = C2xGetTokenData(packetHandle, "EmergencyVehicleAlert", newPath, elcount(value.posConfidence.string), value.posConfidence.string);
  }
  snprintf(newPath, elcount(newPath), "%s.%s", oldPath, "speedConfidence");
  value.speedConfidence.isValidFlag = C2xIsTokenAvailable(packetHandle, "EmergencyVehicleAlert", newPath);
  if(value.speedConfidence.isValidFlag==1)
  {
    value.speedConfidence.isValidFlag = 1;
    value.speedConfidence.stringLength = C2xGetTokenData(packetHandle, "EmergencyVehicleAlert", newPath, elcount(value.speedConfidence.string), value.speedConfidence.string);
  }
  return result;
}

int SetEmergencyVehicleAlertFullPositionVectorParams(LONG packetHandle, struct EmergencyVehicleAlertFullPositionVector value, char oldPath[])
{
  char newPath[300];
  int result;

  result = 0;

  snprintf(newPath, elcount(newPath), "%s.%s", oldPath, "utcTime");
  if(value.utcTime.isValidFlag==1)
  {
    SetEmergencyVehicleAlertDDateTimeParams(packetHandle, value.utcTime, newPath);
    result = CheckLastError("EmergencyVehicleAlert", gkFuncRefGet, result);
  }
  else
  {
    if( C2xIsTokenAvailable(packetHandle, "EmergencyVehicleAlert", newPath) )
    {
      C2xRemoveToken(packetHandle, "EmergencyVehicleAlert", newPath);
    }
  }

  snprintf(newPath, elcount(newPath), "%s.%s", oldPath, "lon");
  C2xSetTokenInt(packetHandle, "EmergencyVehicleAlert", newPath, value.lon);
  result = CheckLastError("EmergencyVehicleAlert", gkFuncRefGet, result);

  snprintf(newPath, elcount(newPath), "%s.%s", oldPath, "lat");
  C2xSetTokenInt(packetHandle, "EmergencyVehicleAlert", newPath, value.lat);
  result = CheckLastError("EmergencyVehicleAlert", gkFuncRefGet, result);

  snprintf(newPath, elcount(newPath), "%s.%s", oldPath, "elevation");
  if(value.elevation.isValidFlag==1)
  {
    C2xSetTokenData(packetHandle, "EmergencyVehicleAlert", newPath, value.elevation.stringLength, value.elevation.string);
  }
  else
  {
    if( C2xIsTokenAvailable(packetHandle, "EmergencyVehicleAlert", newPath) )
    {
      C2xRemoveToken(packetHandle, "EmergencyVehicleAlert", newPath);
    }
  }

  snprintf(newPath, elcount(newPath), "%s.%s", oldPath, "heading");
  if(value.heading.isValidFlag==1)
  {
    C2xSetTokenInt(packetHandle, "EmergencyVehicleAlert", newPath, value.heading.value);
    result = CheckLastError("EmergencyVehicleAlert", gkFuncRefGet, result);
  }
  else
  {
    if( C2xIsTokenAvailable(packetHandle, "EmergencyVehicleAlert", newPath) )
    {
      C2xRemoveToken(packetHandle, "EmergencyVehicleAlert", newPath);
    }
  }

  snprintf(newPath, elcount(newPath), "%s.%s", oldPath, "speed");
  if(value.speed.isValidFlag==1)
  {
    C2xSetTokenData(packetHandle, "EmergencyVehicleAlert", newPath, value.speed.stringLength, value.speed.string);
  }
  else
  {
    if( C2xIsTokenAvailable(packetHandle, "EmergencyVehicleAlert", newPath) )
    {
      C2xRemoveToken(packetHandle, "EmergencyVehicleAlert", newPath);
    }
  }

  snprintf(newPath, elcount(newPath), "%s.%s", oldPath, "posAccuracy");
  if(value.posAccuracy.isValidFlag==1)
  {
    C2xSetTokenData(packetHandle, "EmergencyVehicleAlert", newPath, value.posAccuracy.stringLength, value.posAccuracy.string);
  }
  else
  {
    if( C2xIsTokenAvailable(packetHandle, "EmergencyVehicleAlert", newPath) )
    {
      C2xRemoveToken(packetHandle, "EmergencyVehicleAlert", newPath);
    }
  }

  snprintf(newPath, elcount(newPath), "%s.%s", oldPath, "timeConfidence");
  if(value.timeConfidence.isValidFlag==1)
  {
    C2xSetTokenInt(packetHandle, "EmergencyVehicleAlert", newPath, value.timeConfidence.value);
    result = CheckLastError("EmergencyVehicleAlert", gkFuncRefGet, result);
  }
  else
  {
    if( C2xIsTokenAvailable(packetHandle, "EmergencyVehicleAlert", newPath) )
    {
      C2xRemoveToken(packetHandle, "EmergencyVehicleAlert", newPath);
    }
  }

  snprintf(newPath, elcount(newPath), "%s.%s", oldPath, "posConfidence");
  if(value.posConfidence.isValidFlag==1)
  {
    C2xSetTokenData(packetHandle, "EmergencyVehicleAlert", newPath, value.posConfidence.stringLength, value.posConfidence.string);
  }
  else
  {
    if( C2xIsTokenAvailable(packetHandle, "EmergencyVehicleAlert", newPath) )
    {
      C2xRemoveToken(packetHandle, "EmergencyVehicleAlert", newPath);
    }
  }

  snprintf(newPath, elcount(newPath), "%s.%s", oldPath, "speedConfidence");
  if(value.speedConfidence.isValidFlag==1)
  {
    C2xSetTokenData(packetHandle, "EmergencyVehicleAlert", newPath, value.speedConfidence.stringLength, value.speedConfidence.string);
  }
  else
  {
    if( C2xIsTokenAvailable(packetHandle, "EmergencyVehicleAlert", newPath) )
    {
      C2xRemoveToken(packetHandle, "EmergencyVehicleAlert", newPath);
    }
  }

  return result;
}

int GetEmergencyVehicleAlert_Blob_FurtherInfoIDParams(LONG packetHandle, struct EmergencyVehicleAlert_Blob_FurtherInfoID value, char oldPath[])
{
  char newPath[300];
  int result;

  result = 0;

  snprintf(newPath, elcount(newPath), "%s.%s", oldPath, "temporaryID");
  value.temporaryID = C2xGetTokenInt(packetHandle, "EmergencyVehicleAlert", newPath);
  result = CheckLastError("EmergencyVehicleAlert", gkFuncRefGet, result);

  return result;
}

int SetEmergencyVehicleAlert_Blob_FurtherInfoIDParams(LONG packetHandle, struct EmergencyVehicleAlert_Blob_FurtherInfoID value, char oldPath[])
{
  char newPath[300];
  int result;

  result = 0;

  snprintf(newPath, elcount(newPath), "%s.%s", oldPath, "temporaryID");
  C2xSetTokenInt(packetHandle, "EmergencyVehicleAlert", newPath, value.temporaryID);
  result = CheckLastError("EmergencyVehicleAlert", gkFuncRefGet, result);

  return result;
}

int GetEmergencyVehicleAlertFurtherInfoIDParams(LONG packetHandle, struct EmergencyVehicleAlertFurtherInfoID value, char oldPath[])
{
  char newPath[300];
  int result;

  result = 0;

  snprintf(newPath, elcount(newPath), "%s.%s", oldPath, "_Blob_FurtherInfoID");
  GetEmergencyVehicleAlert_Blob_FurtherInfoIDParams(packetHandle, value._Blob_FurtherInfoID, newPath);
  result = CheckLastError("EmergencyVehicleAlert", gkFuncRefGet, result);

  return result;
}

int SetEmergencyVehicleAlertFurtherInfoIDParams(LONG packetHandle, struct EmergencyVehicleAlertFurtherInfoID value, char oldPath[])
{
  char newPath[300];
  int result;

  result = 0;

  snprintf(newPath, elcount(newPath), "%s.%s", oldPath, "_Blob_FurtherInfoID");
  SetEmergencyVehicleAlert_Blob_FurtherInfoIDParams(packetHandle, value._Blob_FurtherInfoID, newPath);
  result = CheckLastError("EmergencyVehicleAlert", gkFuncRefGet, result);

  return result;
}

int GetEmergencyVehicleAlert_Blob_MsgCRCParams(LONG packetHandle, struct EmergencyVehicleAlert_Blob_MsgCRC value, char oldPath[])
{
  char newPath[300];
  int result;

  result = 0;

  snprintf(newPath, elcount(newPath), "%s.%s", oldPath, "msgCRC");
  value.msgCRC = C2xGetTokenInt(packetHandle, "EmergencyVehicleAlert", newPath);
  result = CheckLastError("EmergencyVehicleAlert", gkFuncRefGet, result);

  return result;
}

int SetEmergencyVehicleAlert_Blob_MsgCRCParams(LONG packetHandle, struct EmergencyVehicleAlert_Blob_MsgCRC value, char oldPath[])
{
  char newPath[300];
  int result;

  result = 0;

  snprintf(newPath, elcount(newPath), "%s.%s", oldPath, "msgCRC");
  C2xSetTokenInt(packetHandle, "EmergencyVehicleAlert", newPath, value.msgCRC);
  result = CheckLastError("EmergencyVehicleAlert", gkFuncRefGet, result);

  return result;
}

int GetEmergencyVehicleAlertMsgCRCParams(LONG packetHandle, struct EmergencyVehicleAlertMsgCRC value, char oldPath[])
{
  char newPath[300];
  int result;

  result = 0;

  snprintf(newPath, elcount(newPath), "%s.%s", oldPath, "_Blob_MsgCRC");
  GetEmergencyVehicleAlert_Blob_MsgCRCParams(packetHandle, value._Blob_MsgCRC, newPath);
  result = CheckLastError("EmergencyVehicleAlert", gkFuncRefGet, result);

  return result;
}

int SetEmergencyVehicleAlertMsgCRCParams(LONG packetHandle, struct EmergencyVehicleAlertMsgCRC value, char oldPath[])
{
  char newPath[300];
  int result;

  result = 0;

  snprintf(newPath, elcount(newPath), "%s.%s", oldPath, "_Blob_MsgCRC");
  SetEmergencyVehicleAlert_Blob_MsgCRCParams(packetHandle, value._Blob_MsgCRC, newPath);
  result = CheckLastError("EmergencyVehicleAlert", gkFuncRefGet, result);

  return result;
}

int GetEmergencyVehicleAlertRoadSideAlertParams(LONG packetHandle, struct EmergencyVehicleAlertRoadSideAlert value, char oldPath[])
{
  char newPath[300];
  int result;

  result = 0;

  snprintf(newPath, elcount(newPath), "%s.%s", oldPath, "msgID");
  value.msgID = C2xGetTokenInt(packetHandle, "EmergencyVehicleAlert", newPath);
  result = CheckLastError("EmergencyVehicleAlert", gkFuncRefGet, result);

  snprintf(newPath, elcount(newPath), "%s.%s", oldPath, "msgCnt");
  value.msgCnt = C2xGetTokenInt(packetHandle, "EmergencyVehicleAlert", newPath);
  result = CheckLastError("EmergencyVehicleAlert", gkFuncRefGet, result);

  snprintf(newPath, elcount(newPath), "%s.%s", oldPath, "typeEvent");
  value.typeEvent = C2xGetTokenInt(packetHandle, "EmergencyVehicleAlert", newPath);
  result = CheckLastError("EmergencyVehicleAlert", gkFuncRefGet, result);

  snprintf(newPath, elcount(newPath), "%s.%s", oldPath, "description");
  value.description.isValidFlag = C2xIsTokenAvailable(packetHandle, "EmergencyVehicleAlert", newPath);
  if(value.description.isValidFlag==1)
  {
    GetEmergencyVehicleAlert_RoadSideAlert_descriptionParams(packetHandle, value.description, newPath);
    result = CheckLastError("EmergencyVehicleAlert", gkFuncRefGet, result);
  }
  snprintf(newPath, elcount(newPath), "%s.%s", oldPath, "priority");
  value.priority.isValidFlag = C2xIsTokenAvailable(packetHandle, "EmergencyVehicleAlert", newPath);
  if(value.priority.isValidFlag==1)
  {
    value.priority.isValidFlag = 1;
    value.priority.stringLength = C2xGetTokenData(packetHandle, "EmergencyVehicleAlert", newPath, elcount(value.priority.string), value.priority.string);
  }
  snprintf(newPath, elcount(newPath), "%s.%s", oldPath, "heading");
  value.heading.isValidFlag = C2xIsTokenAvailable(packetHandle, "EmergencyVehicleAlert", newPath);
  if(value.heading.isValidFlag==1)
  {
    value.heading.isValidFlag = 1;
    value.heading.stringLength = C2xGetTokenData(packetHandle, "EmergencyVehicleAlert", newPath, elcount(value.heading.string), value.heading.string);
  }
  snprintf(newPath, elcount(newPath), "%s.%s", oldPath, "extent");
  value.extent.isValidFlag = C2xIsTokenAvailable(packetHandle, "EmergencyVehicleAlert", newPath);
  if(value.extent.isValidFlag==1)
  {
    value.extent.value = C2xGetTokenInt(packetHandle, "EmergencyVehicleAlert", newPath);
    result = CheckLastError("EmergencyVehicleAlert", gkFuncRefGet, result);
  }
  snprintf(newPath, elcount(newPath), "%s.%s", oldPath, "positon");
  value.positon.isValidFlag = C2xIsTokenAvailable(packetHandle, "EmergencyVehicleAlert", newPath);
  if(value.positon.isValidFlag==1)
  {
    GetEmergencyVehicleAlertFullPositionVectorParams(packetHandle, value.positon, newPath);
    result = CheckLastError("EmergencyVehicleAlert", gkFuncRefGet, result);
  }
  snprintf(newPath, elcount(newPath), "%s.%s", oldPath, "furtherInfoID");
  value.furtherInfoID.isValidFlag = C2xIsTokenAvailable(packetHandle, "EmergencyVehicleAlert", newPath);
  if(value.furtherInfoID.isValidFlag==1)
  {
    value.furtherInfoID.isValidFlag = 1;
    value.furtherInfoID.stringLength = C2xGetTokenData(packetHandle, "EmergencyVehicleAlert", newPath, elcount(value.furtherInfoID.string), value.furtherInfoID.string);
  }
  snprintf(newPath, elcount(newPath), "%s.%s", oldPath, "crc");
  value.crc.stringLength = C2xGetTokenData(packetHandle, "EmergencyVehicleAlert", newPath, elcount(value.crc.string), value.crc.string);
  return result;
}

int SetEmergencyVehicleAlertRoadSideAlertParams(LONG packetHandle, struct EmergencyVehicleAlertRoadSideAlert value, char oldPath[])
{
  char newPath[300];
  int result;

  result = 0;

  snprintf(newPath, elcount(newPath), "%s.%s", oldPath, "msgID");
  C2xSetTokenInt(packetHandle, "EmergencyVehicleAlert", newPath, value.msgID);
  result = CheckLastError("EmergencyVehicleAlert", gkFuncRefGet, result);

  snprintf(newPath, elcount(newPath), "%s.%s", oldPath, "msgCnt");
  C2xSetTokenInt(packetHandle, "EmergencyVehicleAlert", newPath, value.msgCnt);
  result = CheckLastError("EmergencyVehicleAlert", gkFuncRefGet, result);

  snprintf(newPath, elcount(newPath), "%s.%s", oldPath, "typeEvent");
  C2xSetTokenInt(packetHandle, "EmergencyVehicleAlert", newPath, value.typeEvent);
  result = CheckLastError("EmergencyVehicleAlert", gkFuncRefGet, result);

  snprintf(newPath, elcount(newPath), "%s.%s", oldPath, "description");
  if(value.description.isValidFlag==1)
  {
    SetEmergencyVehicleAlert_RoadSideAlert_descriptionParams(packetHandle, value.description, newPath);
    result = CheckLastError("EmergencyVehicleAlert", gkFuncRefGet, result);
  }
  else
  {
    if( C2xIsTokenAvailable(packetHandle, "EmergencyVehicleAlert", newPath) )
    {
      C2xRemoveToken(packetHandle, "EmergencyVehicleAlert", newPath);
    }
  }

  snprintf(newPath, elcount(newPath), "%s.%s", oldPath, "priority");
  if(value.priority.isValidFlag==1)
  {
    C2xSetTokenData(packetHandle, "EmergencyVehicleAlert", newPath, value.priority.stringLength, value.priority.string);
  }
  else
  {
    if( C2xIsTokenAvailable(packetHandle, "EmergencyVehicleAlert", newPath) )
    {
      C2xRemoveToken(packetHandle, "EmergencyVehicleAlert", newPath);
    }
  }

  snprintf(newPath, elcount(newPath), "%s.%s", oldPath, "heading");
  if(value.heading.isValidFlag==1)
  {
    C2xSetTokenData(packetHandle, "EmergencyVehicleAlert", newPath, value.heading.stringLength, value.heading.string);
  }
  else
  {
    if( C2xIsTokenAvailable(packetHandle, "EmergencyVehicleAlert", newPath) )
    {
      C2xRemoveToken(packetHandle, "EmergencyVehicleAlert", newPath);
    }
  }

  snprintf(newPath, elcount(newPath), "%s.%s", oldPath, "extent");
  if(value.extent.isValidFlag==1)
  {
    C2xSetTokenInt(packetHandle, "EmergencyVehicleAlert", newPath, value.extent.value);
    result = CheckLastError("EmergencyVehicleAlert", gkFuncRefGet, result);
  }
  else
  {
    if( C2xIsTokenAvailable(packetHandle, "EmergencyVehicleAlert", newPath) )
    {
      C2xRemoveToken(packetHandle, "EmergencyVehicleAlert", newPath);
    }
  }

  snprintf(newPath, elcount(newPath), "%s.%s", oldPath, "positon");
  if(value.positon.isValidFlag==1)
  {
    SetEmergencyVehicleAlertFullPositionVectorParams(packetHandle, value.positon, newPath);
    result = CheckLastError("EmergencyVehicleAlert", gkFuncRefGet, result);
  }
  else
  {
    if( C2xIsTokenAvailable(packetHandle, "EmergencyVehicleAlert", newPath) )
    {
      C2xRemoveToken(packetHandle, "EmergencyVehicleAlert", newPath);
    }
  }

  snprintf(newPath, elcount(newPath), "%s.%s", oldPath, "furtherInfoID");
  if(value.furtherInfoID.isValidFlag==1)
  {
    C2xSetTokenData(packetHandle, "EmergencyVehicleAlert", newPath, value.furtherInfoID.stringLength, value.furtherInfoID.string);
  }
  else
  {
    if( C2xIsTokenAvailable(packetHandle, "EmergencyVehicleAlert", newPath) )
    {
      C2xRemoveToken(packetHandle, "EmergencyVehicleAlert", newPath);
    }
  }

  snprintf(newPath, elcount(newPath), "%s.%s", oldPath, "crc");
  C2xSetTokenData(packetHandle, "EmergencyVehicleAlert", newPath, value.crc.stringLength, value.crc.string);

  return result;
}

int API_GetEmergencyVehicleAlertParams(LONG packetHandle, struct EmergencyVehicleAlert value)
{
  int result;
  result = 0;

  value.msgID = C2xGetTokenInt(packetHandle, "EmergencyVehicleAlert", "msgID");
  result = CheckLastError("EmergencyVehicleAlert", gkFuncRefGet, result);

  value.id.isValidFlag = C2xIsTokenAvailable(packetHandle, "EmergencyVehicleAlert", "id");
  if(value.id.isValidFlag == 1)
  {
    value.id.isValidFlag = 1;
    GetEmergencyVehicleAlertTemporaryIDParams(packetHandle, value.id, "id");
    result = CheckLastError("EmergencyVehicleAlert", gkFuncRefGet, result);

  }
  value.rsaMsg.isValidFlag = 1;
  GetEmergencyVehicleAlertRoadSideAlertParams(packetHandle, value.rsaMsg, "rsaMsg");
  result = CheckLastError("EmergencyVehicleAlert", gkFuncRefGet, result);

  value.responseType.isValidFlag = C2xIsTokenAvailable(packetHandle, "EmergencyVehicleAlert", "responseType");
  if(value.responseType.isValidFlag == 1)
  {
    value.responseType.value = C2xGetTokenInt(packetHandle, "EmergencyVehicleAlert", "responseType");
    result = CheckLastError("EmergencyVehicleAlert", gkFuncRefGet, result);

  }
  value.details.isValidFlag = C2xIsTokenAvailable(packetHandle, "EmergencyVehicleAlert", "details");
  if(value.details.isValidFlag == 1)
  {
    value.details.value = C2xGetTokenInt(packetHandle, "EmergencyVehicleAlert", "details");
    result = CheckLastError("EmergencyVehicleAlert", gkFuncRefGet, result);

  }
  value.mass.isValidFlag = C2xIsTokenAvailable(packetHandle, "EmergencyVehicleAlert", "mass");
  if(value.mass.isValidFlag == 1)
  {
    value.mass.value = C2xGetTokenInt(packetHandle, "EmergencyVehicleAlert", "mass");
    result = CheckLastError("EmergencyVehicleAlert", gkFuncRefGet, result);

  }
  value.basicType.isValidFlag = C2xIsTokenAvailable(packetHandle, "EmergencyVehicleAlert", "basicType");
  if(value.basicType.isValidFlag == 1)
  {
    value.basicType.value = C2xGetTokenInt(packetHandle, "EmergencyVehicleAlert", "basicType");
    result = CheckLastError("EmergencyVehicleAlert", gkFuncRefGet, result);

  }
  value.vehicleType.isValidFlag = C2xIsTokenAvailable(packetHandle, "EmergencyVehicleAlert", "vehicleType");
  if(value.vehicleType.isValidFlag == 1)
  {
    value.vehicleType.value = C2xGetTokenInt(packetHandle, "EmergencyVehicleAlert", "vehicleType");
    result = CheckLastError("EmergencyVehicleAlert", gkFuncRefGet, result);

  }
  value.responseEquip.isValidFlag = C2xIsTokenAvailable(packetHandle, "EmergencyVehicleAlert", "responseEquip");
  if(value.responseEquip.isValidFlag == 1)
  {
    value.responseEquip.value = C2xGetTokenInt(packetHandle, "EmergencyVehicleAlert", "responseEquip");
    result = CheckLastError("EmergencyVehicleAlert", gkFuncRefGet, result);

  }
  value.responderType.isValidFlag = C2xIsTokenAvailable(packetHandle, "EmergencyVehicleAlert", "responderType");
  if(value.responderType.isValidFlag == 1)
  {
    value.responderType.value = C2xGetTokenInt(packetHandle, "EmergencyVehicleAlert", "responderType");
    result = CheckLastError("EmergencyVehicleAlert", gkFuncRefGet, result);

  }
  value.crc.isValidFlag = 1;
  GetEmergencyVehicleAlertMsgCRCParams(packetHandle, value.crc, "crc");
  result = CheckLastError("EmergencyVehicleAlert", gkFuncRefGet, result);

  return result;
}

int API_SetEmergencyVehicleAlertParams(LONG packetHandle, struct EmergencyVehicleAlert value)
{
  int result;
  result = 0;

  value.msgID = 5;

  C2xSetTokenInt(packetHandle, "EmergencyVehicleAlert", "msgID", value.msgID);
  result = CheckLastError("EmergencyVehicleAlert", gkFuncRefGet, result);

  if (value.id.isValidFlag==1)
  {
    SetEmergencyVehicleAlertTemporaryIDParams(packetHandle, value.id, "id");
    result = CheckLastError("EmergencyVehicleAlert", gkFuncRefGet, result);

  }
  else
  {
    if( C2xIsTokenAvailable(packetHandle, "EmergencyVehicleAlert", "id") )
    {
      C2xRemoveToken(packetHandle, "EmergencyVehicleAlert", "id");
    }
  }

  SetEmergencyVehicleAlertRoadSideAlertParams(packetHandle, value.rsaMsg, "rsaMsg");
  result = CheckLastError("EmergencyVehicleAlert", gkFuncRefGet, result);

  if (value.responseType.isValidFlag==1)
  {
    C2xSetTokenInt(packetHandle, "EmergencyVehicleAlert", "responseType", value.responseType.value);
    result = CheckLastError("EmergencyVehicleAlert", gkFuncRefGet, result);

  }
  else
  {
    if( C2xIsTokenAvailable(packetHandle, "EmergencyVehicleAlert", "responseType") )
    {
      C2xRemoveToken(packetHandle, "EmergencyVehicleAlert", "responseType");
    }
  }

  if (value.details.isValidFlag==1)
  {
    C2xSetTokenInt(packetHandle, "EmergencyVehicleAlert", "details", value.details.value);
    result = CheckLastError("EmergencyVehicleAlert", gkFuncRefGet, result);

  }
  else
  {
    if( C2xIsTokenAvailable(packetHandle, "EmergencyVehicleAlert", "details") )
    {
      C2xRemoveToken(packetHandle, "EmergencyVehicleAlert", "details");
    }
  }

  if (value.mass.isValidFlag==1)
  {
    C2xSetTokenInt(packetHandle, "EmergencyVehicleAlert", "mass", value.mass.value);
    result = CheckLastError("EmergencyVehicleAlert", gkFuncRefGet, result);

  }
  else
  {
    if( C2xIsTokenAvailable(packetHandle, "EmergencyVehicleAlert", "mass") )
    {
      C2xRemoveToken(packetHandle, "EmergencyVehicleAlert", "mass");
    }
  }

  if (value.basicType.isValidFlag==1)
  {
    C2xSetTokenInt(packetHandle, "EmergencyVehicleAlert", "basicType", value.basicType.value);
    result = CheckLastError("EmergencyVehicleAlert", gkFuncRefGet, result);

  }
  else
  {
    if( C2xIsTokenAvailable(packetHandle, "EmergencyVehicleAlert", "basicType") )
    {
      C2xRemoveToken(packetHandle, "EmergencyVehicleAlert", "basicType");
    }
  }

  if (value.vehicleType.isValidFlag==1)
  {
    C2xSetTokenInt(packetHandle, "EmergencyVehicleAlert", "vehicleType", value.vehicleType.value);
    result = CheckLastError("EmergencyVehicleAlert", gkFuncRefGet, result);

  }
  else
  {
    if( C2xIsTokenAvailable(packetHandle, "EmergencyVehicleAlert", "vehicleType") )
    {
      C2xRemoveToken(packetHandle, "EmergencyVehicleAlert", "vehicleType");
    }
  }

  if (value.responseEquip.isValidFlag==1)
  {
    C2xSetTokenInt(packetHandle, "EmergencyVehicleAlert", "responseEquip", value.responseEquip.value);
    result = CheckLastError("EmergencyVehicleAlert", gkFuncRefGet, result);

  }
  else
  {
    if( C2xIsTokenAvailable(packetHandle, "EmergencyVehicleAlert", "responseEquip") )
    {
      C2xRemoveToken(packetHandle, "EmergencyVehicleAlert", "responseEquip");
    }
  }

  if (value.responderType.isValidFlag==1)
  {
    C2xSetTokenInt(packetHandle, "EmergencyVehicleAlert", "responderType", value.responderType.value);
    result = CheckLastError("EmergencyVehicleAlert", gkFuncRefGet, result);

  }
  else
  {
    if( C2xIsTokenAvailable(packetHandle, "EmergencyVehicleAlert", "responderType") )
    {
      C2xRemoveToken(packetHandle, "EmergencyVehicleAlert", "responderType");
    }
  }

  SetEmergencyVehicleAlertMsgCRCParams(packetHandle, value.crc, "crc");
  result = CheckLastError("EmergencyVehicleAlert", gkFuncRefGet, result);

  return result;
}

