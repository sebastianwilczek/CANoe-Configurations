/*@!Encoding:1252*/
/*
//  (c) Vector Informatik GmbH. All rights reserved.
//
//  This file contains definitions of structs and methods that may be used
//  to set and get the values of an ASN.1 defined packet's payload.
//
//  //This example demonstrates how to set a packet's payload:
//  LONG packetHandle;
//  struct BasicSafetyMessageVerbose payload;
//  //you need to set the values of the variable "payload" yourself
//  packetHandle = API_InitBasicSafetyMessageVerbosePacket();
//  if (packetHandle!=0) {
//    if (API_SetBasicSafetyMessageVerboseParams(packetHandle, payload)==0) {
//      if (C2xCompletePacket(packetHandle)==0) {
//        C2xOutputPacket(packetHandle);
//      }
//    }
//  }
//                                                                             */
includes
{

}
variables
{
    struct BasicSafetyMessageVerbose_Blob_TemporaryID {
        INT isValidFlag;   // necessary if this struct is used as an optional field of a SEQUENCE
        DWORD temporaryID;  // INTEGER, 0..4294967295;
    };
    
    struct BasicSafetyMessageVerboseTemporaryID {
        INT isValidFlag;   // necessary if this struct is used as an optional field of a SEQUENCE
        CHAR string[5];
        INT  stringLength;
        struct BasicSafetyMessageVerbose_Blob_TemporaryID _Blob_TemporaryID;  // SEQUENCE;
    };
    
    struct BasicSafetyMessageVerboseElevation {
        INT isValidFlag;   // necessary if this struct is used as an optional field of a SEQUENCE
        CHAR string[3];
        INT  stringLength;
        WORD _Blob_Elevation;  // INTEGER, 0..65535;
    };
    
    struct BasicSafetyMessageVerbose_Blob_PositionalAccuracy {
        INT isValidFlag;   // necessary if this struct is used as an optional field of a SEQUENCE
        BYTE accuracySemiMajor;  // INTEGER, 0..255;
        BYTE accuracySemiMinor;  // INTEGER, 0..255;
        WORD accuracyOrientation;  // INTEGER, 0..65535;
    };
    
    struct BasicSafetyMessageVerbosePositionalAccuracy {
        INT isValidFlag;   // necessary if this struct is used as an optional field of a SEQUENCE
        CHAR string[5];
        INT  stringLength;
        struct BasicSafetyMessageVerbose_Blob_PositionalAccuracy _Blob_PositionalAccuracy;  // SEQUENCE;
    };
    
    struct BasicSafetyMessageVerbose_Blob_TransmissionAndSpeed {
        INT isValidFlag;   // necessary if this struct is used as an optional field of a SEQUENCE
        BYTE transmissionState;  // INTEGER, 0..7, neutral(0), park(1), forwardGears(2), reverseGears(3), reserved1(4), reserved2(5), reserved3(6), unavailable(7);
        WORD speed;  // INTEGER, 0..8191;
    };
    
    struct BasicSafetyMessageVerboseTransmissionAndSpeed {
        INT isValidFlag;   // necessary if this struct is used as an optional field of a SEQUENCE
        CHAR string[3];
        INT  stringLength;
        struct BasicSafetyMessageVerbose_Blob_TransmissionAndSpeed _Blob_TransmissionAndSpeed;  // SEQUENCE;
    };
    
    struct BasicSafetyMessageVerboseSteeringWheelAngle {
        INT isValidFlag;   // necessary if this struct is used as an optional field of a SEQUENCE
        CHAR string[2];
        INT  stringLength;
        INT _Blob_SteeringWheelAngle;  // INTEGER, -128..127;
    };
    
    struct BasicSafetyMessageVerbose_Blob_AccelerationSet4Way {
        INT isValidFlag;   // necessary if this struct is used as an optional field of a SEQUENCE
        INT accelerationLong;  // INTEGER, -32768..32767;
        INT accelerationLat;  // INTEGER, -32768..32767;
        INT accelerationVert;  // INTEGER, -128..127;
        INT yawRate;  // INTEGER, -32768..32767;
    };
    
    struct BasicSafetyMessageVerboseAccelerationSet4Way {
        INT isValidFlag;   // necessary if this struct is used as an optional field of a SEQUENCE
        CHAR string[8];
        INT  stringLength;
        struct BasicSafetyMessageVerbose_Blob_AccelerationSet4Way _Blob_AccelerationSet4Way;  // SEQUENCE;
    };
    
    struct BasicSafetyMessageVerbose_Blob_BrakeSystemStatus_WheelBrakes {
        INT isValidFlag;   // necessary if this struct is used as an optional field of a SEQUENCE
        CHAR string[5];
        INT  stringLength;
    };
    
    struct BasicSafetyMessageVerbose_Blob_BrakeSystemStatus {
        INT isValidFlag;   // necessary if this struct is used as an optional field of a SEQUENCE
        struct BasicSafetyMessageVerbose_Blob_BrakeSystemStatus_WheelBrakes wheelBrakes;  // BITSTRING;
        INT brakesUnavailable;  // BOOLEAN;
        BYTE spareBit;  // INTEGER, 0..1;
        BYTE traction;  // INTEGER, 0..3, unavailable(0), off(1), on_but_notEngaged(2), engaged(3);
        BYTE antilockBrakingSystem;  // INTEGER, 0..3, unavailable(0), off(1), on_but_notEngaged(2), engaged(3);
        BYTE scs;  // INTEGER, 0..3, unavailable(0), off(1), on(2), reserved(3);
        BYTE brakeBoost;  // INTEGER, 0..3, unavailable(0), off(1), on(2), reserved(3);
        BYTE auxBrakes;  // INTEGER, 0..3, unavailable(0), off(1), on(2), reserved(3);
    };
    
    struct BasicSafetyMessageVerboseBrakeSystemStatus {
        INT isValidFlag;   // necessary if this struct is used as an optional field of a SEQUENCE
        CHAR string[3];
        INT  stringLength;
        struct BasicSafetyMessageVerbose_Blob_BrakeSystemStatus _Blob_BrakeSystemStatus;  // SEQUENCE;
    };
    
    struct BasicSafetyMessageVerboseVehicleSize {
        INT isValidFlag;   // necessary if this struct is used as an optional field of a SEQUENCE
        WORD width;  // INTEGER, 0..1023;
        WORD length;  // INTEGER, 0..16383;
    };
    
    struct BasicSafetyMessageVerboseDDateTime {
        INT isValidFlag;   // necessary if this struct is used as an optional field of a SEQUENCE
        struct OPT_WORD_ASN year;  // INTEGER, OPTIONAL, 0..9999;
        struct OPT_BYTE_ASN month;  // INTEGER, OPTIONAL, 0..15;
        struct OPT_BYTE_ASN day;  // INTEGER, OPTIONAL, 0..31;
        struct OPT_BYTE_ASN hour;  // INTEGER, OPTIONAL, 0..31;
        struct OPT_BYTE_ASN minute;  // INTEGER, OPTIONAL, 0..63;
        struct OPT_WORD_ASN second;  // INTEGER, OPTIONAL, 0..65535;
    };
    
    struct BasicSafetyMessageVerbose_Blob_PositionConfidenceSet {
        INT isValidFlag;   // necessary if this struct is used as an optional field of a SEQUENCE
        BYTE positionConfidence;  // INTEGER, 0..15, unavailable(0), a500m(1), a200m(2), a100m(3), a50m(4), a20m(5), a10m(6), a5m(7), a2m(8), a1m(9), a50cm(10), a20cm(11), a10cm(12), a5cm(13), a2cm(14), a1cm(15);
        BYTE elevationConfidence;  // INTEGER, 0..15, unavailable(0), elev_500_00(1), elev_200_00(2), elev_100_00(3), elev_050_00(4), elev_020_00(5), elev_010_00(6), elev_005_00(7), elev_002_00(8), elev_001_00(9), elev_000_50(10), elev_000_20(11), elev_000_10(12), elev_000_05(13), elev_000_02(14), elev_000_01(15);
    };
    
    struct BasicSafetyMessageVerbosePositionConfidenceSet {
        INT isValidFlag;   // necessary if this struct is used as an optional field of a SEQUENCE
        CHAR string[2];
        INT  stringLength;
        struct BasicSafetyMessageVerbose_Blob_PositionConfidenceSet _Blob_PositionConfidenceSet;  // SEQUENCE;
    };
    
    struct BasicSafetyMessageVerbose_Blob_SpeedandHeadingandThrottleConfidence {
        INT isValidFlag;   // necessary if this struct is used as an optional field of a SEQUENCE
        BYTE headingConfidence;  // INTEGER, 0..7, unavailable(0), prec45deg(1), prec10deg(2), prec05deg(3), prec01deg(4), prec0_1deg(5), prec0_05deg(6), prec0_01deg(7);
        BYTE speedConfidence;  // INTEGER, 0..7, unavailable(0), prec100ms(1), prec10ms(2), prec5ms(3), prec1ms(4), prec0_1ms(5), prec0_05ms(6), prec0_01ms(7);
        BYTE throttleConfidence;  // INTEGER, 0..3, unavailable(0), prec10percent(1), prec1percent(2), prec0_5percent(3);
    };
    
    struct BasicSafetyMessageVerboseSpeedandHeadingandThrottleConfidence {
        INT isValidFlag;   // necessary if this struct is used as an optional field of a SEQUENCE
        CHAR string[2];
        INT  stringLength;
        struct BasicSafetyMessageVerbose_Blob_SpeedandHeadingandThrottleConfidence _Blob_SpeedandHeadingandThrottleConfidence;  // SEQUENCE;
    };
    
    struct BasicSafetyMessageVerboseFullPositionVector {
        INT isValidFlag;   // necessary if this struct is used as an optional field of a SEQUENCE
        struct BasicSafetyMessageVerboseDDateTime utcTime;  // SEQUENCE, OPTIONAL;
        LONG lon;  // INTEGER, -1799999999..1800000001;
        LONG lat;  // INTEGER, -900000000..900000001;
        struct BasicSafetyMessageVerboseElevation elevation;  // OCTETSTRING, OPTIONAL;
        struct OPT_WORD_ASN heading;  // INTEGER, OPTIONAL, 0..28800;
        struct BasicSafetyMessageVerboseTransmissionAndSpeed speed;  // OCTETSTRING, OPTIONAL;
        struct BasicSafetyMessageVerbosePositionalAccuracy posAccuracy;  // OCTETSTRING, OPTIONAL;
        struct OPT_ENUM_ASN timeConfidence;  // ENUMERATED, OPTIONAL, unavailable(0), time_100_000(1), time_050_000(2), time_020_000(3), time_010_000(4), time_002_000(5), time_001_000(6), time_000_500(7), time_000_200(8), time_000_100(9), time_000_050(10), time_000_020(11), time_000_010(12), time_000_005(13), time_000_002(14), time_000_001(15), time_000_000_5(16), time_000_000_2(17), time_000_000_1(18), time_000_000_05(19), time_000_000_02(20), time_000_000_01(21), time_000_000_005(22), time_000_000_002(23), time_000_000_001(24), time_000_000_000_5(25), time_000_000_000_2(26), time_000_000_000_1(27), time_000_000_000_05(28), time_000_000_000_02(29), time_000_000_000_01(30), time_000_000_000_005(31), time_000_000_000_002(32), time_000_000_000_001(33), time_000_000_000_000_5(34), time_000_000_000_000_2(35), time_000_000_000_000_1(36), time_000_000_000_000_05(37), time_000_000_000_000_02(38), time_000_000_000_000_01(39);
        struct BasicSafetyMessageVerbosePositionConfidenceSet posConfidence;  // OCTETSTRING, OPTIONAL;
        struct BasicSafetyMessageVerboseSpeedandHeadingandThrottleConfidence speedConfidence;  // OCTETSTRING, OPTIONAL;
    };
    
    struct BasicSafetyMessageVerboseGPSstatus {
        INT isValidFlag;   // necessary if this struct is used as an optional field of a SEQUENCE
        CHAR string[256];
        INT  stringLength;
    };
    
    struct BasicSafetyMessageVerbosePathHistoryPointType_01 {
        INT isValidFlag;   // necessary if this struct is used as an optional field of a SEQUENCE
        LONG latOffset;  // INTEGER, -131072..131071;
        LONG longOffset;  // INTEGER, -131072..131071;
        struct OPT_INT_ASN elevationOffset;  // INTEGER, OPTIONAL, -2048..2047;
        struct OPT_WORD_ASN timeOffset;  // INTEGER, OPTIONAL, 1..65535;
        struct BasicSafetyMessageVerbosePositionalAccuracy posAccuracy;  // OCTETSTRING, OPTIONAL;
        struct OPT_INT_ASN heading;  // INTEGER, OPTIONAL, -128..127;
        struct BasicSafetyMessageVerboseTransmissionAndSpeed speed;  // OCTETSTRING, OPTIONAL;
    };
    
    struct BasicSafetyMessageVerbose_PathHistory_crumbData_pathHistoryPointSets_01 {
        INT isValidFlag;   // necessary if this struct is used as an optional field of a SEQUENCE
        INT length;
        struct BasicSafetyMessageVerbosePathHistoryPointType_01 arrayValue[23];  // SEQUENCE;
    };
    
    struct BasicSafetyMessageVerbose_Blob_PathHistoryPointType_02 {
        INT isValidFlag;   // necessary if this struct is used as an optional field of a SEQUENCE
        LONG latOffset;  // INTEGER, -131072..131071;
        LONG longOffset;  // INTEGER, -131072..131071;
        INT elevationOffset;  // INTEGER, -2048..2047;
        WORD timeOffset;  // INTEGER, 0..65535;
        struct BasicSafetyMessageVerbose_Blob_PositionalAccuracy accuracy;  // SEQUENCE;
        INT heading;  // INTEGER, -128..127;
        struct BasicSafetyMessageVerbose_Blob_TransmissionAndSpeed speed;  // SEQUENCE;
    };
    
    struct BasicSafetyMessageVerbose_Blob_PathHistory_crumbData_pathHistoryPointSets_02 {
        INT isValidFlag;   // necessary if this struct is used as an optional field of a SEQUENCE
        INT length;
        struct BasicSafetyMessageVerbose_Blob_PathHistoryPointType_02 arrayValue[32];  // SEQUENCE;
    };
    
    struct BasicSafetyMessageVerbose_PathHistory_crumbData_pathHistoryPointSets_02 {
        INT isValidFlag;   // necessary if this struct is used as an optional field of a SEQUENCE
        CHAR string[346];
        INT  stringLength;
        struct BasicSafetyMessageVerbose_Blob_PathHistory_crumbData_pathHistoryPointSets_02 _Blob_PathHistory_crumbData_pathHistoryPointSets_02;  // SEQUENCEOF;
    };
    
    struct BasicSafetyMessageVerbose_Blob_PathHistoryPointType_03 {
        INT isValidFlag;   // necessary if this struct is used as an optional field of a SEQUENCE
        LONG latOffset;  // INTEGER, -131072..131071;
        LONG longOffset;  // INTEGER, -131072..131071;
        INT elevationOffset;  // INTEGER, -2048..2047;
        WORD timeOffset;  // INTEGER, 0..65535;
        struct BasicSafetyMessageVerbose_Blob_PositionalAccuracy accuracy;  // SEQUENCE;
    };
    
    struct BasicSafetyMessageVerbose_Blob_PathHistory_crumbData_pathHistoryPointSets_03 {
        INT isValidFlag;   // necessary if this struct is used as an optional field of a SEQUENCE
        INT length;
        struct BasicSafetyMessageVerbose_Blob_PathHistoryPointType_03 arrayValue[32];  // SEQUENCE;
    };
    
    struct BasicSafetyMessageVerbose_PathHistory_crumbData_pathHistoryPointSets_03 {
        INT isValidFlag;   // necessary if this struct is used as an optional field of a SEQUENCE
        CHAR string[277];
        INT  stringLength;
        struct BasicSafetyMessageVerbose_Blob_PathHistory_crumbData_pathHistoryPointSets_03 _Blob_PathHistory_crumbData_pathHistoryPointSets_03;  // SEQUENCEOF;
    };
    
    struct BasicSafetyMessageVerbose_Blob_PathHistoryPointType_04 {
        INT isValidFlag;   // necessary if this struct is used as an optional field of a SEQUENCE
        LONG latOffset;  // INTEGER, -131072..131071;
        LONG longOffset;  // INTEGER, -131072..131071;
        INT elevationOffset;  // INTEGER, -2048..2047;
        WORD timeOffset;  // INTEGER, 0..65535;
    };
    
    struct BasicSafetyMessageVerbose_Blob_PathHistory_crumbData_pathHistoryPointSets_04 {
        INT isValidFlag;   // necessary if this struct is used as an optional field of a SEQUENCE
        INT length;
        struct BasicSafetyMessageVerbose_Blob_PathHistoryPointType_04 arrayValue[32];  // SEQUENCE;
    };
    
    struct BasicSafetyMessageVerbose_PathHistory_crumbData_pathHistoryPointSets_04 {
        INT isValidFlag;   // necessary if this struct is used as an optional field of a SEQUENCE
        CHAR string[185];
        INT  stringLength;
        struct BasicSafetyMessageVerbose_Blob_PathHistory_crumbData_pathHistoryPointSets_04 _Blob_PathHistory_crumbData_pathHistoryPointSets_04;  // SEQUENCEOF;
    };
    
    struct BasicSafetyMessageVerbose_Blob_PathHistoryPointType_05 {
        INT isValidFlag;   // necessary if this struct is used as an optional field of a SEQUENCE
        LONG latOffset;  // INTEGER, -131072..131071;
        LONG longOffset;  // INTEGER, -131072..131071;
        INT elevationOffset;  // INTEGER, -2048..2047;
        struct BasicSafetyMessageVerbose_Blob_PositionalAccuracy accuracy;  // SEQUENCE;
    };
    
    struct BasicSafetyMessageVerbose_Blob_PathHistory_crumbData_pathHistoryPointSets_05 {
        INT isValidFlag;   // necessary if this struct is used as an optional field of a SEQUENCE
        INT length;
        struct BasicSafetyMessageVerbose_Blob_PathHistoryPointType_05 arrayValue[32];  // SEQUENCE;
    };
    
    struct BasicSafetyMessageVerbose_PathHistory_crumbData_pathHistoryPointSets_05 {
        INT isValidFlag;   // necessary if this struct is used as an optional field of a SEQUENCE
        CHAR string[231];
        INT  stringLength;
        struct BasicSafetyMessageVerbose_Blob_PathHistory_crumbData_pathHistoryPointSets_05 _Blob_PathHistory_crumbData_pathHistoryPointSets_05;  // SEQUENCEOF;
    };
    
    struct BasicSafetyMessageVerbose_Blob_PathHistoryPointType_06 {
        INT isValidFlag;   // necessary if this struct is used as an optional field of a SEQUENCE
        LONG latOffset;  // INTEGER, -131072..131071;
        LONG longOffset;  // INTEGER, -131072..131071;
        INT elevationOffset;  // INTEGER, -2048..2047;
    };
    
    struct BasicSafetyMessageVerbose_Blob_PathHistory_crumbData_pathHistoryPointSets_06 {
        INT isValidFlag;   // necessary if this struct is used as an optional field of a SEQUENCE
        INT length;
        struct BasicSafetyMessageVerbose_Blob_PathHistoryPointType_06 arrayValue[32];  // SEQUENCE;
    };
    
    struct BasicSafetyMessageVerbose_PathHistory_crumbData_pathHistoryPointSets_06 {
        INT isValidFlag;   // necessary if this struct is used as an optional field of a SEQUENCE
        CHAR string[139];
        INT  stringLength;
        struct BasicSafetyMessageVerbose_Blob_PathHistory_crumbData_pathHistoryPointSets_06 _Blob_PathHistory_crumbData_pathHistoryPointSets_06;  // SEQUENCEOF;
    };
    
    struct BasicSafetyMessageVerbose_Blob_PathHistoryPointType_07 {
        INT isValidFlag;   // necessary if this struct is used as an optional field of a SEQUENCE
        LONG latOffset;  // INTEGER, -131072..131071;
        LONG longOffset;  // INTEGER, -131072..131071;
        WORD timeOffset;  // INTEGER, 0..65535;
        struct BasicSafetyMessageVerbose_Blob_PositionalAccuracy accuracy;  // SEQUENCE;
    };
    
    struct BasicSafetyMessageVerbose_Blob_PathHistory_crumbData_pathHistoryPointSets_07 {
        INT isValidFlag;   // necessary if this struct is used as an optional field of a SEQUENCE
        INT length;
        struct BasicSafetyMessageVerbose_Blob_PathHistoryPointType_07 arrayValue[32];  // SEQUENCE;
    };
    
    struct BasicSafetyMessageVerbose_PathHistory_crumbData_pathHistoryPointSets_07 {
        INT isValidFlag;   // necessary if this struct is used as an optional field of a SEQUENCE
        CHAR string[243];
        INT  stringLength;
        struct BasicSafetyMessageVerbose_Blob_PathHistory_crumbData_pathHistoryPointSets_07 _Blob_PathHistory_crumbData_pathHistoryPointSets_07;  // SEQUENCEOF;
    };
    
    struct BasicSafetyMessageVerbose_Blob_PathHistoryPointType_08 {
        INT isValidFlag;   // necessary if this struct is used as an optional field of a SEQUENCE
        LONG latOffset;  // INTEGER, -131072..131071;
        LONG longOffset;  // INTEGER, -131072..131071;
        WORD timeOffset;  // INTEGER, 0..65535;
    };
    
    struct BasicSafetyMessageVerbose_Blob_PathHistory_crumbData_pathHistoryPointSets_08 {
        INT isValidFlag;   // necessary if this struct is used as an optional field of a SEQUENCE
        INT length;
        struct BasicSafetyMessageVerbose_Blob_PathHistoryPointType_08 arrayValue[32];  // SEQUENCE;
    };
    
    struct BasicSafetyMessageVerbose_PathHistory_crumbData_pathHistoryPointSets_08 {
        INT isValidFlag;   // necessary if this struct is used as an optional field of a SEQUENCE
        CHAR string[162];
        INT  stringLength;
        struct BasicSafetyMessageVerbose_Blob_PathHistory_crumbData_pathHistoryPointSets_08 _Blob_PathHistory_crumbData_pathHistoryPointSets_08;  // SEQUENCEOF;
    };
    
    struct BasicSafetyMessageVerbose_Blob_PathHistoryPointType_09 {
        INT isValidFlag;   // necessary if this struct is used as an optional field of a SEQUENCE
        LONG latOffset;  // INTEGER, -131072..131071;
        LONG longOffset;  // INTEGER, -131072..131071;
        struct BasicSafetyMessageVerbose_Blob_PositionalAccuracy accuracy;  // SEQUENCE;
    };
    
    struct BasicSafetyMessageVerbose_Blob_PathHistory_crumbData_pathHistoryPointSets_09 {
        INT isValidFlag;   // necessary if this struct is used as an optional field of a SEQUENCE
        INT length;
        struct BasicSafetyMessageVerbose_Blob_PathHistoryPointType_09 arrayValue[32];  // SEQUENCE;
    };
    
    struct BasicSafetyMessageVerbose_PathHistory_crumbData_pathHistoryPointSets_09 {
        INT isValidFlag;   // necessary if this struct is used as an optional field of a SEQUENCE
        CHAR string[197];
        INT  stringLength;
        struct BasicSafetyMessageVerbose_Blob_PathHistory_crumbData_pathHistoryPointSets_09 _Blob_PathHistory_crumbData_pathHistoryPointSets_09;  // SEQUENCEOF;
    };
    
    struct BasicSafetyMessageVerbose_Blob_PathHistoryPointType_10 {
        INT isValidFlag;   // necessary if this struct is used as an optional field of a SEQUENCE
        LONG latOffset;  // INTEGER, -131072..131071;
        LONG longOffset;  // INTEGER, -131072..131071;
    };
    
    struct BasicSafetyMessageVerbose_Blob_PathHistory_crumbData_pathHistoryPointSets_10 {
        INT isValidFlag;   // necessary if this struct is used as an optional field of a SEQUENCE
        INT length;
        struct BasicSafetyMessageVerbose_Blob_PathHistoryPointType_10 arrayValue[32];  // SEQUENCE;
    };
    
    struct BasicSafetyMessageVerbose_PathHistory_crumbData_pathHistoryPointSets_10 {
        INT isValidFlag;   // necessary if this struct is used as an optional field of a SEQUENCE
        CHAR string[105];
        INT  stringLength;
        struct BasicSafetyMessageVerbose_Blob_PathHistory_crumbData_pathHistoryPointSets_10 _Blob_PathHistory_crumbData_pathHistoryPointSets_10;  // SEQUENCEOF;
    };
    
    struct BasicSafetyMessageVerbose_PathHistory_crumbData {
        INT isValidFlag;   // necessary if this struct is used as an optional field of a SEQUENCE
        INT choice;
        struct BasicSafetyMessageVerbose_PathHistory_crumbData_pathHistoryPointSets_01 pathHistoryPointSets_01;  // SEQUENCEOF;
        struct BasicSafetyMessageVerbose_PathHistory_crumbData_pathHistoryPointSets_02 pathHistoryPointSets_02;  // OCTETSTRING;
        struct BasicSafetyMessageVerbose_PathHistory_crumbData_pathHistoryPointSets_03 pathHistoryPointSets_03;  // OCTETSTRING;
        struct BasicSafetyMessageVerbose_PathHistory_crumbData_pathHistoryPointSets_04 pathHistoryPointSets_04;  // OCTETSTRING;
        struct BasicSafetyMessageVerbose_PathHistory_crumbData_pathHistoryPointSets_05 pathHistoryPointSets_05;  // OCTETSTRING;
        struct BasicSafetyMessageVerbose_PathHistory_crumbData_pathHistoryPointSets_06 pathHistoryPointSets_06;  // OCTETSTRING;
        struct BasicSafetyMessageVerbose_PathHistory_crumbData_pathHistoryPointSets_07 pathHistoryPointSets_07;  // OCTETSTRING;
        struct BasicSafetyMessageVerbose_PathHistory_crumbData_pathHistoryPointSets_08 pathHistoryPointSets_08;  // OCTETSTRING;
        struct BasicSafetyMessageVerbose_PathHistory_crumbData_pathHistoryPointSets_09 pathHistoryPointSets_09;  // OCTETSTRING;
        struct BasicSafetyMessageVerbose_PathHistory_crumbData_pathHistoryPointSets_10 pathHistoryPointSets_10;  // OCTETSTRING;
    };
    
    struct BasicSafetyMessageVerbosePathHistory {
        INT isValidFlag;   // necessary if this struct is used as an optional field of a SEQUENCE
        struct BasicSafetyMessageVerboseFullPositionVector initialPosition;  // SEQUENCE, OPTIONAL;
        struct BasicSafetyMessageVerboseGPSstatus currGPSstatus;  // BITSTRING, OPTIONAL;
        struct OPT_BYTE_ASN itemCnt;  // INTEGER, OPTIONAL, 0..32;
        struct BasicSafetyMessageVerbose_PathHistory_crumbData crumbData;  // CHOICE;
    };
    
    struct BasicSafetyMessageVerbosePathPrediction {
        INT isValidFlag;   // necessary if this struct is used as an optional field of a SEQUENCE
        INT radiusOfCurve;  // INTEGER, -32767..32767;
        BYTE confidence;  // INTEGER, 0..200;
    };
    
    struct BasicSafetyMessageVerbose_Blob_GPSstatus {
        INT isValidFlag;   // necessary if this struct is used as an optional field of a SEQUENCE
        CHAR string[9];
        INT  stringLength;
    };
    
    struct BasicSafetyMessageVerbose_Blob_AntennaOffsetSet {
        INT isValidFlag;   // necessary if this struct is used as an optional field of a SEQUENCE
        INT antOffsetX;  // INTEGER, -8192..8191;
        INT antOffsetY;  // INTEGER, -256..255;
        WORD antOffsetZ;  // INTEGER, 0..511;
    };
    
    struct BasicSafetyMessageVerbose_Blob_RTCMHeader {
        INT isValidFlag;   // necessary if this struct is used as an optional field of a SEQUENCE
        struct BasicSafetyMessageVerbose_Blob_GPSstatus status;  // BITSTRING;
        struct BasicSafetyMessageVerbose_Blob_AntennaOffsetSet offsetSet;  // SEQUENCE;
    };
    
    struct BasicSafetyMessageVerboseRTCMHeader {
        INT isValidFlag;   // necessary if this struct is used as an optional field of a SEQUENCE
        CHAR string[6];
        INT  stringLength;
        struct BasicSafetyMessageVerbose_Blob_RTCMHeader _Blob_RTCMHeader;  // SEQUENCE;
    };
    
    struct BasicSafetyMessageVerbose_RTCMPackage_msg1001 {
        INT isValidFlag;   // necessary if this struct is used as an optional field of a SEQUENCE
        CHAR string[125];
        INT  stringLength;
    };
    
    struct BasicSafetyMessageVerbose_RTCMPackage_msg1002 {
        INT isValidFlag;   // necessary if this struct is used as an optional field of a SEQUENCE
        CHAR string[157];
        INT  stringLength;
    };
    
    struct BasicSafetyMessageVerbose_RTCMPackage_msg1003 {
        INT isValidFlag;   // necessary if this struct is used as an optional field of a SEQUENCE
        CHAR string[211];
        INT  stringLength;
    };
    
    struct BasicSafetyMessageVerbose_RTCMPackage_msg1004 {
        INT isValidFlag;   // necessary if this struct is used as an optional field of a SEQUENCE
        CHAR string[259];
        INT  stringLength;
    };
    
    struct BasicSafetyMessageVerbose_RTCMPackage_msg1005 {
        INT isValidFlag;   // necessary if this struct is used as an optional field of a SEQUENCE
        CHAR string[20];
        INT  stringLength;
    };
    
    struct BasicSafetyMessageVerbose_RTCMPackage_msg1006 {
        INT isValidFlag;   // necessary if this struct is used as an optional field of a SEQUENCE
        CHAR string[22];
        INT  stringLength;
    };
    
    struct BasicSafetyMessageVerbose_RTCMPackage_msg1007 {
        INT isValidFlag;   // necessary if this struct is used as an optional field of a SEQUENCE
        CHAR string[37];
        INT  stringLength;
    };
    
    struct BasicSafetyMessageVerbose_RTCMPackage_msg1008 {
        INT isValidFlag;   // necessary if this struct is used as an optional field of a SEQUENCE
        CHAR string[69];
        INT  stringLength;
    };
    
    struct BasicSafetyMessageVerbose_RTCMPackage_msg1009 {
        INT isValidFlag;   // necessary if this struct is used as an optional field of a SEQUENCE
        CHAR string[137];
        INT  stringLength;
    };
    
    struct BasicSafetyMessageVerbose_RTCMPackage_msg1010 {
        INT isValidFlag;   // necessary if this struct is used as an optional field of a SEQUENCE
        CHAR string[167];
        INT  stringLength;
    };
    
    struct BasicSafetyMessageVerbose_RTCMPackage_msg1011 {
        INT isValidFlag;   // necessary if this struct is used as an optional field of a SEQUENCE
        CHAR string[223];
        INT  stringLength;
    };
    
    struct BasicSafetyMessageVerbose_RTCMPackage_msg1012 {
        INT isValidFlag;   // necessary if this struct is used as an optional field of a SEQUENCE
        CHAR string[269];
        INT  stringLength;
    };
    
    struct BasicSafetyMessageVerbose_RTCMPackage_msg1013 {
        INT isValidFlag;   // necessary if this struct is used as an optional field of a SEQUENCE
        CHAR string[28];
        INT  stringLength;
    };
    
    struct BasicSafetyMessageVerbose_RTCMPackage_msg1014 {
        INT isValidFlag;   // necessary if this struct is used as an optional field of a SEQUENCE
        CHAR string[16];
        INT  stringLength;
    };
    
    struct BasicSafetyMessageVerbose_RTCMPackage_msg1015 {
        INT isValidFlag;   // necessary if this struct is used as an optional field of a SEQUENCE
        CHAR string[70];
        INT  stringLength;
    };
    
    struct BasicSafetyMessageVerbose_RTCMPackage_msg1016 {
        INT isValidFlag;   // necessary if this struct is used as an optional field of a SEQUENCE
        CHAR string[82];
        INT  stringLength;
    };
    
    struct BasicSafetyMessageVerbose_RTCMPackage_msg1017 {
        INT isValidFlag;   // necessary if this struct is used as an optional field of a SEQUENCE
        CHAR string[116];
        INT  stringLength;
    };
    
    struct BasicSafetyMessageVerbose_RTCMPackage_msg1019 {
        INT isValidFlag;   // necessary if this struct is used as an optional field of a SEQUENCE
        CHAR string[63];
        INT  stringLength;
    };
    
    struct BasicSafetyMessageVerbose_RTCMPackage_msg1020 {
        INT isValidFlag;   // necessary if this struct is used as an optional field of a SEQUENCE
        CHAR string[46];
        INT  stringLength;
    };
    
    struct BasicSafetyMessageVerbose_RTCMPackage_msg1021 {
        INT isValidFlag;   // necessary if this struct is used as an optional field of a SEQUENCE
        CHAR string[63];
        INT  stringLength;
    };
    
    struct BasicSafetyMessageVerbose_RTCMPackage_msg1022 {
        INT isValidFlag;   // necessary if this struct is used as an optional field of a SEQUENCE
        CHAR string[76];
        INT  stringLength;
    };
    
    struct BasicSafetyMessageVerbose_RTCMPackage_msg1023 {
        INT isValidFlag;   // necessary if this struct is used as an optional field of a SEQUENCE
        CHAR string[74];
        INT  stringLength;
    };
    
    struct BasicSafetyMessageVerbose_RTCMPackage_msg1024 {
        INT isValidFlag;   // necessary if this struct is used as an optional field of a SEQUENCE
        CHAR string[75];
        INT  stringLength;
    };
    
    struct BasicSafetyMessageVerbose_RTCMPackage_msg1025 {
        INT isValidFlag;   // necessary if this struct is used as an optional field of a SEQUENCE
        CHAR string[26];
        INT  stringLength;
    };
    
    struct BasicSafetyMessageVerbose_RTCMPackage_msg1026 {
        INT isValidFlag;   // necessary if this struct is used as an optional field of a SEQUENCE
        CHAR string[31];
        INT  stringLength;
    };
    
    struct BasicSafetyMessageVerbose_RTCMPackage_msg1027 {
        INT isValidFlag;   // necessary if this struct is used as an optional field of a SEQUENCE
        CHAR string[34];
        INT  stringLength;
    };
    
    struct BasicSafetyMessageVerbose_RTCMPackage_msg1029 {
        INT isValidFlag;   // necessary if this struct is used as an optional field of a SEQUENCE
        CHAR string[70];
        INT  stringLength;
    };
    
    struct BasicSafetyMessageVerbose_RTCMPackage_msg1030 {
        INT isValidFlag;   // necessary if this struct is used as an optional field of a SEQUENCE
        CHAR string[106];
        INT  stringLength;
    };
    
    struct BasicSafetyMessageVerbose_RTCMPackage_msg1031 {
        INT isValidFlag;   // necessary if this struct is used as an optional field of a SEQUENCE
        CHAR string[108];
        INT  stringLength;
    };
    
    struct BasicSafetyMessageVerbose_RTCMPackage_msg1032 {
        INT isValidFlag;   // necessary if this struct is used as an optional field of a SEQUENCE
        CHAR string[21];
        INT  stringLength;
    };
    
    struct BasicSafetyMessageVerboseRTCMPackage {
        INT isValidFlag;   // necessary if this struct is used as an optional field of a SEQUENCE
        struct BasicSafetyMessageVerboseFullPositionVector anchorPoint;  // SEQUENCE, OPTIONAL;
        struct BasicSafetyMessageVerboseRTCMHeader rtcmHeader;  // OCTETSTRING;
        struct BasicSafetyMessageVerbose_RTCMPackage_msg1001 msg1001;  // OCTETSTRING, OPTIONAL;
        struct BasicSafetyMessageVerbose_RTCMPackage_msg1002 msg1002;  // OCTETSTRING, OPTIONAL;
        struct BasicSafetyMessageVerbose_RTCMPackage_msg1003 msg1003;  // OCTETSTRING, OPTIONAL;
        struct BasicSafetyMessageVerbose_RTCMPackage_msg1004 msg1004;  // OCTETSTRING, OPTIONAL;
        struct BasicSafetyMessageVerbose_RTCMPackage_msg1005 msg1005;  // OCTETSTRING, OPTIONAL;
        struct BasicSafetyMessageVerbose_RTCMPackage_msg1006 msg1006;  // OCTETSTRING, OPTIONAL;
        struct BasicSafetyMessageVerbose_RTCMPackage_msg1007 msg1007;  // OCTETSTRING, OPTIONAL;
        struct BasicSafetyMessageVerbose_RTCMPackage_msg1008 msg1008;  // OCTETSTRING, OPTIONAL;
        struct BasicSafetyMessageVerbose_RTCMPackage_msg1009 msg1009;  // OCTETSTRING, OPTIONAL;
        struct BasicSafetyMessageVerbose_RTCMPackage_msg1010 msg1010;  // OCTETSTRING, OPTIONAL;
        struct BasicSafetyMessageVerbose_RTCMPackage_msg1011 msg1011;  // OCTETSTRING, OPTIONAL;
        struct BasicSafetyMessageVerbose_RTCMPackage_msg1012 msg1012;  // OCTETSTRING, OPTIONAL;
        struct BasicSafetyMessageVerbose_RTCMPackage_msg1013 msg1013;  // OCTETSTRING, OPTIONAL;
        struct BasicSafetyMessageVerbose_RTCMPackage_msg1014 msg1014;  // OCTETSTRING, OPTIONAL;
        struct BasicSafetyMessageVerbose_RTCMPackage_msg1015 msg1015;  // OCTETSTRING, OPTIONAL;
        struct BasicSafetyMessageVerbose_RTCMPackage_msg1016 msg1016;  // OCTETSTRING, OPTIONAL;
        struct BasicSafetyMessageVerbose_RTCMPackage_msg1017 msg1017;  // OCTETSTRING, OPTIONAL;
        struct BasicSafetyMessageVerbose_RTCMPackage_msg1019 msg1019;  // OCTETSTRING, OPTIONAL;
        struct BasicSafetyMessageVerbose_RTCMPackage_msg1020 msg1020;  // OCTETSTRING, OPTIONAL;
        struct BasicSafetyMessageVerbose_RTCMPackage_msg1021 msg1021;  // OCTETSTRING, OPTIONAL;
        struct BasicSafetyMessageVerbose_RTCMPackage_msg1022 msg1022;  // OCTETSTRING, OPTIONAL;
        struct BasicSafetyMessageVerbose_RTCMPackage_msg1023 msg1023;  // OCTETSTRING, OPTIONAL;
        struct BasicSafetyMessageVerbose_RTCMPackage_msg1024 msg1024;  // OCTETSTRING, OPTIONAL;
        struct BasicSafetyMessageVerbose_RTCMPackage_msg1025 msg1025;  // OCTETSTRING, OPTIONAL;
        struct BasicSafetyMessageVerbose_RTCMPackage_msg1026 msg1026;  // OCTETSTRING, OPTIONAL;
        struct BasicSafetyMessageVerbose_RTCMPackage_msg1027 msg1027;  // OCTETSTRING, OPTIONAL;
        struct BasicSafetyMessageVerbose_RTCMPackage_msg1029 msg1029;  // OCTETSTRING, OPTIONAL;
        struct BasicSafetyMessageVerbose_RTCMPackage_msg1030 msg1030;  // OCTETSTRING, OPTIONAL;
        struct BasicSafetyMessageVerbose_RTCMPackage_msg1031 msg1031;  // OCTETSTRING, OPTIONAL;
        struct BasicSafetyMessageVerbose_RTCMPackage_msg1032 msg1032;  // OCTETSTRING, OPTIONAL;
    };
    
    struct BasicSafetyMessageVerboseVehicleSafetyExtension {
        INT isValidFlag;   // necessary if this struct is used as an optional field of a SEQUENCE
        struct OPT_WORD_ASN events;  // INTEGER, OPTIONAL, 0..8192, eventHazardLights(1), eventStopLineViolation(2), eventABSactivated(4), eventTractionControlLoss(8), eventStabilityControlactivated(16), eventHazardousMaterials(32), eventEmergencyResponse(64), eventHardBraking(128), eventLightsChanged(256), eventWipersChanged(512), eventFlatTire(1024), eventDisabledVehicle(2048), eventAirBagDeployment(4096);
        struct BasicSafetyMessageVerbosePathHistory pathHistory;  // SEQUENCE, OPTIONAL;
        struct BasicSafetyMessageVerbosePathPrediction pathPrediction;  // SEQUENCE, OPTIONAL;
        struct BasicSafetyMessageVerboseRTCMPackage theRTCM;  // SEQUENCE, OPTIONAL;
    };
    
    struct BasicSafetyMessageVerbose_VehicleStatus_wipers {
        INT isValidFlag;   // necessary if this struct is used as an optional field of a SEQUENCE
        INT statusFront;  // ENUMERATED, unavailable(0), off(1), intermittent(2), low(3), high(4), washerInUse(126), automaticPresent(127);
        BYTE rateFront;  // INTEGER, 0..127;
        struct OPT_ENUM_ASN statusRear;  // ENUMERATED, OPTIONAL, unavailable(0), off(1), intermittent(2), low(3), high(4), washerInUse(126), automaticPresent(127);
        struct OPT_BYTE_ASN rateRear;  // INTEGER, OPTIONAL, 0..127;
    };
    
    struct BasicSafetyMessageVerbose_VehicleStatus_steering {
        INT isValidFlag;   // necessary if this struct is used as an optional field of a SEQUENCE
        struct BasicSafetyMessageVerboseSteeringWheelAngle angle;  // OCTETSTRING;
        struct OPT_ENUM_ASN confidence;  // ENUMERATED, OPTIONAL, unavailable(0), prec2deg(1), prec1deg(2), prec0_02deg(3);
        struct OPT_INT_ASN rate;  // INTEGER, OPTIONAL, -127..127;
        struct OPT_INT_ASN wheels;  // INTEGER, OPTIONAL, -127..127;
    };
    
    struct BasicSafetyMessageVerboseVerticalAccelerationThreshold {
        INT isValidFlag;   // necessary if this struct is used as an optional field of a SEQUENCE
        CHAR string[256];
        INT  stringLength;
    };
    
    struct BasicSafetyMessageVerboseAccelSteerYawRateConfidence {
        INT isValidFlag;   // necessary if this struct is used as an optional field of a SEQUENCE
        INT yawRate;  // ENUMERATED, unavailable(0), degSec_100_00(1), degSec_010_00(2), degSec_005_00(3), degSec_001_00(4), degSec_000_10(5), degSec_000_05(6), degSec_000_01(7);
        INT acceleration;  // ENUMERATED, unavailable(0), accl_100_00(1), accl_010_00(2), accl_005_00(3), accl_001_00(4), accl_000_10(5), accl_000_05(6), accl_000_01(7);
        INT steeringWheelAngle;  // ENUMERATED, unavailable(0), prec2deg(1), prec1deg(2), prec0_02deg(3);
    };
    
    struct BasicSafetyMessageVerboseConfidenceSet {
        INT isValidFlag;   // necessary if this struct is used as an optional field of a SEQUENCE
        struct BasicSafetyMessageVerboseAccelSteerYawRateConfidence accelConfidence;  // SEQUENCE, OPTIONAL;
        struct BasicSafetyMessageVerboseSpeedandHeadingandThrottleConfidence speedConfidence;  // OCTETSTRING, OPTIONAL;
        struct OPT_ENUM_ASN timeConfidence;  // ENUMERATED, OPTIONAL, unavailable(0), time_100_000(1), time_050_000(2), time_020_000(3), time_010_000(4), time_002_000(5), time_001_000(6), time_000_500(7), time_000_200(8), time_000_100(9), time_000_050(10), time_000_020(11), time_000_010(12), time_000_005(13), time_000_002(14), time_000_001(15), time_000_000_5(16), time_000_000_2(17), time_000_000_1(18), time_000_000_05(19), time_000_000_02(20), time_000_000_01(21), time_000_000_005(22), time_000_000_002(23), time_000_000_001(24), time_000_000_000_5(25), time_000_000_000_2(26), time_000_000_000_1(27), time_000_000_000_05(28), time_000_000_000_02(29), time_000_000_000_01(30), time_000_000_000_005(31), time_000_000_000_002(32), time_000_000_000_001(33), time_000_000_000_000_5(34), time_000_000_000_000_2(35), time_000_000_000_000_1(36), time_000_000_000_000_05(37), time_000_000_000_000_02(38), time_000_000_000_000_01(39);
        struct BasicSafetyMessageVerbosePositionConfidenceSet posConfidence;  // OCTETSTRING, OPTIONAL;
        struct OPT_ENUM_ASN steerConfidence;  // ENUMERATED, OPTIONAL, unavailable(0), prec2deg(1), prec1deg(2), prec0_02deg(3);
        struct OPT_ENUM_ASN throttleConfidence;  // ENUMERATED, OPTIONAL, unavailable(0), prec10percent(1), prec1percent(2), prec0_5percent(3);
    };
    
    struct BasicSafetyMessageVerbose_VehicleStatus_accelSets {
        INT isValidFlag;   // necessary if this struct is used as an optional field of a SEQUENCE
        struct BasicSafetyMessageVerboseAccelerationSet4Way accel4way;  // OCTETSTRING, OPTIONAL;
        struct BasicSafetyMessageVerboseVerticalAccelerationThreshold vertAccelThres;  // BITSTRING, OPTIONAL;
        struct OPT_ENUM_ASN yawRateCon;  // ENUMERATED, OPTIONAL, unavailable(0), degSec_100_00(1), degSec_010_00(2), degSec_005_00(3), degSec_001_00(4), degSec_000_10(5), degSec_000_05(6), degSec_000_01(7);
        struct OPT_ENUM_ASN hozAccelCon;  // ENUMERATED, OPTIONAL, unavailable(0), accl_100_00(1), accl_010_00(2), accl_005_00(3), accl_001_00(4), accl_000_10(5), accl_000_05(6), accl_000_01(7);
        struct BasicSafetyMessageVerboseConfidenceSet confidenceSet;  // SEQUENCE, OPTIONAL;
    };
    
    struct BasicSafetyMessageVerbose_VehicleStatus_object {
        INT isValidFlag;   // necessary if this struct is used as an optional field of a SEQUENCE
        WORD obDist;  // INTEGER, 0..32767;
        WORD obDirect;  // INTEGER, 0..28800;
        struct BasicSafetyMessageVerboseDDateTime dateTime;  // SEQUENCE;
    };
    
    struct BasicSafetyMessageVerboseBumperHeights {
        INT isValidFlag;   // necessary if this struct is used as an optional field of a SEQUENCE
        BYTE frnt;  // INTEGER, 0..127;
        BYTE rear;  // INTEGER, 0..127;
    };
    
    struct BasicSafetyMessageVerbose_VehicleStatus_vehicleData {
        INT isValidFlag;   // necessary if this struct is used as an optional field of a SEQUENCE
        BYTE height;  // INTEGER, 0..127;
        struct BasicSafetyMessageVerboseBumperHeights bumpers;  // SEQUENCE;
        BYTE mass;  // INTEGER, 1..127;
        WORD trailerWeight;  // INTEGER, 0..65535;
        INT type;  // ENUMERATED, none(0), unknown(1), special(2), moto(3), car(4), carOther(5), bus(6), axleCnt2(7), axleCnt3(8), axleCnt4(9), axleCnt4Trailer(10), axleCnt5Trailer(11), axleCnt6Trailer(12), axleCnt5MultiTrailer(13), axleCnt6MultiTrailer(14), axleCnt7MultiTrailer(15);
    };
    
    struct BasicSafetyMessageVerboseDescriptiveName {
        INT isValidFlag;   // necessary if this struct is used as an optional field of a SEQUENCE
        CHAR string[64];
        INT  stringLength;
    };
    
    struct BasicSafetyMessageVerboseVINstring {
        INT isValidFlag;   // necessary if this struct is used as an optional field of a SEQUENCE
        CHAR string[18];
        INT  stringLength;
    };
    
    struct BasicSafetyMessageVerbose_VehicleIdent_ownerCode {
        INT isValidFlag;   // necessary if this struct is used as an optional field of a SEQUENCE
        CHAR string[33];
        INT  stringLength;
    };
    
    struct BasicSafetyMessageVerbose_VehicleIdent_vehicleClass {
        INT isValidFlag;   // necessary if this struct is used as an optional field of a SEQUENCE
        INT choice;
        INT vGroup;  // ENUMERATED, all_vehicles(9217), bicycles(9218), motorcycles(9219), cars(9220), light_vehicles(9221), cars_and_light_vehicles(9222), cars_with_trailers(9223), cars_with_recreational_trailers(9224), vehicles_with_trailers(9225), heavy_vehicles(9226), trucks(9227), buses(9228), articulated_buses(9229), school_buses(9230), vehicles_with_semi_trailers(9231), vehicles_with_double_trailers(9232), high_profile_vehicles(9233), wide_vehicles(9234), long_vehicles(9235), hazardous_loads(9236), exceptional_loads(9237), abnormal_loads(9238), convoys(9239), maintenance_vehicles(9240), delivery_vehicles(9241), vehicles_with_even_numbered_license_plates(9242), vehicles_with_odd_numbered_license_plates(9243), vehicles_with_parking_permits(9244), vehicles_with_catalytic_converters(9245), vehicles_without_catalytic_converters(9246), gas_powered_vehicles(9247), diesel_powered_vehicles(9248), lPG_vehicles(9249), military_convoys(9250), military_vehicles(9251);
        INT rGroup;  // ENUMERATED, emergency_vehicle_units(9729), federal_law_enforcement_units(9730), state_police_units(9731), county_police_units(9732), local_police_units(9733), ambulance_units(9734), rescue_units(9735), fire_units(9736), hAZMAT_units(9737), light_tow_unit(9738), heavy_tow_unit(9739), freeway_service_patrols(9740), transportation_response_units(9741), private_contractor_response_units(9742);
        INT rEquip;  // ENUMERATED, ground_fire_suppression(9985), heavy_ground_equipment(9986), aircraft(9988), marine_equipment(9989), support_equipment(9990), medical_rescue_unit(9991), other(9993), ground_fire_suppression_other(9994), engine(9995), truck_or_aerial(9996), quint(9997), tanker_pumper_combination(9998), brush_truck(10000), aircraft_rescue_firefighting(10001), heavy_ground_equipment_other(10004), dozer_or_plow(10005), tractor(10006), tanker_or_tender(10008), aircraft_other(10024), aircraft_fixed_wing_tanker(10025), helitanker(10026), helicopter(10027), marine_equipment_other(10034), fire_boat_with_pump(10035), boat_no_pump(10036), support_apparatus_other(10044), breathing_apparatus_support(10045), light_and_air_unit(10046), medical_rescue_unit_other(10054), rescue_unit(10055), urban_search_rescue_unit(10056), high_angle_rescue(10057), crash_fire_rescue(10058), bLS_unit(10059), aLS_unit(10060), mobile_command_post(10075), chief_officer_car(10076), hAZMAT_unit(10077), type_i_hand_crew(10078), type_ii_hand_crew(10079), privately_owned_vehicle(10083), other_apparatus_resource(10084), ambulance(10085), bomb_squad_van(10086), combine_harvester(10087), construction_vehicle(10088), farm_tractor(10089), grass_cutting_machines(10090), hAZMAT_containment_tow(10091), heavy_tow(10092), light_tow(10094), flatbed_tow(10114), hedge_cutting_machines(10093), mobile_crane(10095), refuse_collection_vehicle(10096), resurfacing_vehicle(10097), road_sweeper(10098), roadside_litter_collection_crews(10099), salvage_vehicle(10100), sand_truck(10101), snowplow(10102), steam_roller(10103), swat_team_van(10104), track_laying_vehicle(10105), unknown_vehicle(10106), white_lining_vehicle(10107), dump_truck(10108), supervisor_vehicle(10109), snow_blower(10110), rotary_snow_blower(10111), road_grader(10112), steam_truck(10113);
    };
    
    struct BasicSafetyMessageVerboseVehicleIdent {
        INT isValidFlag;   // necessary if this struct is used as an optional field of a SEQUENCE
        struct BasicSafetyMessageVerboseDescriptiveName name;  // IA5STRING, OPTIONAL;
        struct BasicSafetyMessageVerboseVINstring vin;  // OCTETSTRING, OPTIONAL;
        struct BasicSafetyMessageVerbose_VehicleIdent_ownerCode ownerCode;  // IA5STRING, OPTIONAL;
        struct BasicSafetyMessageVerboseTemporaryID id;  // OCTETSTRING, OPTIONAL;
        struct OPT_ENUM_ASN vehicleType;  // ENUMERATED, OPTIONAL, none(0), unknown(1), special(2), moto(3), car(4), carOther(5), bus(6), axleCnt2(7), axleCnt3(8), axleCnt4(9), axleCnt4Trailer(10), axleCnt5Trailer(11), axleCnt6Trailer(12), axleCnt5MultiTrailer(13), axleCnt6MultiTrailer(14), axleCnt7MultiTrailer(15);
        struct BasicSafetyMessageVerbose_VehicleIdent_vehicleClass vehicleClass;  // CHOICE, OPTIONAL;
    };
    
    struct BasicSafetyMessageVerboseWheelEndElectFault {
        INT isValidFlag;   // necessary if this struct is used as an optional field of a SEQUENCE
        CHAR string[256];
        INT  stringLength;
    };
    
    struct BasicSafetyMessageVerbose_J1939data_tires_ {
        INT isValidFlag;   // necessary if this struct is used as an optional field of a SEQUENCE
        struct OPT_BYTE_ASN location;  // INTEGER, OPTIONAL, 0..255;
        struct OPT_BYTE_ASN pressure;  // INTEGER, OPTIONAL, 0..255;
        struct OPT_WORD_ASN temp;  // INTEGER, OPTIONAL, 0..65535;
        struct OPT_ENUM_ASN wheelSensorStatus;  // ENUMERATED, OPTIONAL, off(0), on(1), notDefined(2), notSupoprted(3);
        struct BasicSafetyMessageVerboseWheelEndElectFault wheelEndElectFault;  // BITSTRING, OPTIONAL;
        struct OPT_WORD_ASN leakageRate;  // INTEGER, OPTIONAL, 0..65535;
        struct OPT_ENUM_ASN detection;  // ENUMERATED, OPTIONAL, noData(0), overPressure(1), noWarningPressure(2), underPressure(3), extremeUnderPressure(4), undefined(5), errorIndicator(6), notAvailable(7);
    };
    
    struct BasicSafetyMessageVerbose_J1939data_tires {
        INT isValidFlag;   // necessary if this struct is used as an optional field of a SEQUENCE
        INT length;
        struct BasicSafetyMessageVerbose_J1939data_tires_ arrayValue[16];  // SEQUENCE;
    };
    
    struct BasicSafetyMessageVerbose_J1939data_axle_ {
        INT isValidFlag;   // necessary if this struct is used as an optional field of a SEQUENCE
        struct OPT_BYTE_ASN location;  // INTEGER, OPTIONAL, 0..127;
        struct OPT_WORD_ASN weight;  // INTEGER, OPTIONAL, 0..65535;
    };
    
    struct BasicSafetyMessageVerbose_J1939data_axle {
        INT isValidFlag;   // necessary if this struct is used as an optional field of a SEQUENCE
        INT length;
        struct BasicSafetyMessageVerbose_J1939data_axle_ arrayValue[16];  // SEQUENCE;
    };
    
    struct BasicSafetyMessageVerboseJ1939data {
        INT isValidFlag;   // necessary if this struct is used as an optional field of a SEQUENCE
        struct BasicSafetyMessageVerbose_J1939data_tires tires;  // SEQUENCEOF, OPTIONAL;
        struct BasicSafetyMessageVerbose_J1939data_axle axle;  // SEQUENCEOF, OPTIONAL;
        struct OPT_WORD_ASN trailerWeight;  // INTEGER, OPTIONAL, 0..65535;
        struct OPT_WORD_ASN cargoWeight;  // INTEGER, OPTIONAL, 0..65535;
        struct OPT_BYTE_ASN steeringAxleTemperature;  // INTEGER, OPTIONAL, 0..255;
        struct OPT_BYTE_ASN driveAxleLocation;  // INTEGER, OPTIONAL, 0..255;
        struct OPT_BYTE_ASN driveAxleLiftAirPressure;  // INTEGER, OPTIONAL, 0..255;
        struct OPT_BYTE_ASN driveAxleTemperature;  // INTEGER, OPTIONAL, 0..255;
        struct OPT_BYTE_ASN driveAxleLubePressure;  // INTEGER, OPTIONAL, 0..255;
        struct OPT_BYTE_ASN steeringAxleLubePressure;  // INTEGER, OPTIONAL, 0..255;
    };
    
    struct BasicSafetyMessageVerbose_VehicleStatus_weatherReport {
        INT isValidFlag;   // necessary if this struct is used as an optional field of a SEQUENCE
        INT isRaining;  // ENUMERATED, precip(1), noPrecip(2), error(3);
        struct OPT_WORD_ASN rainRate;  // INTEGER, OPTIONAL, 0..65535;
        struct OPT_ENUM_ASN precipSituation;  // ENUMERATED, OPTIONAL, other(1), unknown(2), noPrecipitation(3), unidentifiedSlight(4), unidentifiedModerate(5), unidentifiedHeavy(6), snowSlight(7), snowModerate(8), snowHeavy(9), rainSlight(10), rainModerate(11), rainHeavy(12), frozenPrecipitationSlight(13), frozenPrecipitationModerate(14), frozenPrecipitationHeavy(15);
        struct OPT_WORD_ASN solarRadiation;  // INTEGER, OPTIONAL, 0..65535;
        struct OPT_BYTE_ASN friction;  // INTEGER, OPTIONAL, 0..101;
    };
    
    struct BasicSafetyMessageVerboseVehicleStatus {
        INT isValidFlag;   // necessary if this struct is used as an optional field of a SEQUENCE
        struct OPT_WORD_ASN lights;  // INTEGER, OPTIONAL, 0..256, allLightsOff(0), lowBeamHeadlightsOn(1), highBeamHeadlightsOn(2), leftTurnSignalOn(4), rightTurnSignalOn(8), hazardSignalOn(12), automaticLightControlOn(16), daytimeRunningLightsOn(32), fogLightOn(64), parkingLightsOn(128);
        struct OPT_ENUM_ASN lightBar;  // ENUMERATED, OPTIONAL, unavailable(0), notInUse(1), inUse(2), sirenInUse(3), yellowCautionLights(4), schooldBusLights(5), arrowSignsActive(6), slowMovingVehicle(7), freqStops(8), reserved(9);
        struct BasicSafetyMessageVerbose_VehicleStatus_wipers wipers;  // SEQUENCE, OPTIONAL;
        struct BasicSafetyMessageVerboseBrakeSystemStatus brakeStatus;  // OCTETSTRING, OPTIONAL;
        struct OPT_ENUM_ASN brakePressure;  // ENUMERATED, OPTIONAL, unavailable(0), minPressure(1), bkLvl_2(2), bkLvl_3(3), bkLvl_4(4), bkLvl_5(5), bkLvl_6(6), bkLvl_7(7), bkLvl_8(8), bkLvl_9(9), bkLvl_10(10), bkLvl_11(11), bkLvl_12(12), bkLvl_13(13), bkLvl_14(14), maxPressure(15);
        struct OPT_BYTE_ASN roadFriction;  // INTEGER, OPTIONAL, 0..50;
        struct OPT_WORD_ASN sunData;  // INTEGER, OPTIONAL, 0..1000;
        struct OPT_ENUM_ASN rainData;  // ENUMERATED, OPTIONAL, none(0), lightMist(1), heavyMist(2), lightRainOrDrizzle(3), rain(4), moderateRain(5), heavyRain(6), heavyDownpour(7);
        struct OPT_BYTE_ASN airTemp;  // INTEGER, OPTIONAL, 0..191;
        struct OPT_BYTE_ASN airPres;  // INTEGER, OPTIONAL, 0..255;
        struct BasicSafetyMessageVerbose_VehicleStatus_steering steering;  // SEQUENCE, OPTIONAL;
        struct BasicSafetyMessageVerbose_VehicleStatus_accelSets accelSets;  // SEQUENCE, OPTIONAL;
        struct BasicSafetyMessageVerbose_VehicleStatus_object object;  // SEQUENCE, OPTIONAL;
        struct BasicSafetyMessageVerboseFullPositionVector fullPos;  // SEQUENCE, OPTIONAL;
        struct OPT_BYTE_ASN throttlePos;  // INTEGER, OPTIONAL, 0..200;
        struct BasicSafetyMessageVerboseSpeedandHeadingandThrottleConfidence speedHeadC;  // OCTETSTRING, OPTIONAL;
        struct OPT_ENUM_ASN speedC;  // ENUMERATED, OPTIONAL, unavailable(0), prec100ms(1), prec10ms(2), prec5ms(3), prec1ms(4), prec0_1ms(5), prec0_05ms(6), prec0_01ms(7);
        struct BasicSafetyMessageVerbose_VehicleStatus_vehicleData vehicleData;  // SEQUENCE, OPTIONAL;
        struct BasicSafetyMessageVerboseVehicleIdent vehicleIdent;  // SEQUENCE, OPTIONAL;
        struct BasicSafetyMessageVerboseJ1939data j1939data;  // SEQUENCE, OPTIONAL;
        struct BasicSafetyMessageVerbose_VehicleStatus_weatherReport weatherReport;  // SEQUENCE, OPTIONAL;
        struct BasicSafetyMessageVerboseGPSstatus gpsStatus;  // BITSTRING, OPTIONAL;
    };
    
    struct BasicSafetyMessageVerbose {
        INT isValidFlag;   // necessary if this struct is used as an optional field of a SEQUENCE
        INT msgID;  // ENUMERATED, reserved(0), alaCarteMessage(1), basicSafetyMessage(2), basicSafetyMessageVerbose(3), commonSafetyRequest(4), emergencyVehicleAlert(5), intersectionCollisionAlert(6), mapData(7), nmeaCorrections(8), probeDataManagement(9), probeVehicleData(10), roadSideAlert(11), rtcmCorrections(12), signalPhaseAndTimingMessage(13), signalRequestMessage(14), signalStatusMessage(15), travelerInformation(16);
        BYTE msgCnt;  // INTEGER, 0..127;
        struct BasicSafetyMessageVerboseTemporaryID id;  // OCTETSTRING;
        WORD secMark;  // INTEGER, 0..65535;
        LONG lat;  // INTEGER, -900000000..900000001;
        LONG lon;  // INTEGER, -1799999999..1800000001;
        struct BasicSafetyMessageVerboseElevation elev;  // OCTETSTRING;
        struct BasicSafetyMessageVerbosePositionalAccuracy accuracy;  // OCTETSTRING;
        struct BasicSafetyMessageVerboseTransmissionAndSpeed speed;  // OCTETSTRING;
        WORD heading;  // INTEGER, 0..28800;
        struct BasicSafetyMessageVerboseSteeringWheelAngle angle;  // OCTETSTRING;
        struct BasicSafetyMessageVerboseAccelerationSet4Way accelSet;  // OCTETSTRING;
        struct BasicSafetyMessageVerboseBrakeSystemStatus brakes;  // OCTETSTRING;
        struct BasicSafetyMessageVerboseVehicleSize size;  // SEQUENCE;
        struct BasicSafetyMessageVerboseVehicleSafetyExtension safetyExt;  // SEQUENCE, OPTIONAL;
        struct BasicSafetyMessageVerboseVehicleStatus status;  // SEQUENCE, OPTIONAL;
    };
    
}

/*
// init function to create a simple packet handle
*/ 
LONG API_InitBasicSafetyMessageVerbosePacket()
{
  return C2xInitPacket("BasicSafetyMessageVerbose"); 
}

/*
// init function to create a simple packet handle and
// initialize the struct with valid data
*/ 
LONG API_InitBasicSafetyMessageVerbosePacket(struct BasicSafetyMessageVerbose msgStruct)
{
  long pktHandle;

  pktHandle = API_InitBasicSafetyMessageVerbosePacket();

  if (pktHandle != 0)
  {
    // create valid message and application data
    if (C2xCompletePacket(pktHandle) == 0) 
    {
      API_GetBasicSafetyMessageVerboseParams(pktHandle, msgStruct);
    }
  }
  return pktHandle;
}

/*
// init function to create a packet with security layer and
// initialize the struct with valid data
*/ 
LONG API_InitBasicSafetyMessageVerbosePacket(struct BasicSafetyMessageVerbose msgStruct, char packetTypeDesignator[], char certificateName[])
{
  long pktHandle, certHdl;

  // initialize the packet
  pktHandle = C2xInitPacket("BasicSafetyMessageVerbose", packetTypeDesignator);

  if (pktHandle != 0)
  {
    certHdl = C2xSecCertificateGetHandle(certificateName);  // get the certificate handle for the cert with name "certificateName"
    if (certHdl != 0) 
    {
      C2xSecPacketSetSignerHandle(pktHandle, certHdl); // set the certHdl to the packet
    }

    // create valid message and application data
    if (C2xCompletePacket(pktHandle) == 0) 
    {
      // copy application data to the application structure
      API_GetBasicSafetyMessageVerboseParams(pktHandle, msgStruct);
    }
  }
  return pktHandle;
}
    

int GetBasicSafetyMessageVerbose_Blob_TemporaryIDParams(LONG packetHandle, struct BasicSafetyMessageVerbose_Blob_TemporaryID value, char oldPath[])
{
  char newPath[300];
  int result;

  result = 0;

  snprintf(newPath, elcount(newPath), "%s.%s", oldPath, "temporaryID");
  value.temporaryID = C2xGetTokenInt64(packetHandle, "BasicSafetyMessageVerbose", newPath);
  result = CheckLastError("BasicSafetyMessageVerbose", gkFuncRefGet, result);

  return result;
}

int SetBasicSafetyMessageVerbose_Blob_TemporaryIDParams(LONG packetHandle, struct BasicSafetyMessageVerbose_Blob_TemporaryID value, char oldPath[])
{
  char newPath[300];
  int result;

  result = 0;

  snprintf(newPath, elcount(newPath), "%s.%s", oldPath, "temporaryID");
  C2xSetTokenInt64(packetHandle, "BasicSafetyMessageVerbose", newPath, value.temporaryID);
  result = CheckLastError("BasicSafetyMessageVerbose", gkFuncRefGet, result);

  return result;
}

int GetBasicSafetyMessageVerboseTemporaryIDParams(LONG packetHandle, struct BasicSafetyMessageVerboseTemporaryID value, char oldPath[])
{
  char newPath[300];
  int result;

  result = 0;

  snprintf(newPath, elcount(newPath), "%s.%s", oldPath, "_Blob_TemporaryID");
  GetBasicSafetyMessageVerbose_Blob_TemporaryIDParams(packetHandle, value._Blob_TemporaryID, newPath);
  result = CheckLastError("BasicSafetyMessageVerbose", gkFuncRefGet, result);

  return result;
}

int SetBasicSafetyMessageVerboseTemporaryIDParams(LONG packetHandle, struct BasicSafetyMessageVerboseTemporaryID value, char oldPath[])
{
  char newPath[300];
  int result;

  result = 0;

  snprintf(newPath, elcount(newPath), "%s.%s", oldPath, "_Blob_TemporaryID");
  SetBasicSafetyMessageVerbose_Blob_TemporaryIDParams(packetHandle, value._Blob_TemporaryID, newPath);
  result = CheckLastError("BasicSafetyMessageVerbose", gkFuncRefGet, result);

  return result;
}

int GetBasicSafetyMessageVerboseElevationParams(LONG packetHandle, struct BasicSafetyMessageVerboseElevation value, char oldPath[])
{
  char newPath[300];
  int result;

  result = 0;

  snprintf(newPath, elcount(newPath), "%s.%s", oldPath, "_Blob_Elevation");
  value._Blob_Elevation = C2xGetTokenInt(packetHandle, "BasicSafetyMessageVerbose", newPath);
  result = CheckLastError("BasicSafetyMessageVerbose", gkFuncRefGet, result);

  return result;
}

int SetBasicSafetyMessageVerboseElevationParams(LONG packetHandle, struct BasicSafetyMessageVerboseElevation value, char oldPath[])
{
  char newPath[300];
  int result;

  result = 0;

  snprintf(newPath, elcount(newPath), "%s.%s", oldPath, "_Blob_Elevation");
  C2xSetTokenInt(packetHandle, "BasicSafetyMessageVerbose", newPath, value._Blob_Elevation);
  result = CheckLastError("BasicSafetyMessageVerbose", gkFuncRefGet, result);

  return result;
}

int GetBasicSafetyMessageVerbose_Blob_PositionalAccuracyParams(LONG packetHandle, struct BasicSafetyMessageVerbose_Blob_PositionalAccuracy value, char oldPath[])
{
  char newPath[300];
  int result;

  result = 0;

  snprintf(newPath, elcount(newPath), "%s.%s", oldPath, "accuracySemiMajor");
  value.accuracySemiMajor = C2xGetTokenInt(packetHandle, "BasicSafetyMessageVerbose", newPath);
  result = CheckLastError("BasicSafetyMessageVerbose", gkFuncRefGet, result);

  snprintf(newPath, elcount(newPath), "%s.%s", oldPath, "accuracySemiMinor");
  value.accuracySemiMinor = C2xGetTokenInt(packetHandle, "BasicSafetyMessageVerbose", newPath);
  result = CheckLastError("BasicSafetyMessageVerbose", gkFuncRefGet, result);

  snprintf(newPath, elcount(newPath), "%s.%s", oldPath, "accuracyOrientation");
  value.accuracyOrientation = C2xGetTokenInt(packetHandle, "BasicSafetyMessageVerbose", newPath);
  result = CheckLastError("BasicSafetyMessageVerbose", gkFuncRefGet, result);

  return result;
}

int SetBasicSafetyMessageVerbose_Blob_PositionalAccuracyParams(LONG packetHandle, struct BasicSafetyMessageVerbose_Blob_PositionalAccuracy value, char oldPath[])
{
  char newPath[300];
  int result;

  result = 0;

  snprintf(newPath, elcount(newPath), "%s.%s", oldPath, "accuracySemiMajor");
  C2xSetTokenInt(packetHandle, "BasicSafetyMessageVerbose", newPath, value.accuracySemiMajor);
  result = CheckLastError("BasicSafetyMessageVerbose", gkFuncRefGet, result);

  snprintf(newPath, elcount(newPath), "%s.%s", oldPath, "accuracySemiMinor");
  C2xSetTokenInt(packetHandle, "BasicSafetyMessageVerbose", newPath, value.accuracySemiMinor);
  result = CheckLastError("BasicSafetyMessageVerbose", gkFuncRefGet, result);

  snprintf(newPath, elcount(newPath), "%s.%s", oldPath, "accuracyOrientation");
  C2xSetTokenInt(packetHandle, "BasicSafetyMessageVerbose", newPath, value.accuracyOrientation);
  result = CheckLastError("BasicSafetyMessageVerbose", gkFuncRefGet, result);

  return result;
}

int GetBasicSafetyMessageVerbosePositionalAccuracyParams(LONG packetHandle, struct BasicSafetyMessageVerbosePositionalAccuracy value, char oldPath[])
{
  char newPath[300];
  int result;

  result = 0;

  snprintf(newPath, elcount(newPath), "%s.%s", oldPath, "_Blob_PositionalAccuracy");
  GetBasicSafetyMessageVerbose_Blob_PositionalAccuracyParams(packetHandle, value._Blob_PositionalAccuracy, newPath);
  result = CheckLastError("BasicSafetyMessageVerbose", gkFuncRefGet, result);

  return result;
}

int SetBasicSafetyMessageVerbosePositionalAccuracyParams(LONG packetHandle, struct BasicSafetyMessageVerbosePositionalAccuracy value, char oldPath[])
{
  char newPath[300];
  int result;

  result = 0;

  snprintf(newPath, elcount(newPath), "%s.%s", oldPath, "_Blob_PositionalAccuracy");
  SetBasicSafetyMessageVerbose_Blob_PositionalAccuracyParams(packetHandle, value._Blob_PositionalAccuracy, newPath);
  result = CheckLastError("BasicSafetyMessageVerbose", gkFuncRefGet, result);

  return result;
}

int GetBasicSafetyMessageVerbose_Blob_TransmissionAndSpeedParams(LONG packetHandle, struct BasicSafetyMessageVerbose_Blob_TransmissionAndSpeed value, char oldPath[])
{
  char newPath[300];
  int result;

  result = 0;

  snprintf(newPath, elcount(newPath), "%s.%s", oldPath, "transmissionState");
  value.transmissionState = C2xGetTokenInt(packetHandle, "BasicSafetyMessageVerbose", newPath);
  result = CheckLastError("BasicSafetyMessageVerbose", gkFuncRefGet, result);

  snprintf(newPath, elcount(newPath), "%s.%s", oldPath, "speed");
  value.speed = C2xGetTokenInt(packetHandle, "BasicSafetyMessageVerbose", newPath);
  result = CheckLastError("BasicSafetyMessageVerbose", gkFuncRefGet, result);

  return result;
}

int SetBasicSafetyMessageVerbose_Blob_TransmissionAndSpeedParams(LONG packetHandle, struct BasicSafetyMessageVerbose_Blob_TransmissionAndSpeed value, char oldPath[])
{
  char newPath[300];
  int result;

  result = 0;

  snprintf(newPath, elcount(newPath), "%s.%s", oldPath, "transmissionState");
  C2xSetTokenInt(packetHandle, "BasicSafetyMessageVerbose", newPath, value.transmissionState);
  result = CheckLastError("BasicSafetyMessageVerbose", gkFuncRefGet, result);

  snprintf(newPath, elcount(newPath), "%s.%s", oldPath, "speed");
  C2xSetTokenInt(packetHandle, "BasicSafetyMessageVerbose", newPath, value.speed);
  result = CheckLastError("BasicSafetyMessageVerbose", gkFuncRefGet, result);

  return result;
}

int GetBasicSafetyMessageVerboseTransmissionAndSpeedParams(LONG packetHandle, struct BasicSafetyMessageVerboseTransmissionAndSpeed value, char oldPath[])
{
  char newPath[300];
  int result;

  result = 0;

  snprintf(newPath, elcount(newPath), "%s.%s", oldPath, "_Blob_TransmissionAndSpeed");
  GetBasicSafetyMessageVerbose_Blob_TransmissionAndSpeedParams(packetHandle, value._Blob_TransmissionAndSpeed, newPath);
  result = CheckLastError("BasicSafetyMessageVerbose", gkFuncRefGet, result);

  return result;
}

int SetBasicSafetyMessageVerboseTransmissionAndSpeedParams(LONG packetHandle, struct BasicSafetyMessageVerboseTransmissionAndSpeed value, char oldPath[])
{
  char newPath[300];
  int result;

  result = 0;

  snprintf(newPath, elcount(newPath), "%s.%s", oldPath, "_Blob_TransmissionAndSpeed");
  SetBasicSafetyMessageVerbose_Blob_TransmissionAndSpeedParams(packetHandle, value._Blob_TransmissionAndSpeed, newPath);
  result = CheckLastError("BasicSafetyMessageVerbose", gkFuncRefGet, result);

  return result;
}

int GetBasicSafetyMessageVerboseSteeringWheelAngleParams(LONG packetHandle, struct BasicSafetyMessageVerboseSteeringWheelAngle value, char oldPath[])
{
  char newPath[300];
  int result;

  result = 0;

  snprintf(newPath, elcount(newPath), "%s.%s", oldPath, "_Blob_SteeringWheelAngle");
  value._Blob_SteeringWheelAngle = C2xGetTokenInt(packetHandle, "BasicSafetyMessageVerbose", newPath);
  result = CheckLastError("BasicSafetyMessageVerbose", gkFuncRefGet, result);

  return result;
}

int SetBasicSafetyMessageVerboseSteeringWheelAngleParams(LONG packetHandle, struct BasicSafetyMessageVerboseSteeringWheelAngle value, char oldPath[])
{
  char newPath[300];
  int result;

  result = 0;

  snprintf(newPath, elcount(newPath), "%s.%s", oldPath, "_Blob_SteeringWheelAngle");
  C2xSetTokenInt(packetHandle, "BasicSafetyMessageVerbose", newPath, value._Blob_SteeringWheelAngle);
  result = CheckLastError("BasicSafetyMessageVerbose", gkFuncRefGet, result);

  return result;
}

int GetBasicSafetyMessageVerbose_Blob_AccelerationSet4WayParams(LONG packetHandle, struct BasicSafetyMessageVerbose_Blob_AccelerationSet4Way value, char oldPath[])
{
  char newPath[300];
  int result;

  result = 0;

  snprintf(newPath, elcount(newPath), "%s.%s", oldPath, "accelerationLong");
  value.accelerationLong = C2xGetTokenInt(packetHandle, "BasicSafetyMessageVerbose", newPath);
  result = CheckLastError("BasicSafetyMessageVerbose", gkFuncRefGet, result);

  snprintf(newPath, elcount(newPath), "%s.%s", oldPath, "accelerationLat");
  value.accelerationLat = C2xGetTokenInt(packetHandle, "BasicSafetyMessageVerbose", newPath);
  result = CheckLastError("BasicSafetyMessageVerbose", gkFuncRefGet, result);

  snprintf(newPath, elcount(newPath), "%s.%s", oldPath, "accelerationVert");
  value.accelerationVert = C2xGetTokenInt(packetHandle, "BasicSafetyMessageVerbose", newPath);
  result = CheckLastError("BasicSafetyMessageVerbose", gkFuncRefGet, result);

  snprintf(newPath, elcount(newPath), "%s.%s", oldPath, "yawRate");
  value.yawRate = C2xGetTokenInt(packetHandle, "BasicSafetyMessageVerbose", newPath);
  result = CheckLastError("BasicSafetyMessageVerbose", gkFuncRefGet, result);

  return result;
}

int SetBasicSafetyMessageVerbose_Blob_AccelerationSet4WayParams(LONG packetHandle, struct BasicSafetyMessageVerbose_Blob_AccelerationSet4Way value, char oldPath[])
{
  char newPath[300];
  int result;

  result = 0;

  snprintf(newPath, elcount(newPath), "%s.%s", oldPath, "accelerationLong");
  C2xSetTokenInt(packetHandle, "BasicSafetyMessageVerbose", newPath, value.accelerationLong);
  result = CheckLastError("BasicSafetyMessageVerbose", gkFuncRefGet, result);

  snprintf(newPath, elcount(newPath), "%s.%s", oldPath, "accelerationLat");
  C2xSetTokenInt(packetHandle, "BasicSafetyMessageVerbose", newPath, value.accelerationLat);
  result = CheckLastError("BasicSafetyMessageVerbose", gkFuncRefGet, result);

  snprintf(newPath, elcount(newPath), "%s.%s", oldPath, "accelerationVert");
  C2xSetTokenInt(packetHandle, "BasicSafetyMessageVerbose", newPath, value.accelerationVert);
  result = CheckLastError("BasicSafetyMessageVerbose", gkFuncRefGet, result);

  snprintf(newPath, elcount(newPath), "%s.%s", oldPath, "yawRate");
  C2xSetTokenInt(packetHandle, "BasicSafetyMessageVerbose", newPath, value.yawRate);
  result = CheckLastError("BasicSafetyMessageVerbose", gkFuncRefGet, result);

  return result;
}

int GetBasicSafetyMessageVerboseAccelerationSet4WayParams(LONG packetHandle, struct BasicSafetyMessageVerboseAccelerationSet4Way value, char oldPath[])
{
  char newPath[300];
  int result;

  result = 0;

  snprintf(newPath, elcount(newPath), "%s.%s", oldPath, "_Blob_AccelerationSet4Way");
  GetBasicSafetyMessageVerbose_Blob_AccelerationSet4WayParams(packetHandle, value._Blob_AccelerationSet4Way, newPath);
  result = CheckLastError("BasicSafetyMessageVerbose", gkFuncRefGet, result);

  return result;
}

int SetBasicSafetyMessageVerboseAccelerationSet4WayParams(LONG packetHandle, struct BasicSafetyMessageVerboseAccelerationSet4Way value, char oldPath[])
{
  char newPath[300];
  int result;

  result = 0;

  snprintf(newPath, elcount(newPath), "%s.%s", oldPath, "_Blob_AccelerationSet4Way");
  SetBasicSafetyMessageVerbose_Blob_AccelerationSet4WayParams(packetHandle, value._Blob_AccelerationSet4Way, newPath);
  result = CheckLastError("BasicSafetyMessageVerbose", gkFuncRefGet, result);

  return result;
}

int GetBasicSafetyMessageVerbose_Blob_BrakeSystemStatusParams(LONG packetHandle, struct BasicSafetyMessageVerbose_Blob_BrakeSystemStatus value, char oldPath[])
{
  char newPath[300]; 
  int j;
  int result;

  result = 0;

  snprintf(newPath, elcount(newPath), "%s.%s", oldPath, "wheelBrakes");
  value.wheelBrakes.isValidFlag = 1;
  value.wheelBrakes.stringLength = C2xGetTokenLengthBit(packetHandle, "BasicSafetyMessageVerbose", newPath);
  if ((result = CheckLastError("BasicSafetyMessageVerbose", gkFuncRefGet, result))==0)
  {
    for(j=0; j<value.wheelBrakes.stringLength; j++)
    {
      if(C2xGetTokenBitOfBitString(packetHandle, "BasicSafetyMessageVerbose", newPath, j) == 0)
      {
        value.wheelBrakes.string[j] = '0';
      }
      else
      {
        value.wheelBrakes.string[j] = '1';
      }
      result = CheckLastError("BasicSafetyMessageVerbose", gkFuncRefGet, result);
    }
  }

  snprintf(newPath, elcount(newPath), "%s.%s", oldPath, "brakesUnavailable");
  value.brakesUnavailable = C2xGetTokenInt64(packetHandle, "BasicSafetyMessageVerbose", newPath);
  result = CheckLastError("BasicSafetyMessageVerbose", gkFuncRefGet, result);

  snprintf(newPath, elcount(newPath), "%s.%s", oldPath, "spareBit");
  value.spareBit = C2xGetTokenInt(packetHandle, "BasicSafetyMessageVerbose", newPath);
  result = CheckLastError("BasicSafetyMessageVerbose", gkFuncRefGet, result);

  snprintf(newPath, elcount(newPath), "%s.%s", oldPath, "traction");
  value.traction = C2xGetTokenInt(packetHandle, "BasicSafetyMessageVerbose", newPath);
  result = CheckLastError("BasicSafetyMessageVerbose", gkFuncRefGet, result);

  snprintf(newPath, elcount(newPath), "%s.%s", oldPath, "antilockBrakingSystem");
  value.antilockBrakingSystem = C2xGetTokenInt(packetHandle, "BasicSafetyMessageVerbose", newPath);
  result = CheckLastError("BasicSafetyMessageVerbose", gkFuncRefGet, result);

  snprintf(newPath, elcount(newPath), "%s.%s", oldPath, "scs");
  value.scs = C2xGetTokenInt(packetHandle, "BasicSafetyMessageVerbose", newPath);
  result = CheckLastError("BasicSafetyMessageVerbose", gkFuncRefGet, result);

  snprintf(newPath, elcount(newPath), "%s.%s", oldPath, "brakeBoost");
  value.brakeBoost = C2xGetTokenInt(packetHandle, "BasicSafetyMessageVerbose", newPath);
  result = CheckLastError("BasicSafetyMessageVerbose", gkFuncRefGet, result);

  snprintf(newPath, elcount(newPath), "%s.%s", oldPath, "auxBrakes");
  value.auxBrakes = C2xGetTokenInt(packetHandle, "BasicSafetyMessageVerbose", newPath);
  result = CheckLastError("BasicSafetyMessageVerbose", gkFuncRefGet, result);

  return result;
}

int SetBasicSafetyMessageVerbose_Blob_BrakeSystemStatusParams(LONG packetHandle, struct BasicSafetyMessageVerbose_Blob_BrakeSystemStatus value, char oldPath[])
{
  char newPath[300]; 
  int j;
  int result;

  result = 0;

  snprintf(newPath, elcount(newPath), "%s.%s", oldPath, "wheelBrakes");
    for(j=0; j<value.wheelBrakes.stringLength; j++)
    {
      if(value.wheelBrakes.string[j] == '0')
      {
        C2xSetTokenBitOfBitString(packetHandle, "BasicSafetyMessageVerbose", newPath, j, 0);
      }
      else
      {
        C2xSetTokenBitOfBitString(packetHandle, "BasicSafetyMessageVerbose", newPath, j, 1);
      }
      result = CheckLastError("BasicSafetyMessageVerbose", gkFuncRefGet, result);
    }

  snprintf(newPath, elcount(newPath), "%s.%s", oldPath, "brakesUnavailable");
  C2xSetTokenInt64(packetHandle, "BasicSafetyMessageVerbose", newPath, value.brakesUnavailable);
  result = CheckLastError("BasicSafetyMessageVerbose", gkFuncRefGet, result);

  snprintf(newPath, elcount(newPath), "%s.%s", oldPath, "spareBit");
  C2xSetTokenInt(packetHandle, "BasicSafetyMessageVerbose", newPath, value.spareBit);
  result = CheckLastError("BasicSafetyMessageVerbose", gkFuncRefGet, result);

  snprintf(newPath, elcount(newPath), "%s.%s", oldPath, "traction");
  C2xSetTokenInt(packetHandle, "BasicSafetyMessageVerbose", newPath, value.traction);
  result = CheckLastError("BasicSafetyMessageVerbose", gkFuncRefGet, result);

  snprintf(newPath, elcount(newPath), "%s.%s", oldPath, "antilockBrakingSystem");
  C2xSetTokenInt(packetHandle, "BasicSafetyMessageVerbose", newPath, value.antilockBrakingSystem);
  result = CheckLastError("BasicSafetyMessageVerbose", gkFuncRefGet, result);

  snprintf(newPath, elcount(newPath), "%s.%s", oldPath, "scs");
  C2xSetTokenInt(packetHandle, "BasicSafetyMessageVerbose", newPath, value.scs);
  result = CheckLastError("BasicSafetyMessageVerbose", gkFuncRefGet, result);

  snprintf(newPath, elcount(newPath), "%s.%s", oldPath, "brakeBoost");
  C2xSetTokenInt(packetHandle, "BasicSafetyMessageVerbose", newPath, value.brakeBoost);
  result = CheckLastError("BasicSafetyMessageVerbose", gkFuncRefGet, result);

  snprintf(newPath, elcount(newPath), "%s.%s", oldPath, "auxBrakes");
  C2xSetTokenInt(packetHandle, "BasicSafetyMessageVerbose", newPath, value.auxBrakes);
  result = CheckLastError("BasicSafetyMessageVerbose", gkFuncRefGet, result);

  return result;
}

int GetBasicSafetyMessageVerboseBrakeSystemStatusParams(LONG packetHandle, struct BasicSafetyMessageVerboseBrakeSystemStatus value, char oldPath[])
{
  char newPath[300];
  int result;

  result = 0;

  snprintf(newPath, elcount(newPath), "%s.%s", oldPath, "_Blob_BrakeSystemStatus");
  GetBasicSafetyMessageVerbose_Blob_BrakeSystemStatusParams(packetHandle, value._Blob_BrakeSystemStatus, newPath);
  result = CheckLastError("BasicSafetyMessageVerbose", gkFuncRefGet, result);

  return result;
}

int SetBasicSafetyMessageVerboseBrakeSystemStatusParams(LONG packetHandle, struct BasicSafetyMessageVerboseBrakeSystemStatus value, char oldPath[])
{
  char newPath[300];
  int result;

  result = 0;

  snprintf(newPath, elcount(newPath), "%s.%s", oldPath, "_Blob_BrakeSystemStatus");
  SetBasicSafetyMessageVerbose_Blob_BrakeSystemStatusParams(packetHandle, value._Blob_BrakeSystemStatus, newPath);
  result = CheckLastError("BasicSafetyMessageVerbose", gkFuncRefGet, result);

  return result;
}

int GetBasicSafetyMessageVerboseVehicleSizeParams(LONG packetHandle, struct BasicSafetyMessageVerboseVehicleSize value, char oldPath[])
{
  char newPath[300];
  int result;

  result = 0;

  snprintf(newPath, elcount(newPath), "%s.%s", oldPath, "width");
  value.width = C2xGetTokenInt(packetHandle, "BasicSafetyMessageVerbose", newPath);
  result = CheckLastError("BasicSafetyMessageVerbose", gkFuncRefGet, result);

  snprintf(newPath, elcount(newPath), "%s.%s", oldPath, "length");
  value.length = C2xGetTokenInt(packetHandle, "BasicSafetyMessageVerbose", newPath);
  result = CheckLastError("BasicSafetyMessageVerbose", gkFuncRefGet, result);

  return result;
}

int SetBasicSafetyMessageVerboseVehicleSizeParams(LONG packetHandle, struct BasicSafetyMessageVerboseVehicleSize value, char oldPath[])
{
  char newPath[300];
  int result;

  result = 0;

  snprintf(newPath, elcount(newPath), "%s.%s", oldPath, "width");
  C2xSetTokenInt(packetHandle, "BasicSafetyMessageVerbose", newPath, value.width);
  result = CheckLastError("BasicSafetyMessageVerbose", gkFuncRefGet, result);

  snprintf(newPath, elcount(newPath), "%s.%s", oldPath, "length");
  C2xSetTokenInt(packetHandle, "BasicSafetyMessageVerbose", newPath, value.length);
  result = CheckLastError("BasicSafetyMessageVerbose", gkFuncRefGet, result);

  return result;
}

int GetBasicSafetyMessageVerboseDDateTimeParams(LONG packetHandle, struct BasicSafetyMessageVerboseDDateTime value, char oldPath[])
{
  char newPath[300];
  int result;

  result = 0;

  snprintf(newPath, elcount(newPath), "%s.%s", oldPath, "year");
  value.year.isValidFlag = C2xIsTokenAvailable(packetHandle, "BasicSafetyMessageVerbose", newPath);
  if(value.year.isValidFlag==1)
  {
    value.year.value = C2xGetTokenInt(packetHandle, "BasicSafetyMessageVerbose", newPath);
    result = CheckLastError("BasicSafetyMessageVerbose", gkFuncRefGet, result);
  }
  snprintf(newPath, elcount(newPath), "%s.%s", oldPath, "month");
  value.month.isValidFlag = C2xIsTokenAvailable(packetHandle, "BasicSafetyMessageVerbose", newPath);
  if(value.month.isValidFlag==1)
  {
    value.month.value = C2xGetTokenInt(packetHandle, "BasicSafetyMessageVerbose", newPath);
    result = CheckLastError("BasicSafetyMessageVerbose", gkFuncRefGet, result);
  }
  snprintf(newPath, elcount(newPath), "%s.%s", oldPath, "day");
  value.day.isValidFlag = C2xIsTokenAvailable(packetHandle, "BasicSafetyMessageVerbose", newPath);
  if(value.day.isValidFlag==1)
  {
    value.day.value = C2xGetTokenInt(packetHandle, "BasicSafetyMessageVerbose", newPath);
    result = CheckLastError("BasicSafetyMessageVerbose", gkFuncRefGet, result);
  }
  snprintf(newPath, elcount(newPath), "%s.%s", oldPath, "hour");
  value.hour.isValidFlag = C2xIsTokenAvailable(packetHandle, "BasicSafetyMessageVerbose", newPath);
  if(value.hour.isValidFlag==1)
  {
    value.hour.value = C2xGetTokenInt(packetHandle, "BasicSafetyMessageVerbose", newPath);
    result = CheckLastError("BasicSafetyMessageVerbose", gkFuncRefGet, result);
  }
  snprintf(newPath, elcount(newPath), "%s.%s", oldPath, "minute");
  value.minute.isValidFlag = C2xIsTokenAvailable(packetHandle, "BasicSafetyMessageVerbose", newPath);
  if(value.minute.isValidFlag==1)
  {
    value.minute.value = C2xGetTokenInt(packetHandle, "BasicSafetyMessageVerbose", newPath);
    result = CheckLastError("BasicSafetyMessageVerbose", gkFuncRefGet, result);
  }
  snprintf(newPath, elcount(newPath), "%s.%s", oldPath, "second");
  value.second.isValidFlag = C2xIsTokenAvailable(packetHandle, "BasicSafetyMessageVerbose", newPath);
  if(value.second.isValidFlag==1)
  {
    value.second.value = C2xGetTokenInt(packetHandle, "BasicSafetyMessageVerbose", newPath);
    result = CheckLastError("BasicSafetyMessageVerbose", gkFuncRefGet, result);
  }
  return result;
}

int SetBasicSafetyMessageVerboseDDateTimeParams(LONG packetHandle, struct BasicSafetyMessageVerboseDDateTime value, char oldPath[])
{
  char newPath[300];
  int result;

  result = 0;

  snprintf(newPath, elcount(newPath), "%s.%s", oldPath, "year");
  if(value.year.isValidFlag==1)
  {
    C2xSetTokenInt(packetHandle, "BasicSafetyMessageVerbose", newPath, value.year.value);
    result = CheckLastError("BasicSafetyMessageVerbose", gkFuncRefGet, result);
  }
  else
  {
    if( C2xIsTokenAvailable(packetHandle, "BasicSafetyMessageVerbose", newPath) )
    {
      C2xRemoveToken(packetHandle, "BasicSafetyMessageVerbose", newPath);
    }
  }

  snprintf(newPath, elcount(newPath), "%s.%s", oldPath, "month");
  if(value.month.isValidFlag==1)
  {
    C2xSetTokenInt(packetHandle, "BasicSafetyMessageVerbose", newPath, value.month.value);
    result = CheckLastError("BasicSafetyMessageVerbose", gkFuncRefGet, result);
  }
  else
  {
    if( C2xIsTokenAvailable(packetHandle, "BasicSafetyMessageVerbose", newPath) )
    {
      C2xRemoveToken(packetHandle, "BasicSafetyMessageVerbose", newPath);
    }
  }

  snprintf(newPath, elcount(newPath), "%s.%s", oldPath, "day");
  if(value.day.isValidFlag==1)
  {
    C2xSetTokenInt(packetHandle, "BasicSafetyMessageVerbose", newPath, value.day.value);
    result = CheckLastError("BasicSafetyMessageVerbose", gkFuncRefGet, result);
  }
  else
  {
    if( C2xIsTokenAvailable(packetHandle, "BasicSafetyMessageVerbose", newPath) )
    {
      C2xRemoveToken(packetHandle, "BasicSafetyMessageVerbose", newPath);
    }
  }

  snprintf(newPath, elcount(newPath), "%s.%s", oldPath, "hour");
  if(value.hour.isValidFlag==1)
  {
    C2xSetTokenInt(packetHandle, "BasicSafetyMessageVerbose", newPath, value.hour.value);
    result = CheckLastError("BasicSafetyMessageVerbose", gkFuncRefGet, result);
  }
  else
  {
    if( C2xIsTokenAvailable(packetHandle, "BasicSafetyMessageVerbose", newPath) )
    {
      C2xRemoveToken(packetHandle, "BasicSafetyMessageVerbose", newPath);
    }
  }

  snprintf(newPath, elcount(newPath), "%s.%s", oldPath, "minute");
  if(value.minute.isValidFlag==1)
  {
    C2xSetTokenInt(packetHandle, "BasicSafetyMessageVerbose", newPath, value.minute.value);
    result = CheckLastError("BasicSafetyMessageVerbose", gkFuncRefGet, result);
  }
  else
  {
    if( C2xIsTokenAvailable(packetHandle, "BasicSafetyMessageVerbose", newPath) )
    {
      C2xRemoveToken(packetHandle, "BasicSafetyMessageVerbose", newPath);
    }
  }

  snprintf(newPath, elcount(newPath), "%s.%s", oldPath, "second");
  if(value.second.isValidFlag==1)
  {
    C2xSetTokenInt(packetHandle, "BasicSafetyMessageVerbose", newPath, value.second.value);
    result = CheckLastError("BasicSafetyMessageVerbose", gkFuncRefGet, result);
  }
  else
  {
    if( C2xIsTokenAvailable(packetHandle, "BasicSafetyMessageVerbose", newPath) )
    {
      C2xRemoveToken(packetHandle, "BasicSafetyMessageVerbose", newPath);
    }
  }

  return result;
}

int GetBasicSafetyMessageVerbose_Blob_PositionConfidenceSetParams(LONG packetHandle, struct BasicSafetyMessageVerbose_Blob_PositionConfidenceSet value, char oldPath[])
{
  char newPath[300];
  int result;

  result = 0;

  snprintf(newPath, elcount(newPath), "%s.%s", oldPath, "positionConfidence");
  value.positionConfidence = C2xGetTokenInt(packetHandle, "BasicSafetyMessageVerbose", newPath);
  result = CheckLastError("BasicSafetyMessageVerbose", gkFuncRefGet, result);

  snprintf(newPath, elcount(newPath), "%s.%s", oldPath, "elevationConfidence");
  value.elevationConfidence = C2xGetTokenInt(packetHandle, "BasicSafetyMessageVerbose", newPath);
  result = CheckLastError("BasicSafetyMessageVerbose", gkFuncRefGet, result);

  return result;
}

int SetBasicSafetyMessageVerbose_Blob_PositionConfidenceSetParams(LONG packetHandle, struct BasicSafetyMessageVerbose_Blob_PositionConfidenceSet value, char oldPath[])
{
  char newPath[300];
  int result;

  result = 0;

  snprintf(newPath, elcount(newPath), "%s.%s", oldPath, "positionConfidence");
  C2xSetTokenInt(packetHandle, "BasicSafetyMessageVerbose", newPath, value.positionConfidence);
  result = CheckLastError("BasicSafetyMessageVerbose", gkFuncRefGet, result);

  snprintf(newPath, elcount(newPath), "%s.%s", oldPath, "elevationConfidence");
  C2xSetTokenInt(packetHandle, "BasicSafetyMessageVerbose", newPath, value.elevationConfidence);
  result = CheckLastError("BasicSafetyMessageVerbose", gkFuncRefGet, result);

  return result;
}

int GetBasicSafetyMessageVerbosePositionConfidenceSetParams(LONG packetHandle, struct BasicSafetyMessageVerbosePositionConfidenceSet value, char oldPath[])
{
  char newPath[300];
  int result;

  result = 0;

  snprintf(newPath, elcount(newPath), "%s.%s", oldPath, "_Blob_PositionConfidenceSet");
  GetBasicSafetyMessageVerbose_Blob_PositionConfidenceSetParams(packetHandle, value._Blob_PositionConfidenceSet, newPath);
  result = CheckLastError("BasicSafetyMessageVerbose", gkFuncRefGet, result);

  return result;
}

int SetBasicSafetyMessageVerbosePositionConfidenceSetParams(LONG packetHandle, struct BasicSafetyMessageVerbosePositionConfidenceSet value, char oldPath[])
{
  char newPath[300];
  int result;

  result = 0;

  snprintf(newPath, elcount(newPath), "%s.%s", oldPath, "_Blob_PositionConfidenceSet");
  SetBasicSafetyMessageVerbose_Blob_PositionConfidenceSetParams(packetHandle, value._Blob_PositionConfidenceSet, newPath);
  result = CheckLastError("BasicSafetyMessageVerbose", gkFuncRefGet, result);

  return result;
}

int GetBasicSafetyMessageVerbose_Blob_SpeedandHeadingandThrottleConfidenceParams(LONG packetHandle, struct BasicSafetyMessageVerbose_Blob_SpeedandHeadingandThrottleConfidence value, char oldPath[])
{
  char newPath[300];
  int result;

  result = 0;

  snprintf(newPath, elcount(newPath), "%s.%s", oldPath, "headingConfidence");
  value.headingConfidence = C2xGetTokenInt(packetHandle, "BasicSafetyMessageVerbose", newPath);
  result = CheckLastError("BasicSafetyMessageVerbose", gkFuncRefGet, result);

  snprintf(newPath, elcount(newPath), "%s.%s", oldPath, "speedConfidence");
  value.speedConfidence = C2xGetTokenInt(packetHandle, "BasicSafetyMessageVerbose", newPath);
  result = CheckLastError("BasicSafetyMessageVerbose", gkFuncRefGet, result);

  snprintf(newPath, elcount(newPath), "%s.%s", oldPath, "throttleConfidence");
  value.throttleConfidence = C2xGetTokenInt(packetHandle, "BasicSafetyMessageVerbose", newPath);
  result = CheckLastError("BasicSafetyMessageVerbose", gkFuncRefGet, result);

  return result;
}

int SetBasicSafetyMessageVerbose_Blob_SpeedandHeadingandThrottleConfidenceParams(LONG packetHandle, struct BasicSafetyMessageVerbose_Blob_SpeedandHeadingandThrottleConfidence value, char oldPath[])
{
  char newPath[300];
  int result;

  result = 0;

  snprintf(newPath, elcount(newPath), "%s.%s", oldPath, "headingConfidence");
  C2xSetTokenInt(packetHandle, "BasicSafetyMessageVerbose", newPath, value.headingConfidence);
  result = CheckLastError("BasicSafetyMessageVerbose", gkFuncRefGet, result);

  snprintf(newPath, elcount(newPath), "%s.%s", oldPath, "speedConfidence");
  C2xSetTokenInt(packetHandle, "BasicSafetyMessageVerbose", newPath, value.speedConfidence);
  result = CheckLastError("BasicSafetyMessageVerbose", gkFuncRefGet, result);

  snprintf(newPath, elcount(newPath), "%s.%s", oldPath, "throttleConfidence");
  C2xSetTokenInt(packetHandle, "BasicSafetyMessageVerbose", newPath, value.throttleConfidence);
  result = CheckLastError("BasicSafetyMessageVerbose", gkFuncRefGet, result);

  return result;
}

int GetBasicSafetyMessageVerboseSpeedandHeadingandThrottleConfidenceParams(LONG packetHandle, struct BasicSafetyMessageVerboseSpeedandHeadingandThrottleConfidence value, char oldPath[])
{
  char newPath[300];
  int result;

  result = 0;

  snprintf(newPath, elcount(newPath), "%s.%s", oldPath, "_Blob_SpeedandHeadingandThrottleConfidence");
  GetBasicSafetyMessageVerbose_Blob_SpeedandHeadingandThrottleConfidenceParams(packetHandle, value._Blob_SpeedandHeadingandThrottleConfidence, newPath);
  result = CheckLastError("BasicSafetyMessageVerbose", gkFuncRefGet, result);

  return result;
}

int SetBasicSafetyMessageVerboseSpeedandHeadingandThrottleConfidenceParams(LONG packetHandle, struct BasicSafetyMessageVerboseSpeedandHeadingandThrottleConfidence value, char oldPath[])
{
  char newPath[300];
  int result;

  result = 0;

  snprintf(newPath, elcount(newPath), "%s.%s", oldPath, "_Blob_SpeedandHeadingandThrottleConfidence");
  SetBasicSafetyMessageVerbose_Blob_SpeedandHeadingandThrottleConfidenceParams(packetHandle, value._Blob_SpeedandHeadingandThrottleConfidence, newPath);
  result = CheckLastError("BasicSafetyMessageVerbose", gkFuncRefGet, result);

  return result;
}

int GetBasicSafetyMessageVerboseFullPositionVectorParams(LONG packetHandle, struct BasicSafetyMessageVerboseFullPositionVector value, char oldPath[])
{
  char newPath[300];
  int result;

  result = 0;

  snprintf(newPath, elcount(newPath), "%s.%s", oldPath, "utcTime");
  value.utcTime.isValidFlag = C2xIsTokenAvailable(packetHandle, "BasicSafetyMessageVerbose", newPath);
  if(value.utcTime.isValidFlag==1)
  {
    GetBasicSafetyMessageVerboseDDateTimeParams(packetHandle, value.utcTime, newPath);
    result = CheckLastError("BasicSafetyMessageVerbose", gkFuncRefGet, result);
  }
  snprintf(newPath, elcount(newPath), "%s.%s", oldPath, "lon");
  value.lon = C2xGetTokenInt(packetHandle, "BasicSafetyMessageVerbose", newPath);
  result = CheckLastError("BasicSafetyMessageVerbose", gkFuncRefGet, result);

  snprintf(newPath, elcount(newPath), "%s.%s", oldPath, "lat");
  value.lat = C2xGetTokenInt(packetHandle, "BasicSafetyMessageVerbose", newPath);
  result = CheckLastError("BasicSafetyMessageVerbose", gkFuncRefGet, result);

  snprintf(newPath, elcount(newPath), "%s.%s", oldPath, "elevation");
  value.elevation.isValidFlag = C2xIsTokenAvailable(packetHandle, "BasicSafetyMessageVerbose", newPath);
  if(value.elevation.isValidFlag==1)
  {
    value.elevation.isValidFlag = 1;
    value.elevation.stringLength = C2xGetTokenData(packetHandle, "BasicSafetyMessageVerbose", newPath, elcount(value.elevation.string), value.elevation.string);
  }
  snprintf(newPath, elcount(newPath), "%s.%s", oldPath, "heading");
  value.heading.isValidFlag = C2xIsTokenAvailable(packetHandle, "BasicSafetyMessageVerbose", newPath);
  if(value.heading.isValidFlag==1)
  {
    value.heading.value = C2xGetTokenInt(packetHandle, "BasicSafetyMessageVerbose", newPath);
    result = CheckLastError("BasicSafetyMessageVerbose", gkFuncRefGet, result);
  }
  snprintf(newPath, elcount(newPath), "%s.%s", oldPath, "speed");
  value.speed.isValidFlag = C2xIsTokenAvailable(packetHandle, "BasicSafetyMessageVerbose", newPath);
  if(value.speed.isValidFlag==1)
  {
    value.speed.isValidFlag = 1;
    value.speed.stringLength = C2xGetTokenData(packetHandle, "BasicSafetyMessageVerbose", newPath, elcount(value.speed.string), value.speed.string);
  }
  snprintf(newPath, elcount(newPath), "%s.%s", oldPath, "posAccuracy");
  value.posAccuracy.isValidFlag = C2xIsTokenAvailable(packetHandle, "BasicSafetyMessageVerbose", newPath);
  if(value.posAccuracy.isValidFlag==1)
  {
    value.posAccuracy.isValidFlag = 1;
    value.posAccuracy.stringLength = C2xGetTokenData(packetHandle, "BasicSafetyMessageVerbose", newPath, elcount(value.posAccuracy.string), value.posAccuracy.string);
  }
  snprintf(newPath, elcount(newPath), "%s.%s", oldPath, "timeConfidence");
  value.timeConfidence.isValidFlag = C2xIsTokenAvailable(packetHandle, "BasicSafetyMessageVerbose", newPath);
  if(value.timeConfidence.isValidFlag==1)
  {
    value.timeConfidence.value = C2xGetTokenInt(packetHandle, "BasicSafetyMessageVerbose", newPath);
    result = CheckLastError("BasicSafetyMessageVerbose", gkFuncRefGet, result);
  }
  snprintf(newPath, elcount(newPath), "%s.%s", oldPath, "posConfidence");
  value.posConfidence.isValidFlag = C2xIsTokenAvailable(packetHandle, "BasicSafetyMessageVerbose", newPath);
  if(value.posConfidence.isValidFlag==1)
  {
    value.posConfidence.isValidFlag = 1;
    value.posConfidence.stringLength = C2xGetTokenData(packetHandle, "BasicSafetyMessageVerbose", newPath, elcount(value.posConfidence.string), value.posConfidence.string);
  }
  snprintf(newPath, elcount(newPath), "%s.%s", oldPath, "speedConfidence");
  value.speedConfidence.isValidFlag = C2xIsTokenAvailable(packetHandle, "BasicSafetyMessageVerbose", newPath);
  if(value.speedConfidence.isValidFlag==1)
  {
    value.speedConfidence.isValidFlag = 1;
    value.speedConfidence.stringLength = C2xGetTokenData(packetHandle, "BasicSafetyMessageVerbose", newPath, elcount(value.speedConfidence.string), value.speedConfidence.string);
  }
  return result;
}

int SetBasicSafetyMessageVerboseFullPositionVectorParams(LONG packetHandle, struct BasicSafetyMessageVerboseFullPositionVector value, char oldPath[])
{
  char newPath[300];
  int result;

  result = 0;

  snprintf(newPath, elcount(newPath), "%s.%s", oldPath, "utcTime");
  if(value.utcTime.isValidFlag==1)
  {
    SetBasicSafetyMessageVerboseDDateTimeParams(packetHandle, value.utcTime, newPath);
    result = CheckLastError("BasicSafetyMessageVerbose", gkFuncRefGet, result);
  }
  else
  {
    if( C2xIsTokenAvailable(packetHandle, "BasicSafetyMessageVerbose", newPath) )
    {
      C2xRemoveToken(packetHandle, "BasicSafetyMessageVerbose", newPath);
    }
  }

  snprintf(newPath, elcount(newPath), "%s.%s", oldPath, "lon");
  C2xSetTokenInt(packetHandle, "BasicSafetyMessageVerbose", newPath, value.lon);
  result = CheckLastError("BasicSafetyMessageVerbose", gkFuncRefGet, result);

  snprintf(newPath, elcount(newPath), "%s.%s", oldPath, "lat");
  C2xSetTokenInt(packetHandle, "BasicSafetyMessageVerbose", newPath, value.lat);
  result = CheckLastError("BasicSafetyMessageVerbose", gkFuncRefGet, result);

  snprintf(newPath, elcount(newPath), "%s.%s", oldPath, "elevation");
  if(value.elevation.isValidFlag==1)
  {
    C2xSetTokenData(packetHandle, "BasicSafetyMessageVerbose", newPath, value.elevation.stringLength, value.elevation.string);
  }
  else
  {
    if( C2xIsTokenAvailable(packetHandle, "BasicSafetyMessageVerbose", newPath) )
    {
      C2xRemoveToken(packetHandle, "BasicSafetyMessageVerbose", newPath);
    }
  }

  snprintf(newPath, elcount(newPath), "%s.%s", oldPath, "heading");
  if(value.heading.isValidFlag==1)
  {
    C2xSetTokenInt(packetHandle, "BasicSafetyMessageVerbose", newPath, value.heading.value);
    result = CheckLastError("BasicSafetyMessageVerbose", gkFuncRefGet, result);
  }
  else
  {
    if( C2xIsTokenAvailable(packetHandle, "BasicSafetyMessageVerbose", newPath) )
    {
      C2xRemoveToken(packetHandle, "BasicSafetyMessageVerbose", newPath);
    }
  }

  snprintf(newPath, elcount(newPath), "%s.%s", oldPath, "speed");
  if(value.speed.isValidFlag==1)
  {
    C2xSetTokenData(packetHandle, "BasicSafetyMessageVerbose", newPath, value.speed.stringLength, value.speed.string);
  }
  else
  {
    if( C2xIsTokenAvailable(packetHandle, "BasicSafetyMessageVerbose", newPath) )
    {
      C2xRemoveToken(packetHandle, "BasicSafetyMessageVerbose", newPath);
    }
  }

  snprintf(newPath, elcount(newPath), "%s.%s", oldPath, "posAccuracy");
  if(value.posAccuracy.isValidFlag==1)
  {
    C2xSetTokenData(packetHandle, "BasicSafetyMessageVerbose", newPath, value.posAccuracy.stringLength, value.posAccuracy.string);
  }
  else
  {
    if( C2xIsTokenAvailable(packetHandle, "BasicSafetyMessageVerbose", newPath) )
    {
      C2xRemoveToken(packetHandle, "BasicSafetyMessageVerbose", newPath);
    }
  }

  snprintf(newPath, elcount(newPath), "%s.%s", oldPath, "timeConfidence");
  if(value.timeConfidence.isValidFlag==1)
  {
    C2xSetTokenInt(packetHandle, "BasicSafetyMessageVerbose", newPath, value.timeConfidence.value);
    result = CheckLastError("BasicSafetyMessageVerbose", gkFuncRefGet, result);
  }
  else
  {
    if( C2xIsTokenAvailable(packetHandle, "BasicSafetyMessageVerbose", newPath) )
    {
      C2xRemoveToken(packetHandle, "BasicSafetyMessageVerbose", newPath);
    }
  }

  snprintf(newPath, elcount(newPath), "%s.%s", oldPath, "posConfidence");
  if(value.posConfidence.isValidFlag==1)
  {
    C2xSetTokenData(packetHandle, "BasicSafetyMessageVerbose", newPath, value.posConfidence.stringLength, value.posConfidence.string);
  }
  else
  {
    if( C2xIsTokenAvailable(packetHandle, "BasicSafetyMessageVerbose", newPath) )
    {
      C2xRemoveToken(packetHandle, "BasicSafetyMessageVerbose", newPath);
    }
  }

  snprintf(newPath, elcount(newPath), "%s.%s", oldPath, "speedConfidence");
  if(value.speedConfidence.isValidFlag==1)
  {
    C2xSetTokenData(packetHandle, "BasicSafetyMessageVerbose", newPath, value.speedConfidence.stringLength, value.speedConfidence.string);
  }
  else
  {
    if( C2xIsTokenAvailable(packetHandle, "BasicSafetyMessageVerbose", newPath) )
    {
      C2xRemoveToken(packetHandle, "BasicSafetyMessageVerbose", newPath);
    }
  }

  return result;
}

int GetBasicSafetyMessageVerbosePathHistoryPointType_01Params(LONG packetHandle, struct BasicSafetyMessageVerbosePathHistoryPointType_01 value, char oldPath[])
{
  char newPath[300];
  int result;

  result = 0;

  snprintf(newPath, elcount(newPath), "%s.%s", oldPath, "latOffset");
  value.latOffset = C2xGetTokenInt(packetHandle, "BasicSafetyMessageVerbose", newPath);
  result = CheckLastError("BasicSafetyMessageVerbose", gkFuncRefGet, result);

  snprintf(newPath, elcount(newPath), "%s.%s", oldPath, "longOffset");
  value.longOffset = C2xGetTokenInt(packetHandle, "BasicSafetyMessageVerbose", newPath);
  result = CheckLastError("BasicSafetyMessageVerbose", gkFuncRefGet, result);

  snprintf(newPath, elcount(newPath), "%s.%s", oldPath, "elevationOffset");
  value.elevationOffset.isValidFlag = C2xIsTokenAvailable(packetHandle, "BasicSafetyMessageVerbose", newPath);
  if(value.elevationOffset.isValidFlag==1)
  {
    value.elevationOffset.value = C2xGetTokenInt(packetHandle, "BasicSafetyMessageVerbose", newPath);
    result = CheckLastError("BasicSafetyMessageVerbose", gkFuncRefGet, result);
  }
  snprintf(newPath, elcount(newPath), "%s.%s", oldPath, "timeOffset");
  value.timeOffset.isValidFlag = C2xIsTokenAvailable(packetHandle, "BasicSafetyMessageVerbose", newPath);
  if(value.timeOffset.isValidFlag==1)
  {
    value.timeOffset.value = C2xGetTokenInt(packetHandle, "BasicSafetyMessageVerbose", newPath);
    result = CheckLastError("BasicSafetyMessageVerbose", gkFuncRefGet, result);
  }
  snprintf(newPath, elcount(newPath), "%s.%s", oldPath, "posAccuracy");
  value.posAccuracy.isValidFlag = C2xIsTokenAvailable(packetHandle, "BasicSafetyMessageVerbose", newPath);
  if(value.posAccuracy.isValidFlag==1)
  {
    value.posAccuracy.isValidFlag = 1;
    value.posAccuracy.stringLength = C2xGetTokenData(packetHandle, "BasicSafetyMessageVerbose", newPath, elcount(value.posAccuracy.string), value.posAccuracy.string);
  }
  snprintf(newPath, elcount(newPath), "%s.%s", oldPath, "heading");
  value.heading.isValidFlag = C2xIsTokenAvailable(packetHandle, "BasicSafetyMessageVerbose", newPath);
  if(value.heading.isValidFlag==1)
  {
    value.heading.value = C2xGetTokenInt(packetHandle, "BasicSafetyMessageVerbose", newPath);
    result = CheckLastError("BasicSafetyMessageVerbose", gkFuncRefGet, result);
  }
  snprintf(newPath, elcount(newPath), "%s.%s", oldPath, "speed");
  value.speed.isValidFlag = C2xIsTokenAvailable(packetHandle, "BasicSafetyMessageVerbose", newPath);
  if(value.speed.isValidFlag==1)
  {
    value.speed.isValidFlag = 1;
    value.speed.stringLength = C2xGetTokenData(packetHandle, "BasicSafetyMessageVerbose", newPath, elcount(value.speed.string), value.speed.string);
  }
  return result;
}

int SetBasicSafetyMessageVerbosePathHistoryPointType_01Params(LONG packetHandle, struct BasicSafetyMessageVerbosePathHistoryPointType_01 value, char oldPath[])
{
  char newPath[300];
  int result;

  result = 0;

  snprintf(newPath, elcount(newPath), "%s.%s", oldPath, "latOffset");
  C2xSetTokenInt(packetHandle, "BasicSafetyMessageVerbose", newPath, value.latOffset);
  result = CheckLastError("BasicSafetyMessageVerbose", gkFuncRefGet, result);

  snprintf(newPath, elcount(newPath), "%s.%s", oldPath, "longOffset");
  C2xSetTokenInt(packetHandle, "BasicSafetyMessageVerbose", newPath, value.longOffset);
  result = CheckLastError("BasicSafetyMessageVerbose", gkFuncRefGet, result);

  snprintf(newPath, elcount(newPath), "%s.%s", oldPath, "elevationOffset");
  if(value.elevationOffset.isValidFlag==1)
  {
    C2xSetTokenInt(packetHandle, "BasicSafetyMessageVerbose", newPath, value.elevationOffset.value);
    result = CheckLastError("BasicSafetyMessageVerbose", gkFuncRefGet, result);
  }
  else
  {
    if( C2xIsTokenAvailable(packetHandle, "BasicSafetyMessageVerbose", newPath) )
    {
      C2xRemoveToken(packetHandle, "BasicSafetyMessageVerbose", newPath);
    }
  }

  snprintf(newPath, elcount(newPath), "%s.%s", oldPath, "timeOffset");
  if(value.timeOffset.isValidFlag==1)
  {
    C2xSetTokenInt(packetHandle, "BasicSafetyMessageVerbose", newPath, value.timeOffset.value);
    result = CheckLastError("BasicSafetyMessageVerbose", gkFuncRefGet, result);
  }
  else
  {
    if( C2xIsTokenAvailable(packetHandle, "BasicSafetyMessageVerbose", newPath) )
    {
      C2xRemoveToken(packetHandle, "BasicSafetyMessageVerbose", newPath);
    }
  }

  snprintf(newPath, elcount(newPath), "%s.%s", oldPath, "posAccuracy");
  if(value.posAccuracy.isValidFlag==1)
  {
    C2xSetTokenData(packetHandle, "BasicSafetyMessageVerbose", newPath, value.posAccuracy.stringLength, value.posAccuracy.string);
  }
  else
  {
    if( C2xIsTokenAvailable(packetHandle, "BasicSafetyMessageVerbose", newPath) )
    {
      C2xRemoveToken(packetHandle, "BasicSafetyMessageVerbose", newPath);
    }
  }

  snprintf(newPath, elcount(newPath), "%s.%s", oldPath, "heading");
  if(value.heading.isValidFlag==1)
  {
    C2xSetTokenInt(packetHandle, "BasicSafetyMessageVerbose", newPath, value.heading.value);
    result = CheckLastError("BasicSafetyMessageVerbose", gkFuncRefGet, result);
  }
  else
  {
    if( C2xIsTokenAvailable(packetHandle, "BasicSafetyMessageVerbose", newPath) )
    {
      C2xRemoveToken(packetHandle, "BasicSafetyMessageVerbose", newPath);
    }
  }

  snprintf(newPath, elcount(newPath), "%s.%s", oldPath, "speed");
  if(value.speed.isValidFlag==1)
  {
    C2xSetTokenData(packetHandle, "BasicSafetyMessageVerbose", newPath, value.speed.stringLength, value.speed.string);
  }
  else
  {
    if( C2xIsTokenAvailable(packetHandle, "BasicSafetyMessageVerbose", newPath) )
    {
      C2xRemoveToken(packetHandle, "BasicSafetyMessageVerbose", newPath);
    }
  }

  return result;
}

int GetBasicSafetyMessageVerbose_PathHistory_crumbData_pathHistoryPointSets_01Params(LONG packetHandle, struct BasicSafetyMessageVerbose_PathHistory_crumbData_pathHistoryPointSets_01 value, char oldPath[])
{
  char newPath[300]; 
  int i;
  int result;

  result = 0;

  value.length = C2xGetTokenInt(packetHandle, "BasicSafetyMessageVerbose", oldPath);
  if((result = CheckLastError("BasicSafetyMessageVerbose", gkFuncRefGet, result))==0)
  {
    for(i=0; i<value.length; i++)
    {
      snprintf(newPath, elcount(newPath), "%s[%d]", oldPath, i);
      GetBasicSafetyMessageVerbosePathHistoryPointType_01Params(packetHandle, value.arrayValue[i], newPath);
      result = CheckLastError("BasicSafetyMessageVerbose", gkFuncRefGet, result);
    }
  }
  return result;
}

int SetBasicSafetyMessageVerbose_PathHistory_crumbData_pathHistoryPointSets_01Params(LONG packetHandle, struct BasicSafetyMessageVerbose_PathHistory_crumbData_pathHistoryPointSets_01 value, char oldPath[])
{
  char newPath[300]; 
  int i;
  int result;

  result = 0;

  C2xRemoveToken(packetHandle, "BasicSafetyMessageVerbose", oldPath);
  for(i=0; i<value.length; i++)
  {
    snprintf(newPath, elcount(newPath), "%s[%d]", oldPath, i);
    SetBasicSafetyMessageVerbosePathHistoryPointType_01Params(packetHandle, value.arrayValue[i], newPath);
    result = CheckLastError("BasicSafetyMessageVerbose", gkFuncRefGet, result);
  }
  return result;
}

int GetBasicSafetyMessageVerbose_Blob_PathHistoryPointType_02Params(LONG packetHandle, struct BasicSafetyMessageVerbose_Blob_PathHistoryPointType_02 value, char oldPath[])
{
  char newPath[300];
  int result;

  result = 0;

  snprintf(newPath, elcount(newPath), "%s.%s", oldPath, "latOffset");
  value.latOffset = C2xGetTokenInt(packetHandle, "BasicSafetyMessageVerbose", newPath);
  result = CheckLastError("BasicSafetyMessageVerbose", gkFuncRefGet, result);

  snprintf(newPath, elcount(newPath), "%s.%s", oldPath, "longOffset");
  value.longOffset = C2xGetTokenInt(packetHandle, "BasicSafetyMessageVerbose", newPath);
  result = CheckLastError("BasicSafetyMessageVerbose", gkFuncRefGet, result);

  snprintf(newPath, elcount(newPath), "%s.%s", oldPath, "elevationOffset");
  value.elevationOffset = C2xGetTokenInt(packetHandle, "BasicSafetyMessageVerbose", newPath);
  result = CheckLastError("BasicSafetyMessageVerbose", gkFuncRefGet, result);

  snprintf(newPath, elcount(newPath), "%s.%s", oldPath, "timeOffset");
  value.timeOffset = C2xGetTokenInt(packetHandle, "BasicSafetyMessageVerbose", newPath);
  result = CheckLastError("BasicSafetyMessageVerbose", gkFuncRefGet, result);

  snprintf(newPath, elcount(newPath), "%s.%s", oldPath, "accuracy");
  GetBasicSafetyMessageVerbose_Blob_PositionalAccuracyParams(packetHandle, value.accuracy, newPath);
  result = CheckLastError("BasicSafetyMessageVerbose", gkFuncRefGet, result);

  snprintf(newPath, elcount(newPath), "%s.%s", oldPath, "heading");
  value.heading = C2xGetTokenInt(packetHandle, "BasicSafetyMessageVerbose", newPath);
  result = CheckLastError("BasicSafetyMessageVerbose", gkFuncRefGet, result);

  snprintf(newPath, elcount(newPath), "%s.%s", oldPath, "speed");
  GetBasicSafetyMessageVerbose_Blob_TransmissionAndSpeedParams(packetHandle, value.speed, newPath);
  result = CheckLastError("BasicSafetyMessageVerbose", gkFuncRefGet, result);

  return result;
}

int SetBasicSafetyMessageVerbose_Blob_PathHistoryPointType_02Params(LONG packetHandle, struct BasicSafetyMessageVerbose_Blob_PathHistoryPointType_02 value, char oldPath[])
{
  char newPath[300];
  int result;

  result = 0;

  snprintf(newPath, elcount(newPath), "%s.%s", oldPath, "latOffset");
  C2xSetTokenInt(packetHandle, "BasicSafetyMessageVerbose", newPath, value.latOffset);
  result = CheckLastError("BasicSafetyMessageVerbose", gkFuncRefGet, result);

  snprintf(newPath, elcount(newPath), "%s.%s", oldPath, "longOffset");
  C2xSetTokenInt(packetHandle, "BasicSafetyMessageVerbose", newPath, value.longOffset);
  result = CheckLastError("BasicSafetyMessageVerbose", gkFuncRefGet, result);

  snprintf(newPath, elcount(newPath), "%s.%s", oldPath, "elevationOffset");
  C2xSetTokenInt(packetHandle, "BasicSafetyMessageVerbose", newPath, value.elevationOffset);
  result = CheckLastError("BasicSafetyMessageVerbose", gkFuncRefGet, result);

  snprintf(newPath, elcount(newPath), "%s.%s", oldPath, "timeOffset");
  C2xSetTokenInt(packetHandle, "BasicSafetyMessageVerbose", newPath, value.timeOffset);
  result = CheckLastError("BasicSafetyMessageVerbose", gkFuncRefGet, result);

  snprintf(newPath, elcount(newPath), "%s.%s", oldPath, "accuracy");
  SetBasicSafetyMessageVerbose_Blob_PositionalAccuracyParams(packetHandle, value.accuracy, newPath);
  result = CheckLastError("BasicSafetyMessageVerbose", gkFuncRefGet, result);

  snprintf(newPath, elcount(newPath), "%s.%s", oldPath, "heading");
  C2xSetTokenInt(packetHandle, "BasicSafetyMessageVerbose", newPath, value.heading);
  result = CheckLastError("BasicSafetyMessageVerbose", gkFuncRefGet, result);

  snprintf(newPath, elcount(newPath), "%s.%s", oldPath, "speed");
  SetBasicSafetyMessageVerbose_Blob_TransmissionAndSpeedParams(packetHandle, value.speed, newPath);
  result = CheckLastError("BasicSafetyMessageVerbose", gkFuncRefGet, result);

  return result;
}

int GetBasicSafetyMessageVerbose_Blob_PathHistory_crumbData_pathHistoryPointSets_02Params(LONG packetHandle, struct BasicSafetyMessageVerbose_Blob_PathHistory_crumbData_pathHistoryPointSets_02 value, char oldPath[])
{
  char newPath[300]; 
  int i;
  int result;

  result = 0;

  value.length = C2xGetTokenInt(packetHandle, "BasicSafetyMessageVerbose", oldPath);
  if((result = CheckLastError("BasicSafetyMessageVerbose", gkFuncRefGet, result))==0)
  {
    for(i=0; i<value.length; i++)
    {
      snprintf(newPath, elcount(newPath), "%s[%d]", oldPath, i);
      GetBasicSafetyMessageVerbose_Blob_PathHistoryPointType_02Params(packetHandle, value.arrayValue[i], newPath);
      result = CheckLastError("BasicSafetyMessageVerbose", gkFuncRefGet, result);
    }
  }
  return result;
}

int SetBasicSafetyMessageVerbose_Blob_PathHistory_crumbData_pathHistoryPointSets_02Params(LONG packetHandle, struct BasicSafetyMessageVerbose_Blob_PathHistory_crumbData_pathHistoryPointSets_02 value, char oldPath[])
{
  char newPath[300]; 
  int i;
  int result;

  result = 0;

  C2xRemoveToken(packetHandle, "BasicSafetyMessageVerbose", oldPath);
  for(i=0; i<value.length; i++)
  {
    snprintf(newPath, elcount(newPath), "%s[%d]", oldPath, i);
    SetBasicSafetyMessageVerbose_Blob_PathHistoryPointType_02Params(packetHandle, value.arrayValue[i], newPath);
    result = CheckLastError("BasicSafetyMessageVerbose", gkFuncRefGet, result);
  }
  return result;
}

int GetBasicSafetyMessageVerbose_PathHistory_crumbData_pathHistoryPointSets_02Params(LONG packetHandle, struct BasicSafetyMessageVerbose_PathHistory_crumbData_pathHistoryPointSets_02 value, char oldPath[])
{
  char newPath[300];
  int result;

  result = 0;

  snprintf(newPath, elcount(newPath), "%s.%s", oldPath, "_Blob_PathHistory_crumbData_pathHistoryPointSets_02");
  GetBasicSafetyMessageVerbose_Blob_PathHistory_crumbData_pathHistoryPointSets_02Params(packetHandle, value._Blob_PathHistory_crumbData_pathHistoryPointSets_02, newPath);
  result = CheckLastError("BasicSafetyMessageVerbose", gkFuncRefGet, result);

  return result;
}

int SetBasicSafetyMessageVerbose_PathHistory_crumbData_pathHistoryPointSets_02Params(LONG packetHandle, struct BasicSafetyMessageVerbose_PathHistory_crumbData_pathHistoryPointSets_02 value, char oldPath[])
{
  char newPath[300];
  int result;

  result = 0;

  snprintf(newPath, elcount(newPath), "%s.%s", oldPath, "_Blob_PathHistory_crumbData_pathHistoryPointSets_02");
  SetBasicSafetyMessageVerbose_Blob_PathHistory_crumbData_pathHistoryPointSets_02Params(packetHandle, value._Blob_PathHistory_crumbData_pathHistoryPointSets_02, newPath);
  result = CheckLastError("BasicSafetyMessageVerbose", gkFuncRefGet, result);

  return result;
}

int GetBasicSafetyMessageVerbose_Blob_PathHistoryPointType_03Params(LONG packetHandle, struct BasicSafetyMessageVerbose_Blob_PathHistoryPointType_03 value, char oldPath[])
{
  char newPath[300];
  int result;

  result = 0;

  snprintf(newPath, elcount(newPath), "%s.%s", oldPath, "latOffset");
  value.latOffset = C2xGetTokenInt(packetHandle, "BasicSafetyMessageVerbose", newPath);
  result = CheckLastError("BasicSafetyMessageVerbose", gkFuncRefGet, result);

  snprintf(newPath, elcount(newPath), "%s.%s", oldPath, "longOffset");
  value.longOffset = C2xGetTokenInt(packetHandle, "BasicSafetyMessageVerbose", newPath);
  result = CheckLastError("BasicSafetyMessageVerbose", gkFuncRefGet, result);

  snprintf(newPath, elcount(newPath), "%s.%s", oldPath, "elevationOffset");
  value.elevationOffset = C2xGetTokenInt(packetHandle, "BasicSafetyMessageVerbose", newPath);
  result = CheckLastError("BasicSafetyMessageVerbose", gkFuncRefGet, result);

  snprintf(newPath, elcount(newPath), "%s.%s", oldPath, "timeOffset");
  value.timeOffset = C2xGetTokenInt(packetHandle, "BasicSafetyMessageVerbose", newPath);
  result = CheckLastError("BasicSafetyMessageVerbose", gkFuncRefGet, result);

  snprintf(newPath, elcount(newPath), "%s.%s", oldPath, "accuracy");
  GetBasicSafetyMessageVerbose_Blob_PositionalAccuracyParams(packetHandle, value.accuracy, newPath);
  result = CheckLastError("BasicSafetyMessageVerbose", gkFuncRefGet, result);

  return result;
}

int SetBasicSafetyMessageVerbose_Blob_PathHistoryPointType_03Params(LONG packetHandle, struct BasicSafetyMessageVerbose_Blob_PathHistoryPointType_03 value, char oldPath[])
{
  char newPath[300];
  int result;

  result = 0;

  snprintf(newPath, elcount(newPath), "%s.%s", oldPath, "latOffset");
  C2xSetTokenInt(packetHandle, "BasicSafetyMessageVerbose", newPath, value.latOffset);
  result = CheckLastError("BasicSafetyMessageVerbose", gkFuncRefGet, result);

  snprintf(newPath, elcount(newPath), "%s.%s", oldPath, "longOffset");
  C2xSetTokenInt(packetHandle, "BasicSafetyMessageVerbose", newPath, value.longOffset);
  result = CheckLastError("BasicSafetyMessageVerbose", gkFuncRefGet, result);

  snprintf(newPath, elcount(newPath), "%s.%s", oldPath, "elevationOffset");
  C2xSetTokenInt(packetHandle, "BasicSafetyMessageVerbose", newPath, value.elevationOffset);
  result = CheckLastError("BasicSafetyMessageVerbose", gkFuncRefGet, result);

  snprintf(newPath, elcount(newPath), "%s.%s", oldPath, "timeOffset");
  C2xSetTokenInt(packetHandle, "BasicSafetyMessageVerbose", newPath, value.timeOffset);
  result = CheckLastError("BasicSafetyMessageVerbose", gkFuncRefGet, result);

  snprintf(newPath, elcount(newPath), "%s.%s", oldPath, "accuracy");
  SetBasicSafetyMessageVerbose_Blob_PositionalAccuracyParams(packetHandle, value.accuracy, newPath);
  result = CheckLastError("BasicSafetyMessageVerbose", gkFuncRefGet, result);

  return result;
}

int GetBasicSafetyMessageVerbose_Blob_PathHistory_crumbData_pathHistoryPointSets_03Params(LONG packetHandle, struct BasicSafetyMessageVerbose_Blob_PathHistory_crumbData_pathHistoryPointSets_03 value, char oldPath[])
{
  char newPath[300]; 
  int i;
  int result;

  result = 0;

  value.length = C2xGetTokenInt(packetHandle, "BasicSafetyMessageVerbose", oldPath);
  if((result = CheckLastError("BasicSafetyMessageVerbose", gkFuncRefGet, result))==0)
  {
    for(i=0; i<value.length; i++)
    {
      snprintf(newPath, elcount(newPath), "%s[%d]", oldPath, i);
      GetBasicSafetyMessageVerbose_Blob_PathHistoryPointType_03Params(packetHandle, value.arrayValue[i], newPath);
      result = CheckLastError("BasicSafetyMessageVerbose", gkFuncRefGet, result);
    }
  }
  return result;
}

int SetBasicSafetyMessageVerbose_Blob_PathHistory_crumbData_pathHistoryPointSets_03Params(LONG packetHandle, struct BasicSafetyMessageVerbose_Blob_PathHistory_crumbData_pathHistoryPointSets_03 value, char oldPath[])
{
  char newPath[300]; 
  int i;
  int result;

  result = 0;

  C2xRemoveToken(packetHandle, "BasicSafetyMessageVerbose", oldPath);
  for(i=0; i<value.length; i++)
  {
    snprintf(newPath, elcount(newPath), "%s[%d]", oldPath, i);
    SetBasicSafetyMessageVerbose_Blob_PathHistoryPointType_03Params(packetHandle, value.arrayValue[i], newPath);
    result = CheckLastError("BasicSafetyMessageVerbose", gkFuncRefGet, result);
  }
  return result;
}

int GetBasicSafetyMessageVerbose_PathHistory_crumbData_pathHistoryPointSets_03Params(LONG packetHandle, struct BasicSafetyMessageVerbose_PathHistory_crumbData_pathHistoryPointSets_03 value, char oldPath[])
{
  char newPath[300];
  int result;

  result = 0;

  snprintf(newPath, elcount(newPath), "%s.%s", oldPath, "_Blob_PathHistory_crumbData_pathHistoryPointSets_03");
  GetBasicSafetyMessageVerbose_Blob_PathHistory_crumbData_pathHistoryPointSets_03Params(packetHandle, value._Blob_PathHistory_crumbData_pathHistoryPointSets_03, newPath);
  result = CheckLastError("BasicSafetyMessageVerbose", gkFuncRefGet, result);

  return result;
}

int SetBasicSafetyMessageVerbose_PathHistory_crumbData_pathHistoryPointSets_03Params(LONG packetHandle, struct BasicSafetyMessageVerbose_PathHistory_crumbData_pathHistoryPointSets_03 value, char oldPath[])
{
  char newPath[300];
  int result;

  result = 0;

  snprintf(newPath, elcount(newPath), "%s.%s", oldPath, "_Blob_PathHistory_crumbData_pathHistoryPointSets_03");
  SetBasicSafetyMessageVerbose_Blob_PathHistory_crumbData_pathHistoryPointSets_03Params(packetHandle, value._Blob_PathHistory_crumbData_pathHistoryPointSets_03, newPath);
  result = CheckLastError("BasicSafetyMessageVerbose", gkFuncRefGet, result);

  return result;
}

int GetBasicSafetyMessageVerbose_Blob_PathHistoryPointType_04Params(LONG packetHandle, struct BasicSafetyMessageVerbose_Blob_PathHistoryPointType_04 value, char oldPath[])
{
  char newPath[300];
  int result;

  result = 0;

  snprintf(newPath, elcount(newPath), "%s.%s", oldPath, "latOffset");
  value.latOffset = C2xGetTokenInt(packetHandle, "BasicSafetyMessageVerbose", newPath);
  result = CheckLastError("BasicSafetyMessageVerbose", gkFuncRefGet, result);

  snprintf(newPath, elcount(newPath), "%s.%s", oldPath, "longOffset");
  value.longOffset = C2xGetTokenInt(packetHandle, "BasicSafetyMessageVerbose", newPath);
  result = CheckLastError("BasicSafetyMessageVerbose", gkFuncRefGet, result);

  snprintf(newPath, elcount(newPath), "%s.%s", oldPath, "elevationOffset");
  value.elevationOffset = C2xGetTokenInt(packetHandle, "BasicSafetyMessageVerbose", newPath);
  result = CheckLastError("BasicSafetyMessageVerbose", gkFuncRefGet, result);

  snprintf(newPath, elcount(newPath), "%s.%s", oldPath, "timeOffset");
  value.timeOffset = C2xGetTokenInt(packetHandle, "BasicSafetyMessageVerbose", newPath);
  result = CheckLastError("BasicSafetyMessageVerbose", gkFuncRefGet, result);

  return result;
}

int SetBasicSafetyMessageVerbose_Blob_PathHistoryPointType_04Params(LONG packetHandle, struct BasicSafetyMessageVerbose_Blob_PathHistoryPointType_04 value, char oldPath[])
{
  char newPath[300];
  int result;

  result = 0;

  snprintf(newPath, elcount(newPath), "%s.%s", oldPath, "latOffset");
  C2xSetTokenInt(packetHandle, "BasicSafetyMessageVerbose", newPath, value.latOffset);
  result = CheckLastError("BasicSafetyMessageVerbose", gkFuncRefGet, result);

  snprintf(newPath, elcount(newPath), "%s.%s", oldPath, "longOffset");
  C2xSetTokenInt(packetHandle, "BasicSafetyMessageVerbose", newPath, value.longOffset);
  result = CheckLastError("BasicSafetyMessageVerbose", gkFuncRefGet, result);

  snprintf(newPath, elcount(newPath), "%s.%s", oldPath, "elevationOffset");
  C2xSetTokenInt(packetHandle, "BasicSafetyMessageVerbose", newPath, value.elevationOffset);
  result = CheckLastError("BasicSafetyMessageVerbose", gkFuncRefGet, result);

  snprintf(newPath, elcount(newPath), "%s.%s", oldPath, "timeOffset");
  C2xSetTokenInt(packetHandle, "BasicSafetyMessageVerbose", newPath, value.timeOffset);
  result = CheckLastError("BasicSafetyMessageVerbose", gkFuncRefGet, result);

  return result;
}

int GetBasicSafetyMessageVerbose_Blob_PathHistory_crumbData_pathHistoryPointSets_04Params(LONG packetHandle, struct BasicSafetyMessageVerbose_Blob_PathHistory_crumbData_pathHistoryPointSets_04 value, char oldPath[])
{
  char newPath[300]; 
  int i;
  int result;

  result = 0;

  value.length = C2xGetTokenInt(packetHandle, "BasicSafetyMessageVerbose", oldPath);
  if((result = CheckLastError("BasicSafetyMessageVerbose", gkFuncRefGet, result))==0)
  {
    for(i=0; i<value.length; i++)
    {
      snprintf(newPath, elcount(newPath), "%s[%d]", oldPath, i);
      GetBasicSafetyMessageVerbose_Blob_PathHistoryPointType_04Params(packetHandle, value.arrayValue[i], newPath);
      result = CheckLastError("BasicSafetyMessageVerbose", gkFuncRefGet, result);
    }
  }
  return result;
}

int SetBasicSafetyMessageVerbose_Blob_PathHistory_crumbData_pathHistoryPointSets_04Params(LONG packetHandle, struct BasicSafetyMessageVerbose_Blob_PathHistory_crumbData_pathHistoryPointSets_04 value, char oldPath[])
{
  char newPath[300]; 
  int i;
  int result;

  result = 0;

  C2xRemoveToken(packetHandle, "BasicSafetyMessageVerbose", oldPath);
  for(i=0; i<value.length; i++)
  {
    snprintf(newPath, elcount(newPath), "%s[%d]", oldPath, i);
    SetBasicSafetyMessageVerbose_Blob_PathHistoryPointType_04Params(packetHandle, value.arrayValue[i], newPath);
    result = CheckLastError("BasicSafetyMessageVerbose", gkFuncRefGet, result);
  }
  return result;
}

int GetBasicSafetyMessageVerbose_PathHistory_crumbData_pathHistoryPointSets_04Params(LONG packetHandle, struct BasicSafetyMessageVerbose_PathHistory_crumbData_pathHistoryPointSets_04 value, char oldPath[])
{
  char newPath[300];
  int result;

  result = 0;

  snprintf(newPath, elcount(newPath), "%s.%s", oldPath, "_Blob_PathHistory_crumbData_pathHistoryPointSets_04");
  GetBasicSafetyMessageVerbose_Blob_PathHistory_crumbData_pathHistoryPointSets_04Params(packetHandle, value._Blob_PathHistory_crumbData_pathHistoryPointSets_04, newPath);
  result = CheckLastError("BasicSafetyMessageVerbose", gkFuncRefGet, result);

  return result;
}

int SetBasicSafetyMessageVerbose_PathHistory_crumbData_pathHistoryPointSets_04Params(LONG packetHandle, struct BasicSafetyMessageVerbose_PathHistory_crumbData_pathHistoryPointSets_04 value, char oldPath[])
{
  char newPath[300];
  int result;

  result = 0;

  snprintf(newPath, elcount(newPath), "%s.%s", oldPath, "_Blob_PathHistory_crumbData_pathHistoryPointSets_04");
  SetBasicSafetyMessageVerbose_Blob_PathHistory_crumbData_pathHistoryPointSets_04Params(packetHandle, value._Blob_PathHistory_crumbData_pathHistoryPointSets_04, newPath);
  result = CheckLastError("BasicSafetyMessageVerbose", gkFuncRefGet, result);

  return result;
}

int GetBasicSafetyMessageVerbose_Blob_PathHistoryPointType_05Params(LONG packetHandle, struct BasicSafetyMessageVerbose_Blob_PathHistoryPointType_05 value, char oldPath[])
{
  char newPath[300];
  int result;

  result = 0;

  snprintf(newPath, elcount(newPath), "%s.%s", oldPath, "latOffset");
  value.latOffset = C2xGetTokenInt(packetHandle, "BasicSafetyMessageVerbose", newPath);
  result = CheckLastError("BasicSafetyMessageVerbose", gkFuncRefGet, result);

  snprintf(newPath, elcount(newPath), "%s.%s", oldPath, "longOffset");
  value.longOffset = C2xGetTokenInt(packetHandle, "BasicSafetyMessageVerbose", newPath);
  result = CheckLastError("BasicSafetyMessageVerbose", gkFuncRefGet, result);

  snprintf(newPath, elcount(newPath), "%s.%s", oldPath, "elevationOffset");
  value.elevationOffset = C2xGetTokenInt(packetHandle, "BasicSafetyMessageVerbose", newPath);
  result = CheckLastError("BasicSafetyMessageVerbose", gkFuncRefGet, result);

  snprintf(newPath, elcount(newPath), "%s.%s", oldPath, "accuracy");
  GetBasicSafetyMessageVerbose_Blob_PositionalAccuracyParams(packetHandle, value.accuracy, newPath);
  result = CheckLastError("BasicSafetyMessageVerbose", gkFuncRefGet, result);

  return result;
}

int SetBasicSafetyMessageVerbose_Blob_PathHistoryPointType_05Params(LONG packetHandle, struct BasicSafetyMessageVerbose_Blob_PathHistoryPointType_05 value, char oldPath[])
{
  char newPath[300];
  int result;

  result = 0;

  snprintf(newPath, elcount(newPath), "%s.%s", oldPath, "latOffset");
  C2xSetTokenInt(packetHandle, "BasicSafetyMessageVerbose", newPath, value.latOffset);
  result = CheckLastError("BasicSafetyMessageVerbose", gkFuncRefGet, result);

  snprintf(newPath, elcount(newPath), "%s.%s", oldPath, "longOffset");
  C2xSetTokenInt(packetHandle, "BasicSafetyMessageVerbose", newPath, value.longOffset);
  result = CheckLastError("BasicSafetyMessageVerbose", gkFuncRefGet, result);

  snprintf(newPath, elcount(newPath), "%s.%s", oldPath, "elevationOffset");
  C2xSetTokenInt(packetHandle, "BasicSafetyMessageVerbose", newPath, value.elevationOffset);
  result = CheckLastError("BasicSafetyMessageVerbose", gkFuncRefGet, result);

  snprintf(newPath, elcount(newPath), "%s.%s", oldPath, "accuracy");
  SetBasicSafetyMessageVerbose_Blob_PositionalAccuracyParams(packetHandle, value.accuracy, newPath);
  result = CheckLastError("BasicSafetyMessageVerbose", gkFuncRefGet, result);

  return result;
}

int GetBasicSafetyMessageVerbose_Blob_PathHistory_crumbData_pathHistoryPointSets_05Params(LONG packetHandle, struct BasicSafetyMessageVerbose_Blob_PathHistory_crumbData_pathHistoryPointSets_05 value, char oldPath[])
{
  char newPath[300]; 
  int i;
  int result;

  result = 0;

  value.length = C2xGetTokenInt(packetHandle, "BasicSafetyMessageVerbose", oldPath);
  if((result = CheckLastError("BasicSafetyMessageVerbose", gkFuncRefGet, result))==0)
  {
    for(i=0; i<value.length; i++)
    {
      snprintf(newPath, elcount(newPath), "%s[%d]", oldPath, i);
      GetBasicSafetyMessageVerbose_Blob_PathHistoryPointType_05Params(packetHandle, value.arrayValue[i], newPath);
      result = CheckLastError("BasicSafetyMessageVerbose", gkFuncRefGet, result);
    }
  }
  return result;
}

int SetBasicSafetyMessageVerbose_Blob_PathHistory_crumbData_pathHistoryPointSets_05Params(LONG packetHandle, struct BasicSafetyMessageVerbose_Blob_PathHistory_crumbData_pathHistoryPointSets_05 value, char oldPath[])
{
  char newPath[300]; 
  int i;
  int result;

  result = 0;

  C2xRemoveToken(packetHandle, "BasicSafetyMessageVerbose", oldPath);
  for(i=0; i<value.length; i++)
  {
    snprintf(newPath, elcount(newPath), "%s[%d]", oldPath, i);
    SetBasicSafetyMessageVerbose_Blob_PathHistoryPointType_05Params(packetHandle, value.arrayValue[i], newPath);
    result = CheckLastError("BasicSafetyMessageVerbose", gkFuncRefGet, result);
  }
  return result;
}

int GetBasicSafetyMessageVerbose_PathHistory_crumbData_pathHistoryPointSets_05Params(LONG packetHandle, struct BasicSafetyMessageVerbose_PathHistory_crumbData_pathHistoryPointSets_05 value, char oldPath[])
{
  char newPath[300];
  int result;

  result = 0;

  snprintf(newPath, elcount(newPath), "%s.%s", oldPath, "_Blob_PathHistory_crumbData_pathHistoryPointSets_05");
  GetBasicSafetyMessageVerbose_Blob_PathHistory_crumbData_pathHistoryPointSets_05Params(packetHandle, value._Blob_PathHistory_crumbData_pathHistoryPointSets_05, newPath);
  result = CheckLastError("BasicSafetyMessageVerbose", gkFuncRefGet, result);

  return result;
}

int SetBasicSafetyMessageVerbose_PathHistory_crumbData_pathHistoryPointSets_05Params(LONG packetHandle, struct BasicSafetyMessageVerbose_PathHistory_crumbData_pathHistoryPointSets_05 value, char oldPath[])
{
  char newPath[300];
  int result;

  result = 0;

  snprintf(newPath, elcount(newPath), "%s.%s", oldPath, "_Blob_PathHistory_crumbData_pathHistoryPointSets_05");
  SetBasicSafetyMessageVerbose_Blob_PathHistory_crumbData_pathHistoryPointSets_05Params(packetHandle, value._Blob_PathHistory_crumbData_pathHistoryPointSets_05, newPath);
  result = CheckLastError("BasicSafetyMessageVerbose", gkFuncRefGet, result);

  return result;
}

int GetBasicSafetyMessageVerbose_Blob_PathHistoryPointType_06Params(LONG packetHandle, struct BasicSafetyMessageVerbose_Blob_PathHistoryPointType_06 value, char oldPath[])
{
  char newPath[300];
  int result;

  result = 0;

  snprintf(newPath, elcount(newPath), "%s.%s", oldPath, "latOffset");
  value.latOffset = C2xGetTokenInt(packetHandle, "BasicSafetyMessageVerbose", newPath);
  result = CheckLastError("BasicSafetyMessageVerbose", gkFuncRefGet, result);

  snprintf(newPath, elcount(newPath), "%s.%s", oldPath, "longOffset");
  value.longOffset = C2xGetTokenInt(packetHandle, "BasicSafetyMessageVerbose", newPath);
  result = CheckLastError("BasicSafetyMessageVerbose", gkFuncRefGet, result);

  snprintf(newPath, elcount(newPath), "%s.%s", oldPath, "elevationOffset");
  value.elevationOffset = C2xGetTokenInt(packetHandle, "BasicSafetyMessageVerbose", newPath);
  result = CheckLastError("BasicSafetyMessageVerbose", gkFuncRefGet, result);

  return result;
}

int SetBasicSafetyMessageVerbose_Blob_PathHistoryPointType_06Params(LONG packetHandle, struct BasicSafetyMessageVerbose_Blob_PathHistoryPointType_06 value, char oldPath[])
{
  char newPath[300];
  int result;

  result = 0;

  snprintf(newPath, elcount(newPath), "%s.%s", oldPath, "latOffset");
  C2xSetTokenInt(packetHandle, "BasicSafetyMessageVerbose", newPath, value.latOffset);
  result = CheckLastError("BasicSafetyMessageVerbose", gkFuncRefGet, result);

  snprintf(newPath, elcount(newPath), "%s.%s", oldPath, "longOffset");
  C2xSetTokenInt(packetHandle, "BasicSafetyMessageVerbose", newPath, value.longOffset);
  result = CheckLastError("BasicSafetyMessageVerbose", gkFuncRefGet, result);

  snprintf(newPath, elcount(newPath), "%s.%s", oldPath, "elevationOffset");
  C2xSetTokenInt(packetHandle, "BasicSafetyMessageVerbose", newPath, value.elevationOffset);
  result = CheckLastError("BasicSafetyMessageVerbose", gkFuncRefGet, result);

  return result;
}

int GetBasicSafetyMessageVerbose_Blob_PathHistory_crumbData_pathHistoryPointSets_06Params(LONG packetHandle, struct BasicSafetyMessageVerbose_Blob_PathHistory_crumbData_pathHistoryPointSets_06 value, char oldPath[])
{
  char newPath[300]; 
  int i;
  int result;

  result = 0;

  value.length = C2xGetTokenInt(packetHandle, "BasicSafetyMessageVerbose", oldPath);
  if((result = CheckLastError("BasicSafetyMessageVerbose", gkFuncRefGet, result))==0)
  {
    for(i=0; i<value.length; i++)
    {
      snprintf(newPath, elcount(newPath), "%s[%d]", oldPath, i);
      GetBasicSafetyMessageVerbose_Blob_PathHistoryPointType_06Params(packetHandle, value.arrayValue[i], newPath);
      result = CheckLastError("BasicSafetyMessageVerbose", gkFuncRefGet, result);
    }
  }
  return result;
}

int SetBasicSafetyMessageVerbose_Blob_PathHistory_crumbData_pathHistoryPointSets_06Params(LONG packetHandle, struct BasicSafetyMessageVerbose_Blob_PathHistory_crumbData_pathHistoryPointSets_06 value, char oldPath[])
{
  char newPath[300]; 
  int i;
  int result;

  result = 0;

  C2xRemoveToken(packetHandle, "BasicSafetyMessageVerbose", oldPath);
  for(i=0; i<value.length; i++)
  {
    snprintf(newPath, elcount(newPath), "%s[%d]", oldPath, i);
    SetBasicSafetyMessageVerbose_Blob_PathHistoryPointType_06Params(packetHandle, value.arrayValue[i], newPath);
    result = CheckLastError("BasicSafetyMessageVerbose", gkFuncRefGet, result);
  }
  return result;
}

int GetBasicSafetyMessageVerbose_PathHistory_crumbData_pathHistoryPointSets_06Params(LONG packetHandle, struct BasicSafetyMessageVerbose_PathHistory_crumbData_pathHistoryPointSets_06 value, char oldPath[])
{
  char newPath[300];
  int result;

  result = 0;

  snprintf(newPath, elcount(newPath), "%s.%s", oldPath, "_Blob_PathHistory_crumbData_pathHistoryPointSets_06");
  GetBasicSafetyMessageVerbose_Blob_PathHistory_crumbData_pathHistoryPointSets_06Params(packetHandle, value._Blob_PathHistory_crumbData_pathHistoryPointSets_06, newPath);
  result = CheckLastError("BasicSafetyMessageVerbose", gkFuncRefGet, result);

  return result;
}

int SetBasicSafetyMessageVerbose_PathHistory_crumbData_pathHistoryPointSets_06Params(LONG packetHandle, struct BasicSafetyMessageVerbose_PathHistory_crumbData_pathHistoryPointSets_06 value, char oldPath[])
{
  char newPath[300];
  int result;

  result = 0;

  snprintf(newPath, elcount(newPath), "%s.%s", oldPath, "_Blob_PathHistory_crumbData_pathHistoryPointSets_06");
  SetBasicSafetyMessageVerbose_Blob_PathHistory_crumbData_pathHistoryPointSets_06Params(packetHandle, value._Blob_PathHistory_crumbData_pathHistoryPointSets_06, newPath);
  result = CheckLastError("BasicSafetyMessageVerbose", gkFuncRefGet, result);

  return result;
}

int GetBasicSafetyMessageVerbose_Blob_PathHistoryPointType_07Params(LONG packetHandle, struct BasicSafetyMessageVerbose_Blob_PathHistoryPointType_07 value, char oldPath[])
{
  char newPath[300];
  int result;

  result = 0;

  snprintf(newPath, elcount(newPath), "%s.%s", oldPath, "latOffset");
  value.latOffset = C2xGetTokenInt(packetHandle, "BasicSafetyMessageVerbose", newPath);
  result = CheckLastError("BasicSafetyMessageVerbose", gkFuncRefGet, result);

  snprintf(newPath, elcount(newPath), "%s.%s", oldPath, "longOffset");
  value.longOffset = C2xGetTokenInt(packetHandle, "BasicSafetyMessageVerbose", newPath);
  result = CheckLastError("BasicSafetyMessageVerbose", gkFuncRefGet, result);

  snprintf(newPath, elcount(newPath), "%s.%s", oldPath, "timeOffset");
  value.timeOffset = C2xGetTokenInt(packetHandle, "BasicSafetyMessageVerbose", newPath);
  result = CheckLastError("BasicSafetyMessageVerbose", gkFuncRefGet, result);

  snprintf(newPath, elcount(newPath), "%s.%s", oldPath, "accuracy");
  GetBasicSafetyMessageVerbose_Blob_PositionalAccuracyParams(packetHandle, value.accuracy, newPath);
  result = CheckLastError("BasicSafetyMessageVerbose", gkFuncRefGet, result);

  return result;
}

int SetBasicSafetyMessageVerbose_Blob_PathHistoryPointType_07Params(LONG packetHandle, struct BasicSafetyMessageVerbose_Blob_PathHistoryPointType_07 value, char oldPath[])
{
  char newPath[300];
  int result;

  result = 0;

  snprintf(newPath, elcount(newPath), "%s.%s", oldPath, "latOffset");
  C2xSetTokenInt(packetHandle, "BasicSafetyMessageVerbose", newPath, value.latOffset);
  result = CheckLastError("BasicSafetyMessageVerbose", gkFuncRefGet, result);

  snprintf(newPath, elcount(newPath), "%s.%s", oldPath, "longOffset");
  C2xSetTokenInt(packetHandle, "BasicSafetyMessageVerbose", newPath, value.longOffset);
  result = CheckLastError("BasicSafetyMessageVerbose", gkFuncRefGet, result);

  snprintf(newPath, elcount(newPath), "%s.%s", oldPath, "timeOffset");
  C2xSetTokenInt(packetHandle, "BasicSafetyMessageVerbose", newPath, value.timeOffset);
  result = CheckLastError("BasicSafetyMessageVerbose", gkFuncRefGet, result);

  snprintf(newPath, elcount(newPath), "%s.%s", oldPath, "accuracy");
  SetBasicSafetyMessageVerbose_Blob_PositionalAccuracyParams(packetHandle, value.accuracy, newPath);
  result = CheckLastError("BasicSafetyMessageVerbose", gkFuncRefGet, result);

  return result;
}

int GetBasicSafetyMessageVerbose_Blob_PathHistory_crumbData_pathHistoryPointSets_07Params(LONG packetHandle, struct BasicSafetyMessageVerbose_Blob_PathHistory_crumbData_pathHistoryPointSets_07 value, char oldPath[])
{
  char newPath[300]; 
  int i;
  int result;

  result = 0;

  value.length = C2xGetTokenInt(packetHandle, "BasicSafetyMessageVerbose", oldPath);
  if((result = CheckLastError("BasicSafetyMessageVerbose", gkFuncRefGet, result))==0)
  {
    for(i=0; i<value.length; i++)
    {
      snprintf(newPath, elcount(newPath), "%s[%d]", oldPath, i);
      GetBasicSafetyMessageVerbose_Blob_PathHistoryPointType_07Params(packetHandle, value.arrayValue[i], newPath);
      result = CheckLastError("BasicSafetyMessageVerbose", gkFuncRefGet, result);
    }
  }
  return result;
}

int SetBasicSafetyMessageVerbose_Blob_PathHistory_crumbData_pathHistoryPointSets_07Params(LONG packetHandle, struct BasicSafetyMessageVerbose_Blob_PathHistory_crumbData_pathHistoryPointSets_07 value, char oldPath[])
{
  char newPath[300]; 
  int i;
  int result;

  result = 0;

  C2xRemoveToken(packetHandle, "BasicSafetyMessageVerbose", oldPath);
  for(i=0; i<value.length; i++)
  {
    snprintf(newPath, elcount(newPath), "%s[%d]", oldPath, i);
    SetBasicSafetyMessageVerbose_Blob_PathHistoryPointType_07Params(packetHandle, value.arrayValue[i], newPath);
    result = CheckLastError("BasicSafetyMessageVerbose", gkFuncRefGet, result);
  }
  return result;
}

int GetBasicSafetyMessageVerbose_PathHistory_crumbData_pathHistoryPointSets_07Params(LONG packetHandle, struct BasicSafetyMessageVerbose_PathHistory_crumbData_pathHistoryPointSets_07 value, char oldPath[])
{
  char newPath[300];
  int result;

  result = 0;

  snprintf(newPath, elcount(newPath), "%s.%s", oldPath, "_Blob_PathHistory_crumbData_pathHistoryPointSets_07");
  GetBasicSafetyMessageVerbose_Blob_PathHistory_crumbData_pathHistoryPointSets_07Params(packetHandle, value._Blob_PathHistory_crumbData_pathHistoryPointSets_07, newPath);
  result = CheckLastError("BasicSafetyMessageVerbose", gkFuncRefGet, result);

  return result;
}

int SetBasicSafetyMessageVerbose_PathHistory_crumbData_pathHistoryPointSets_07Params(LONG packetHandle, struct BasicSafetyMessageVerbose_PathHistory_crumbData_pathHistoryPointSets_07 value, char oldPath[])
{
  char newPath[300];
  int result;

  result = 0;

  snprintf(newPath, elcount(newPath), "%s.%s", oldPath, "_Blob_PathHistory_crumbData_pathHistoryPointSets_07");
  SetBasicSafetyMessageVerbose_Blob_PathHistory_crumbData_pathHistoryPointSets_07Params(packetHandle, value._Blob_PathHistory_crumbData_pathHistoryPointSets_07, newPath);
  result = CheckLastError("BasicSafetyMessageVerbose", gkFuncRefGet, result);

  return result;
}

int GetBasicSafetyMessageVerbose_Blob_PathHistoryPointType_08Params(LONG packetHandle, struct BasicSafetyMessageVerbose_Blob_PathHistoryPointType_08 value, char oldPath[])
{
  char newPath[300];
  int result;

  result = 0;

  snprintf(newPath, elcount(newPath), "%s.%s", oldPath, "latOffset");
  value.latOffset = C2xGetTokenInt(packetHandle, "BasicSafetyMessageVerbose", newPath);
  result = CheckLastError("BasicSafetyMessageVerbose", gkFuncRefGet, result);

  snprintf(newPath, elcount(newPath), "%s.%s", oldPath, "longOffset");
  value.longOffset = C2xGetTokenInt(packetHandle, "BasicSafetyMessageVerbose", newPath);
  result = CheckLastError("BasicSafetyMessageVerbose", gkFuncRefGet, result);

  snprintf(newPath, elcount(newPath), "%s.%s", oldPath, "timeOffset");
  value.timeOffset = C2xGetTokenInt(packetHandle, "BasicSafetyMessageVerbose", newPath);
  result = CheckLastError("BasicSafetyMessageVerbose", gkFuncRefGet, result);

  return result;
}

int SetBasicSafetyMessageVerbose_Blob_PathHistoryPointType_08Params(LONG packetHandle, struct BasicSafetyMessageVerbose_Blob_PathHistoryPointType_08 value, char oldPath[])
{
  char newPath[300];
  int result;

  result = 0;

  snprintf(newPath, elcount(newPath), "%s.%s", oldPath, "latOffset");
  C2xSetTokenInt(packetHandle, "BasicSafetyMessageVerbose", newPath, value.latOffset);
  result = CheckLastError("BasicSafetyMessageVerbose", gkFuncRefGet, result);

  snprintf(newPath, elcount(newPath), "%s.%s", oldPath, "longOffset");
  C2xSetTokenInt(packetHandle, "BasicSafetyMessageVerbose", newPath, value.longOffset);
  result = CheckLastError("BasicSafetyMessageVerbose", gkFuncRefGet, result);

  snprintf(newPath, elcount(newPath), "%s.%s", oldPath, "timeOffset");
  C2xSetTokenInt(packetHandle, "BasicSafetyMessageVerbose", newPath, value.timeOffset);
  result = CheckLastError("BasicSafetyMessageVerbose", gkFuncRefGet, result);

  return result;
}

int GetBasicSafetyMessageVerbose_Blob_PathHistory_crumbData_pathHistoryPointSets_08Params(LONG packetHandle, struct BasicSafetyMessageVerbose_Blob_PathHistory_crumbData_pathHistoryPointSets_08 value, char oldPath[])
{
  char newPath[300]; 
  int i;
  int result;

  result = 0;

  value.length = C2xGetTokenInt(packetHandle, "BasicSafetyMessageVerbose", oldPath);
  if((result = CheckLastError("BasicSafetyMessageVerbose", gkFuncRefGet, result))==0)
  {
    for(i=0; i<value.length; i++)
    {
      snprintf(newPath, elcount(newPath), "%s[%d]", oldPath, i);
      GetBasicSafetyMessageVerbose_Blob_PathHistoryPointType_08Params(packetHandle, value.arrayValue[i], newPath);
      result = CheckLastError("BasicSafetyMessageVerbose", gkFuncRefGet, result);
    }
  }
  return result;
}

int SetBasicSafetyMessageVerbose_Blob_PathHistory_crumbData_pathHistoryPointSets_08Params(LONG packetHandle, struct BasicSafetyMessageVerbose_Blob_PathHistory_crumbData_pathHistoryPointSets_08 value, char oldPath[])
{
  char newPath[300]; 
  int i;
  int result;

  result = 0;

  C2xRemoveToken(packetHandle, "BasicSafetyMessageVerbose", oldPath);
  for(i=0; i<value.length; i++)
  {
    snprintf(newPath, elcount(newPath), "%s[%d]", oldPath, i);
    SetBasicSafetyMessageVerbose_Blob_PathHistoryPointType_08Params(packetHandle, value.arrayValue[i], newPath);
    result = CheckLastError("BasicSafetyMessageVerbose", gkFuncRefGet, result);
  }
  return result;
}

int GetBasicSafetyMessageVerbose_PathHistory_crumbData_pathHistoryPointSets_08Params(LONG packetHandle, struct BasicSafetyMessageVerbose_PathHistory_crumbData_pathHistoryPointSets_08 value, char oldPath[])
{
  char newPath[300];
  int result;

  result = 0;

  snprintf(newPath, elcount(newPath), "%s.%s", oldPath, "_Blob_PathHistory_crumbData_pathHistoryPointSets_08");
  GetBasicSafetyMessageVerbose_Blob_PathHistory_crumbData_pathHistoryPointSets_08Params(packetHandle, value._Blob_PathHistory_crumbData_pathHistoryPointSets_08, newPath);
  result = CheckLastError("BasicSafetyMessageVerbose", gkFuncRefGet, result);

  return result;
}

int SetBasicSafetyMessageVerbose_PathHistory_crumbData_pathHistoryPointSets_08Params(LONG packetHandle, struct BasicSafetyMessageVerbose_PathHistory_crumbData_pathHistoryPointSets_08 value, char oldPath[])
{
  char newPath[300];
  int result;

  result = 0;

  snprintf(newPath, elcount(newPath), "%s.%s", oldPath, "_Blob_PathHistory_crumbData_pathHistoryPointSets_08");
  SetBasicSafetyMessageVerbose_Blob_PathHistory_crumbData_pathHistoryPointSets_08Params(packetHandle, value._Blob_PathHistory_crumbData_pathHistoryPointSets_08, newPath);
  result = CheckLastError("BasicSafetyMessageVerbose", gkFuncRefGet, result);

  return result;
}

int GetBasicSafetyMessageVerbose_Blob_PathHistoryPointType_09Params(LONG packetHandle, struct BasicSafetyMessageVerbose_Blob_PathHistoryPointType_09 value, char oldPath[])
{
  char newPath[300];
  int result;

  result = 0;

  snprintf(newPath, elcount(newPath), "%s.%s", oldPath, "latOffset");
  value.latOffset = C2xGetTokenInt(packetHandle, "BasicSafetyMessageVerbose", newPath);
  result = CheckLastError("BasicSafetyMessageVerbose", gkFuncRefGet, result);

  snprintf(newPath, elcount(newPath), "%s.%s", oldPath, "longOffset");
  value.longOffset = C2xGetTokenInt(packetHandle, "BasicSafetyMessageVerbose", newPath);
  result = CheckLastError("BasicSafetyMessageVerbose", gkFuncRefGet, result);

  snprintf(newPath, elcount(newPath), "%s.%s", oldPath, "accuracy");
  GetBasicSafetyMessageVerbose_Blob_PositionalAccuracyParams(packetHandle, value.accuracy, newPath);
  result = CheckLastError("BasicSafetyMessageVerbose", gkFuncRefGet, result);

  return result;
}

int SetBasicSafetyMessageVerbose_Blob_PathHistoryPointType_09Params(LONG packetHandle, struct BasicSafetyMessageVerbose_Blob_PathHistoryPointType_09 value, char oldPath[])
{
  char newPath[300];
  int result;

  result = 0;

  snprintf(newPath, elcount(newPath), "%s.%s", oldPath, "latOffset");
  C2xSetTokenInt(packetHandle, "BasicSafetyMessageVerbose", newPath, value.latOffset);
  result = CheckLastError("BasicSafetyMessageVerbose", gkFuncRefGet, result);

  snprintf(newPath, elcount(newPath), "%s.%s", oldPath, "longOffset");
  C2xSetTokenInt(packetHandle, "BasicSafetyMessageVerbose", newPath, value.longOffset);
  result = CheckLastError("BasicSafetyMessageVerbose", gkFuncRefGet, result);

  snprintf(newPath, elcount(newPath), "%s.%s", oldPath, "accuracy");
  SetBasicSafetyMessageVerbose_Blob_PositionalAccuracyParams(packetHandle, value.accuracy, newPath);
  result = CheckLastError("BasicSafetyMessageVerbose", gkFuncRefGet, result);

  return result;
}

int GetBasicSafetyMessageVerbose_Blob_PathHistory_crumbData_pathHistoryPointSets_09Params(LONG packetHandle, struct BasicSafetyMessageVerbose_Blob_PathHistory_crumbData_pathHistoryPointSets_09 value, char oldPath[])
{
  char newPath[300]; 
  int i;
  int result;

  result = 0;

  value.length = C2xGetTokenInt(packetHandle, "BasicSafetyMessageVerbose", oldPath);
  if((result = CheckLastError("BasicSafetyMessageVerbose", gkFuncRefGet, result))==0)
  {
    for(i=0; i<value.length; i++)
    {
      snprintf(newPath, elcount(newPath), "%s[%d]", oldPath, i);
      GetBasicSafetyMessageVerbose_Blob_PathHistoryPointType_09Params(packetHandle, value.arrayValue[i], newPath);
      result = CheckLastError("BasicSafetyMessageVerbose", gkFuncRefGet, result);
    }
  }
  return result;
}

int SetBasicSafetyMessageVerbose_Blob_PathHistory_crumbData_pathHistoryPointSets_09Params(LONG packetHandle, struct BasicSafetyMessageVerbose_Blob_PathHistory_crumbData_pathHistoryPointSets_09 value, char oldPath[])
{
  char newPath[300]; 
  int i;
  int result;

  result = 0;

  C2xRemoveToken(packetHandle, "BasicSafetyMessageVerbose", oldPath);
  for(i=0; i<value.length; i++)
  {
    snprintf(newPath, elcount(newPath), "%s[%d]", oldPath, i);
    SetBasicSafetyMessageVerbose_Blob_PathHistoryPointType_09Params(packetHandle, value.arrayValue[i], newPath);
    result = CheckLastError("BasicSafetyMessageVerbose", gkFuncRefGet, result);
  }
  return result;
}

int GetBasicSafetyMessageVerbose_PathHistory_crumbData_pathHistoryPointSets_09Params(LONG packetHandle, struct BasicSafetyMessageVerbose_PathHistory_crumbData_pathHistoryPointSets_09 value, char oldPath[])
{
  char newPath[300];
  int result;

  result = 0;

  snprintf(newPath, elcount(newPath), "%s.%s", oldPath, "_Blob_PathHistory_crumbData_pathHistoryPointSets_09");
  GetBasicSafetyMessageVerbose_Blob_PathHistory_crumbData_pathHistoryPointSets_09Params(packetHandle, value._Blob_PathHistory_crumbData_pathHistoryPointSets_09, newPath);
  result = CheckLastError("BasicSafetyMessageVerbose", gkFuncRefGet, result);

  return result;
}

int SetBasicSafetyMessageVerbose_PathHistory_crumbData_pathHistoryPointSets_09Params(LONG packetHandle, struct BasicSafetyMessageVerbose_PathHistory_crumbData_pathHistoryPointSets_09 value, char oldPath[])
{
  char newPath[300];
  int result;

  result = 0;

  snprintf(newPath, elcount(newPath), "%s.%s", oldPath, "_Blob_PathHistory_crumbData_pathHistoryPointSets_09");
  SetBasicSafetyMessageVerbose_Blob_PathHistory_crumbData_pathHistoryPointSets_09Params(packetHandle, value._Blob_PathHistory_crumbData_pathHistoryPointSets_09, newPath);
  result = CheckLastError("BasicSafetyMessageVerbose", gkFuncRefGet, result);

  return result;
}

int GetBasicSafetyMessageVerbose_Blob_PathHistoryPointType_10Params(LONG packetHandle, struct BasicSafetyMessageVerbose_Blob_PathHistoryPointType_10 value, char oldPath[])
{
  char newPath[300];
  int result;

  result = 0;

  snprintf(newPath, elcount(newPath), "%s.%s", oldPath, "latOffset");
  value.latOffset = C2xGetTokenInt(packetHandle, "BasicSafetyMessageVerbose", newPath);
  result = CheckLastError("BasicSafetyMessageVerbose", gkFuncRefGet, result);

  snprintf(newPath, elcount(newPath), "%s.%s", oldPath, "longOffset");
  value.longOffset = C2xGetTokenInt(packetHandle, "BasicSafetyMessageVerbose", newPath);
  result = CheckLastError("BasicSafetyMessageVerbose", gkFuncRefGet, result);

  return result;
}

int SetBasicSafetyMessageVerbose_Blob_PathHistoryPointType_10Params(LONG packetHandle, struct BasicSafetyMessageVerbose_Blob_PathHistoryPointType_10 value, char oldPath[])
{
  char newPath[300];
  int result;

  result = 0;

  snprintf(newPath, elcount(newPath), "%s.%s", oldPath, "latOffset");
  C2xSetTokenInt(packetHandle, "BasicSafetyMessageVerbose", newPath, value.latOffset);
  result = CheckLastError("BasicSafetyMessageVerbose", gkFuncRefGet, result);

  snprintf(newPath, elcount(newPath), "%s.%s", oldPath, "longOffset");
  C2xSetTokenInt(packetHandle, "BasicSafetyMessageVerbose", newPath, value.longOffset);
  result = CheckLastError("BasicSafetyMessageVerbose", gkFuncRefGet, result);

  return result;
}

int GetBasicSafetyMessageVerbose_Blob_PathHistory_crumbData_pathHistoryPointSets_10Params(LONG packetHandle, struct BasicSafetyMessageVerbose_Blob_PathHistory_crumbData_pathHistoryPointSets_10 value, char oldPath[])
{
  char newPath[300]; 
  int i;
  int result;

  result = 0;

  value.length = C2xGetTokenInt(packetHandle, "BasicSafetyMessageVerbose", oldPath);
  if((result = CheckLastError("BasicSafetyMessageVerbose", gkFuncRefGet, result))==0)
  {
    for(i=0; i<value.length; i++)
    {
      snprintf(newPath, elcount(newPath), "%s[%d]", oldPath, i);
      GetBasicSafetyMessageVerbose_Blob_PathHistoryPointType_10Params(packetHandle, value.arrayValue[i], newPath);
      result = CheckLastError("BasicSafetyMessageVerbose", gkFuncRefGet, result);
    }
  }
  return result;
}

int SetBasicSafetyMessageVerbose_Blob_PathHistory_crumbData_pathHistoryPointSets_10Params(LONG packetHandle, struct BasicSafetyMessageVerbose_Blob_PathHistory_crumbData_pathHistoryPointSets_10 value, char oldPath[])
{
  char newPath[300]; 
  int i;
  int result;

  result = 0;

  C2xRemoveToken(packetHandle, "BasicSafetyMessageVerbose", oldPath);
  for(i=0; i<value.length; i++)
  {
    snprintf(newPath, elcount(newPath), "%s[%d]", oldPath, i);
    SetBasicSafetyMessageVerbose_Blob_PathHistoryPointType_10Params(packetHandle, value.arrayValue[i], newPath);
    result = CheckLastError("BasicSafetyMessageVerbose", gkFuncRefGet, result);
  }
  return result;
}

int GetBasicSafetyMessageVerbose_PathHistory_crumbData_pathHistoryPointSets_10Params(LONG packetHandle, struct BasicSafetyMessageVerbose_PathHistory_crumbData_pathHistoryPointSets_10 value, char oldPath[])
{
  char newPath[300];
  int result;

  result = 0;

  snprintf(newPath, elcount(newPath), "%s.%s", oldPath, "_Blob_PathHistory_crumbData_pathHistoryPointSets_10");
  GetBasicSafetyMessageVerbose_Blob_PathHistory_crumbData_pathHistoryPointSets_10Params(packetHandle, value._Blob_PathHistory_crumbData_pathHistoryPointSets_10, newPath);
  result = CheckLastError("BasicSafetyMessageVerbose", gkFuncRefGet, result);

  return result;
}

int SetBasicSafetyMessageVerbose_PathHistory_crumbData_pathHistoryPointSets_10Params(LONG packetHandle, struct BasicSafetyMessageVerbose_PathHistory_crumbData_pathHistoryPointSets_10 value, char oldPath[])
{
  char newPath[300];
  int result;

  result = 0;

  snprintf(newPath, elcount(newPath), "%s.%s", oldPath, "_Blob_PathHistory_crumbData_pathHistoryPointSets_10");
  SetBasicSafetyMessageVerbose_Blob_PathHistory_crumbData_pathHistoryPointSets_10Params(packetHandle, value._Blob_PathHistory_crumbData_pathHistoryPointSets_10, newPath);
  result = CheckLastError("BasicSafetyMessageVerbose", gkFuncRefGet, result);

  return result;
}

int GetBasicSafetyMessageVerbose_PathHistory_crumbDataParams(LONG packetHandle, struct BasicSafetyMessageVerbose_PathHistory_crumbData value, char oldPath[])
{
  char newPath[300];
  int result;

  result = 0;

  value.choice = C2xGetTokenInt(packetHandle, "BasicSafetyMessageVerbose", oldPath);

  switch(value.choice)
  {
    case 0:
    {
      snprintf(newPath, elcount(newPath), "%s.%s", oldPath, "pathHistoryPointSets_01");
      GetBasicSafetyMessageVerbose_PathHistory_crumbData_pathHistoryPointSets_01Params(packetHandle, value.pathHistoryPointSets_01, newPath);
      result = CheckLastError("BasicSafetyMessageVerbose", gkFuncRefGet, result);
    }
    break;
    case 1:
    {
      snprintf(newPath, elcount(newPath), "%s.%s", oldPath, "pathHistoryPointSets_02");
      GetBasicSafetyMessageVerbose_PathHistory_crumbData_pathHistoryPointSets_02Params(packetHandle, value.pathHistoryPointSets_02, newPath);
      result = CheckLastError("BasicSafetyMessageVerbose", gkFuncRefGet, result);
    }
    break;
    case 2:
    {
      snprintf(newPath, elcount(newPath), "%s.%s", oldPath, "pathHistoryPointSets_03");
      GetBasicSafetyMessageVerbose_PathHistory_crumbData_pathHistoryPointSets_03Params(packetHandle, value.pathHistoryPointSets_03, newPath);
      result = CheckLastError("BasicSafetyMessageVerbose", gkFuncRefGet, result);
    }
    break;
    case 3:
    {
      snprintf(newPath, elcount(newPath), "%s.%s", oldPath, "pathHistoryPointSets_04");
      GetBasicSafetyMessageVerbose_PathHistory_crumbData_pathHistoryPointSets_04Params(packetHandle, value.pathHistoryPointSets_04, newPath);
      result = CheckLastError("BasicSafetyMessageVerbose", gkFuncRefGet, result);
    }
    break;
    case 4:
    {
      snprintf(newPath, elcount(newPath), "%s.%s", oldPath, "pathHistoryPointSets_05");
      GetBasicSafetyMessageVerbose_PathHistory_crumbData_pathHistoryPointSets_05Params(packetHandle, value.pathHistoryPointSets_05, newPath);
      result = CheckLastError("BasicSafetyMessageVerbose", gkFuncRefGet, result);
    }
    break;
    case 5:
    {
      snprintf(newPath, elcount(newPath), "%s.%s", oldPath, "pathHistoryPointSets_06");
      GetBasicSafetyMessageVerbose_PathHistory_crumbData_pathHistoryPointSets_06Params(packetHandle, value.pathHistoryPointSets_06, newPath);
      result = CheckLastError("BasicSafetyMessageVerbose", gkFuncRefGet, result);
    }
    break;
    case 6:
    {
      snprintf(newPath, elcount(newPath), "%s.%s", oldPath, "pathHistoryPointSets_07");
      GetBasicSafetyMessageVerbose_PathHistory_crumbData_pathHistoryPointSets_07Params(packetHandle, value.pathHistoryPointSets_07, newPath);
      result = CheckLastError("BasicSafetyMessageVerbose", gkFuncRefGet, result);
    }
    break;
    case 7:
    {
      snprintf(newPath, elcount(newPath), "%s.%s", oldPath, "pathHistoryPointSets_08");
      GetBasicSafetyMessageVerbose_PathHistory_crumbData_pathHistoryPointSets_08Params(packetHandle, value.pathHistoryPointSets_08, newPath);
      result = CheckLastError("BasicSafetyMessageVerbose", gkFuncRefGet, result);
    }
    break;
    case 8:
    {
      snprintf(newPath, elcount(newPath), "%s.%s", oldPath, "pathHistoryPointSets_09");
      GetBasicSafetyMessageVerbose_PathHistory_crumbData_pathHistoryPointSets_09Params(packetHandle, value.pathHistoryPointSets_09, newPath);
      result = CheckLastError("BasicSafetyMessageVerbose", gkFuncRefGet, result);
    }
    break;
    case 9:
    {
      snprintf(newPath, elcount(newPath), "%s.%s", oldPath, "pathHistoryPointSets_10");
      GetBasicSafetyMessageVerbose_PathHistory_crumbData_pathHistoryPointSets_10Params(packetHandle, value.pathHistoryPointSets_10, newPath);
      result = CheckLastError("BasicSafetyMessageVerbose", gkFuncRefGet, result);
    }
    break;
  }
  return result;
}

int SetBasicSafetyMessageVerbose_PathHistory_crumbDataParams(LONG packetHandle, struct BasicSafetyMessageVerbose_PathHistory_crumbData value, char oldPath[])
{
  char newPath[300];
  int result;

  result = 0;

  switch(value.choice)
  {
    case 0:
    {
      snprintf(newPath, elcount(newPath), "%s.%s", oldPath, "pathHistoryPointSets_01");
      SetBasicSafetyMessageVerbose_PathHistory_crumbData_pathHistoryPointSets_01Params(packetHandle, value.pathHistoryPointSets_01, newPath);
      result = CheckLastError("BasicSafetyMessageVerbose", gkFuncRefGet, result);
    }
    break;
    case 1:
    {
      snprintf(newPath, elcount(newPath), "%s.%s", oldPath, "pathHistoryPointSets_02");
      SetBasicSafetyMessageVerbose_PathHistory_crumbData_pathHistoryPointSets_02Params(packetHandle, value.pathHistoryPointSets_02, newPath);
      result = CheckLastError("BasicSafetyMessageVerbose", gkFuncRefGet, result);
    }
    break;
    case 2:
    {
      snprintf(newPath, elcount(newPath), "%s.%s", oldPath, "pathHistoryPointSets_03");
      SetBasicSafetyMessageVerbose_PathHistory_crumbData_pathHistoryPointSets_03Params(packetHandle, value.pathHistoryPointSets_03, newPath);
      result = CheckLastError("BasicSafetyMessageVerbose", gkFuncRefGet, result);
    }
    break;
    case 3:
    {
      snprintf(newPath, elcount(newPath), "%s.%s", oldPath, "pathHistoryPointSets_04");
      SetBasicSafetyMessageVerbose_PathHistory_crumbData_pathHistoryPointSets_04Params(packetHandle, value.pathHistoryPointSets_04, newPath);
      result = CheckLastError("BasicSafetyMessageVerbose", gkFuncRefGet, result);
    }
    break;
    case 4:
    {
      snprintf(newPath, elcount(newPath), "%s.%s", oldPath, "pathHistoryPointSets_05");
      SetBasicSafetyMessageVerbose_PathHistory_crumbData_pathHistoryPointSets_05Params(packetHandle, value.pathHistoryPointSets_05, newPath);
      result = CheckLastError("BasicSafetyMessageVerbose", gkFuncRefGet, result);
    }
    break;
    case 5:
    {
      snprintf(newPath, elcount(newPath), "%s.%s", oldPath, "pathHistoryPointSets_06");
      SetBasicSafetyMessageVerbose_PathHistory_crumbData_pathHistoryPointSets_06Params(packetHandle, value.pathHistoryPointSets_06, newPath);
      result = CheckLastError("BasicSafetyMessageVerbose", gkFuncRefGet, result);
    }
    break;
    case 6:
    {
      snprintf(newPath, elcount(newPath), "%s.%s", oldPath, "pathHistoryPointSets_07");
      SetBasicSafetyMessageVerbose_PathHistory_crumbData_pathHistoryPointSets_07Params(packetHandle, value.pathHistoryPointSets_07, newPath);
      result = CheckLastError("BasicSafetyMessageVerbose", gkFuncRefGet, result);
    }
    break;
    case 7:
    {
      snprintf(newPath, elcount(newPath), "%s.%s", oldPath, "pathHistoryPointSets_08");
      SetBasicSafetyMessageVerbose_PathHistory_crumbData_pathHistoryPointSets_08Params(packetHandle, value.pathHistoryPointSets_08, newPath);
      result = CheckLastError("BasicSafetyMessageVerbose", gkFuncRefGet, result);
    }
    break;
    case 8:
    {
      snprintf(newPath, elcount(newPath), "%s.%s", oldPath, "pathHistoryPointSets_09");
      SetBasicSafetyMessageVerbose_PathHistory_crumbData_pathHistoryPointSets_09Params(packetHandle, value.pathHistoryPointSets_09, newPath);
      result = CheckLastError("BasicSafetyMessageVerbose", gkFuncRefGet, result);
    }
    break;
    case 9:
    {
      snprintf(newPath, elcount(newPath), "%s.%s", oldPath, "pathHistoryPointSets_10");
      SetBasicSafetyMessageVerbose_PathHistory_crumbData_pathHistoryPointSets_10Params(packetHandle, value.pathHistoryPointSets_10, newPath);
      result = CheckLastError("BasicSafetyMessageVerbose", gkFuncRefGet, result);
    }
    break;
  }
  return result;
}

int GetBasicSafetyMessageVerbosePathHistoryParams(LONG packetHandle, struct BasicSafetyMessageVerbosePathHistory value, char oldPath[])
{
  char newPath[300]; 
  int j;
  int result;

  result = 0;

  snprintf(newPath, elcount(newPath), "%s.%s", oldPath, "initialPosition");
  value.initialPosition.isValidFlag = C2xIsTokenAvailable(packetHandle, "BasicSafetyMessageVerbose", newPath);
  if(value.initialPosition.isValidFlag==1)
  {
    GetBasicSafetyMessageVerboseFullPositionVectorParams(packetHandle, value.initialPosition, newPath);
    result = CheckLastError("BasicSafetyMessageVerbose", gkFuncRefGet, result);
  }
  snprintf(newPath, elcount(newPath), "%s.%s", oldPath, "currGPSstatus");
  value.currGPSstatus.isValidFlag = C2xIsTokenAvailable(packetHandle, "BasicSafetyMessageVerbose", newPath);
  if(value.currGPSstatus.isValidFlag==1)
  {
    value.currGPSstatus.isValidFlag = 1;
    value.currGPSstatus.stringLength = C2xGetTokenLengthBit(packetHandle, "BasicSafetyMessageVerbose", newPath);
    if ((result = CheckLastError("BasicSafetyMessageVerbose", gkFuncRefGet, result))==0)
    {
      for(j=0; j<value.currGPSstatus.stringLength; j++)
      {
        if(C2xGetTokenBitOfBitString(packetHandle, "BasicSafetyMessageVerbose", newPath, j) == 0)
        {
          value.currGPSstatus.string[j] = '0';
        }
        else
        {
          value.currGPSstatus.string[j] = '1';
        }
        result = CheckLastError("BasicSafetyMessageVerbose", gkFuncRefGet, result);
      }
    }

  }
  snprintf(newPath, elcount(newPath), "%s.%s", oldPath, "itemCnt");
  value.itemCnt.isValidFlag = C2xIsTokenAvailable(packetHandle, "BasicSafetyMessageVerbose", newPath);
  if(value.itemCnt.isValidFlag==1)
  {
    value.itemCnt.value = C2xGetTokenInt(packetHandle, "BasicSafetyMessageVerbose", newPath);
    result = CheckLastError("BasicSafetyMessageVerbose", gkFuncRefGet, result);
  }
  snprintf(newPath, elcount(newPath), "%s.%s", oldPath, "crumbData");
  GetBasicSafetyMessageVerbose_PathHistory_crumbDataParams(packetHandle, value.crumbData, newPath);
  result = CheckLastError("BasicSafetyMessageVerbose", gkFuncRefGet, result);

  return result;
}

int SetBasicSafetyMessageVerbosePathHistoryParams(LONG packetHandle, struct BasicSafetyMessageVerbosePathHistory value, char oldPath[])
{
  char newPath[300]; 
  int j;
  int result;

  result = 0;

  snprintf(newPath, elcount(newPath), "%s.%s", oldPath, "initialPosition");
  if(value.initialPosition.isValidFlag==1)
  {
    SetBasicSafetyMessageVerboseFullPositionVectorParams(packetHandle, value.initialPosition, newPath);
    result = CheckLastError("BasicSafetyMessageVerbose", gkFuncRefGet, result);
  }
  else
  {
    if( C2xIsTokenAvailable(packetHandle, "BasicSafetyMessageVerbose", newPath) )
    {
      C2xRemoveToken(packetHandle, "BasicSafetyMessageVerbose", newPath);
    }
  }

  snprintf(newPath, elcount(newPath), "%s.%s", oldPath, "currGPSstatus");
  if(value.currGPSstatus.isValidFlag==1)
  {
      for(j=0; j<value.currGPSstatus.stringLength; j++)
      {
        if(value.currGPSstatus.string[j] == '0')
        {
          C2xSetTokenBitOfBitString(packetHandle, "BasicSafetyMessageVerbose", newPath, j, 0);
        }
        else
        {
          C2xSetTokenBitOfBitString(packetHandle, "BasicSafetyMessageVerbose", newPath, j, 1);
        }
        result = CheckLastError("BasicSafetyMessageVerbose", gkFuncRefGet, result);
      }
  }
  else
  {
    if( C2xIsTokenAvailable(packetHandle, "BasicSafetyMessageVerbose", newPath) )
    {
      C2xRemoveToken(packetHandle, "BasicSafetyMessageVerbose", newPath);
    }
  }

  snprintf(newPath, elcount(newPath), "%s.%s", oldPath, "itemCnt");
  if(value.itemCnt.isValidFlag==1)
  {
    C2xSetTokenInt(packetHandle, "BasicSafetyMessageVerbose", newPath, value.itemCnt.value);
    result = CheckLastError("BasicSafetyMessageVerbose", gkFuncRefGet, result);
  }
  else
  {
    if( C2xIsTokenAvailable(packetHandle, "BasicSafetyMessageVerbose", newPath) )
    {
      C2xRemoveToken(packetHandle, "BasicSafetyMessageVerbose", newPath);
    }
  }

  snprintf(newPath, elcount(newPath), "%s.%s", oldPath, "crumbData");
  SetBasicSafetyMessageVerbose_PathHistory_crumbDataParams(packetHandle, value.crumbData, newPath);
  result = CheckLastError("BasicSafetyMessageVerbose", gkFuncRefGet, result);

  return result;
}

int GetBasicSafetyMessageVerbosePathPredictionParams(LONG packetHandle, struct BasicSafetyMessageVerbosePathPrediction value, char oldPath[])
{
  char newPath[300];
  int result;

  result = 0;

  snprintf(newPath, elcount(newPath), "%s.%s", oldPath, "radiusOfCurve");
  value.radiusOfCurve = C2xGetTokenInt(packetHandle, "BasicSafetyMessageVerbose", newPath);
  result = CheckLastError("BasicSafetyMessageVerbose", gkFuncRefGet, result);

  snprintf(newPath, elcount(newPath), "%s.%s", oldPath, "confidence");
  value.confidence = C2xGetTokenInt(packetHandle, "BasicSafetyMessageVerbose", newPath);
  result = CheckLastError("BasicSafetyMessageVerbose", gkFuncRefGet, result);

  return result;
}

int SetBasicSafetyMessageVerbosePathPredictionParams(LONG packetHandle, struct BasicSafetyMessageVerbosePathPrediction value, char oldPath[])
{
  char newPath[300];
  int result;

  result = 0;

  snprintf(newPath, elcount(newPath), "%s.%s", oldPath, "radiusOfCurve");
  C2xSetTokenInt(packetHandle, "BasicSafetyMessageVerbose", newPath, value.radiusOfCurve);
  result = CheckLastError("BasicSafetyMessageVerbose", gkFuncRefGet, result);

  snprintf(newPath, elcount(newPath), "%s.%s", oldPath, "confidence");
  C2xSetTokenInt(packetHandle, "BasicSafetyMessageVerbose", newPath, value.confidence);
  result = CheckLastError("BasicSafetyMessageVerbose", gkFuncRefGet, result);

  return result;
}

int GetBasicSafetyMessageVerbose_Blob_AntennaOffsetSetParams(LONG packetHandle, struct BasicSafetyMessageVerbose_Blob_AntennaOffsetSet value, char oldPath[])
{
  char newPath[300];
  int result;

  result = 0;

  snprintf(newPath, elcount(newPath), "%s.%s", oldPath, "antOffsetX");
  value.antOffsetX = C2xGetTokenInt(packetHandle, "BasicSafetyMessageVerbose", newPath);
  result = CheckLastError("BasicSafetyMessageVerbose", gkFuncRefGet, result);

  snprintf(newPath, elcount(newPath), "%s.%s", oldPath, "antOffsetY");
  value.antOffsetY = C2xGetTokenInt(packetHandle, "BasicSafetyMessageVerbose", newPath);
  result = CheckLastError("BasicSafetyMessageVerbose", gkFuncRefGet, result);

  snprintf(newPath, elcount(newPath), "%s.%s", oldPath, "antOffsetZ");
  value.antOffsetZ = C2xGetTokenInt(packetHandle, "BasicSafetyMessageVerbose", newPath);
  result = CheckLastError("BasicSafetyMessageVerbose", gkFuncRefGet, result);

  return result;
}

int SetBasicSafetyMessageVerbose_Blob_AntennaOffsetSetParams(LONG packetHandle, struct BasicSafetyMessageVerbose_Blob_AntennaOffsetSet value, char oldPath[])
{
  char newPath[300];
  int result;

  result = 0;

  snprintf(newPath, elcount(newPath), "%s.%s", oldPath, "antOffsetX");
  C2xSetTokenInt(packetHandle, "BasicSafetyMessageVerbose", newPath, value.antOffsetX);
  result = CheckLastError("BasicSafetyMessageVerbose", gkFuncRefGet, result);

  snprintf(newPath, elcount(newPath), "%s.%s", oldPath, "antOffsetY");
  C2xSetTokenInt(packetHandle, "BasicSafetyMessageVerbose", newPath, value.antOffsetY);
  result = CheckLastError("BasicSafetyMessageVerbose", gkFuncRefGet, result);

  snprintf(newPath, elcount(newPath), "%s.%s", oldPath, "antOffsetZ");
  C2xSetTokenInt(packetHandle, "BasicSafetyMessageVerbose", newPath, value.antOffsetZ);
  result = CheckLastError("BasicSafetyMessageVerbose", gkFuncRefGet, result);

  return result;
}

int GetBasicSafetyMessageVerbose_Blob_RTCMHeaderParams(LONG packetHandle, struct BasicSafetyMessageVerbose_Blob_RTCMHeader value, char oldPath[])
{
  char newPath[300]; 
  int j;
  int result;

  result = 0;

  snprintf(newPath, elcount(newPath), "%s.%s", oldPath, "status");
  value.status.isValidFlag = 1;
  value.status.stringLength = C2xGetTokenLengthBit(packetHandle, "BasicSafetyMessageVerbose", newPath);
  if ((result = CheckLastError("BasicSafetyMessageVerbose", gkFuncRefGet, result))==0)
  {
    for(j=0; j<value.status.stringLength; j++)
    {
      if(C2xGetTokenBitOfBitString(packetHandle, "BasicSafetyMessageVerbose", newPath, j) == 0)
      {
        value.status.string[j] = '0';
      }
      else
      {
        value.status.string[j] = '1';
      }
      result = CheckLastError("BasicSafetyMessageVerbose", gkFuncRefGet, result);
    }
  }

  snprintf(newPath, elcount(newPath), "%s.%s", oldPath, "offsetSet");
  GetBasicSafetyMessageVerbose_Blob_AntennaOffsetSetParams(packetHandle, value.offsetSet, newPath);
  result = CheckLastError("BasicSafetyMessageVerbose", gkFuncRefGet, result);

  return result;
}

int SetBasicSafetyMessageVerbose_Blob_RTCMHeaderParams(LONG packetHandle, struct BasicSafetyMessageVerbose_Blob_RTCMHeader value, char oldPath[])
{
  char newPath[300]; 
  int j;
  int result;

  result = 0;

  snprintf(newPath, elcount(newPath), "%s.%s", oldPath, "status");
    for(j=0; j<value.status.stringLength; j++)
    {
      if(value.status.string[j] == '0')
      {
        C2xSetTokenBitOfBitString(packetHandle, "BasicSafetyMessageVerbose", newPath, j, 0);
      }
      else
      {
        C2xSetTokenBitOfBitString(packetHandle, "BasicSafetyMessageVerbose", newPath, j, 1);
      }
      result = CheckLastError("BasicSafetyMessageVerbose", gkFuncRefGet, result);
    }

  snprintf(newPath, elcount(newPath), "%s.%s", oldPath, "offsetSet");
  SetBasicSafetyMessageVerbose_Blob_AntennaOffsetSetParams(packetHandle, value.offsetSet, newPath);
  result = CheckLastError("BasicSafetyMessageVerbose", gkFuncRefGet, result);

  return result;
}

int GetBasicSafetyMessageVerboseRTCMHeaderParams(LONG packetHandle, struct BasicSafetyMessageVerboseRTCMHeader value, char oldPath[])
{
  char newPath[300];
  int result;

  result = 0;

  snprintf(newPath, elcount(newPath), "%s.%s", oldPath, "_Blob_RTCMHeader");
  GetBasicSafetyMessageVerbose_Blob_RTCMHeaderParams(packetHandle, value._Blob_RTCMHeader, newPath);
  result = CheckLastError("BasicSafetyMessageVerbose", gkFuncRefGet, result);

  return result;
}

int SetBasicSafetyMessageVerboseRTCMHeaderParams(LONG packetHandle, struct BasicSafetyMessageVerboseRTCMHeader value, char oldPath[])
{
  char newPath[300];
  int result;

  result = 0;

  snprintf(newPath, elcount(newPath), "%s.%s", oldPath, "_Blob_RTCMHeader");
  SetBasicSafetyMessageVerbose_Blob_RTCMHeaderParams(packetHandle, value._Blob_RTCMHeader, newPath);
  result = CheckLastError("BasicSafetyMessageVerbose", gkFuncRefGet, result);

  return result;
}

int GetBasicSafetyMessageVerboseRTCMPackageParams(LONG packetHandle, struct BasicSafetyMessageVerboseRTCMPackage value, char oldPath[])
{
  char newPath[300];
  int result;

  result = 0;

  snprintf(newPath, elcount(newPath), "%s.%s", oldPath, "anchorPoint");
  value.anchorPoint.isValidFlag = C2xIsTokenAvailable(packetHandle, "BasicSafetyMessageVerbose", newPath);
  if(value.anchorPoint.isValidFlag==1)
  {
    GetBasicSafetyMessageVerboseFullPositionVectorParams(packetHandle, value.anchorPoint, newPath);
    result = CheckLastError("BasicSafetyMessageVerbose", gkFuncRefGet, result);
  }
  snprintf(newPath, elcount(newPath), "%s.%s", oldPath, "rtcmHeader");
  value.rtcmHeader.stringLength = C2xGetTokenData(packetHandle, "BasicSafetyMessageVerbose", newPath, elcount(value.rtcmHeader.string), value.rtcmHeader.string);
  snprintf(newPath, elcount(newPath), "%s.%s", oldPath, "msg1001");
  value.msg1001.isValidFlag = C2xIsTokenAvailable(packetHandle, "BasicSafetyMessageVerbose", newPath);
  if(value.msg1001.isValidFlag==1)
  {
    value.msg1001.isValidFlag = 1;
    value.msg1001.stringLength = C2xGetTokenData(packetHandle, "BasicSafetyMessageVerbose", newPath, elcount(value.msg1001.string), value.msg1001.string);
  }
  snprintf(newPath, elcount(newPath), "%s.%s", oldPath, "msg1002");
  value.msg1002.isValidFlag = C2xIsTokenAvailable(packetHandle, "BasicSafetyMessageVerbose", newPath);
  if(value.msg1002.isValidFlag==1)
  {
    value.msg1002.isValidFlag = 1;
    value.msg1002.stringLength = C2xGetTokenData(packetHandle, "BasicSafetyMessageVerbose", newPath, elcount(value.msg1002.string), value.msg1002.string);
  }
  snprintf(newPath, elcount(newPath), "%s.%s", oldPath, "msg1003");
  value.msg1003.isValidFlag = C2xIsTokenAvailable(packetHandle, "BasicSafetyMessageVerbose", newPath);
  if(value.msg1003.isValidFlag==1)
  {
    value.msg1003.isValidFlag = 1;
    value.msg1003.stringLength = C2xGetTokenData(packetHandle, "BasicSafetyMessageVerbose", newPath, elcount(value.msg1003.string), value.msg1003.string);
  }
  snprintf(newPath, elcount(newPath), "%s.%s", oldPath, "msg1004");
  value.msg1004.isValidFlag = C2xIsTokenAvailable(packetHandle, "BasicSafetyMessageVerbose", newPath);
  if(value.msg1004.isValidFlag==1)
  {
    value.msg1004.isValidFlag = 1;
    value.msg1004.stringLength = C2xGetTokenData(packetHandle, "BasicSafetyMessageVerbose", newPath, elcount(value.msg1004.string), value.msg1004.string);
  }
  snprintf(newPath, elcount(newPath), "%s.%s", oldPath, "msg1005");
  value.msg1005.isValidFlag = C2xIsTokenAvailable(packetHandle, "BasicSafetyMessageVerbose", newPath);
  if(value.msg1005.isValidFlag==1)
  {
    value.msg1005.isValidFlag = 1;
    value.msg1005.stringLength = C2xGetTokenData(packetHandle, "BasicSafetyMessageVerbose", newPath, elcount(value.msg1005.string), value.msg1005.string);
  }
  snprintf(newPath, elcount(newPath), "%s.%s", oldPath, "msg1006");
  value.msg1006.isValidFlag = C2xIsTokenAvailable(packetHandle, "BasicSafetyMessageVerbose", newPath);
  if(value.msg1006.isValidFlag==1)
  {
    value.msg1006.isValidFlag = 1;
    value.msg1006.stringLength = C2xGetTokenData(packetHandle, "BasicSafetyMessageVerbose", newPath, elcount(value.msg1006.string), value.msg1006.string);
  }
  snprintf(newPath, elcount(newPath), "%s.%s", oldPath, "msg1007");
  value.msg1007.isValidFlag = C2xIsTokenAvailable(packetHandle, "BasicSafetyMessageVerbose", newPath);
  if(value.msg1007.isValidFlag==1)
  {
    value.msg1007.isValidFlag = 1;
    value.msg1007.stringLength = C2xGetTokenData(packetHandle, "BasicSafetyMessageVerbose", newPath, elcount(value.msg1007.string), value.msg1007.string);
  }
  snprintf(newPath, elcount(newPath), "%s.%s", oldPath, "msg1008");
  value.msg1008.isValidFlag = C2xIsTokenAvailable(packetHandle, "BasicSafetyMessageVerbose", newPath);
  if(value.msg1008.isValidFlag==1)
  {
    value.msg1008.isValidFlag = 1;
    value.msg1008.stringLength = C2xGetTokenData(packetHandle, "BasicSafetyMessageVerbose", newPath, elcount(value.msg1008.string), value.msg1008.string);
  }
  snprintf(newPath, elcount(newPath), "%s.%s", oldPath, "msg1009");
  value.msg1009.isValidFlag = C2xIsTokenAvailable(packetHandle, "BasicSafetyMessageVerbose", newPath);
  if(value.msg1009.isValidFlag==1)
  {
    value.msg1009.isValidFlag = 1;
    value.msg1009.stringLength = C2xGetTokenData(packetHandle, "BasicSafetyMessageVerbose", newPath, elcount(value.msg1009.string), value.msg1009.string);
  }
  snprintf(newPath, elcount(newPath), "%s.%s", oldPath, "msg1010");
  value.msg1010.isValidFlag = C2xIsTokenAvailable(packetHandle, "BasicSafetyMessageVerbose", newPath);
  if(value.msg1010.isValidFlag==1)
  {
    value.msg1010.isValidFlag = 1;
    value.msg1010.stringLength = C2xGetTokenData(packetHandle, "BasicSafetyMessageVerbose", newPath, elcount(value.msg1010.string), value.msg1010.string);
  }
  snprintf(newPath, elcount(newPath), "%s.%s", oldPath, "msg1011");
  value.msg1011.isValidFlag = C2xIsTokenAvailable(packetHandle, "BasicSafetyMessageVerbose", newPath);
  if(value.msg1011.isValidFlag==1)
  {
    value.msg1011.isValidFlag = 1;
    value.msg1011.stringLength = C2xGetTokenData(packetHandle, "BasicSafetyMessageVerbose", newPath, elcount(value.msg1011.string), value.msg1011.string);
  }
  snprintf(newPath, elcount(newPath), "%s.%s", oldPath, "msg1012");
  value.msg1012.isValidFlag = C2xIsTokenAvailable(packetHandle, "BasicSafetyMessageVerbose", newPath);
  if(value.msg1012.isValidFlag==1)
  {
    value.msg1012.isValidFlag = 1;
    value.msg1012.stringLength = C2xGetTokenData(packetHandle, "BasicSafetyMessageVerbose", newPath, elcount(value.msg1012.string), value.msg1012.string);
  }
  snprintf(newPath, elcount(newPath), "%s.%s", oldPath, "msg1013");
  value.msg1013.isValidFlag = C2xIsTokenAvailable(packetHandle, "BasicSafetyMessageVerbose", newPath);
  if(value.msg1013.isValidFlag==1)
  {
    value.msg1013.isValidFlag = 1;
    value.msg1013.stringLength = C2xGetTokenData(packetHandle, "BasicSafetyMessageVerbose", newPath, elcount(value.msg1013.string), value.msg1013.string);
  }
  snprintf(newPath, elcount(newPath), "%s.%s", oldPath, "msg1014");
  value.msg1014.isValidFlag = C2xIsTokenAvailable(packetHandle, "BasicSafetyMessageVerbose", newPath);
  if(value.msg1014.isValidFlag==1)
  {
    value.msg1014.isValidFlag = 1;
    value.msg1014.stringLength = C2xGetTokenData(packetHandle, "BasicSafetyMessageVerbose", newPath, elcount(value.msg1014.string), value.msg1014.string);
  }
  snprintf(newPath, elcount(newPath), "%s.%s", oldPath, "msg1015");
  value.msg1015.isValidFlag = C2xIsTokenAvailable(packetHandle, "BasicSafetyMessageVerbose", newPath);
  if(value.msg1015.isValidFlag==1)
  {
    value.msg1015.isValidFlag = 1;
    value.msg1015.stringLength = C2xGetTokenData(packetHandle, "BasicSafetyMessageVerbose", newPath, elcount(value.msg1015.string), value.msg1015.string);
  }
  snprintf(newPath, elcount(newPath), "%s.%s", oldPath, "msg1016");
  value.msg1016.isValidFlag = C2xIsTokenAvailable(packetHandle, "BasicSafetyMessageVerbose", newPath);
  if(value.msg1016.isValidFlag==1)
  {
    value.msg1016.isValidFlag = 1;
    value.msg1016.stringLength = C2xGetTokenData(packetHandle, "BasicSafetyMessageVerbose", newPath, elcount(value.msg1016.string), value.msg1016.string);
  }
  snprintf(newPath, elcount(newPath), "%s.%s", oldPath, "msg1017");
  value.msg1017.isValidFlag = C2xIsTokenAvailable(packetHandle, "BasicSafetyMessageVerbose", newPath);
  if(value.msg1017.isValidFlag==1)
  {
    value.msg1017.isValidFlag = 1;
    value.msg1017.stringLength = C2xGetTokenData(packetHandle, "BasicSafetyMessageVerbose", newPath, elcount(value.msg1017.string), value.msg1017.string);
  }
  snprintf(newPath, elcount(newPath), "%s.%s", oldPath, "msg1019");
  value.msg1019.isValidFlag = C2xIsTokenAvailable(packetHandle, "BasicSafetyMessageVerbose", newPath);
  if(value.msg1019.isValidFlag==1)
  {
    value.msg1019.isValidFlag = 1;
    value.msg1019.stringLength = C2xGetTokenData(packetHandle, "BasicSafetyMessageVerbose", newPath, elcount(value.msg1019.string), value.msg1019.string);
  }
  snprintf(newPath, elcount(newPath), "%s.%s", oldPath, "msg1020");
  value.msg1020.isValidFlag = C2xIsTokenAvailable(packetHandle, "BasicSafetyMessageVerbose", newPath);
  if(value.msg1020.isValidFlag==1)
  {
    value.msg1020.isValidFlag = 1;
    value.msg1020.stringLength = C2xGetTokenData(packetHandle, "BasicSafetyMessageVerbose", newPath, elcount(value.msg1020.string), value.msg1020.string);
  }
  snprintf(newPath, elcount(newPath), "%s.%s", oldPath, "msg1021");
  value.msg1021.isValidFlag = C2xIsTokenAvailable(packetHandle, "BasicSafetyMessageVerbose", newPath);
  if(value.msg1021.isValidFlag==1)
  {
    value.msg1021.isValidFlag = 1;
    value.msg1021.stringLength = C2xGetTokenData(packetHandle, "BasicSafetyMessageVerbose", newPath, elcount(value.msg1021.string), value.msg1021.string);
  }
  snprintf(newPath, elcount(newPath), "%s.%s", oldPath, "msg1022");
  value.msg1022.isValidFlag = C2xIsTokenAvailable(packetHandle, "BasicSafetyMessageVerbose", newPath);
  if(value.msg1022.isValidFlag==1)
  {
    value.msg1022.isValidFlag = 1;
    value.msg1022.stringLength = C2xGetTokenData(packetHandle, "BasicSafetyMessageVerbose", newPath, elcount(value.msg1022.string), value.msg1022.string);
  }
  snprintf(newPath, elcount(newPath), "%s.%s", oldPath, "msg1023");
  value.msg1023.isValidFlag = C2xIsTokenAvailable(packetHandle, "BasicSafetyMessageVerbose", newPath);
  if(value.msg1023.isValidFlag==1)
  {
    value.msg1023.isValidFlag = 1;
    value.msg1023.stringLength = C2xGetTokenData(packetHandle, "BasicSafetyMessageVerbose", newPath, elcount(value.msg1023.string), value.msg1023.string);
  }
  snprintf(newPath, elcount(newPath), "%s.%s", oldPath, "msg1024");
  value.msg1024.isValidFlag = C2xIsTokenAvailable(packetHandle, "BasicSafetyMessageVerbose", newPath);
  if(value.msg1024.isValidFlag==1)
  {
    value.msg1024.isValidFlag = 1;
    value.msg1024.stringLength = C2xGetTokenData(packetHandle, "BasicSafetyMessageVerbose", newPath, elcount(value.msg1024.string), value.msg1024.string);
  }
  snprintf(newPath, elcount(newPath), "%s.%s", oldPath, "msg1025");
  value.msg1025.isValidFlag = C2xIsTokenAvailable(packetHandle, "BasicSafetyMessageVerbose", newPath);
  if(value.msg1025.isValidFlag==1)
  {
    value.msg1025.isValidFlag = 1;
    value.msg1025.stringLength = C2xGetTokenData(packetHandle, "BasicSafetyMessageVerbose", newPath, elcount(value.msg1025.string), value.msg1025.string);
  }
  snprintf(newPath, elcount(newPath), "%s.%s", oldPath, "msg1026");
  value.msg1026.isValidFlag = C2xIsTokenAvailable(packetHandle, "BasicSafetyMessageVerbose", newPath);
  if(value.msg1026.isValidFlag==1)
  {
    value.msg1026.isValidFlag = 1;
    value.msg1026.stringLength = C2xGetTokenData(packetHandle, "BasicSafetyMessageVerbose", newPath, elcount(value.msg1026.string), value.msg1026.string);
  }
  snprintf(newPath, elcount(newPath), "%s.%s", oldPath, "msg1027");
  value.msg1027.isValidFlag = C2xIsTokenAvailable(packetHandle, "BasicSafetyMessageVerbose", newPath);
  if(value.msg1027.isValidFlag==1)
  {
    value.msg1027.isValidFlag = 1;
    value.msg1027.stringLength = C2xGetTokenData(packetHandle, "BasicSafetyMessageVerbose", newPath, elcount(value.msg1027.string), value.msg1027.string);
  }
  snprintf(newPath, elcount(newPath), "%s.%s", oldPath, "msg1029");
  value.msg1029.isValidFlag = C2xIsTokenAvailable(packetHandle, "BasicSafetyMessageVerbose", newPath);
  if(value.msg1029.isValidFlag==1)
  {
    value.msg1029.isValidFlag = 1;
    value.msg1029.stringLength = C2xGetTokenData(packetHandle, "BasicSafetyMessageVerbose", newPath, elcount(value.msg1029.string), value.msg1029.string);
  }
  snprintf(newPath, elcount(newPath), "%s.%s", oldPath, "msg1030");
  value.msg1030.isValidFlag = C2xIsTokenAvailable(packetHandle, "BasicSafetyMessageVerbose", newPath);
  if(value.msg1030.isValidFlag==1)
  {
    value.msg1030.isValidFlag = 1;
    value.msg1030.stringLength = C2xGetTokenData(packetHandle, "BasicSafetyMessageVerbose", newPath, elcount(value.msg1030.string), value.msg1030.string);
  }
  snprintf(newPath, elcount(newPath), "%s.%s", oldPath, "msg1031");
  value.msg1031.isValidFlag = C2xIsTokenAvailable(packetHandle, "BasicSafetyMessageVerbose", newPath);
  if(value.msg1031.isValidFlag==1)
  {
    value.msg1031.isValidFlag = 1;
    value.msg1031.stringLength = C2xGetTokenData(packetHandle, "BasicSafetyMessageVerbose", newPath, elcount(value.msg1031.string), value.msg1031.string);
  }
  snprintf(newPath, elcount(newPath), "%s.%s", oldPath, "msg1032");
  value.msg1032.isValidFlag = C2xIsTokenAvailable(packetHandle, "BasicSafetyMessageVerbose", newPath);
  if(value.msg1032.isValidFlag==1)
  {
    value.msg1032.isValidFlag = 1;
    value.msg1032.stringLength = C2xGetTokenData(packetHandle, "BasicSafetyMessageVerbose", newPath, elcount(value.msg1032.string), value.msg1032.string);
  }
  return result;
}

int SetBasicSafetyMessageVerboseRTCMPackageParams(LONG packetHandle, struct BasicSafetyMessageVerboseRTCMPackage value, char oldPath[])
{
  char newPath[300];
  int result;

  result = 0;

  snprintf(newPath, elcount(newPath), "%s.%s", oldPath, "anchorPoint");
  if(value.anchorPoint.isValidFlag==1)
  {
    SetBasicSafetyMessageVerboseFullPositionVectorParams(packetHandle, value.anchorPoint, newPath);
    result = CheckLastError("BasicSafetyMessageVerbose", gkFuncRefGet, result);
  }
  else
  {
    if( C2xIsTokenAvailable(packetHandle, "BasicSafetyMessageVerbose", newPath) )
    {
      C2xRemoveToken(packetHandle, "BasicSafetyMessageVerbose", newPath);
    }
  }

  snprintf(newPath, elcount(newPath), "%s.%s", oldPath, "rtcmHeader");
  C2xSetTokenData(packetHandle, "BasicSafetyMessageVerbose", newPath, value.rtcmHeader.stringLength, value.rtcmHeader.string);

  snprintf(newPath, elcount(newPath), "%s.%s", oldPath, "msg1001");
  if(value.msg1001.isValidFlag==1)
  {
    C2xSetTokenData(packetHandle, "BasicSafetyMessageVerbose", newPath, value.msg1001.stringLength, value.msg1001.string);
  }
  else
  {
    if( C2xIsTokenAvailable(packetHandle, "BasicSafetyMessageVerbose", newPath) )
    {
      C2xRemoveToken(packetHandle, "BasicSafetyMessageVerbose", newPath);
    }
  }

  snprintf(newPath, elcount(newPath), "%s.%s", oldPath, "msg1002");
  if(value.msg1002.isValidFlag==1)
  {
    C2xSetTokenData(packetHandle, "BasicSafetyMessageVerbose", newPath, value.msg1002.stringLength, value.msg1002.string);
  }
  else
  {
    if( C2xIsTokenAvailable(packetHandle, "BasicSafetyMessageVerbose", newPath) )
    {
      C2xRemoveToken(packetHandle, "BasicSafetyMessageVerbose", newPath);
    }
  }

  snprintf(newPath, elcount(newPath), "%s.%s", oldPath, "msg1003");
  if(value.msg1003.isValidFlag==1)
  {
    C2xSetTokenData(packetHandle, "BasicSafetyMessageVerbose", newPath, value.msg1003.stringLength, value.msg1003.string);
  }
  else
  {
    if( C2xIsTokenAvailable(packetHandle, "BasicSafetyMessageVerbose", newPath) )
    {
      C2xRemoveToken(packetHandle, "BasicSafetyMessageVerbose", newPath);
    }
  }

  snprintf(newPath, elcount(newPath), "%s.%s", oldPath, "msg1004");
  if(value.msg1004.isValidFlag==1)
  {
    C2xSetTokenData(packetHandle, "BasicSafetyMessageVerbose", newPath, value.msg1004.stringLength, value.msg1004.string);
  }
  else
  {
    if( C2xIsTokenAvailable(packetHandle, "BasicSafetyMessageVerbose", newPath) )
    {
      C2xRemoveToken(packetHandle, "BasicSafetyMessageVerbose", newPath);
    }
  }

  snprintf(newPath, elcount(newPath), "%s.%s", oldPath, "msg1005");
  if(value.msg1005.isValidFlag==1)
  {
    C2xSetTokenData(packetHandle, "BasicSafetyMessageVerbose", newPath, value.msg1005.stringLength, value.msg1005.string);
  }
  else
  {
    if( C2xIsTokenAvailable(packetHandle, "BasicSafetyMessageVerbose", newPath) )
    {
      C2xRemoveToken(packetHandle, "BasicSafetyMessageVerbose", newPath);
    }
  }

  snprintf(newPath, elcount(newPath), "%s.%s", oldPath, "msg1006");
  if(value.msg1006.isValidFlag==1)
  {
    C2xSetTokenData(packetHandle, "BasicSafetyMessageVerbose", newPath, value.msg1006.stringLength, value.msg1006.string);
  }
  else
  {
    if( C2xIsTokenAvailable(packetHandle, "BasicSafetyMessageVerbose", newPath) )
    {
      C2xRemoveToken(packetHandle, "BasicSafetyMessageVerbose", newPath);
    }
  }

  snprintf(newPath, elcount(newPath), "%s.%s", oldPath, "msg1007");
  if(value.msg1007.isValidFlag==1)
  {
    C2xSetTokenData(packetHandle, "BasicSafetyMessageVerbose", newPath, value.msg1007.stringLength, value.msg1007.string);
  }
  else
  {
    if( C2xIsTokenAvailable(packetHandle, "BasicSafetyMessageVerbose", newPath) )
    {
      C2xRemoveToken(packetHandle, "BasicSafetyMessageVerbose", newPath);
    }
  }

  snprintf(newPath, elcount(newPath), "%s.%s", oldPath, "msg1008");
  if(value.msg1008.isValidFlag==1)
  {
    C2xSetTokenData(packetHandle, "BasicSafetyMessageVerbose", newPath, value.msg1008.stringLength, value.msg1008.string);
  }
  else
  {
    if( C2xIsTokenAvailable(packetHandle, "BasicSafetyMessageVerbose", newPath) )
    {
      C2xRemoveToken(packetHandle, "BasicSafetyMessageVerbose", newPath);
    }
  }

  snprintf(newPath, elcount(newPath), "%s.%s", oldPath, "msg1009");
  if(value.msg1009.isValidFlag==1)
  {
    C2xSetTokenData(packetHandle, "BasicSafetyMessageVerbose", newPath, value.msg1009.stringLength, value.msg1009.string);
  }
  else
  {
    if( C2xIsTokenAvailable(packetHandle, "BasicSafetyMessageVerbose", newPath) )
    {
      C2xRemoveToken(packetHandle, "BasicSafetyMessageVerbose", newPath);
    }
  }

  snprintf(newPath, elcount(newPath), "%s.%s", oldPath, "msg1010");
  if(value.msg1010.isValidFlag==1)
  {
    C2xSetTokenData(packetHandle, "BasicSafetyMessageVerbose", newPath, value.msg1010.stringLength, value.msg1010.string);
  }
  else
  {
    if( C2xIsTokenAvailable(packetHandle, "BasicSafetyMessageVerbose", newPath) )
    {
      C2xRemoveToken(packetHandle, "BasicSafetyMessageVerbose", newPath);
    }
  }

  snprintf(newPath, elcount(newPath), "%s.%s", oldPath, "msg1011");
  if(value.msg1011.isValidFlag==1)
  {
    C2xSetTokenData(packetHandle, "BasicSafetyMessageVerbose", newPath, value.msg1011.stringLength, value.msg1011.string);
  }
  else
  {
    if( C2xIsTokenAvailable(packetHandle, "BasicSafetyMessageVerbose", newPath) )
    {
      C2xRemoveToken(packetHandle, "BasicSafetyMessageVerbose", newPath);
    }
  }

  snprintf(newPath, elcount(newPath), "%s.%s", oldPath, "msg1012");
  if(value.msg1012.isValidFlag==1)
  {
    C2xSetTokenData(packetHandle, "BasicSafetyMessageVerbose", newPath, value.msg1012.stringLength, value.msg1012.string);
  }
  else
  {
    if( C2xIsTokenAvailable(packetHandle, "BasicSafetyMessageVerbose", newPath) )
    {
      C2xRemoveToken(packetHandle, "BasicSafetyMessageVerbose", newPath);
    }
  }

  snprintf(newPath, elcount(newPath), "%s.%s", oldPath, "msg1013");
  if(value.msg1013.isValidFlag==1)
  {
    C2xSetTokenData(packetHandle, "BasicSafetyMessageVerbose", newPath, value.msg1013.stringLength, value.msg1013.string);
  }
  else
  {
    if( C2xIsTokenAvailable(packetHandle, "BasicSafetyMessageVerbose", newPath) )
    {
      C2xRemoveToken(packetHandle, "BasicSafetyMessageVerbose", newPath);
    }
  }

  snprintf(newPath, elcount(newPath), "%s.%s", oldPath, "msg1014");
  if(value.msg1014.isValidFlag==1)
  {
    C2xSetTokenData(packetHandle, "BasicSafetyMessageVerbose", newPath, value.msg1014.stringLength, value.msg1014.string);
  }
  else
  {
    if( C2xIsTokenAvailable(packetHandle, "BasicSafetyMessageVerbose", newPath) )
    {
      C2xRemoveToken(packetHandle, "BasicSafetyMessageVerbose", newPath);
    }
  }

  snprintf(newPath, elcount(newPath), "%s.%s", oldPath, "msg1015");
  if(value.msg1015.isValidFlag==1)
  {
    C2xSetTokenData(packetHandle, "BasicSafetyMessageVerbose", newPath, value.msg1015.stringLength, value.msg1015.string);
  }
  else
  {
    if( C2xIsTokenAvailable(packetHandle, "BasicSafetyMessageVerbose", newPath) )
    {
      C2xRemoveToken(packetHandle, "BasicSafetyMessageVerbose", newPath);
    }
  }

  snprintf(newPath, elcount(newPath), "%s.%s", oldPath, "msg1016");
  if(value.msg1016.isValidFlag==1)
  {
    C2xSetTokenData(packetHandle, "BasicSafetyMessageVerbose", newPath, value.msg1016.stringLength, value.msg1016.string);
  }
  else
  {
    if( C2xIsTokenAvailable(packetHandle, "BasicSafetyMessageVerbose", newPath) )
    {
      C2xRemoveToken(packetHandle, "BasicSafetyMessageVerbose", newPath);
    }
  }

  snprintf(newPath, elcount(newPath), "%s.%s", oldPath, "msg1017");
  if(value.msg1017.isValidFlag==1)
  {
    C2xSetTokenData(packetHandle, "BasicSafetyMessageVerbose", newPath, value.msg1017.stringLength, value.msg1017.string);
  }
  else
  {
    if( C2xIsTokenAvailable(packetHandle, "BasicSafetyMessageVerbose", newPath) )
    {
      C2xRemoveToken(packetHandle, "BasicSafetyMessageVerbose", newPath);
    }
  }

  snprintf(newPath, elcount(newPath), "%s.%s", oldPath, "msg1019");
  if(value.msg1019.isValidFlag==1)
  {
    C2xSetTokenData(packetHandle, "BasicSafetyMessageVerbose", newPath, value.msg1019.stringLength, value.msg1019.string);
  }
  else
  {
    if( C2xIsTokenAvailable(packetHandle, "BasicSafetyMessageVerbose", newPath) )
    {
      C2xRemoveToken(packetHandle, "BasicSafetyMessageVerbose", newPath);
    }
  }

  snprintf(newPath, elcount(newPath), "%s.%s", oldPath, "msg1020");
  if(value.msg1020.isValidFlag==1)
  {
    C2xSetTokenData(packetHandle, "BasicSafetyMessageVerbose", newPath, value.msg1020.stringLength, value.msg1020.string);
  }
  else
  {
    if( C2xIsTokenAvailable(packetHandle, "BasicSafetyMessageVerbose", newPath) )
    {
      C2xRemoveToken(packetHandle, "BasicSafetyMessageVerbose", newPath);
    }
  }

  snprintf(newPath, elcount(newPath), "%s.%s", oldPath, "msg1021");
  if(value.msg1021.isValidFlag==1)
  {
    C2xSetTokenData(packetHandle, "BasicSafetyMessageVerbose", newPath, value.msg1021.stringLength, value.msg1021.string);
  }
  else
  {
    if( C2xIsTokenAvailable(packetHandle, "BasicSafetyMessageVerbose", newPath) )
    {
      C2xRemoveToken(packetHandle, "BasicSafetyMessageVerbose", newPath);
    }
  }

  snprintf(newPath, elcount(newPath), "%s.%s", oldPath, "msg1022");
  if(value.msg1022.isValidFlag==1)
  {
    C2xSetTokenData(packetHandle, "BasicSafetyMessageVerbose", newPath, value.msg1022.stringLength, value.msg1022.string);
  }
  else
  {
    if( C2xIsTokenAvailable(packetHandle, "BasicSafetyMessageVerbose", newPath) )
    {
      C2xRemoveToken(packetHandle, "BasicSafetyMessageVerbose", newPath);
    }
  }

  snprintf(newPath, elcount(newPath), "%s.%s", oldPath, "msg1023");
  if(value.msg1023.isValidFlag==1)
  {
    C2xSetTokenData(packetHandle, "BasicSafetyMessageVerbose", newPath, value.msg1023.stringLength, value.msg1023.string);
  }
  else
  {
    if( C2xIsTokenAvailable(packetHandle, "BasicSafetyMessageVerbose", newPath) )
    {
      C2xRemoveToken(packetHandle, "BasicSafetyMessageVerbose", newPath);
    }
  }

  snprintf(newPath, elcount(newPath), "%s.%s", oldPath, "msg1024");
  if(value.msg1024.isValidFlag==1)
  {
    C2xSetTokenData(packetHandle, "BasicSafetyMessageVerbose", newPath, value.msg1024.stringLength, value.msg1024.string);
  }
  else
  {
    if( C2xIsTokenAvailable(packetHandle, "BasicSafetyMessageVerbose", newPath) )
    {
      C2xRemoveToken(packetHandle, "BasicSafetyMessageVerbose", newPath);
    }
  }

  snprintf(newPath, elcount(newPath), "%s.%s", oldPath, "msg1025");
  if(value.msg1025.isValidFlag==1)
  {
    C2xSetTokenData(packetHandle, "BasicSafetyMessageVerbose", newPath, value.msg1025.stringLength, value.msg1025.string);
  }
  else
  {
    if( C2xIsTokenAvailable(packetHandle, "BasicSafetyMessageVerbose", newPath) )
    {
      C2xRemoveToken(packetHandle, "BasicSafetyMessageVerbose", newPath);
    }
  }

  snprintf(newPath, elcount(newPath), "%s.%s", oldPath, "msg1026");
  if(value.msg1026.isValidFlag==1)
  {
    C2xSetTokenData(packetHandle, "BasicSafetyMessageVerbose", newPath, value.msg1026.stringLength, value.msg1026.string);
  }
  else
  {
    if( C2xIsTokenAvailable(packetHandle, "BasicSafetyMessageVerbose", newPath) )
    {
      C2xRemoveToken(packetHandle, "BasicSafetyMessageVerbose", newPath);
    }
  }

  snprintf(newPath, elcount(newPath), "%s.%s", oldPath, "msg1027");
  if(value.msg1027.isValidFlag==1)
  {
    C2xSetTokenData(packetHandle, "BasicSafetyMessageVerbose", newPath, value.msg1027.stringLength, value.msg1027.string);
  }
  else
  {
    if( C2xIsTokenAvailable(packetHandle, "BasicSafetyMessageVerbose", newPath) )
    {
      C2xRemoveToken(packetHandle, "BasicSafetyMessageVerbose", newPath);
    }
  }

  snprintf(newPath, elcount(newPath), "%s.%s", oldPath, "msg1029");
  if(value.msg1029.isValidFlag==1)
  {
    C2xSetTokenData(packetHandle, "BasicSafetyMessageVerbose", newPath, value.msg1029.stringLength, value.msg1029.string);
  }
  else
  {
    if( C2xIsTokenAvailable(packetHandle, "BasicSafetyMessageVerbose", newPath) )
    {
      C2xRemoveToken(packetHandle, "BasicSafetyMessageVerbose", newPath);
    }
  }

  snprintf(newPath, elcount(newPath), "%s.%s", oldPath, "msg1030");
  if(value.msg1030.isValidFlag==1)
  {
    C2xSetTokenData(packetHandle, "BasicSafetyMessageVerbose", newPath, value.msg1030.stringLength, value.msg1030.string);
  }
  else
  {
    if( C2xIsTokenAvailable(packetHandle, "BasicSafetyMessageVerbose", newPath) )
    {
      C2xRemoveToken(packetHandle, "BasicSafetyMessageVerbose", newPath);
    }
  }

  snprintf(newPath, elcount(newPath), "%s.%s", oldPath, "msg1031");
  if(value.msg1031.isValidFlag==1)
  {
    C2xSetTokenData(packetHandle, "BasicSafetyMessageVerbose", newPath, value.msg1031.stringLength, value.msg1031.string);
  }
  else
  {
    if( C2xIsTokenAvailable(packetHandle, "BasicSafetyMessageVerbose", newPath) )
    {
      C2xRemoveToken(packetHandle, "BasicSafetyMessageVerbose", newPath);
    }
  }

  snprintf(newPath, elcount(newPath), "%s.%s", oldPath, "msg1032");
  if(value.msg1032.isValidFlag==1)
  {
    C2xSetTokenData(packetHandle, "BasicSafetyMessageVerbose", newPath, value.msg1032.stringLength, value.msg1032.string);
  }
  else
  {
    if( C2xIsTokenAvailable(packetHandle, "BasicSafetyMessageVerbose", newPath) )
    {
      C2xRemoveToken(packetHandle, "BasicSafetyMessageVerbose", newPath);
    }
  }

  return result;
}

int GetBasicSafetyMessageVerboseVehicleSafetyExtensionParams(LONG packetHandle, struct BasicSafetyMessageVerboseVehicleSafetyExtension value, char oldPath[])
{
  char newPath[300];
  int result;

  result = 0;

  snprintf(newPath, elcount(newPath), "%s.%s", oldPath, "events");
  value.events.isValidFlag = C2xIsTokenAvailable(packetHandle, "BasicSafetyMessageVerbose", newPath);
  if(value.events.isValidFlag==1)
  {
    value.events.value = C2xGetTokenInt(packetHandle, "BasicSafetyMessageVerbose", newPath);
    result = CheckLastError("BasicSafetyMessageVerbose", gkFuncRefGet, result);
  }
  snprintf(newPath, elcount(newPath), "%s.%s", oldPath, "pathHistory");
  value.pathHistory.isValidFlag = C2xIsTokenAvailable(packetHandle, "BasicSafetyMessageVerbose", newPath);
  if(value.pathHistory.isValidFlag==1)
  {
    GetBasicSafetyMessageVerbosePathHistoryParams(packetHandle, value.pathHistory, newPath);
    result = CheckLastError("BasicSafetyMessageVerbose", gkFuncRefGet, result);
  }
  snprintf(newPath, elcount(newPath), "%s.%s", oldPath, "pathPrediction");
  value.pathPrediction.isValidFlag = C2xIsTokenAvailable(packetHandle, "BasicSafetyMessageVerbose", newPath);
  if(value.pathPrediction.isValidFlag==1)
  {
    GetBasicSafetyMessageVerbosePathPredictionParams(packetHandle, value.pathPrediction, newPath);
    result = CheckLastError("BasicSafetyMessageVerbose", gkFuncRefGet, result);
  }
  snprintf(newPath, elcount(newPath), "%s.%s", oldPath, "theRTCM");
  value.theRTCM.isValidFlag = C2xIsTokenAvailable(packetHandle, "BasicSafetyMessageVerbose", newPath);
  if(value.theRTCM.isValidFlag==1)
  {
    GetBasicSafetyMessageVerboseRTCMPackageParams(packetHandle, value.theRTCM, newPath);
    result = CheckLastError("BasicSafetyMessageVerbose", gkFuncRefGet, result);
  }
  return result;
}

int SetBasicSafetyMessageVerboseVehicleSafetyExtensionParams(LONG packetHandle, struct BasicSafetyMessageVerboseVehicleSafetyExtension value, char oldPath[])
{
  char newPath[300];
  int result;

  result = 0;

  snprintf(newPath, elcount(newPath), "%s.%s", oldPath, "events");
  if(value.events.isValidFlag==1)
  {
    C2xSetTokenInt(packetHandle, "BasicSafetyMessageVerbose", newPath, value.events.value);
    result = CheckLastError("BasicSafetyMessageVerbose", gkFuncRefGet, result);
  }
  else
  {
    if( C2xIsTokenAvailable(packetHandle, "BasicSafetyMessageVerbose", newPath) )
    {
      C2xRemoveToken(packetHandle, "BasicSafetyMessageVerbose", newPath);
    }
  }

  snprintf(newPath, elcount(newPath), "%s.%s", oldPath, "pathHistory");
  if(value.pathHistory.isValidFlag==1)
  {
    SetBasicSafetyMessageVerbosePathHistoryParams(packetHandle, value.pathHistory, newPath);
    result = CheckLastError("BasicSafetyMessageVerbose", gkFuncRefGet, result);
  }
  else
  {
    if( C2xIsTokenAvailable(packetHandle, "BasicSafetyMessageVerbose", newPath) )
    {
      C2xRemoveToken(packetHandle, "BasicSafetyMessageVerbose", newPath);
    }
  }

  snprintf(newPath, elcount(newPath), "%s.%s", oldPath, "pathPrediction");
  if(value.pathPrediction.isValidFlag==1)
  {
    SetBasicSafetyMessageVerbosePathPredictionParams(packetHandle, value.pathPrediction, newPath);
    result = CheckLastError("BasicSafetyMessageVerbose", gkFuncRefGet, result);
  }
  else
  {
    if( C2xIsTokenAvailable(packetHandle, "BasicSafetyMessageVerbose", newPath) )
    {
      C2xRemoveToken(packetHandle, "BasicSafetyMessageVerbose", newPath);
    }
  }

  snprintf(newPath, elcount(newPath), "%s.%s", oldPath, "theRTCM");
  if(value.theRTCM.isValidFlag==1)
  {
    SetBasicSafetyMessageVerboseRTCMPackageParams(packetHandle, value.theRTCM, newPath);
    result = CheckLastError("BasicSafetyMessageVerbose", gkFuncRefGet, result);
  }
  else
  {
    if( C2xIsTokenAvailable(packetHandle, "BasicSafetyMessageVerbose", newPath) )
    {
      C2xRemoveToken(packetHandle, "BasicSafetyMessageVerbose", newPath);
    }
  }

  return result;
}

int GetBasicSafetyMessageVerbose_VehicleStatus_wipersParams(LONG packetHandle, struct BasicSafetyMessageVerbose_VehicleStatus_wipers value, char oldPath[])
{
  char newPath[300];
  int result;

  result = 0;

  snprintf(newPath, elcount(newPath), "%s.%s", oldPath, "statusFront");
  value.statusFront = C2xGetTokenInt(packetHandle, "BasicSafetyMessageVerbose", newPath);
  result = CheckLastError("BasicSafetyMessageVerbose", gkFuncRefGet, result);

  snprintf(newPath, elcount(newPath), "%s.%s", oldPath, "rateFront");
  value.rateFront = C2xGetTokenInt(packetHandle, "BasicSafetyMessageVerbose", newPath);
  result = CheckLastError("BasicSafetyMessageVerbose", gkFuncRefGet, result);

  snprintf(newPath, elcount(newPath), "%s.%s", oldPath, "statusRear");
  value.statusRear.isValidFlag = C2xIsTokenAvailable(packetHandle, "BasicSafetyMessageVerbose", newPath);
  if(value.statusRear.isValidFlag==1)
  {
    value.statusRear.value = C2xGetTokenInt(packetHandle, "BasicSafetyMessageVerbose", newPath);
    result = CheckLastError("BasicSafetyMessageVerbose", gkFuncRefGet, result);
  }
  snprintf(newPath, elcount(newPath), "%s.%s", oldPath, "rateRear");
  value.rateRear.isValidFlag = C2xIsTokenAvailable(packetHandle, "BasicSafetyMessageVerbose", newPath);
  if(value.rateRear.isValidFlag==1)
  {
    value.rateRear.value = C2xGetTokenInt(packetHandle, "BasicSafetyMessageVerbose", newPath);
    result = CheckLastError("BasicSafetyMessageVerbose", gkFuncRefGet, result);
  }
  return result;
}

int SetBasicSafetyMessageVerbose_VehicleStatus_wipersParams(LONG packetHandle, struct BasicSafetyMessageVerbose_VehicleStatus_wipers value, char oldPath[])
{
  char newPath[300];
  int result;

  result = 0;

  snprintf(newPath, elcount(newPath), "%s.%s", oldPath, "statusFront");
  C2xSetTokenInt(packetHandle, "BasicSafetyMessageVerbose", newPath, value.statusFront);
  result = CheckLastError("BasicSafetyMessageVerbose", gkFuncRefGet, result);

  snprintf(newPath, elcount(newPath), "%s.%s", oldPath, "rateFront");
  C2xSetTokenInt(packetHandle, "BasicSafetyMessageVerbose", newPath, value.rateFront);
  result = CheckLastError("BasicSafetyMessageVerbose", gkFuncRefGet, result);

  snprintf(newPath, elcount(newPath), "%s.%s", oldPath, "statusRear");
  if(value.statusRear.isValidFlag==1)
  {
    C2xSetTokenInt(packetHandle, "BasicSafetyMessageVerbose", newPath, value.statusRear.value);
    result = CheckLastError("BasicSafetyMessageVerbose", gkFuncRefGet, result);
  }
  else
  {
    if( C2xIsTokenAvailable(packetHandle, "BasicSafetyMessageVerbose", newPath) )
    {
      C2xRemoveToken(packetHandle, "BasicSafetyMessageVerbose", newPath);
    }
  }

  snprintf(newPath, elcount(newPath), "%s.%s", oldPath, "rateRear");
  if(value.rateRear.isValidFlag==1)
  {
    C2xSetTokenInt(packetHandle, "BasicSafetyMessageVerbose", newPath, value.rateRear.value);
    result = CheckLastError("BasicSafetyMessageVerbose", gkFuncRefGet, result);
  }
  else
  {
    if( C2xIsTokenAvailable(packetHandle, "BasicSafetyMessageVerbose", newPath) )
    {
      C2xRemoveToken(packetHandle, "BasicSafetyMessageVerbose", newPath);
    }
  }

  return result;
}

int GetBasicSafetyMessageVerbose_VehicleStatus_steeringParams(LONG packetHandle, struct BasicSafetyMessageVerbose_VehicleStatus_steering value, char oldPath[])
{
  char newPath[300];
  int result;

  result = 0;

  snprintf(newPath, elcount(newPath), "%s.%s", oldPath, "angle");
  value.angle.stringLength = C2xGetTokenData(packetHandle, "BasicSafetyMessageVerbose", newPath, elcount(value.angle.string), value.angle.string);
  snprintf(newPath, elcount(newPath), "%s.%s", oldPath, "confidence");
  value.confidence.isValidFlag = C2xIsTokenAvailable(packetHandle, "BasicSafetyMessageVerbose", newPath);
  if(value.confidence.isValidFlag==1)
  {
    value.confidence.value = C2xGetTokenInt(packetHandle, "BasicSafetyMessageVerbose", newPath);
    result = CheckLastError("BasicSafetyMessageVerbose", gkFuncRefGet, result);
  }
  snprintf(newPath, elcount(newPath), "%s.%s", oldPath, "rate");
  value.rate.isValidFlag = C2xIsTokenAvailable(packetHandle, "BasicSafetyMessageVerbose", newPath);
  if(value.rate.isValidFlag==1)
  {
    value.rate.value = C2xGetTokenInt(packetHandle, "BasicSafetyMessageVerbose", newPath);
    result = CheckLastError("BasicSafetyMessageVerbose", gkFuncRefGet, result);
  }
  snprintf(newPath, elcount(newPath), "%s.%s", oldPath, "wheels");
  value.wheels.isValidFlag = C2xIsTokenAvailable(packetHandle, "BasicSafetyMessageVerbose", newPath);
  if(value.wheels.isValidFlag==1)
  {
    value.wheels.value = C2xGetTokenInt(packetHandle, "BasicSafetyMessageVerbose", newPath);
    result = CheckLastError("BasicSafetyMessageVerbose", gkFuncRefGet, result);
  }
  return result;
}

int SetBasicSafetyMessageVerbose_VehicleStatus_steeringParams(LONG packetHandle, struct BasicSafetyMessageVerbose_VehicleStatus_steering value, char oldPath[])
{
  char newPath[300];
  int result;

  result = 0;

  snprintf(newPath, elcount(newPath), "%s.%s", oldPath, "angle");
  C2xSetTokenData(packetHandle, "BasicSafetyMessageVerbose", newPath, value.angle.stringLength, value.angle.string);

  snprintf(newPath, elcount(newPath), "%s.%s", oldPath, "confidence");
  if(value.confidence.isValidFlag==1)
  {
    C2xSetTokenInt(packetHandle, "BasicSafetyMessageVerbose", newPath, value.confidence.value);
    result = CheckLastError("BasicSafetyMessageVerbose", gkFuncRefGet, result);
  }
  else
  {
    if( C2xIsTokenAvailable(packetHandle, "BasicSafetyMessageVerbose", newPath) )
    {
      C2xRemoveToken(packetHandle, "BasicSafetyMessageVerbose", newPath);
    }
  }

  snprintf(newPath, elcount(newPath), "%s.%s", oldPath, "rate");
  if(value.rate.isValidFlag==1)
  {
    C2xSetTokenInt(packetHandle, "BasicSafetyMessageVerbose", newPath, value.rate.value);
    result = CheckLastError("BasicSafetyMessageVerbose", gkFuncRefGet, result);
  }
  else
  {
    if( C2xIsTokenAvailable(packetHandle, "BasicSafetyMessageVerbose", newPath) )
    {
      C2xRemoveToken(packetHandle, "BasicSafetyMessageVerbose", newPath);
    }
  }

  snprintf(newPath, elcount(newPath), "%s.%s", oldPath, "wheels");
  if(value.wheels.isValidFlag==1)
  {
    C2xSetTokenInt(packetHandle, "BasicSafetyMessageVerbose", newPath, value.wheels.value);
    result = CheckLastError("BasicSafetyMessageVerbose", gkFuncRefGet, result);
  }
  else
  {
    if( C2xIsTokenAvailable(packetHandle, "BasicSafetyMessageVerbose", newPath) )
    {
      C2xRemoveToken(packetHandle, "BasicSafetyMessageVerbose", newPath);
    }
  }

  return result;
}

int GetBasicSafetyMessageVerboseAccelSteerYawRateConfidenceParams(LONG packetHandle, struct BasicSafetyMessageVerboseAccelSteerYawRateConfidence value, char oldPath[])
{
  char newPath[300];
  int result;

  result = 0;

  snprintf(newPath, elcount(newPath), "%s.%s", oldPath, "yawRate");
  value.yawRate = C2xGetTokenInt(packetHandle, "BasicSafetyMessageVerbose", newPath);
  result = CheckLastError("BasicSafetyMessageVerbose", gkFuncRefGet, result);

  snprintf(newPath, elcount(newPath), "%s.%s", oldPath, "acceleration");
  value.acceleration = C2xGetTokenInt(packetHandle, "BasicSafetyMessageVerbose", newPath);
  result = CheckLastError("BasicSafetyMessageVerbose", gkFuncRefGet, result);

  snprintf(newPath, elcount(newPath), "%s.%s", oldPath, "steeringWheelAngle");
  value.steeringWheelAngle = C2xGetTokenInt(packetHandle, "BasicSafetyMessageVerbose", newPath);
  result = CheckLastError("BasicSafetyMessageVerbose", gkFuncRefGet, result);

  return result;
}

int SetBasicSafetyMessageVerboseAccelSteerYawRateConfidenceParams(LONG packetHandle, struct BasicSafetyMessageVerboseAccelSteerYawRateConfidence value, char oldPath[])
{
  char newPath[300];
  int result;

  result = 0;

  snprintf(newPath, elcount(newPath), "%s.%s", oldPath, "yawRate");
  C2xSetTokenInt(packetHandle, "BasicSafetyMessageVerbose", newPath, value.yawRate);
  result = CheckLastError("BasicSafetyMessageVerbose", gkFuncRefGet, result);

  snprintf(newPath, elcount(newPath), "%s.%s", oldPath, "acceleration");
  C2xSetTokenInt(packetHandle, "BasicSafetyMessageVerbose", newPath, value.acceleration);
  result = CheckLastError("BasicSafetyMessageVerbose", gkFuncRefGet, result);

  snprintf(newPath, elcount(newPath), "%s.%s", oldPath, "steeringWheelAngle");
  C2xSetTokenInt(packetHandle, "BasicSafetyMessageVerbose", newPath, value.steeringWheelAngle);
  result = CheckLastError("BasicSafetyMessageVerbose", gkFuncRefGet, result);

  return result;
}

int GetBasicSafetyMessageVerboseConfidenceSetParams(LONG packetHandle, struct BasicSafetyMessageVerboseConfidenceSet value, char oldPath[])
{
  char newPath[300];
  int result;

  result = 0;

  snprintf(newPath, elcount(newPath), "%s.%s", oldPath, "accelConfidence");
  value.accelConfidence.isValidFlag = C2xIsTokenAvailable(packetHandle, "BasicSafetyMessageVerbose", newPath);
  if(value.accelConfidence.isValidFlag==1)
  {
    GetBasicSafetyMessageVerboseAccelSteerYawRateConfidenceParams(packetHandle, value.accelConfidence, newPath);
    result = CheckLastError("BasicSafetyMessageVerbose", gkFuncRefGet, result);
  }
  snprintf(newPath, elcount(newPath), "%s.%s", oldPath, "speedConfidence");
  value.speedConfidence.isValidFlag = C2xIsTokenAvailable(packetHandle, "BasicSafetyMessageVerbose", newPath);
  if(value.speedConfidence.isValidFlag==1)
  {
    value.speedConfidence.isValidFlag = 1;
    value.speedConfidence.stringLength = C2xGetTokenData(packetHandle, "BasicSafetyMessageVerbose", newPath, elcount(value.speedConfidence.string), value.speedConfidence.string);
  }
  snprintf(newPath, elcount(newPath), "%s.%s", oldPath, "timeConfidence");
  value.timeConfidence.isValidFlag = C2xIsTokenAvailable(packetHandle, "BasicSafetyMessageVerbose", newPath);
  if(value.timeConfidence.isValidFlag==1)
  {
    value.timeConfidence.value = C2xGetTokenInt(packetHandle, "BasicSafetyMessageVerbose", newPath);
    result = CheckLastError("BasicSafetyMessageVerbose", gkFuncRefGet, result);
  }
  snprintf(newPath, elcount(newPath), "%s.%s", oldPath, "posConfidence");
  value.posConfidence.isValidFlag = C2xIsTokenAvailable(packetHandle, "BasicSafetyMessageVerbose", newPath);
  if(value.posConfidence.isValidFlag==1)
  {
    value.posConfidence.isValidFlag = 1;
    value.posConfidence.stringLength = C2xGetTokenData(packetHandle, "BasicSafetyMessageVerbose", newPath, elcount(value.posConfidence.string), value.posConfidence.string);
  }
  snprintf(newPath, elcount(newPath), "%s.%s", oldPath, "steerConfidence");
  value.steerConfidence.isValidFlag = C2xIsTokenAvailable(packetHandle, "BasicSafetyMessageVerbose", newPath);
  if(value.steerConfidence.isValidFlag==1)
  {
    value.steerConfidence.value = C2xGetTokenInt(packetHandle, "BasicSafetyMessageVerbose", newPath);
    result = CheckLastError("BasicSafetyMessageVerbose", gkFuncRefGet, result);
  }
  snprintf(newPath, elcount(newPath), "%s.%s", oldPath, "throttleConfidence");
  value.throttleConfidence.isValidFlag = C2xIsTokenAvailable(packetHandle, "BasicSafetyMessageVerbose", newPath);
  if(value.throttleConfidence.isValidFlag==1)
  {
    value.throttleConfidence.value = C2xGetTokenInt(packetHandle, "BasicSafetyMessageVerbose", newPath);
    result = CheckLastError("BasicSafetyMessageVerbose", gkFuncRefGet, result);
  }
  return result;
}

int SetBasicSafetyMessageVerboseConfidenceSetParams(LONG packetHandle, struct BasicSafetyMessageVerboseConfidenceSet value, char oldPath[])
{
  char newPath[300];
  int result;

  result = 0;

  snprintf(newPath, elcount(newPath), "%s.%s", oldPath, "accelConfidence");
  if(value.accelConfidence.isValidFlag==1)
  {
    SetBasicSafetyMessageVerboseAccelSteerYawRateConfidenceParams(packetHandle, value.accelConfidence, newPath);
    result = CheckLastError("BasicSafetyMessageVerbose", gkFuncRefGet, result);
  }
  else
  {
    if( C2xIsTokenAvailable(packetHandle, "BasicSafetyMessageVerbose", newPath) )
    {
      C2xRemoveToken(packetHandle, "BasicSafetyMessageVerbose", newPath);
    }
  }

  snprintf(newPath, elcount(newPath), "%s.%s", oldPath, "speedConfidence");
  if(value.speedConfidence.isValidFlag==1)
  {
    C2xSetTokenData(packetHandle, "BasicSafetyMessageVerbose", newPath, value.speedConfidence.stringLength, value.speedConfidence.string);
  }
  else
  {
    if( C2xIsTokenAvailable(packetHandle, "BasicSafetyMessageVerbose", newPath) )
    {
      C2xRemoveToken(packetHandle, "BasicSafetyMessageVerbose", newPath);
    }
  }

  snprintf(newPath, elcount(newPath), "%s.%s", oldPath, "timeConfidence");
  if(value.timeConfidence.isValidFlag==1)
  {
    C2xSetTokenInt(packetHandle, "BasicSafetyMessageVerbose", newPath, value.timeConfidence.value);
    result = CheckLastError("BasicSafetyMessageVerbose", gkFuncRefGet, result);
  }
  else
  {
    if( C2xIsTokenAvailable(packetHandle, "BasicSafetyMessageVerbose", newPath) )
    {
      C2xRemoveToken(packetHandle, "BasicSafetyMessageVerbose", newPath);
    }
  }

  snprintf(newPath, elcount(newPath), "%s.%s", oldPath, "posConfidence");
  if(value.posConfidence.isValidFlag==1)
  {
    C2xSetTokenData(packetHandle, "BasicSafetyMessageVerbose", newPath, value.posConfidence.stringLength, value.posConfidence.string);
  }
  else
  {
    if( C2xIsTokenAvailable(packetHandle, "BasicSafetyMessageVerbose", newPath) )
    {
      C2xRemoveToken(packetHandle, "BasicSafetyMessageVerbose", newPath);
    }
  }

  snprintf(newPath, elcount(newPath), "%s.%s", oldPath, "steerConfidence");
  if(value.steerConfidence.isValidFlag==1)
  {
    C2xSetTokenInt(packetHandle, "BasicSafetyMessageVerbose", newPath, value.steerConfidence.value);
    result = CheckLastError("BasicSafetyMessageVerbose", gkFuncRefGet, result);
  }
  else
  {
    if( C2xIsTokenAvailable(packetHandle, "BasicSafetyMessageVerbose", newPath) )
    {
      C2xRemoveToken(packetHandle, "BasicSafetyMessageVerbose", newPath);
    }
  }

  snprintf(newPath, elcount(newPath), "%s.%s", oldPath, "throttleConfidence");
  if(value.throttleConfidence.isValidFlag==1)
  {
    C2xSetTokenInt(packetHandle, "BasicSafetyMessageVerbose", newPath, value.throttleConfidence.value);
    result = CheckLastError("BasicSafetyMessageVerbose", gkFuncRefGet, result);
  }
  else
  {
    if( C2xIsTokenAvailable(packetHandle, "BasicSafetyMessageVerbose", newPath) )
    {
      C2xRemoveToken(packetHandle, "BasicSafetyMessageVerbose", newPath);
    }
  }

  return result;
}

int GetBasicSafetyMessageVerbose_VehicleStatus_accelSetsParams(LONG packetHandle, struct BasicSafetyMessageVerbose_VehicleStatus_accelSets value, char oldPath[])
{
  char newPath[300]; 
  int j;
  int result;

  result = 0;

  snprintf(newPath, elcount(newPath), "%s.%s", oldPath, "accel4way");
  value.accel4way.isValidFlag = C2xIsTokenAvailable(packetHandle, "BasicSafetyMessageVerbose", newPath);
  if(value.accel4way.isValidFlag==1)
  {
    value.accel4way.isValidFlag = 1;
    value.accel4way.stringLength = C2xGetTokenData(packetHandle, "BasicSafetyMessageVerbose", newPath, elcount(value.accel4way.string), value.accel4way.string);
  }
  snprintf(newPath, elcount(newPath), "%s.%s", oldPath, "vertAccelThres");
  value.vertAccelThres.isValidFlag = C2xIsTokenAvailable(packetHandle, "BasicSafetyMessageVerbose", newPath);
  if(value.vertAccelThres.isValidFlag==1)
  {
    value.vertAccelThres.isValidFlag = 1;
    value.vertAccelThres.stringLength = C2xGetTokenLengthBit(packetHandle, "BasicSafetyMessageVerbose", newPath);
    if ((result = CheckLastError("BasicSafetyMessageVerbose", gkFuncRefGet, result))==0)
    {
      for(j=0; j<value.vertAccelThres.stringLength; j++)
      {
        if(C2xGetTokenBitOfBitString(packetHandle, "BasicSafetyMessageVerbose", newPath, j) == 0)
        {
          value.vertAccelThres.string[j] = '0';
        }
        else
        {
          value.vertAccelThres.string[j] = '1';
        }
        result = CheckLastError("BasicSafetyMessageVerbose", gkFuncRefGet, result);
      }
    }

  }
  snprintf(newPath, elcount(newPath), "%s.%s", oldPath, "yawRateCon");
  value.yawRateCon.isValidFlag = C2xIsTokenAvailable(packetHandle, "BasicSafetyMessageVerbose", newPath);
  if(value.yawRateCon.isValidFlag==1)
  {
    value.yawRateCon.value = C2xGetTokenInt(packetHandle, "BasicSafetyMessageVerbose", newPath);
    result = CheckLastError("BasicSafetyMessageVerbose", gkFuncRefGet, result);
  }
  snprintf(newPath, elcount(newPath), "%s.%s", oldPath, "hozAccelCon");
  value.hozAccelCon.isValidFlag = C2xIsTokenAvailable(packetHandle, "BasicSafetyMessageVerbose", newPath);
  if(value.hozAccelCon.isValidFlag==1)
  {
    value.hozAccelCon.value = C2xGetTokenInt(packetHandle, "BasicSafetyMessageVerbose", newPath);
    result = CheckLastError("BasicSafetyMessageVerbose", gkFuncRefGet, result);
  }
  snprintf(newPath, elcount(newPath), "%s.%s", oldPath, "confidenceSet");
  value.confidenceSet.isValidFlag = C2xIsTokenAvailable(packetHandle, "BasicSafetyMessageVerbose", newPath);
  if(value.confidenceSet.isValidFlag==1)
  {
    GetBasicSafetyMessageVerboseConfidenceSetParams(packetHandle, value.confidenceSet, newPath);
    result = CheckLastError("BasicSafetyMessageVerbose", gkFuncRefGet, result);
  }
  return result;
}

int SetBasicSafetyMessageVerbose_VehicleStatus_accelSetsParams(LONG packetHandle, struct BasicSafetyMessageVerbose_VehicleStatus_accelSets value, char oldPath[])
{
  char newPath[300]; 
  int j;
  int result;

  result = 0;

  snprintf(newPath, elcount(newPath), "%s.%s", oldPath, "accel4way");
  if(value.accel4way.isValidFlag==1)
  {
    C2xSetTokenData(packetHandle, "BasicSafetyMessageVerbose", newPath, value.accel4way.stringLength, value.accel4way.string);
  }
  else
  {
    if( C2xIsTokenAvailable(packetHandle, "BasicSafetyMessageVerbose", newPath) )
    {
      C2xRemoveToken(packetHandle, "BasicSafetyMessageVerbose", newPath);
    }
  }

  snprintf(newPath, elcount(newPath), "%s.%s", oldPath, "vertAccelThres");
  if(value.vertAccelThres.isValidFlag==1)
  {
      for(j=0; j<value.vertAccelThres.stringLength; j++)
      {
        if(value.vertAccelThres.string[j] == '0')
        {
          C2xSetTokenBitOfBitString(packetHandle, "BasicSafetyMessageVerbose", newPath, j, 0);
        }
        else
        {
          C2xSetTokenBitOfBitString(packetHandle, "BasicSafetyMessageVerbose", newPath, j, 1);
        }
        result = CheckLastError("BasicSafetyMessageVerbose", gkFuncRefGet, result);
      }
  }
  else
  {
    if( C2xIsTokenAvailable(packetHandle, "BasicSafetyMessageVerbose", newPath) )
    {
      C2xRemoveToken(packetHandle, "BasicSafetyMessageVerbose", newPath);
    }
  }

  snprintf(newPath, elcount(newPath), "%s.%s", oldPath, "yawRateCon");
  if(value.yawRateCon.isValidFlag==1)
  {
    C2xSetTokenInt(packetHandle, "BasicSafetyMessageVerbose", newPath, value.yawRateCon.value);
    result = CheckLastError("BasicSafetyMessageVerbose", gkFuncRefGet, result);
  }
  else
  {
    if( C2xIsTokenAvailable(packetHandle, "BasicSafetyMessageVerbose", newPath) )
    {
      C2xRemoveToken(packetHandle, "BasicSafetyMessageVerbose", newPath);
    }
  }

  snprintf(newPath, elcount(newPath), "%s.%s", oldPath, "hozAccelCon");
  if(value.hozAccelCon.isValidFlag==1)
  {
    C2xSetTokenInt(packetHandle, "BasicSafetyMessageVerbose", newPath, value.hozAccelCon.value);
    result = CheckLastError("BasicSafetyMessageVerbose", gkFuncRefGet, result);
  }
  else
  {
    if( C2xIsTokenAvailable(packetHandle, "BasicSafetyMessageVerbose", newPath) )
    {
      C2xRemoveToken(packetHandle, "BasicSafetyMessageVerbose", newPath);
    }
  }

  snprintf(newPath, elcount(newPath), "%s.%s", oldPath, "confidenceSet");
  if(value.confidenceSet.isValidFlag==1)
  {
    SetBasicSafetyMessageVerboseConfidenceSetParams(packetHandle, value.confidenceSet, newPath);
    result = CheckLastError("BasicSafetyMessageVerbose", gkFuncRefGet, result);
  }
  else
  {
    if( C2xIsTokenAvailable(packetHandle, "BasicSafetyMessageVerbose", newPath) )
    {
      C2xRemoveToken(packetHandle, "BasicSafetyMessageVerbose", newPath);
    }
  }

  return result;
}

int GetBasicSafetyMessageVerbose_VehicleStatus_objectParams(LONG packetHandle, struct BasicSafetyMessageVerbose_VehicleStatus_object value, char oldPath[])
{
  char newPath[300];
  int result;

  result = 0;

  snprintf(newPath, elcount(newPath), "%s.%s", oldPath, "obDist");
  value.obDist = C2xGetTokenInt(packetHandle, "BasicSafetyMessageVerbose", newPath);
  result = CheckLastError("BasicSafetyMessageVerbose", gkFuncRefGet, result);

  snprintf(newPath, elcount(newPath), "%s.%s", oldPath, "obDirect");
  value.obDirect = C2xGetTokenInt(packetHandle, "BasicSafetyMessageVerbose", newPath);
  result = CheckLastError("BasicSafetyMessageVerbose", gkFuncRefGet, result);

  snprintf(newPath, elcount(newPath), "%s.%s", oldPath, "dateTime");
  GetBasicSafetyMessageVerboseDDateTimeParams(packetHandle, value.dateTime, newPath);
  result = CheckLastError("BasicSafetyMessageVerbose", gkFuncRefGet, result);

  return result;
}

int SetBasicSafetyMessageVerbose_VehicleStatus_objectParams(LONG packetHandle, struct BasicSafetyMessageVerbose_VehicleStatus_object value, char oldPath[])
{
  char newPath[300];
  int result;

  result = 0;

  snprintf(newPath, elcount(newPath), "%s.%s", oldPath, "obDist");
  C2xSetTokenInt(packetHandle, "BasicSafetyMessageVerbose", newPath, value.obDist);
  result = CheckLastError("BasicSafetyMessageVerbose", gkFuncRefGet, result);

  snprintf(newPath, elcount(newPath), "%s.%s", oldPath, "obDirect");
  C2xSetTokenInt(packetHandle, "BasicSafetyMessageVerbose", newPath, value.obDirect);
  result = CheckLastError("BasicSafetyMessageVerbose", gkFuncRefGet, result);

  snprintf(newPath, elcount(newPath), "%s.%s", oldPath, "dateTime");
  SetBasicSafetyMessageVerboseDDateTimeParams(packetHandle, value.dateTime, newPath);
  result = CheckLastError("BasicSafetyMessageVerbose", gkFuncRefGet, result);

  return result;
}

int GetBasicSafetyMessageVerboseBumperHeightsParams(LONG packetHandle, struct BasicSafetyMessageVerboseBumperHeights value, char oldPath[])
{
  char newPath[300];
  int result;

  result = 0;

  snprintf(newPath, elcount(newPath), "%s.%s", oldPath, "frnt");
  value.frnt = C2xGetTokenInt(packetHandle, "BasicSafetyMessageVerbose", newPath);
  result = CheckLastError("BasicSafetyMessageVerbose", gkFuncRefGet, result);

  snprintf(newPath, elcount(newPath), "%s.%s", oldPath, "rear");
  value.rear = C2xGetTokenInt(packetHandle, "BasicSafetyMessageVerbose", newPath);
  result = CheckLastError("BasicSafetyMessageVerbose", gkFuncRefGet, result);

  return result;
}

int SetBasicSafetyMessageVerboseBumperHeightsParams(LONG packetHandle, struct BasicSafetyMessageVerboseBumperHeights value, char oldPath[])
{
  char newPath[300];
  int result;

  result = 0;

  snprintf(newPath, elcount(newPath), "%s.%s", oldPath, "frnt");
  C2xSetTokenInt(packetHandle, "BasicSafetyMessageVerbose", newPath, value.frnt);
  result = CheckLastError("BasicSafetyMessageVerbose", gkFuncRefGet, result);

  snprintf(newPath, elcount(newPath), "%s.%s", oldPath, "rear");
  C2xSetTokenInt(packetHandle, "BasicSafetyMessageVerbose", newPath, value.rear);
  result = CheckLastError("BasicSafetyMessageVerbose", gkFuncRefGet, result);

  return result;
}

int GetBasicSafetyMessageVerbose_VehicleStatus_vehicleDataParams(LONG packetHandle, struct BasicSafetyMessageVerbose_VehicleStatus_vehicleData value, char oldPath[])
{
  char newPath[300];
  int result;

  result = 0;

  snprintf(newPath, elcount(newPath), "%s.%s", oldPath, "height");
  value.height = C2xGetTokenInt(packetHandle, "BasicSafetyMessageVerbose", newPath);
  result = CheckLastError("BasicSafetyMessageVerbose", gkFuncRefGet, result);

  snprintf(newPath, elcount(newPath), "%s.%s", oldPath, "bumpers");
  GetBasicSafetyMessageVerboseBumperHeightsParams(packetHandle, value.bumpers, newPath);
  result = CheckLastError("BasicSafetyMessageVerbose", gkFuncRefGet, result);

  snprintf(newPath, elcount(newPath), "%s.%s", oldPath, "mass");
  value.mass = C2xGetTokenInt(packetHandle, "BasicSafetyMessageVerbose", newPath);
  result = CheckLastError("BasicSafetyMessageVerbose", gkFuncRefGet, result);

  snprintf(newPath, elcount(newPath), "%s.%s", oldPath, "trailerWeight");
  value.trailerWeight = C2xGetTokenInt(packetHandle, "BasicSafetyMessageVerbose", newPath);
  result = CheckLastError("BasicSafetyMessageVerbose", gkFuncRefGet, result);

  snprintf(newPath, elcount(newPath), "%s.%s", oldPath, "type");
  value.type = C2xGetTokenInt(packetHandle, "BasicSafetyMessageVerbose", newPath);
  result = CheckLastError("BasicSafetyMessageVerbose", gkFuncRefGet, result);

  return result;
}

int SetBasicSafetyMessageVerbose_VehicleStatus_vehicleDataParams(LONG packetHandle, struct BasicSafetyMessageVerbose_VehicleStatus_vehicleData value, char oldPath[])
{
  char newPath[300];
  int result;

  result = 0;

  snprintf(newPath, elcount(newPath), "%s.%s", oldPath, "height");
  C2xSetTokenInt(packetHandle, "BasicSafetyMessageVerbose", newPath, value.height);
  result = CheckLastError("BasicSafetyMessageVerbose", gkFuncRefGet, result);

  snprintf(newPath, elcount(newPath), "%s.%s", oldPath, "bumpers");
  SetBasicSafetyMessageVerboseBumperHeightsParams(packetHandle, value.bumpers, newPath);
  result = CheckLastError("BasicSafetyMessageVerbose", gkFuncRefGet, result);

  snprintf(newPath, elcount(newPath), "%s.%s", oldPath, "mass");
  C2xSetTokenInt(packetHandle, "BasicSafetyMessageVerbose", newPath, value.mass);
  result = CheckLastError("BasicSafetyMessageVerbose", gkFuncRefGet, result);

  snprintf(newPath, elcount(newPath), "%s.%s", oldPath, "trailerWeight");
  C2xSetTokenInt(packetHandle, "BasicSafetyMessageVerbose", newPath, value.trailerWeight);
  result = CheckLastError("BasicSafetyMessageVerbose", gkFuncRefGet, result);

  snprintf(newPath, elcount(newPath), "%s.%s", oldPath, "type");
  C2xSetTokenInt(packetHandle, "BasicSafetyMessageVerbose", newPath, value.type);
  result = CheckLastError("BasicSafetyMessageVerbose", gkFuncRefGet, result);

  return result;
}

int GetBasicSafetyMessageVerbose_VehicleIdent_vehicleClassParams(LONG packetHandle, struct BasicSafetyMessageVerbose_VehicleIdent_vehicleClass value, char oldPath[])
{
  char newPath[300];
  int result;

  result = 0;

  value.choice = C2xGetTokenInt(packetHandle, "BasicSafetyMessageVerbose", oldPath);

  switch(value.choice)
  {
    case 0:
    {
      snprintf(newPath, elcount(newPath), "%s.%s", oldPath, "vGroup");
      value.vGroup = C2xGetTokenInt(packetHandle, "BasicSafetyMessageVerbose", newPath);
      result = CheckLastError("BasicSafetyMessageVerbose", gkFuncRefGet, result);
    }
    break;
    case 1:
    {
      snprintf(newPath, elcount(newPath), "%s.%s", oldPath, "rGroup");
      value.rGroup = C2xGetTokenInt(packetHandle, "BasicSafetyMessageVerbose", newPath);
      result = CheckLastError("BasicSafetyMessageVerbose", gkFuncRefGet, result);
    }
    break;
    case 2:
    {
      snprintf(newPath, elcount(newPath), "%s.%s", oldPath, "rEquip");
      value.rEquip = C2xGetTokenInt(packetHandle, "BasicSafetyMessageVerbose", newPath);
      result = CheckLastError("BasicSafetyMessageVerbose", gkFuncRefGet, result);
    }
    break;
  }
  return result;
}

int SetBasicSafetyMessageVerbose_VehicleIdent_vehicleClassParams(LONG packetHandle, struct BasicSafetyMessageVerbose_VehicleIdent_vehicleClass value, char oldPath[])
{
  char newPath[300];
  int result;

  result = 0;

  switch(value.choice)
  {
    case 0:
    {
      snprintf(newPath, elcount(newPath), "%s.%s", oldPath, "vGroup");
      C2xSetTokenInt(packetHandle, "BasicSafetyMessageVerbose", newPath, value.vGroup);
      result = CheckLastError("BasicSafetyMessageVerbose", gkFuncRefGet, result);
    }
    break;
    case 1:
    {
      snprintf(newPath, elcount(newPath), "%s.%s", oldPath, "rGroup");
      C2xSetTokenInt(packetHandle, "BasicSafetyMessageVerbose", newPath, value.rGroup);
      result = CheckLastError("BasicSafetyMessageVerbose", gkFuncRefGet, result);
    }
    break;
    case 2:
    {
      snprintf(newPath, elcount(newPath), "%s.%s", oldPath, "rEquip");
      C2xSetTokenInt(packetHandle, "BasicSafetyMessageVerbose", newPath, value.rEquip);
      result = CheckLastError("BasicSafetyMessageVerbose", gkFuncRefGet, result);
    }
    break;
  }
  return result;
}

int GetBasicSafetyMessageVerboseVehicleIdentParams(LONG packetHandle, struct BasicSafetyMessageVerboseVehicleIdent value, char oldPath[])
{
  char newPath[300];
  int result;

  result = 0;

  snprintf(newPath, elcount(newPath), "%s.%s", oldPath, "name");
  value.name.isValidFlag = C2xIsTokenAvailable(packetHandle, "BasicSafetyMessageVerbose", newPath);
  if(value.name.isValidFlag==1)
  {
    value.name.stringLength = C2xGetTokenData(packetHandle, "BasicSafetyMessageVerbose", newPath, elcount(value.name.string), value.name.string);
    result = CheckLastError("BasicSafetyMessageVerbose", gkFuncRefGet, result);
  }
  snprintf(newPath, elcount(newPath), "%s.%s", oldPath, "vin");
  value.vin.isValidFlag = C2xIsTokenAvailable(packetHandle, "BasicSafetyMessageVerbose", newPath);
  if(value.vin.isValidFlag==1)
  {
    value.vin.isValidFlag = 1;
    value.vin.stringLength = C2xGetTokenData(packetHandle, "BasicSafetyMessageVerbose", newPath, elcount(value.vin.string), value.vin.string);
  }
  snprintf(newPath, elcount(newPath), "%s.%s", oldPath, "ownerCode");
  value.ownerCode.isValidFlag = C2xIsTokenAvailable(packetHandle, "BasicSafetyMessageVerbose", newPath);
  if(value.ownerCode.isValidFlag==1)
  {
    value.ownerCode.stringLength = C2xGetTokenData(packetHandle, "BasicSafetyMessageVerbose", newPath, elcount(value.ownerCode.string), value.ownerCode.string);
    result = CheckLastError("BasicSafetyMessageVerbose", gkFuncRefGet, result);
  }
  snprintf(newPath, elcount(newPath), "%s.%s", oldPath, "id");
  value.id.isValidFlag = C2xIsTokenAvailable(packetHandle, "BasicSafetyMessageVerbose", newPath);
  if(value.id.isValidFlag==1)
  {
    value.id.isValidFlag = 1;
    value.id.stringLength = C2xGetTokenData(packetHandle, "BasicSafetyMessageVerbose", newPath, elcount(value.id.string), value.id.string);
  }
  snprintf(newPath, elcount(newPath), "%s.%s", oldPath, "vehicleType");
  value.vehicleType.isValidFlag = C2xIsTokenAvailable(packetHandle, "BasicSafetyMessageVerbose", newPath);
  if(value.vehicleType.isValidFlag==1)
  {
    value.vehicleType.value = C2xGetTokenInt(packetHandle, "BasicSafetyMessageVerbose", newPath);
    result = CheckLastError("BasicSafetyMessageVerbose", gkFuncRefGet, result);
  }
  snprintf(newPath, elcount(newPath), "%s.%s", oldPath, "vehicleClass");
  value.vehicleClass.isValidFlag = C2xIsTokenAvailable(packetHandle, "BasicSafetyMessageVerbose", newPath);
  if(value.vehicleClass.isValidFlag==1)
  {
    GetBasicSafetyMessageVerbose_VehicleIdent_vehicleClassParams(packetHandle, value.vehicleClass, newPath);
    result = CheckLastError("BasicSafetyMessageVerbose", gkFuncRefGet, result);
  }
  return result;
}

int SetBasicSafetyMessageVerboseVehicleIdentParams(LONG packetHandle, struct BasicSafetyMessageVerboseVehicleIdent value, char oldPath[])
{
  char newPath[300];
  int result;

  result = 0;

  snprintf(newPath, elcount(newPath), "%s.%s", oldPath, "name");
  if(value.name.isValidFlag==1)
  {
    C2xSetTokenData(packetHandle, "BasicSafetyMessageVerbose", newPath, value.name.stringLength, value.name.string);
    result = CheckLastError("BasicSafetyMessageVerbose", gkFuncRefGet, result);
  }
  else
  {
    if( C2xIsTokenAvailable(packetHandle, "BasicSafetyMessageVerbose", newPath) )
    {
      C2xRemoveToken(packetHandle, "BasicSafetyMessageVerbose", newPath);
    }
  }

  snprintf(newPath, elcount(newPath), "%s.%s", oldPath, "vin");
  if(value.vin.isValidFlag==1)
  {
    C2xSetTokenData(packetHandle, "BasicSafetyMessageVerbose", newPath, value.vin.stringLength, value.vin.string);
  }
  else
  {
    if( C2xIsTokenAvailable(packetHandle, "BasicSafetyMessageVerbose", newPath) )
    {
      C2xRemoveToken(packetHandle, "BasicSafetyMessageVerbose", newPath);
    }
  }

  snprintf(newPath, elcount(newPath), "%s.%s", oldPath, "ownerCode");
  if(value.ownerCode.isValidFlag==1)
  {
    C2xSetTokenData(packetHandle, "BasicSafetyMessageVerbose", newPath, value.ownerCode.stringLength, value.ownerCode.string);
    result = CheckLastError("BasicSafetyMessageVerbose", gkFuncRefGet, result);
  }
  else
  {
    if( C2xIsTokenAvailable(packetHandle, "BasicSafetyMessageVerbose", newPath) )
    {
      C2xRemoveToken(packetHandle, "BasicSafetyMessageVerbose", newPath);
    }
  }

  snprintf(newPath, elcount(newPath), "%s.%s", oldPath, "id");
  if(value.id.isValidFlag==1)
  {
    C2xSetTokenData(packetHandle, "BasicSafetyMessageVerbose", newPath, value.id.stringLength, value.id.string);
  }
  else
  {
    if( C2xIsTokenAvailable(packetHandle, "BasicSafetyMessageVerbose", newPath) )
    {
      C2xRemoveToken(packetHandle, "BasicSafetyMessageVerbose", newPath);
    }
  }

  snprintf(newPath, elcount(newPath), "%s.%s", oldPath, "vehicleType");
  if(value.vehicleType.isValidFlag==1)
  {
    C2xSetTokenInt(packetHandle, "BasicSafetyMessageVerbose", newPath, value.vehicleType.value);
    result = CheckLastError("BasicSafetyMessageVerbose", gkFuncRefGet, result);
  }
  else
  {
    if( C2xIsTokenAvailable(packetHandle, "BasicSafetyMessageVerbose", newPath) )
    {
      C2xRemoveToken(packetHandle, "BasicSafetyMessageVerbose", newPath);
    }
  }

  snprintf(newPath, elcount(newPath), "%s.%s", oldPath, "vehicleClass");
  if(value.vehicleClass.isValidFlag==1)
  {
    SetBasicSafetyMessageVerbose_VehicleIdent_vehicleClassParams(packetHandle, value.vehicleClass, newPath);
    result = CheckLastError("BasicSafetyMessageVerbose", gkFuncRefGet, result);
  }
  else
  {
    if( C2xIsTokenAvailable(packetHandle, "BasicSafetyMessageVerbose", newPath) )
    {
      C2xRemoveToken(packetHandle, "BasicSafetyMessageVerbose", newPath);
    }
  }

  return result;
}

int GetBasicSafetyMessageVerbose_J1939data_tires_Params(LONG packetHandle, struct BasicSafetyMessageVerbose_J1939data_tires_ value, char oldPath[])
{
  char newPath[300]; 
  int j;
  int result;

  result = 0;

  snprintf(newPath, elcount(newPath), "%s.%s", oldPath, "location");
  value.location.isValidFlag = C2xIsTokenAvailable(packetHandle, "BasicSafetyMessageVerbose", newPath);
  if(value.location.isValidFlag==1)
  {
    value.location.value = C2xGetTokenInt(packetHandle, "BasicSafetyMessageVerbose", newPath);
    result = CheckLastError("BasicSafetyMessageVerbose", gkFuncRefGet, result);
  }
  snprintf(newPath, elcount(newPath), "%s.%s", oldPath, "pressure");
  value.pressure.isValidFlag = C2xIsTokenAvailable(packetHandle, "BasicSafetyMessageVerbose", newPath);
  if(value.pressure.isValidFlag==1)
  {
    value.pressure.value = C2xGetTokenInt(packetHandle, "BasicSafetyMessageVerbose", newPath);
    result = CheckLastError("BasicSafetyMessageVerbose", gkFuncRefGet, result);
  }
  snprintf(newPath, elcount(newPath), "%s.%s", oldPath, "temp");
  value.temp.isValidFlag = C2xIsTokenAvailable(packetHandle, "BasicSafetyMessageVerbose", newPath);
  if(value.temp.isValidFlag==1)
  {
    value.temp.value = C2xGetTokenInt(packetHandle, "BasicSafetyMessageVerbose", newPath);
    result = CheckLastError("BasicSafetyMessageVerbose", gkFuncRefGet, result);
  }
  snprintf(newPath, elcount(newPath), "%s.%s", oldPath, "wheelSensorStatus");
  value.wheelSensorStatus.isValidFlag = C2xIsTokenAvailable(packetHandle, "BasicSafetyMessageVerbose", newPath);
  if(value.wheelSensorStatus.isValidFlag==1)
  {
    value.wheelSensorStatus.value = C2xGetTokenInt(packetHandle, "BasicSafetyMessageVerbose", newPath);
    result = CheckLastError("BasicSafetyMessageVerbose", gkFuncRefGet, result);
  }
  snprintf(newPath, elcount(newPath), "%s.%s", oldPath, "wheelEndElectFault");
  value.wheelEndElectFault.isValidFlag = C2xIsTokenAvailable(packetHandle, "BasicSafetyMessageVerbose", newPath);
  if(value.wheelEndElectFault.isValidFlag==1)
  {
    value.wheelEndElectFault.isValidFlag = 1;
    value.wheelEndElectFault.stringLength = C2xGetTokenLengthBit(packetHandle, "BasicSafetyMessageVerbose", newPath);
    if ((result = CheckLastError("BasicSafetyMessageVerbose", gkFuncRefGet, result))==0)
    {
      for(j=0; j<value.wheelEndElectFault.stringLength; j++)
      {
        if(C2xGetTokenBitOfBitString(packetHandle, "BasicSafetyMessageVerbose", newPath, j) == 0)
        {
          value.wheelEndElectFault.string[j] = '0';
        }
        else
        {
          value.wheelEndElectFault.string[j] = '1';
        }
        result = CheckLastError("BasicSafetyMessageVerbose", gkFuncRefGet, result);
      }
    }

  }
  snprintf(newPath, elcount(newPath), "%s.%s", oldPath, "leakageRate");
  value.leakageRate.isValidFlag = C2xIsTokenAvailable(packetHandle, "BasicSafetyMessageVerbose", newPath);
  if(value.leakageRate.isValidFlag==1)
  {
    value.leakageRate.value = C2xGetTokenInt(packetHandle, "BasicSafetyMessageVerbose", newPath);
    result = CheckLastError("BasicSafetyMessageVerbose", gkFuncRefGet, result);
  }
  snprintf(newPath, elcount(newPath), "%s.%s", oldPath, "detection");
  value.detection.isValidFlag = C2xIsTokenAvailable(packetHandle, "BasicSafetyMessageVerbose", newPath);
  if(value.detection.isValidFlag==1)
  {
    value.detection.value = C2xGetTokenInt(packetHandle, "BasicSafetyMessageVerbose", newPath);
    result = CheckLastError("BasicSafetyMessageVerbose", gkFuncRefGet, result);
  }
  return result;
}

int SetBasicSafetyMessageVerbose_J1939data_tires_Params(LONG packetHandle, struct BasicSafetyMessageVerbose_J1939data_tires_ value, char oldPath[])
{
  char newPath[300]; 
  int j;
  int result;

  result = 0;

  snprintf(newPath, elcount(newPath), "%s.%s", oldPath, "location");
  if(value.location.isValidFlag==1)
  {
    C2xSetTokenInt(packetHandle, "BasicSafetyMessageVerbose", newPath, value.location.value);
    result = CheckLastError("BasicSafetyMessageVerbose", gkFuncRefGet, result);
  }
  else
  {
    if( C2xIsTokenAvailable(packetHandle, "BasicSafetyMessageVerbose", newPath) )
    {
      C2xRemoveToken(packetHandle, "BasicSafetyMessageVerbose", newPath);
    }
  }

  snprintf(newPath, elcount(newPath), "%s.%s", oldPath, "pressure");
  if(value.pressure.isValidFlag==1)
  {
    C2xSetTokenInt(packetHandle, "BasicSafetyMessageVerbose", newPath, value.pressure.value);
    result = CheckLastError("BasicSafetyMessageVerbose", gkFuncRefGet, result);
  }
  else
  {
    if( C2xIsTokenAvailable(packetHandle, "BasicSafetyMessageVerbose", newPath) )
    {
      C2xRemoveToken(packetHandle, "BasicSafetyMessageVerbose", newPath);
    }
  }

  snprintf(newPath, elcount(newPath), "%s.%s", oldPath, "temp");
  if(value.temp.isValidFlag==1)
  {
    C2xSetTokenInt(packetHandle, "BasicSafetyMessageVerbose", newPath, value.temp.value);
    result = CheckLastError("BasicSafetyMessageVerbose", gkFuncRefGet, result);
  }
  else
  {
    if( C2xIsTokenAvailable(packetHandle, "BasicSafetyMessageVerbose", newPath) )
    {
      C2xRemoveToken(packetHandle, "BasicSafetyMessageVerbose", newPath);
    }
  }

  snprintf(newPath, elcount(newPath), "%s.%s", oldPath, "wheelSensorStatus");
  if(value.wheelSensorStatus.isValidFlag==1)
  {
    C2xSetTokenInt(packetHandle, "BasicSafetyMessageVerbose", newPath, value.wheelSensorStatus.value);
    result = CheckLastError("BasicSafetyMessageVerbose", gkFuncRefGet, result);
  }
  else
  {
    if( C2xIsTokenAvailable(packetHandle, "BasicSafetyMessageVerbose", newPath) )
    {
      C2xRemoveToken(packetHandle, "BasicSafetyMessageVerbose", newPath);
    }
  }

  snprintf(newPath, elcount(newPath), "%s.%s", oldPath, "wheelEndElectFault");
  if(value.wheelEndElectFault.isValidFlag==1)
  {
      for(j=0; j<value.wheelEndElectFault.stringLength; j++)
      {
        if(value.wheelEndElectFault.string[j] == '0')
        {
          C2xSetTokenBitOfBitString(packetHandle, "BasicSafetyMessageVerbose", newPath, j, 0);
        }
        else
        {
          C2xSetTokenBitOfBitString(packetHandle, "BasicSafetyMessageVerbose", newPath, j, 1);
        }
        result = CheckLastError("BasicSafetyMessageVerbose", gkFuncRefGet, result);
      }
  }
  else
  {
    if( C2xIsTokenAvailable(packetHandle, "BasicSafetyMessageVerbose", newPath) )
    {
      C2xRemoveToken(packetHandle, "BasicSafetyMessageVerbose", newPath);
    }
  }

  snprintf(newPath, elcount(newPath), "%s.%s", oldPath, "leakageRate");
  if(value.leakageRate.isValidFlag==1)
  {
    C2xSetTokenInt(packetHandle, "BasicSafetyMessageVerbose", newPath, value.leakageRate.value);
    result = CheckLastError("BasicSafetyMessageVerbose", gkFuncRefGet, result);
  }
  else
  {
    if( C2xIsTokenAvailable(packetHandle, "BasicSafetyMessageVerbose", newPath) )
    {
      C2xRemoveToken(packetHandle, "BasicSafetyMessageVerbose", newPath);
    }
  }

  snprintf(newPath, elcount(newPath), "%s.%s", oldPath, "detection");
  if(value.detection.isValidFlag==1)
  {
    C2xSetTokenInt(packetHandle, "BasicSafetyMessageVerbose", newPath, value.detection.value);
    result = CheckLastError("BasicSafetyMessageVerbose", gkFuncRefGet, result);
  }
  else
  {
    if( C2xIsTokenAvailable(packetHandle, "BasicSafetyMessageVerbose", newPath) )
    {
      C2xRemoveToken(packetHandle, "BasicSafetyMessageVerbose", newPath);
    }
  }

  return result;
}

int GetBasicSafetyMessageVerbose_J1939data_tiresParams(LONG packetHandle, struct BasicSafetyMessageVerbose_J1939data_tires value, char oldPath[])
{
  char newPath[300]; 
  int i;
  int result;

  result = 0;

  value.length = C2xGetTokenInt(packetHandle, "BasicSafetyMessageVerbose", oldPath);
  if((result = CheckLastError("BasicSafetyMessageVerbose", gkFuncRefGet, result))==0)
  {
    for(i=0; i<value.length; i++)
    {
      snprintf(newPath, elcount(newPath), "%s[%d]", oldPath, i);
      GetBasicSafetyMessageVerbose_J1939data_tires_Params(packetHandle, value.arrayValue[i], newPath);
      result = CheckLastError("BasicSafetyMessageVerbose", gkFuncRefGet, result);
    }
  }
  return result;
}

int SetBasicSafetyMessageVerbose_J1939data_tiresParams(LONG packetHandle, struct BasicSafetyMessageVerbose_J1939data_tires value, char oldPath[])
{
  char newPath[300]; 
  int i;
  int result;

  result = 0;

  C2xRemoveToken(packetHandle, "BasicSafetyMessageVerbose", oldPath);
  for(i=0; i<value.length; i++)
  {
    snprintf(newPath, elcount(newPath), "%s[%d]", oldPath, i);
    SetBasicSafetyMessageVerbose_J1939data_tires_Params(packetHandle, value.arrayValue[i], newPath);
    result = CheckLastError("BasicSafetyMessageVerbose", gkFuncRefGet, result);
  }
  return result;
}

int GetBasicSafetyMessageVerbose_J1939data_axle_Params(LONG packetHandle, struct BasicSafetyMessageVerbose_J1939data_axle_ value, char oldPath[])
{
  char newPath[300];
  int result;

  result = 0;

  snprintf(newPath, elcount(newPath), "%s.%s", oldPath, "location");
  value.location.isValidFlag = C2xIsTokenAvailable(packetHandle, "BasicSafetyMessageVerbose", newPath);
  if(value.location.isValidFlag==1)
  {
    value.location.value = C2xGetTokenInt(packetHandle, "BasicSafetyMessageVerbose", newPath);
    result = CheckLastError("BasicSafetyMessageVerbose", gkFuncRefGet, result);
  }
  snprintf(newPath, elcount(newPath), "%s.%s", oldPath, "weight");
  value.weight.isValidFlag = C2xIsTokenAvailable(packetHandle, "BasicSafetyMessageVerbose", newPath);
  if(value.weight.isValidFlag==1)
  {
    value.weight.value = C2xGetTokenInt(packetHandle, "BasicSafetyMessageVerbose", newPath);
    result = CheckLastError("BasicSafetyMessageVerbose", gkFuncRefGet, result);
  }
  return result;
}

int SetBasicSafetyMessageVerbose_J1939data_axle_Params(LONG packetHandle, struct BasicSafetyMessageVerbose_J1939data_axle_ value, char oldPath[])
{
  char newPath[300];
  int result;

  result = 0;

  snprintf(newPath, elcount(newPath), "%s.%s", oldPath, "location");
  if(value.location.isValidFlag==1)
  {
    C2xSetTokenInt(packetHandle, "BasicSafetyMessageVerbose", newPath, value.location.value);
    result = CheckLastError("BasicSafetyMessageVerbose", gkFuncRefGet, result);
  }
  else
  {
    if( C2xIsTokenAvailable(packetHandle, "BasicSafetyMessageVerbose", newPath) )
    {
      C2xRemoveToken(packetHandle, "BasicSafetyMessageVerbose", newPath);
    }
  }

  snprintf(newPath, elcount(newPath), "%s.%s", oldPath, "weight");
  if(value.weight.isValidFlag==1)
  {
    C2xSetTokenInt(packetHandle, "BasicSafetyMessageVerbose", newPath, value.weight.value);
    result = CheckLastError("BasicSafetyMessageVerbose", gkFuncRefGet, result);
  }
  else
  {
    if( C2xIsTokenAvailable(packetHandle, "BasicSafetyMessageVerbose", newPath) )
    {
      C2xRemoveToken(packetHandle, "BasicSafetyMessageVerbose", newPath);
    }
  }

  return result;
}

int GetBasicSafetyMessageVerbose_J1939data_axleParams(LONG packetHandle, struct BasicSafetyMessageVerbose_J1939data_axle value, char oldPath[])
{
  char newPath[300]; 
  int i;
  int result;

  result = 0;

  value.length = C2xGetTokenInt(packetHandle, "BasicSafetyMessageVerbose", oldPath);
  if((result = CheckLastError("BasicSafetyMessageVerbose", gkFuncRefGet, result))==0)
  {
    for(i=0; i<value.length; i++)
    {
      snprintf(newPath, elcount(newPath), "%s[%d]", oldPath, i);
      GetBasicSafetyMessageVerbose_J1939data_axle_Params(packetHandle, value.arrayValue[i], newPath);
      result = CheckLastError("BasicSafetyMessageVerbose", gkFuncRefGet, result);
    }
  }
  return result;
}

int SetBasicSafetyMessageVerbose_J1939data_axleParams(LONG packetHandle, struct BasicSafetyMessageVerbose_J1939data_axle value, char oldPath[])
{
  char newPath[300]; 
  int i;
  int result;

  result = 0;

  C2xRemoveToken(packetHandle, "BasicSafetyMessageVerbose", oldPath);
  for(i=0; i<value.length; i++)
  {
    snprintf(newPath, elcount(newPath), "%s[%d]", oldPath, i);
    SetBasicSafetyMessageVerbose_J1939data_axle_Params(packetHandle, value.arrayValue[i], newPath);
    result = CheckLastError("BasicSafetyMessageVerbose", gkFuncRefGet, result);
  }
  return result;
}

int GetBasicSafetyMessageVerboseJ1939dataParams(LONG packetHandle, struct BasicSafetyMessageVerboseJ1939data value, char oldPath[])
{
  char newPath[300];
  int result;

  result = 0;

  snprintf(newPath, elcount(newPath), "%s.%s", oldPath, "tires");
  value.tires.isValidFlag = C2xIsTokenAvailable(packetHandle, "BasicSafetyMessageVerbose", newPath);
  if(value.tires.isValidFlag==1)
  {
    GetBasicSafetyMessageVerbose_J1939data_tiresParams(packetHandle, value.tires, newPath);
    result = CheckLastError("BasicSafetyMessageVerbose", gkFuncRefGet, result);
  }
  snprintf(newPath, elcount(newPath), "%s.%s", oldPath, "axle");
  value.axle.isValidFlag = C2xIsTokenAvailable(packetHandle, "BasicSafetyMessageVerbose", newPath);
  if(value.axle.isValidFlag==1)
  {
    GetBasicSafetyMessageVerbose_J1939data_axleParams(packetHandle, value.axle, newPath);
    result = CheckLastError("BasicSafetyMessageVerbose", gkFuncRefGet, result);
  }
  snprintf(newPath, elcount(newPath), "%s.%s", oldPath, "trailerWeight");
  value.trailerWeight.isValidFlag = C2xIsTokenAvailable(packetHandle, "BasicSafetyMessageVerbose", newPath);
  if(value.trailerWeight.isValidFlag==1)
  {
    value.trailerWeight.value = C2xGetTokenInt(packetHandle, "BasicSafetyMessageVerbose", newPath);
    result = CheckLastError("BasicSafetyMessageVerbose", gkFuncRefGet, result);
  }
  snprintf(newPath, elcount(newPath), "%s.%s", oldPath, "cargoWeight");
  value.cargoWeight.isValidFlag = C2xIsTokenAvailable(packetHandle, "BasicSafetyMessageVerbose", newPath);
  if(value.cargoWeight.isValidFlag==1)
  {
    value.cargoWeight.value = C2xGetTokenInt(packetHandle, "BasicSafetyMessageVerbose", newPath);
    result = CheckLastError("BasicSafetyMessageVerbose", gkFuncRefGet, result);
  }
  snprintf(newPath, elcount(newPath), "%s.%s", oldPath, "steeringAxleTemperature");
  value.steeringAxleTemperature.isValidFlag = C2xIsTokenAvailable(packetHandle, "BasicSafetyMessageVerbose", newPath);
  if(value.steeringAxleTemperature.isValidFlag==1)
  {
    value.steeringAxleTemperature.value = C2xGetTokenInt(packetHandle, "BasicSafetyMessageVerbose", newPath);
    result = CheckLastError("BasicSafetyMessageVerbose", gkFuncRefGet, result);
  }
  snprintf(newPath, elcount(newPath), "%s.%s", oldPath, "driveAxleLocation");
  value.driveAxleLocation.isValidFlag = C2xIsTokenAvailable(packetHandle, "BasicSafetyMessageVerbose", newPath);
  if(value.driveAxleLocation.isValidFlag==1)
  {
    value.driveAxleLocation.value = C2xGetTokenInt(packetHandle, "BasicSafetyMessageVerbose", newPath);
    result = CheckLastError("BasicSafetyMessageVerbose", gkFuncRefGet, result);
  }
  snprintf(newPath, elcount(newPath), "%s.%s", oldPath, "driveAxleLiftAirPressure");
  value.driveAxleLiftAirPressure.isValidFlag = C2xIsTokenAvailable(packetHandle, "BasicSafetyMessageVerbose", newPath);
  if(value.driveAxleLiftAirPressure.isValidFlag==1)
  {
    value.driveAxleLiftAirPressure.value = C2xGetTokenInt(packetHandle, "BasicSafetyMessageVerbose", newPath);
    result = CheckLastError("BasicSafetyMessageVerbose", gkFuncRefGet, result);
  }
  snprintf(newPath, elcount(newPath), "%s.%s", oldPath, "driveAxleTemperature");
  value.driveAxleTemperature.isValidFlag = C2xIsTokenAvailable(packetHandle, "BasicSafetyMessageVerbose", newPath);
  if(value.driveAxleTemperature.isValidFlag==1)
  {
    value.driveAxleTemperature.value = C2xGetTokenInt(packetHandle, "BasicSafetyMessageVerbose", newPath);
    result = CheckLastError("BasicSafetyMessageVerbose", gkFuncRefGet, result);
  }
  snprintf(newPath, elcount(newPath), "%s.%s", oldPath, "driveAxleLubePressure");
  value.driveAxleLubePressure.isValidFlag = C2xIsTokenAvailable(packetHandle, "BasicSafetyMessageVerbose", newPath);
  if(value.driveAxleLubePressure.isValidFlag==1)
  {
    value.driveAxleLubePressure.value = C2xGetTokenInt(packetHandle, "BasicSafetyMessageVerbose", newPath);
    result = CheckLastError("BasicSafetyMessageVerbose", gkFuncRefGet, result);
  }
  snprintf(newPath, elcount(newPath), "%s.%s", oldPath, "steeringAxleLubePressure");
  value.steeringAxleLubePressure.isValidFlag = C2xIsTokenAvailable(packetHandle, "BasicSafetyMessageVerbose", newPath);
  if(value.steeringAxleLubePressure.isValidFlag==1)
  {
    value.steeringAxleLubePressure.value = C2xGetTokenInt(packetHandle, "BasicSafetyMessageVerbose", newPath);
    result = CheckLastError("BasicSafetyMessageVerbose", gkFuncRefGet, result);
  }
  return result;
}

int SetBasicSafetyMessageVerboseJ1939dataParams(LONG packetHandle, struct BasicSafetyMessageVerboseJ1939data value, char oldPath[])
{
  char newPath[300];
  int result;

  result = 0;

  snprintf(newPath, elcount(newPath), "%s.%s", oldPath, "tires");
  if(value.tires.isValidFlag==1)
  {
    SetBasicSafetyMessageVerbose_J1939data_tiresParams(packetHandle, value.tires, newPath);
    result = CheckLastError("BasicSafetyMessageVerbose", gkFuncRefGet, result);
  }
  else
  {
    if( C2xIsTokenAvailable(packetHandle, "BasicSafetyMessageVerbose", newPath) )
    {
      C2xRemoveToken(packetHandle, "BasicSafetyMessageVerbose", newPath);
    }
  }

  snprintf(newPath, elcount(newPath), "%s.%s", oldPath, "axle");
  if(value.axle.isValidFlag==1)
  {
    SetBasicSafetyMessageVerbose_J1939data_axleParams(packetHandle, value.axle, newPath);
    result = CheckLastError("BasicSafetyMessageVerbose", gkFuncRefGet, result);
  }
  else
  {
    if( C2xIsTokenAvailable(packetHandle, "BasicSafetyMessageVerbose", newPath) )
    {
      C2xRemoveToken(packetHandle, "BasicSafetyMessageVerbose", newPath);
    }
  }

  snprintf(newPath, elcount(newPath), "%s.%s", oldPath, "trailerWeight");
  if(value.trailerWeight.isValidFlag==1)
  {
    C2xSetTokenInt(packetHandle, "BasicSafetyMessageVerbose", newPath, value.trailerWeight.value);
    result = CheckLastError("BasicSafetyMessageVerbose", gkFuncRefGet, result);
  }
  else
  {
    if( C2xIsTokenAvailable(packetHandle, "BasicSafetyMessageVerbose", newPath) )
    {
      C2xRemoveToken(packetHandle, "BasicSafetyMessageVerbose", newPath);
    }
  }

  snprintf(newPath, elcount(newPath), "%s.%s", oldPath, "cargoWeight");
  if(value.cargoWeight.isValidFlag==1)
  {
    C2xSetTokenInt(packetHandle, "BasicSafetyMessageVerbose", newPath, value.cargoWeight.value);
    result = CheckLastError("BasicSafetyMessageVerbose", gkFuncRefGet, result);
  }
  else
  {
    if( C2xIsTokenAvailable(packetHandle, "BasicSafetyMessageVerbose", newPath) )
    {
      C2xRemoveToken(packetHandle, "BasicSafetyMessageVerbose", newPath);
    }
  }

  snprintf(newPath, elcount(newPath), "%s.%s", oldPath, "steeringAxleTemperature");
  if(value.steeringAxleTemperature.isValidFlag==1)
  {
    C2xSetTokenInt(packetHandle, "BasicSafetyMessageVerbose", newPath, value.steeringAxleTemperature.value);
    result = CheckLastError("BasicSafetyMessageVerbose", gkFuncRefGet, result);
  }
  else
  {
    if( C2xIsTokenAvailable(packetHandle, "BasicSafetyMessageVerbose", newPath) )
    {
      C2xRemoveToken(packetHandle, "BasicSafetyMessageVerbose", newPath);
    }
  }

  snprintf(newPath, elcount(newPath), "%s.%s", oldPath, "driveAxleLocation");
  if(value.driveAxleLocation.isValidFlag==1)
  {
    C2xSetTokenInt(packetHandle, "BasicSafetyMessageVerbose", newPath, value.driveAxleLocation.value);
    result = CheckLastError("BasicSafetyMessageVerbose", gkFuncRefGet, result);
  }
  else
  {
    if( C2xIsTokenAvailable(packetHandle, "BasicSafetyMessageVerbose", newPath) )
    {
      C2xRemoveToken(packetHandle, "BasicSafetyMessageVerbose", newPath);
    }
  }

  snprintf(newPath, elcount(newPath), "%s.%s", oldPath, "driveAxleLiftAirPressure");
  if(value.driveAxleLiftAirPressure.isValidFlag==1)
  {
    C2xSetTokenInt(packetHandle, "BasicSafetyMessageVerbose", newPath, value.driveAxleLiftAirPressure.value);
    result = CheckLastError("BasicSafetyMessageVerbose", gkFuncRefGet, result);
  }
  else
  {
    if( C2xIsTokenAvailable(packetHandle, "BasicSafetyMessageVerbose", newPath) )
    {
      C2xRemoveToken(packetHandle, "BasicSafetyMessageVerbose", newPath);
    }
  }

  snprintf(newPath, elcount(newPath), "%s.%s", oldPath, "driveAxleTemperature");
  if(value.driveAxleTemperature.isValidFlag==1)
  {
    C2xSetTokenInt(packetHandle, "BasicSafetyMessageVerbose", newPath, value.driveAxleTemperature.value);
    result = CheckLastError("BasicSafetyMessageVerbose", gkFuncRefGet, result);
  }
  else
  {
    if( C2xIsTokenAvailable(packetHandle, "BasicSafetyMessageVerbose", newPath) )
    {
      C2xRemoveToken(packetHandle, "BasicSafetyMessageVerbose", newPath);
    }
  }

  snprintf(newPath, elcount(newPath), "%s.%s", oldPath, "driveAxleLubePressure");
  if(value.driveAxleLubePressure.isValidFlag==1)
  {
    C2xSetTokenInt(packetHandle, "BasicSafetyMessageVerbose", newPath, value.driveAxleLubePressure.value);
    result = CheckLastError("BasicSafetyMessageVerbose", gkFuncRefGet, result);
  }
  else
  {
    if( C2xIsTokenAvailable(packetHandle, "BasicSafetyMessageVerbose", newPath) )
    {
      C2xRemoveToken(packetHandle, "BasicSafetyMessageVerbose", newPath);
    }
  }

  snprintf(newPath, elcount(newPath), "%s.%s", oldPath, "steeringAxleLubePressure");
  if(value.steeringAxleLubePressure.isValidFlag==1)
  {
    C2xSetTokenInt(packetHandle, "BasicSafetyMessageVerbose", newPath, value.steeringAxleLubePressure.value);
    result = CheckLastError("BasicSafetyMessageVerbose", gkFuncRefGet, result);
  }
  else
  {
    if( C2xIsTokenAvailable(packetHandle, "BasicSafetyMessageVerbose", newPath) )
    {
      C2xRemoveToken(packetHandle, "BasicSafetyMessageVerbose", newPath);
    }
  }

  return result;
}

int GetBasicSafetyMessageVerbose_VehicleStatus_weatherReportParams(LONG packetHandle, struct BasicSafetyMessageVerbose_VehicleStatus_weatherReport value, char oldPath[])
{
  char newPath[300];
  int result;

  result = 0;

  snprintf(newPath, elcount(newPath), "%s.%s", oldPath, "isRaining");
  value.isRaining = C2xGetTokenInt(packetHandle, "BasicSafetyMessageVerbose", newPath);
  result = CheckLastError("BasicSafetyMessageVerbose", gkFuncRefGet, result);

  snprintf(newPath, elcount(newPath), "%s.%s", oldPath, "rainRate");
  value.rainRate.isValidFlag = C2xIsTokenAvailable(packetHandle, "BasicSafetyMessageVerbose", newPath);
  if(value.rainRate.isValidFlag==1)
  {
    value.rainRate.value = C2xGetTokenInt(packetHandle, "BasicSafetyMessageVerbose", newPath);
    result = CheckLastError("BasicSafetyMessageVerbose", gkFuncRefGet, result);
  }
  snprintf(newPath, elcount(newPath), "%s.%s", oldPath, "precipSituation");
  value.precipSituation.isValidFlag = C2xIsTokenAvailable(packetHandle, "BasicSafetyMessageVerbose", newPath);
  if(value.precipSituation.isValidFlag==1)
  {
    value.precipSituation.value = C2xGetTokenInt(packetHandle, "BasicSafetyMessageVerbose", newPath);
    result = CheckLastError("BasicSafetyMessageVerbose", gkFuncRefGet, result);
  }
  snprintf(newPath, elcount(newPath), "%s.%s", oldPath, "solarRadiation");
  value.solarRadiation.isValidFlag = C2xIsTokenAvailable(packetHandle, "BasicSafetyMessageVerbose", newPath);
  if(value.solarRadiation.isValidFlag==1)
  {
    value.solarRadiation.value = C2xGetTokenInt(packetHandle, "BasicSafetyMessageVerbose", newPath);
    result = CheckLastError("BasicSafetyMessageVerbose", gkFuncRefGet, result);
  }
  snprintf(newPath, elcount(newPath), "%s.%s", oldPath, "friction");
  value.friction.isValidFlag = C2xIsTokenAvailable(packetHandle, "BasicSafetyMessageVerbose", newPath);
  if(value.friction.isValidFlag==1)
  {
    value.friction.value = C2xGetTokenInt(packetHandle, "BasicSafetyMessageVerbose", newPath);
    result = CheckLastError("BasicSafetyMessageVerbose", gkFuncRefGet, result);
  }
  return result;
}

int SetBasicSafetyMessageVerbose_VehicleStatus_weatherReportParams(LONG packetHandle, struct BasicSafetyMessageVerbose_VehicleStatus_weatherReport value, char oldPath[])
{
  char newPath[300];
  int result;

  result = 0;

  snprintf(newPath, elcount(newPath), "%s.%s", oldPath, "isRaining");
  C2xSetTokenInt(packetHandle, "BasicSafetyMessageVerbose", newPath, value.isRaining);
  result = CheckLastError("BasicSafetyMessageVerbose", gkFuncRefGet, result);

  snprintf(newPath, elcount(newPath), "%s.%s", oldPath, "rainRate");
  if(value.rainRate.isValidFlag==1)
  {
    C2xSetTokenInt(packetHandle, "BasicSafetyMessageVerbose", newPath, value.rainRate.value);
    result = CheckLastError("BasicSafetyMessageVerbose", gkFuncRefGet, result);
  }
  else
  {
    if( C2xIsTokenAvailable(packetHandle, "BasicSafetyMessageVerbose", newPath) )
    {
      C2xRemoveToken(packetHandle, "BasicSafetyMessageVerbose", newPath);
    }
  }

  snprintf(newPath, elcount(newPath), "%s.%s", oldPath, "precipSituation");
  if(value.precipSituation.isValidFlag==1)
  {
    C2xSetTokenInt(packetHandle, "BasicSafetyMessageVerbose", newPath, value.precipSituation.value);
    result = CheckLastError("BasicSafetyMessageVerbose", gkFuncRefGet, result);
  }
  else
  {
    if( C2xIsTokenAvailable(packetHandle, "BasicSafetyMessageVerbose", newPath) )
    {
      C2xRemoveToken(packetHandle, "BasicSafetyMessageVerbose", newPath);
    }
  }

  snprintf(newPath, elcount(newPath), "%s.%s", oldPath, "solarRadiation");
  if(value.solarRadiation.isValidFlag==1)
  {
    C2xSetTokenInt(packetHandle, "BasicSafetyMessageVerbose", newPath, value.solarRadiation.value);
    result = CheckLastError("BasicSafetyMessageVerbose", gkFuncRefGet, result);
  }
  else
  {
    if( C2xIsTokenAvailable(packetHandle, "BasicSafetyMessageVerbose", newPath) )
    {
      C2xRemoveToken(packetHandle, "BasicSafetyMessageVerbose", newPath);
    }
  }

  snprintf(newPath, elcount(newPath), "%s.%s", oldPath, "friction");
  if(value.friction.isValidFlag==1)
  {
    C2xSetTokenInt(packetHandle, "BasicSafetyMessageVerbose", newPath, value.friction.value);
    result = CheckLastError("BasicSafetyMessageVerbose", gkFuncRefGet, result);
  }
  else
  {
    if( C2xIsTokenAvailable(packetHandle, "BasicSafetyMessageVerbose", newPath) )
    {
      C2xRemoveToken(packetHandle, "BasicSafetyMessageVerbose", newPath);
    }
  }

  return result;
}

int GetBasicSafetyMessageVerboseVehicleStatusParams(LONG packetHandle, struct BasicSafetyMessageVerboseVehicleStatus value, char oldPath[])
{
  char newPath[300]; 
  int j;
  int result;

  result = 0;

  snprintf(newPath, elcount(newPath), "%s.%s", oldPath, "lights");
  value.lights.isValidFlag = C2xIsTokenAvailable(packetHandle, "BasicSafetyMessageVerbose", newPath);
  if(value.lights.isValidFlag==1)
  {
    value.lights.value = C2xGetTokenInt(packetHandle, "BasicSafetyMessageVerbose", newPath);
    result = CheckLastError("BasicSafetyMessageVerbose", gkFuncRefGet, result);
  }
  snprintf(newPath, elcount(newPath), "%s.%s", oldPath, "lightBar");
  value.lightBar.isValidFlag = C2xIsTokenAvailable(packetHandle, "BasicSafetyMessageVerbose", newPath);
  if(value.lightBar.isValidFlag==1)
  {
    value.lightBar.value = C2xGetTokenInt(packetHandle, "BasicSafetyMessageVerbose", newPath);
    result = CheckLastError("BasicSafetyMessageVerbose", gkFuncRefGet, result);
  }
  snprintf(newPath, elcount(newPath), "%s.%s", oldPath, "wipers");
  value.wipers.isValidFlag = C2xIsTokenAvailable(packetHandle, "BasicSafetyMessageVerbose", newPath);
  if(value.wipers.isValidFlag==1)
  {
    GetBasicSafetyMessageVerbose_VehicleStatus_wipersParams(packetHandle, value.wipers, newPath);
    result = CheckLastError("BasicSafetyMessageVerbose", gkFuncRefGet, result);
  }
  snprintf(newPath, elcount(newPath), "%s.%s", oldPath, "brakeStatus");
  value.brakeStatus.isValidFlag = C2xIsTokenAvailable(packetHandle, "BasicSafetyMessageVerbose", newPath);
  if(value.brakeStatus.isValidFlag==1)
  {
    value.brakeStatus.isValidFlag = 1;
    value.brakeStatus.stringLength = C2xGetTokenData(packetHandle, "BasicSafetyMessageVerbose", newPath, elcount(value.brakeStatus.string), value.brakeStatus.string);
  }
  snprintf(newPath, elcount(newPath), "%s.%s", oldPath, "brakePressure");
  value.brakePressure.isValidFlag = C2xIsTokenAvailable(packetHandle, "BasicSafetyMessageVerbose", newPath);
  if(value.brakePressure.isValidFlag==1)
  {
    value.brakePressure.value = C2xGetTokenInt(packetHandle, "BasicSafetyMessageVerbose", newPath);
    result = CheckLastError("BasicSafetyMessageVerbose", gkFuncRefGet, result);
  }
  snprintf(newPath, elcount(newPath), "%s.%s", oldPath, "roadFriction");
  value.roadFriction.isValidFlag = C2xIsTokenAvailable(packetHandle, "BasicSafetyMessageVerbose", newPath);
  if(value.roadFriction.isValidFlag==1)
  {
    value.roadFriction.value = C2xGetTokenInt(packetHandle, "BasicSafetyMessageVerbose", newPath);
    result = CheckLastError("BasicSafetyMessageVerbose", gkFuncRefGet, result);
  }
  snprintf(newPath, elcount(newPath), "%s.%s", oldPath, "sunData");
  value.sunData.isValidFlag = C2xIsTokenAvailable(packetHandle, "BasicSafetyMessageVerbose", newPath);
  if(value.sunData.isValidFlag==1)
  {
    value.sunData.value = C2xGetTokenInt(packetHandle, "BasicSafetyMessageVerbose", newPath);
    result = CheckLastError("BasicSafetyMessageVerbose", gkFuncRefGet, result);
  }
  snprintf(newPath, elcount(newPath), "%s.%s", oldPath, "rainData");
  value.rainData.isValidFlag = C2xIsTokenAvailable(packetHandle, "BasicSafetyMessageVerbose", newPath);
  if(value.rainData.isValidFlag==1)
  {
    value.rainData.value = C2xGetTokenInt(packetHandle, "BasicSafetyMessageVerbose", newPath);
    result = CheckLastError("BasicSafetyMessageVerbose", gkFuncRefGet, result);
  }
  snprintf(newPath, elcount(newPath), "%s.%s", oldPath, "airTemp");
  value.airTemp.isValidFlag = C2xIsTokenAvailable(packetHandle, "BasicSafetyMessageVerbose", newPath);
  if(value.airTemp.isValidFlag==1)
  {
    value.airTemp.value = C2xGetTokenInt(packetHandle, "BasicSafetyMessageVerbose", newPath);
    result = CheckLastError("BasicSafetyMessageVerbose", gkFuncRefGet, result);
  }
  snprintf(newPath, elcount(newPath), "%s.%s", oldPath, "airPres");
  value.airPres.isValidFlag = C2xIsTokenAvailable(packetHandle, "BasicSafetyMessageVerbose", newPath);
  if(value.airPres.isValidFlag==1)
  {
    value.airPres.value = C2xGetTokenInt(packetHandle, "BasicSafetyMessageVerbose", newPath);
    result = CheckLastError("BasicSafetyMessageVerbose", gkFuncRefGet, result);
  }
  snprintf(newPath, elcount(newPath), "%s.%s", oldPath, "steering");
  value.steering.isValidFlag = C2xIsTokenAvailable(packetHandle, "BasicSafetyMessageVerbose", newPath);
  if(value.steering.isValidFlag==1)
  {
    GetBasicSafetyMessageVerbose_VehicleStatus_steeringParams(packetHandle, value.steering, newPath);
    result = CheckLastError("BasicSafetyMessageVerbose", gkFuncRefGet, result);
  }
  snprintf(newPath, elcount(newPath), "%s.%s", oldPath, "accelSets");
  value.accelSets.isValidFlag = C2xIsTokenAvailable(packetHandle, "BasicSafetyMessageVerbose", newPath);
  if(value.accelSets.isValidFlag==1)
  {
    GetBasicSafetyMessageVerbose_VehicleStatus_accelSetsParams(packetHandle, value.accelSets, newPath);
    result = CheckLastError("BasicSafetyMessageVerbose", gkFuncRefGet, result);
  }
  snprintf(newPath, elcount(newPath), "%s.%s", oldPath, "object");
  value.object.isValidFlag = C2xIsTokenAvailable(packetHandle, "BasicSafetyMessageVerbose", newPath);
  if(value.object.isValidFlag==1)
  {
    GetBasicSafetyMessageVerbose_VehicleStatus_objectParams(packetHandle, value.object, newPath);
    result = CheckLastError("BasicSafetyMessageVerbose", gkFuncRefGet, result);
  }
  snprintf(newPath, elcount(newPath), "%s.%s", oldPath, "fullPos");
  value.fullPos.isValidFlag = C2xIsTokenAvailable(packetHandle, "BasicSafetyMessageVerbose", newPath);
  if(value.fullPos.isValidFlag==1)
  {
    GetBasicSafetyMessageVerboseFullPositionVectorParams(packetHandle, value.fullPos, newPath);
    result = CheckLastError("BasicSafetyMessageVerbose", gkFuncRefGet, result);
  }
  snprintf(newPath, elcount(newPath), "%s.%s", oldPath, "throttlePos");
  value.throttlePos.isValidFlag = C2xIsTokenAvailable(packetHandle, "BasicSafetyMessageVerbose", newPath);
  if(value.throttlePos.isValidFlag==1)
  {
    value.throttlePos.value = C2xGetTokenInt(packetHandle, "BasicSafetyMessageVerbose", newPath);
    result = CheckLastError("BasicSafetyMessageVerbose", gkFuncRefGet, result);
  }
  snprintf(newPath, elcount(newPath), "%s.%s", oldPath, "speedHeadC");
  value.speedHeadC.isValidFlag = C2xIsTokenAvailable(packetHandle, "BasicSafetyMessageVerbose", newPath);
  if(value.speedHeadC.isValidFlag==1)
  {
    value.speedHeadC.isValidFlag = 1;
    value.speedHeadC.stringLength = C2xGetTokenData(packetHandle, "BasicSafetyMessageVerbose", newPath, elcount(value.speedHeadC.string), value.speedHeadC.string);
  }
  snprintf(newPath, elcount(newPath), "%s.%s", oldPath, "speedC");
  value.speedC.isValidFlag = C2xIsTokenAvailable(packetHandle, "BasicSafetyMessageVerbose", newPath);
  if(value.speedC.isValidFlag==1)
  {
    value.speedC.value = C2xGetTokenInt(packetHandle, "BasicSafetyMessageVerbose", newPath);
    result = CheckLastError("BasicSafetyMessageVerbose", gkFuncRefGet, result);
  }
  snprintf(newPath, elcount(newPath), "%s.%s", oldPath, "vehicleData");
  value.vehicleData.isValidFlag = C2xIsTokenAvailable(packetHandle, "BasicSafetyMessageVerbose", newPath);
  if(value.vehicleData.isValidFlag==1)
  {
    GetBasicSafetyMessageVerbose_VehicleStatus_vehicleDataParams(packetHandle, value.vehicleData, newPath);
    result = CheckLastError("BasicSafetyMessageVerbose", gkFuncRefGet, result);
  }
  snprintf(newPath, elcount(newPath), "%s.%s", oldPath, "vehicleIdent");
  value.vehicleIdent.isValidFlag = C2xIsTokenAvailable(packetHandle, "BasicSafetyMessageVerbose", newPath);
  if(value.vehicleIdent.isValidFlag==1)
  {
    GetBasicSafetyMessageVerboseVehicleIdentParams(packetHandle, value.vehicleIdent, newPath);
    result = CheckLastError("BasicSafetyMessageVerbose", gkFuncRefGet, result);
  }
  snprintf(newPath, elcount(newPath), "%s.%s", oldPath, "j1939data");
  value.j1939data.isValidFlag = C2xIsTokenAvailable(packetHandle, "BasicSafetyMessageVerbose", newPath);
  if(value.j1939data.isValidFlag==1)
  {
    GetBasicSafetyMessageVerboseJ1939dataParams(packetHandle, value.j1939data, newPath);
    result = CheckLastError("BasicSafetyMessageVerbose", gkFuncRefGet, result);
  }
  snprintf(newPath, elcount(newPath), "%s.%s", oldPath, "weatherReport");
  value.weatherReport.isValidFlag = C2xIsTokenAvailable(packetHandle, "BasicSafetyMessageVerbose", newPath);
  if(value.weatherReport.isValidFlag==1)
  {
    GetBasicSafetyMessageVerbose_VehicleStatus_weatherReportParams(packetHandle, value.weatherReport, newPath);
    result = CheckLastError("BasicSafetyMessageVerbose", gkFuncRefGet, result);
  }
  snprintf(newPath, elcount(newPath), "%s.%s", oldPath, "gpsStatus");
  value.gpsStatus.isValidFlag = C2xIsTokenAvailable(packetHandle, "BasicSafetyMessageVerbose", newPath);
  if(value.gpsStatus.isValidFlag==1)
  {
    value.gpsStatus.isValidFlag = 1;
    value.gpsStatus.stringLength = C2xGetTokenLengthBit(packetHandle, "BasicSafetyMessageVerbose", newPath);
    if ((result = CheckLastError("BasicSafetyMessageVerbose", gkFuncRefGet, result))==0)
    {
      for(j=0; j<value.gpsStatus.stringLength; j++)
      {
        if(C2xGetTokenBitOfBitString(packetHandle, "BasicSafetyMessageVerbose", newPath, j) == 0)
        {
          value.gpsStatus.string[j] = '0';
        }
        else
        {
          value.gpsStatus.string[j] = '1';
        }
        result = CheckLastError("BasicSafetyMessageVerbose", gkFuncRefGet, result);
      }
    }

  }
  return result;
}

int SetBasicSafetyMessageVerboseVehicleStatusParams(LONG packetHandle, struct BasicSafetyMessageVerboseVehicleStatus value, char oldPath[])
{
  char newPath[300]; 
  int j;
  int result;

  result = 0;

  snprintf(newPath, elcount(newPath), "%s.%s", oldPath, "lights");
  if(value.lights.isValidFlag==1)
  {
    C2xSetTokenInt(packetHandle, "BasicSafetyMessageVerbose", newPath, value.lights.value);
    result = CheckLastError("BasicSafetyMessageVerbose", gkFuncRefGet, result);
  }
  else
  {
    if( C2xIsTokenAvailable(packetHandle, "BasicSafetyMessageVerbose", newPath) )
    {
      C2xRemoveToken(packetHandle, "BasicSafetyMessageVerbose", newPath);
    }
  }

  snprintf(newPath, elcount(newPath), "%s.%s", oldPath, "lightBar");
  if(value.lightBar.isValidFlag==1)
  {
    C2xSetTokenInt(packetHandle, "BasicSafetyMessageVerbose", newPath, value.lightBar.value);
    result = CheckLastError("BasicSafetyMessageVerbose", gkFuncRefGet, result);
  }
  else
  {
    if( C2xIsTokenAvailable(packetHandle, "BasicSafetyMessageVerbose", newPath) )
    {
      C2xRemoveToken(packetHandle, "BasicSafetyMessageVerbose", newPath);
    }
  }

  snprintf(newPath, elcount(newPath), "%s.%s", oldPath, "wipers");
  if(value.wipers.isValidFlag==1)
  {
    SetBasicSafetyMessageVerbose_VehicleStatus_wipersParams(packetHandle, value.wipers, newPath);
    result = CheckLastError("BasicSafetyMessageVerbose", gkFuncRefGet, result);
  }
  else
  {
    if( C2xIsTokenAvailable(packetHandle, "BasicSafetyMessageVerbose", newPath) )
    {
      C2xRemoveToken(packetHandle, "BasicSafetyMessageVerbose", newPath);
    }
  }

  snprintf(newPath, elcount(newPath), "%s.%s", oldPath, "brakeStatus");
  if(value.brakeStatus.isValidFlag==1)
  {
    C2xSetTokenData(packetHandle, "BasicSafetyMessageVerbose", newPath, value.brakeStatus.stringLength, value.brakeStatus.string);
  }
  else
  {
    if( C2xIsTokenAvailable(packetHandle, "BasicSafetyMessageVerbose", newPath) )
    {
      C2xRemoveToken(packetHandle, "BasicSafetyMessageVerbose", newPath);
    }
  }

  snprintf(newPath, elcount(newPath), "%s.%s", oldPath, "brakePressure");
  if(value.brakePressure.isValidFlag==1)
  {
    C2xSetTokenInt(packetHandle, "BasicSafetyMessageVerbose", newPath, value.brakePressure.value);
    result = CheckLastError("BasicSafetyMessageVerbose", gkFuncRefGet, result);
  }
  else
  {
    if( C2xIsTokenAvailable(packetHandle, "BasicSafetyMessageVerbose", newPath) )
    {
      C2xRemoveToken(packetHandle, "BasicSafetyMessageVerbose", newPath);
    }
  }

  snprintf(newPath, elcount(newPath), "%s.%s", oldPath, "roadFriction");
  if(value.roadFriction.isValidFlag==1)
  {
    C2xSetTokenInt(packetHandle, "BasicSafetyMessageVerbose", newPath, value.roadFriction.value);
    result = CheckLastError("BasicSafetyMessageVerbose", gkFuncRefGet, result);
  }
  else
  {
    if( C2xIsTokenAvailable(packetHandle, "BasicSafetyMessageVerbose", newPath) )
    {
      C2xRemoveToken(packetHandle, "BasicSafetyMessageVerbose", newPath);
    }
  }

  snprintf(newPath, elcount(newPath), "%s.%s", oldPath, "sunData");
  if(value.sunData.isValidFlag==1)
  {
    C2xSetTokenInt(packetHandle, "BasicSafetyMessageVerbose", newPath, value.sunData.value);
    result = CheckLastError("BasicSafetyMessageVerbose", gkFuncRefGet, result);
  }
  else
  {
    if( C2xIsTokenAvailable(packetHandle, "BasicSafetyMessageVerbose", newPath) )
    {
      C2xRemoveToken(packetHandle, "BasicSafetyMessageVerbose", newPath);
    }
  }

  snprintf(newPath, elcount(newPath), "%s.%s", oldPath, "rainData");
  if(value.rainData.isValidFlag==1)
  {
    C2xSetTokenInt(packetHandle, "BasicSafetyMessageVerbose", newPath, value.rainData.value);
    result = CheckLastError("BasicSafetyMessageVerbose", gkFuncRefGet, result);
  }
  else
  {
    if( C2xIsTokenAvailable(packetHandle, "BasicSafetyMessageVerbose", newPath) )
    {
      C2xRemoveToken(packetHandle, "BasicSafetyMessageVerbose", newPath);
    }
  }

  snprintf(newPath, elcount(newPath), "%s.%s", oldPath, "airTemp");
  if(value.airTemp.isValidFlag==1)
  {
    C2xSetTokenInt(packetHandle, "BasicSafetyMessageVerbose", newPath, value.airTemp.value);
    result = CheckLastError("BasicSafetyMessageVerbose", gkFuncRefGet, result);
  }
  else
  {
    if( C2xIsTokenAvailable(packetHandle, "BasicSafetyMessageVerbose", newPath) )
    {
      C2xRemoveToken(packetHandle, "BasicSafetyMessageVerbose", newPath);
    }
  }

  snprintf(newPath, elcount(newPath), "%s.%s", oldPath, "airPres");
  if(value.airPres.isValidFlag==1)
  {
    C2xSetTokenInt(packetHandle, "BasicSafetyMessageVerbose", newPath, value.airPres.value);
    result = CheckLastError("BasicSafetyMessageVerbose", gkFuncRefGet, result);
  }
  else
  {
    if( C2xIsTokenAvailable(packetHandle, "BasicSafetyMessageVerbose", newPath) )
    {
      C2xRemoveToken(packetHandle, "BasicSafetyMessageVerbose", newPath);
    }
  }

  snprintf(newPath, elcount(newPath), "%s.%s", oldPath, "steering");
  if(value.steering.isValidFlag==1)
  {
    SetBasicSafetyMessageVerbose_VehicleStatus_steeringParams(packetHandle, value.steering, newPath);
    result = CheckLastError("BasicSafetyMessageVerbose", gkFuncRefGet, result);
  }
  else
  {
    if( C2xIsTokenAvailable(packetHandle, "BasicSafetyMessageVerbose", newPath) )
    {
      C2xRemoveToken(packetHandle, "BasicSafetyMessageVerbose", newPath);
    }
  }

  snprintf(newPath, elcount(newPath), "%s.%s", oldPath, "accelSets");
  if(value.accelSets.isValidFlag==1)
  {
    SetBasicSafetyMessageVerbose_VehicleStatus_accelSetsParams(packetHandle, value.accelSets, newPath);
    result = CheckLastError("BasicSafetyMessageVerbose", gkFuncRefGet, result);
  }
  else
  {
    if( C2xIsTokenAvailable(packetHandle, "BasicSafetyMessageVerbose", newPath) )
    {
      C2xRemoveToken(packetHandle, "BasicSafetyMessageVerbose", newPath);
    }
  }

  snprintf(newPath, elcount(newPath), "%s.%s", oldPath, "object");
  if(value.object.isValidFlag==1)
  {
    SetBasicSafetyMessageVerbose_VehicleStatus_objectParams(packetHandle, value.object, newPath);
    result = CheckLastError("BasicSafetyMessageVerbose", gkFuncRefGet, result);
  }
  else
  {
    if( C2xIsTokenAvailable(packetHandle, "BasicSafetyMessageVerbose", newPath) )
    {
      C2xRemoveToken(packetHandle, "BasicSafetyMessageVerbose", newPath);
    }
  }

  snprintf(newPath, elcount(newPath), "%s.%s", oldPath, "fullPos");
  if(value.fullPos.isValidFlag==1)
  {
    SetBasicSafetyMessageVerboseFullPositionVectorParams(packetHandle, value.fullPos, newPath);
    result = CheckLastError("BasicSafetyMessageVerbose", gkFuncRefGet, result);
  }
  else
  {
    if( C2xIsTokenAvailable(packetHandle, "BasicSafetyMessageVerbose", newPath) )
    {
      C2xRemoveToken(packetHandle, "BasicSafetyMessageVerbose", newPath);
    }
  }

  snprintf(newPath, elcount(newPath), "%s.%s", oldPath, "throttlePos");
  if(value.throttlePos.isValidFlag==1)
  {
    C2xSetTokenInt(packetHandle, "BasicSafetyMessageVerbose", newPath, value.throttlePos.value);
    result = CheckLastError("BasicSafetyMessageVerbose", gkFuncRefGet, result);
  }
  else
  {
    if( C2xIsTokenAvailable(packetHandle, "BasicSafetyMessageVerbose", newPath) )
    {
      C2xRemoveToken(packetHandle, "BasicSafetyMessageVerbose", newPath);
    }
  }

  snprintf(newPath, elcount(newPath), "%s.%s", oldPath, "speedHeadC");
  if(value.speedHeadC.isValidFlag==1)
  {
    C2xSetTokenData(packetHandle, "BasicSafetyMessageVerbose", newPath, value.speedHeadC.stringLength, value.speedHeadC.string);
  }
  else
  {
    if( C2xIsTokenAvailable(packetHandle, "BasicSafetyMessageVerbose", newPath) )
    {
      C2xRemoveToken(packetHandle, "BasicSafetyMessageVerbose", newPath);
    }
  }

  snprintf(newPath, elcount(newPath), "%s.%s", oldPath, "speedC");
  if(value.speedC.isValidFlag==1)
  {
    C2xSetTokenInt(packetHandle, "BasicSafetyMessageVerbose", newPath, value.speedC.value);
    result = CheckLastError("BasicSafetyMessageVerbose", gkFuncRefGet, result);
  }
  else
  {
    if( C2xIsTokenAvailable(packetHandle, "BasicSafetyMessageVerbose", newPath) )
    {
      C2xRemoveToken(packetHandle, "BasicSafetyMessageVerbose", newPath);
    }
  }

  snprintf(newPath, elcount(newPath), "%s.%s", oldPath, "vehicleData");
  if(value.vehicleData.isValidFlag==1)
  {
    SetBasicSafetyMessageVerbose_VehicleStatus_vehicleDataParams(packetHandle, value.vehicleData, newPath);
    result = CheckLastError("BasicSafetyMessageVerbose", gkFuncRefGet, result);
  }
  else
  {
    if( C2xIsTokenAvailable(packetHandle, "BasicSafetyMessageVerbose", newPath) )
    {
      C2xRemoveToken(packetHandle, "BasicSafetyMessageVerbose", newPath);
    }
  }

  snprintf(newPath, elcount(newPath), "%s.%s", oldPath, "vehicleIdent");
  if(value.vehicleIdent.isValidFlag==1)
  {
    SetBasicSafetyMessageVerboseVehicleIdentParams(packetHandle, value.vehicleIdent, newPath);
    result = CheckLastError("BasicSafetyMessageVerbose", gkFuncRefGet, result);
  }
  else
  {
    if( C2xIsTokenAvailable(packetHandle, "BasicSafetyMessageVerbose", newPath) )
    {
      C2xRemoveToken(packetHandle, "BasicSafetyMessageVerbose", newPath);
    }
  }

  snprintf(newPath, elcount(newPath), "%s.%s", oldPath, "j1939data");
  if(value.j1939data.isValidFlag==1)
  {
    SetBasicSafetyMessageVerboseJ1939dataParams(packetHandle, value.j1939data, newPath);
    result = CheckLastError("BasicSafetyMessageVerbose", gkFuncRefGet, result);
  }
  else
  {
    if( C2xIsTokenAvailable(packetHandle, "BasicSafetyMessageVerbose", newPath) )
    {
      C2xRemoveToken(packetHandle, "BasicSafetyMessageVerbose", newPath);
    }
  }

  snprintf(newPath, elcount(newPath), "%s.%s", oldPath, "weatherReport");
  if(value.weatherReport.isValidFlag==1)
  {
    SetBasicSafetyMessageVerbose_VehicleStatus_weatherReportParams(packetHandle, value.weatherReport, newPath);
    result = CheckLastError("BasicSafetyMessageVerbose", gkFuncRefGet, result);
  }
  else
  {
    if( C2xIsTokenAvailable(packetHandle, "BasicSafetyMessageVerbose", newPath) )
    {
      C2xRemoveToken(packetHandle, "BasicSafetyMessageVerbose", newPath);
    }
  }

  snprintf(newPath, elcount(newPath), "%s.%s", oldPath, "gpsStatus");
  if(value.gpsStatus.isValidFlag==1)
  {
      for(j=0; j<value.gpsStatus.stringLength; j++)
      {
        if(value.gpsStatus.string[j] == '0')
        {
          C2xSetTokenBitOfBitString(packetHandle, "BasicSafetyMessageVerbose", newPath, j, 0);
        }
        else
        {
          C2xSetTokenBitOfBitString(packetHandle, "BasicSafetyMessageVerbose", newPath, j, 1);
        }
        result = CheckLastError("BasicSafetyMessageVerbose", gkFuncRefGet, result);
      }
  }
  else
  {
    if( C2xIsTokenAvailable(packetHandle, "BasicSafetyMessageVerbose", newPath) )
    {
      C2xRemoveToken(packetHandle, "BasicSafetyMessageVerbose", newPath);
    }
  }

  return result;
}

int API_GetBasicSafetyMessageVerboseParams(LONG packetHandle, struct BasicSafetyMessageVerbose value)
{
  int result;
  result = 0;

  value.msgID = C2xGetTokenInt(packetHandle, "BasicSafetyMessageVerbose", "msgID");
  result = CheckLastError("BasicSafetyMessageVerbose", gkFuncRefGet, result);

  value.msgCnt = C2xGetTokenInt(packetHandle, "BasicSafetyMessageVerbose", "msgCnt");
  result = CheckLastError("BasicSafetyMessageVerbose", gkFuncRefGet, result);

  value.id.isValidFlag = 1;
  GetBasicSafetyMessageVerboseTemporaryIDParams(packetHandle, value.id, "id");
  result = CheckLastError("BasicSafetyMessageVerbose", gkFuncRefGet, result);

  value.secMark = C2xGetTokenInt(packetHandle, "BasicSafetyMessageVerbose", "secMark");
  result = CheckLastError("BasicSafetyMessageVerbose", gkFuncRefGet, result);

  value.lat = C2xGetTokenInt(packetHandle, "BasicSafetyMessageVerbose", "lat");
  result = CheckLastError("BasicSafetyMessageVerbose", gkFuncRefGet, result);

  value.lon = C2xGetTokenInt(packetHandle, "BasicSafetyMessageVerbose", "lon");
  result = CheckLastError("BasicSafetyMessageVerbose", gkFuncRefGet, result);

  value.elev.isValidFlag = 1;
  GetBasicSafetyMessageVerboseElevationParams(packetHandle, value.elev, "elev");
  result = CheckLastError("BasicSafetyMessageVerbose", gkFuncRefGet, result);

  value.accuracy.isValidFlag = 1;
  GetBasicSafetyMessageVerbosePositionalAccuracyParams(packetHandle, value.accuracy, "accuracy");
  result = CheckLastError("BasicSafetyMessageVerbose", gkFuncRefGet, result);

  value.speed.isValidFlag = 1;
  GetBasicSafetyMessageVerboseTransmissionAndSpeedParams(packetHandle, value.speed, "speed");
  result = CheckLastError("BasicSafetyMessageVerbose", gkFuncRefGet, result);

  value.heading = C2xGetTokenInt(packetHandle, "BasicSafetyMessageVerbose", "heading");
  result = CheckLastError("BasicSafetyMessageVerbose", gkFuncRefGet, result);

  value.angle.isValidFlag = 1;
  GetBasicSafetyMessageVerboseSteeringWheelAngleParams(packetHandle, value.angle, "angle");
  result = CheckLastError("BasicSafetyMessageVerbose", gkFuncRefGet, result);

  value.accelSet.isValidFlag = 1;
  GetBasicSafetyMessageVerboseAccelerationSet4WayParams(packetHandle, value.accelSet, "accelSet");
  result = CheckLastError("BasicSafetyMessageVerbose", gkFuncRefGet, result);

  value.brakes.isValidFlag = 1;
  GetBasicSafetyMessageVerboseBrakeSystemStatusParams(packetHandle, value.brakes, "brakes");
  result = CheckLastError("BasicSafetyMessageVerbose", gkFuncRefGet, result);

  value.size.isValidFlag = 1;
  GetBasicSafetyMessageVerboseVehicleSizeParams(packetHandle, value.size, "size");
  result = CheckLastError("BasicSafetyMessageVerbose", gkFuncRefGet, result);

  value.safetyExt.isValidFlag = C2xIsTokenAvailable(packetHandle, "BasicSafetyMessageVerbose", "safetyExt");
  if(value.safetyExt.isValidFlag == 1)
  {
    value.safetyExt.isValidFlag = 1;
    GetBasicSafetyMessageVerboseVehicleSafetyExtensionParams(packetHandle, value.safetyExt, "safetyExt");
    result = CheckLastError("BasicSafetyMessageVerbose", gkFuncRefGet, result);

  }
  value.status.isValidFlag = C2xIsTokenAvailable(packetHandle, "BasicSafetyMessageVerbose", "status");
  if(value.status.isValidFlag == 1)
  {
    value.status.isValidFlag = 1;
    GetBasicSafetyMessageVerboseVehicleStatusParams(packetHandle, value.status, "status");
    result = CheckLastError("BasicSafetyMessageVerbose", gkFuncRefGet, result);

  }
  return result;
}

int API_SetBasicSafetyMessageVerboseParams(LONG packetHandle, struct BasicSafetyMessageVerbose value)
{
  int result;
  result = 0;

  value.msgID = 3;

  C2xSetTokenInt(packetHandle, "BasicSafetyMessageVerbose", "msgID", value.msgID);
  result = CheckLastError("BasicSafetyMessageVerbose", gkFuncRefGet, result);

  C2xSetTokenInt(packetHandle, "BasicSafetyMessageVerbose", "msgCnt", value.msgCnt);
  result = CheckLastError("BasicSafetyMessageVerbose", gkFuncRefGet, result);

  SetBasicSafetyMessageVerboseTemporaryIDParams(packetHandle, value.id, "id");
  result = CheckLastError("BasicSafetyMessageVerbose", gkFuncRefGet, result);

  C2xSetTokenInt(packetHandle, "BasicSafetyMessageVerbose", "secMark", value.secMark);
  result = CheckLastError("BasicSafetyMessageVerbose", gkFuncRefGet, result);

  C2xSetTokenInt(packetHandle, "BasicSafetyMessageVerbose", "lat", value.lat);
  result = CheckLastError("BasicSafetyMessageVerbose", gkFuncRefGet, result);

  C2xSetTokenInt(packetHandle, "BasicSafetyMessageVerbose", "lon", value.lon);
  result = CheckLastError("BasicSafetyMessageVerbose", gkFuncRefGet, result);

  SetBasicSafetyMessageVerboseElevationParams(packetHandle, value.elev, "elev");
  result = CheckLastError("BasicSafetyMessageVerbose", gkFuncRefGet, result);

  SetBasicSafetyMessageVerbosePositionalAccuracyParams(packetHandle, value.accuracy, "accuracy");
  result = CheckLastError("BasicSafetyMessageVerbose", gkFuncRefGet, result);

  SetBasicSafetyMessageVerboseTransmissionAndSpeedParams(packetHandle, value.speed, "speed");
  result = CheckLastError("BasicSafetyMessageVerbose", gkFuncRefGet, result);

  C2xSetTokenInt(packetHandle, "BasicSafetyMessageVerbose", "heading", value.heading);
  result = CheckLastError("BasicSafetyMessageVerbose", gkFuncRefGet, result);

  SetBasicSafetyMessageVerboseSteeringWheelAngleParams(packetHandle, value.angle, "angle");
  result = CheckLastError("BasicSafetyMessageVerbose", gkFuncRefGet, result);

  SetBasicSafetyMessageVerboseAccelerationSet4WayParams(packetHandle, value.accelSet, "accelSet");
  result = CheckLastError("BasicSafetyMessageVerbose", gkFuncRefGet, result);

  SetBasicSafetyMessageVerboseBrakeSystemStatusParams(packetHandle, value.brakes, "brakes");
  result = CheckLastError("BasicSafetyMessageVerbose", gkFuncRefGet, result);

  SetBasicSafetyMessageVerboseVehicleSizeParams(packetHandle, value.size, "size");
  result = CheckLastError("BasicSafetyMessageVerbose", gkFuncRefGet, result);

  if (value.safetyExt.isValidFlag==1)
  {
    SetBasicSafetyMessageVerboseVehicleSafetyExtensionParams(packetHandle, value.safetyExt, "safetyExt");
    result = CheckLastError("BasicSafetyMessageVerbose", gkFuncRefGet, result);

  }
  else
  {
    if( C2xIsTokenAvailable(packetHandle, "BasicSafetyMessageVerbose", "safetyExt") )
    {
      C2xRemoveToken(packetHandle, "BasicSafetyMessageVerbose", "safetyExt");
    }
  }

  if (value.status.isValidFlag==1)
  {
    SetBasicSafetyMessageVerboseVehicleStatusParams(packetHandle, value.status, "status");
    result = CheckLastError("BasicSafetyMessageVerbose", gkFuncRefGet, result);

  }
  else
  {
    if( C2xIsTokenAvailable(packetHandle, "BasicSafetyMessageVerbose", "status") )
    {
      C2xRemoveToken(packetHandle, "BasicSafetyMessageVerbose", "status");
    }
  }

  return result;
}

