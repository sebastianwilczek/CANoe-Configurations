/*@!Encoding:1252*/
/*
//  (c) Vector Informatik GmbH. All rights reserved.
//
//  This file contains definitions of structs and methods that may be used
//  to set and get the values of an ASN.1 defined packet's payload.
//
//  //This example demonstrates how to set a packet's payload:
//  LONG packetHandle;
//  struct NMEA_Corrections payload;
//  //you need to set the values of the variable "payload" yourself
//  packetHandle = API_InitNMEA_CorrectionsPacket();
//  if (packetHandle!=0) {
//    if (API_SetNMEA_CorrectionsParams(packetHandle, payload)==0) {
//      if (C2xCompletePacket(packetHandle)==0) {
//        C2xOutputPacket(packetHandle);
//      }
//    }
//  }
//                                                                             */
includes
{

}
variables
{
    struct NMEA_CorrectionsNMEA_Payload {
        INT isValidFlag;   // necessary if this struct is used as an optional field of a SEQUENCE
        CHAR string[1024];
        INT  stringLength;
    };
    
    struct NMEA_Corrections {
        INT isValidFlag;   // necessary if this struct is used as an optional field of a SEQUENCE
        INT msgID;  // ENUMERATED, reserved(0), alaCarteMessage(1), basicSafetyMessage(2), basicSafetyMessageVerbose(3), commonSafetyRequest(4), emergencyVehicleAlert(5), intersectionCollisionAlert(6), mapData(7), nmeaCorrections(8), probeDataManagement(9), probeVehicleData(10), roadSideAlert(11), rtcmCorrections(12), signalPhaseAndTimingMessage(13), signalRequestMessage(14), signalStatusMessage(15), travelerInformation(16);
        INT rev;  // ENUMERATED, unknown(0), reserved(1), rev1(10), rev2(20), rev3(30), rev4(40), rev5(50);
        WORD msg;  // INTEGER, 0..32767;
        WORD wdCount;  // INTEGER, 0..1023;
        struct NMEA_CorrectionsNMEA_Payload payload;  // OCTETSTRING;
    };
    
}

/*
// init function to create a simple packet handle
*/ 
LONG API_InitNMEA_CorrectionsPacket()
{
  return C2xInitPacket("NMEA_Corrections"); 
}

/*
// init function to create a simple packet handle and
// initialize the struct with valid data
*/ 
LONG API_InitNMEA_CorrectionsPacket(struct NMEA_Corrections msgStruct)
{
  long pktHandle;

  pktHandle = API_InitNMEA_CorrectionsPacket();

  if (pktHandle != 0)
  {
    // create valid message and application data
    if (C2xCompletePacket(pktHandle) == 0) 
    {
      API_GetNMEA_CorrectionsParams(pktHandle, msgStruct);
    }
  }
  return pktHandle;
}

/*
// init function to create a packet with security layer and
// initialize the struct with valid data
*/ 
LONG API_InitNMEA_CorrectionsPacket(struct NMEA_Corrections msgStruct, char packetTypeDesignator[], char certificateName[])
{
  long pktHandle, certHdl;

  // initialize the packet
  pktHandle = C2xInitPacket("NMEA_Corrections", packetTypeDesignator);

  if (pktHandle != 0)
  {
    certHdl = C2xSecCertificateGetHandle(certificateName);  // get the certificate handle for the cert with name "certificateName"
    if (certHdl != 0) 
    {
      C2xSecPacketSetSignerHandle(pktHandle, certHdl); // set the certHdl to the packet
    }

    // create valid message and application data
    if (C2xCompletePacket(pktHandle) == 0) 
    {
      // copy application data to the application structure
      API_GetNMEA_CorrectionsParams(pktHandle, msgStruct);
    }
  }
  return pktHandle;
}
    

int API_GetNMEA_CorrectionsParams(LONG packetHandle, struct NMEA_Corrections value)
{
  int result;
  result = 0;

  value.msgID = C2xGetTokenInt(packetHandle, "NMEA_Corrections", "msgID");
  result = CheckLastError("NMEA_Corrections", gkFuncRefGet, result);

  value.rev = C2xGetTokenInt(packetHandle, "NMEA_Corrections", "rev");
  result = CheckLastError("NMEA_Corrections", gkFuncRefGet, result);

  value.msg = C2xGetTokenInt(packetHandle, "NMEA_Corrections", "msg");
  result = CheckLastError("NMEA_Corrections", gkFuncRefGet, result);

  value.wdCount = C2xGetTokenInt(packetHandle, "NMEA_Corrections", "wdCount");
  result = CheckLastError("NMEA_Corrections", gkFuncRefGet, result);

  value.payload.stringLength = C2xGetTokenData(packetHandle, "NMEA_Corrections", "payload", elcount(value.payload.string), value.payload.string);
  result = CheckLastError("NMEA_Corrections", gkFuncRefGet, result);

  return result;
}

int API_SetNMEA_CorrectionsParams(LONG packetHandle, struct NMEA_Corrections value)
{
  int result;
  result = 0;

  value.msgID = 8;

  C2xSetTokenInt(packetHandle, "NMEA_Corrections", "msgID", value.msgID);
  result = CheckLastError("NMEA_Corrections", gkFuncRefGet, result);

  C2xSetTokenInt(packetHandle, "NMEA_Corrections", "rev", value.rev);
  result = CheckLastError("NMEA_Corrections", gkFuncRefGet, result);

  C2xSetTokenInt(packetHandle, "NMEA_Corrections", "msg", value.msg);
  result = CheckLastError("NMEA_Corrections", gkFuncRefGet, result);

  C2xSetTokenInt(packetHandle, "NMEA_Corrections", "wdCount", value.wdCount);
  result = CheckLastError("NMEA_Corrections", gkFuncRefGet, result);

  C2xSetTokenData(packetHandle, "NMEA_Corrections", "payload", value.payload.stringLength, value.payload.string);
  result = CheckLastError("NMEA_Corrections", gkFuncRefGet, result);

  return result;
}

