/*@!Encoding:1252*/
/*
//  (c) Vector Informatik GmbH. All rights reserved.
//
//  This file contains definitions of structs and methods that may be used
//  to set and get the values of an ASN.1 defined packet's payload.
//
//  //This example demonstrates how to set a packet's payload:
//  LONG packetHandle;
//  struct SignalRequestMsg payload;
//  //you need to set the values of the variable "payload" yourself
//  packetHandle = API_InitSignalRequestMsgPacket();
//  if (packetHandle!=0) {
//    if (API_SetSignalRequestMsgParams(packetHandle, payload)==0) {
//      if (C2xCompletePacket(packetHandle)==0) {
//        C2xOutputPacket(packetHandle);
//      }
//    }
//  }
//                                                                             */
includes
{

}
variables
{
    struct SignalRequestMsg_Blob_Preempt {
        INT isValidFlag;   // necessary if this struct is used as an optional field of a SEQUENCE
        BYTE preempt_or_prio;  // INTEGER, 0..1, Priority(0), Preempt(1);
        BYTE controller;  // INTEGER, 0..7;
    };
    
    struct SignalRequestMsg_Blob_SignalReqScheme {
        INT isValidFlag;   // necessary if this struct is used as an optional field of a SEQUENCE
        struct SignalRequestMsg_Blob_Preempt preempt;  // SEQUENCE;
        BYTE strategy;  // INTEGER, 0..15;
    };
    
    struct SignalRequestMsgSignalReqScheme {
        INT isValidFlag;   // necessary if this struct is used as an optional field of a SEQUENCE
        CHAR string[2];
        INT  stringLength;
        struct SignalRequestMsg_Blob_SignalReqScheme _Blob_SignalReqScheme;  // SEQUENCE;
    };
    
    struct SignalRequestMsg_Blob_LaneNumber {
        INT isValidFlag;   // necessary if this struct is used as an optional field of a SEQUENCE
        BYTE laneNumber;  // INTEGER, 0..255;
    };
    
    struct SignalRequestMsgLaneNumber {
        INT isValidFlag;   // necessary if this struct is used as an optional field of a SEQUENCE
        CHAR string[2];
        INT  stringLength;
        struct SignalRequestMsg_Blob_LaneNumber _Blob_LaneNumber;  // SEQUENCE;
    };
    
    struct SignalRequestMsg_Blob_NTCIPVehicleClass {
        INT isValidFlag;   // necessary if this struct is used as an optional field of a SEQUENCE
        BYTE type;  // INTEGER, 0..15;
        BYTE level;  // INTEGER, 0..15;
    };
    
    struct SignalRequestMsgNTCIPVehicleclass {
        INT isValidFlag;   // necessary if this struct is used as an optional field of a SEQUENCE
        CHAR string[2];
        INT  stringLength;
        struct SignalRequestMsg_Blob_NTCIPVehicleClass _Blob_NTCIPVehicleClass;  // SEQUENCE;
    };
    
    struct SignalRequestMsgCodeWord {
        INT isValidFlag;   // necessary if this struct is used as an optional field of a SEQUENCE
        CHAR string[17];
        INT  stringLength;
    };
    
    struct SignalRequestMsgSignalRequest {
        INT isValidFlag;   // necessary if this struct is used as an optional field of a SEQUENCE
        WORD id;  // INTEGER, 0..65535;
        struct SignalRequestMsgSignalReqScheme isCancel;  // OCTETSTRING, OPTIONAL;
        struct SignalRequestMsgSignalReqScheme requestedAction;  // OCTETSTRING, OPTIONAL;
        struct SignalRequestMsgLaneNumber inLane;  // OCTETSTRING, OPTIONAL;
        struct SignalRequestMsgLaneNumber outLane;  // OCTETSTRING, OPTIONAL;
        struct SignalRequestMsgNTCIPVehicleclass type;  // OCTETSTRING;
        struct SignalRequestMsgCodeWord codeWord;  // OCTETSTRING, OPTIONAL;
    };
    
    struct SignalRequestMsgDTime {
        INT isValidFlag;   // necessary if this struct is used as an optional field of a SEQUENCE
        BYTE hour;  // INTEGER, 0..31;
        BYTE minute;  // INTEGER, 0..63;
        WORD second;  // INTEGER, 0..65535;
    };
    
    struct SignalRequestMsgTransitStatus {
        INT isValidFlag;   // necessary if this struct is used as an optional field of a SEQUENCE
        CHAR string[7];
        INT  stringLength;
    };
    
    struct SignalRequestMsgDescriptiveName {
        INT isValidFlag;   // necessary if this struct is used as an optional field of a SEQUENCE
        CHAR string[64];
        INT  stringLength;
    };
    
    struct SignalRequestMsgVINstring {
        INT isValidFlag;   // necessary if this struct is used as an optional field of a SEQUENCE
        CHAR string[18];
        INT  stringLength;
    };
    
    struct SignalRequestMsg_VehicleIdent_ownerCode {
        INT isValidFlag;   // necessary if this struct is used as an optional field of a SEQUENCE
        CHAR string[33];
        INT  stringLength;
    };
    
    struct SignalRequestMsg_Blob_TemporaryID {
        INT isValidFlag;   // necessary if this struct is used as an optional field of a SEQUENCE
        DWORD temporaryID;  // INTEGER, 0..4294967295;
    };
    
    struct SignalRequestMsgTemporaryID {
        INT isValidFlag;   // necessary if this struct is used as an optional field of a SEQUENCE
        CHAR string[5];
        INT  stringLength;
        struct SignalRequestMsg_Blob_TemporaryID _Blob_TemporaryID;  // SEQUENCE;
    };
    
    struct SignalRequestMsg_VehicleIdent_vehicleClass {
        INT isValidFlag;   // necessary if this struct is used as an optional field of a SEQUENCE
        INT choice;
        INT vGroup;  // ENUMERATED, all_vehicles(9217), bicycles(9218), motorcycles(9219), cars(9220), light_vehicles(9221), cars_and_light_vehicles(9222), cars_with_trailers(9223), cars_with_recreational_trailers(9224), vehicles_with_trailers(9225), heavy_vehicles(9226), trucks(9227), buses(9228), articulated_buses(9229), school_buses(9230), vehicles_with_semi_trailers(9231), vehicles_with_double_trailers(9232), high_profile_vehicles(9233), wide_vehicles(9234), long_vehicles(9235), hazardous_loads(9236), exceptional_loads(9237), abnormal_loads(9238), convoys(9239), maintenance_vehicles(9240), delivery_vehicles(9241), vehicles_with_even_numbered_license_plates(9242), vehicles_with_odd_numbered_license_plates(9243), vehicles_with_parking_permits(9244), vehicles_with_catalytic_converters(9245), vehicles_without_catalytic_converters(9246), gas_powered_vehicles(9247), diesel_powered_vehicles(9248), lPG_vehicles(9249), military_convoys(9250), military_vehicles(9251);
        INT rGroup;  // ENUMERATED, emergency_vehicle_units(9729), federal_law_enforcement_units(9730), state_police_units(9731), county_police_units(9732), local_police_units(9733), ambulance_units(9734), rescue_units(9735), fire_units(9736), hAZMAT_units(9737), light_tow_unit(9738), heavy_tow_unit(9739), freeway_service_patrols(9740), transportation_response_units(9741), private_contractor_response_units(9742);
        INT rEquip;  // ENUMERATED, ground_fire_suppression(9985), heavy_ground_equipment(9986), aircraft(9988), marine_equipment(9989), support_equipment(9990), medical_rescue_unit(9991), other(9993), ground_fire_suppression_other(9994), engine(9995), truck_or_aerial(9996), quint(9997), tanker_pumper_combination(9998), brush_truck(10000), aircraft_rescue_firefighting(10001), heavy_ground_equipment_other(10004), dozer_or_plow(10005), tractor(10006), tanker_or_tender(10008), aircraft_other(10024), aircraft_fixed_wing_tanker(10025), helitanker(10026), helicopter(10027), marine_equipment_other(10034), fire_boat_with_pump(10035), boat_no_pump(10036), support_apparatus_other(10044), breathing_apparatus_support(10045), light_and_air_unit(10046), medical_rescue_unit_other(10054), rescue_unit(10055), urban_search_rescue_unit(10056), high_angle_rescue(10057), crash_fire_rescue(10058), bLS_unit(10059), aLS_unit(10060), mobile_command_post(10075), chief_officer_car(10076), hAZMAT_unit(10077), type_i_hand_crew(10078), type_ii_hand_crew(10079), privately_owned_vehicle(10083), other_apparatus_resource(10084), ambulance(10085), bomb_squad_van(10086), combine_harvester(10087), construction_vehicle(10088), farm_tractor(10089), grass_cutting_machines(10090), hAZMAT_containment_tow(10091), heavy_tow(10092), light_tow(10094), flatbed_tow(10114), hedge_cutting_machines(10093), mobile_crane(10095), refuse_collection_vehicle(10096), resurfacing_vehicle(10097), road_sweeper(10098), roadside_litter_collection_crews(10099), salvage_vehicle(10100), sand_truck(10101), snowplow(10102), steam_roller(10103), swat_team_van(10104), track_laying_vehicle(10105), unknown_vehicle(10106), white_lining_vehicle(10107), dump_truck(10108), supervisor_vehicle(10109), snow_blower(10110), rotary_snow_blower(10111), road_grader(10112), steam_truck(10113);
    };
    
    struct SignalRequestMsgVehicleIdent {
        INT isValidFlag;   // necessary if this struct is used as an optional field of a SEQUENCE
        struct SignalRequestMsgDescriptiveName name;  // IA5STRING, OPTIONAL;
        struct SignalRequestMsgVINstring vin;  // OCTETSTRING, OPTIONAL;
        struct SignalRequestMsg_VehicleIdent_ownerCode ownerCode;  // IA5STRING, OPTIONAL;
        struct SignalRequestMsgTemporaryID id;  // OCTETSTRING, OPTIONAL;
        struct OPT_ENUM_ASN vehicleType;  // ENUMERATED, OPTIONAL, none(0), unknown(1), special(2), moto(3), car(4), carOther(5), bus(6), axleCnt2(7), axleCnt3(8), axleCnt4(9), axleCnt4Trailer(10), axleCnt5Trailer(11), axleCnt6Trailer(12), axleCnt5MultiTrailer(13), axleCnt6MultiTrailer(14), axleCnt7MultiTrailer(15);
        struct SignalRequestMsg_VehicleIdent_vehicleClass vehicleClass;  // CHOICE, OPTIONAL;
    };
    
    struct SignalRequestMsg_Blob_Position3D {
        INT isValidFlag;   // necessary if this struct is used as an optional field of a SEQUENCE
        LONG latitude;  // INTEGER, -2147483648..2147483647;
        LONG longitude;  // INTEGER, -2147483648..2147483647;
        WORD elevation;  // INTEGER, 0..65535;
    };
    
    struct SignalRequestMsg_Blob_PositionalAccuracy {
        INT isValidFlag;   // necessary if this struct is used as an optional field of a SEQUENCE
        BYTE accuracySemiMajor;  // INTEGER, 0..255;
        BYTE accuracySemiMinor;  // INTEGER, 0..255;
        WORD accuracyOrientation;  // INTEGER, 0..65535;
    };
    
    struct SignalRequestMsg_Blob_AccelerationSet4Way {
        INT isValidFlag;   // necessary if this struct is used as an optional field of a SEQUENCE
        INT accelerationLong;  // INTEGER, -32768..32767;
        INT accelerationLat;  // INTEGER, -32768..32767;
        INT accelerationVert;  // INTEGER, -128..127;
        INT yawRate;  // INTEGER, -32768..32767;
    };
    
    struct SignalRequestMsg_Blob_Motion {
        INT isValidFlag;   // necessary if this struct is used as an optional field of a SEQUENCE
        BYTE transmissionState;  // INTEGER, 0..7, neutral(0), park(1), forwardGears(2), reverseGears(3), reserved1(4), reserved2(5), reserved3(6), unavailable(7);
        WORD speed;  // INTEGER, 0..8191;
        WORD heading;  // INTEGER, 0..65535;
        INT steeringWheelAngle;  // INTEGER, -128..127;
        struct SignalRequestMsg_Blob_AccelerationSet4Way accelSet;  // SEQUENCE;
    };
    
    struct SignalRequestMsg_Blob_BrakeSystemStatus_WheelBrakes {
        INT isValidFlag;   // necessary if this struct is used as an optional field of a SEQUENCE
        CHAR string[5];
        INT  stringLength;
    };
    
    struct SignalRequestMsg_Blob_BrakeSystemStatus {
        INT isValidFlag;   // necessary if this struct is used as an optional field of a SEQUENCE
        struct SignalRequestMsg_Blob_BrakeSystemStatus_WheelBrakes wheelBrakes;  // BITSTRING;
        INT brakesUnavailable;  // BOOLEAN;
        BYTE spareBit;  // INTEGER, 0..1;
        BYTE traction;  // INTEGER, 0..3, unavailable(0), off(1), on_but_notEngaged(2), engaged(3);
        BYTE antilockBrakingSystem;  // INTEGER, 0..3, unavailable(0), off(1), on_but_notEngaged(2), engaged(3);
        BYTE scs;  // INTEGER, 0..3, unavailable(0), off(1), on(2), reserved(3);
        BYTE brakeBoost;  // INTEGER, 0..3, unavailable(0), off(1), on(2), reserved(3);
        BYTE auxBrakes;  // INTEGER, 0..3, unavailable(0), off(1), on(2), reserved(3);
    };
    
    struct SignalRequestMsg_Blob_VehicleSize {
        INT isValidFlag;   // necessary if this struct is used as an optional field of a SEQUENCE
        WORD vehicleWidth;  // INTEGER, 0..1023;
        WORD vehicleLength;  // INTEGER, 0..16383;
    };
    
    struct SignalRequestMsg_Blob_BSMblob {
        INT isValidFlag;   // necessary if this struct is used as an optional field of a SEQUENCE
        BYTE msgCnt;  // INTEGER, 0..255;
        DWORD id;  // INTEGER, 0..4294967295;
        WORD secMark;  // INTEGER, 0..65535;
        struct SignalRequestMsg_Blob_Position3D pos;  // SEQUENCE;
        struct SignalRequestMsg_Blob_PositionalAccuracy accuracy;  // SEQUENCE;
        struct SignalRequestMsg_Blob_Motion motion;  // SEQUENCE;
        struct SignalRequestMsg_Blob_BrakeSystemStatus brakes;  // SEQUENCE;
        struct SignalRequestMsg_Blob_VehicleSize size;  // SEQUENCE;
    };
    
    struct SignalRequestMsgBSMblob {
        INT isValidFlag;   // necessary if this struct is used as an optional field of a SEQUENCE
        CHAR string[39];
        INT  stringLength;
        struct SignalRequestMsg_Blob_BSMblob _Blob_BSMblob;  // SEQUENCE;
    };
    
    struct SignalRequestMsg_Blob_VehicleRequestStatus {
        INT isValidFlag;   // necessary if this struct is used as an optional field of a SEQUENCE
        INT Brakes_on;  // BOOLEAN;
        BYTE EmergencyUse_or_Operation;  // INTEGER, 0..1, Operation(0), EmergencyUse(1);
        INT LightsInUse;  // BOOLEAN;
        BYTE MappedValues;  // INTEGER, 0..31;
    };
    
    struct SignalRequestMsgVehicleRequestStatus {
        INT isValidFlag;   // necessary if this struct is used as an optional field of a SEQUENCE
        CHAR string[2];
        INT  stringLength;
        struct SignalRequestMsg_Blob_VehicleRequestStatus _Blob_VehicleRequestStatus;  // SEQUENCE;
    };
    
    struct SignalRequestMsg {
        INT isValidFlag;   // necessary if this struct is used as an optional field of a SEQUENCE
        INT msgID;  // ENUMERATED, reserved(0), alaCarteMessage(1), basicSafetyMessage(2), basicSafetyMessageVerbose(3), commonSafetyRequest(4), emergencyVehicleAlert(5), intersectionCollisionAlert(6), mapData(7), nmeaCorrections(8), probeDataManagement(9), probeVehicleData(10), roadSideAlert(11), rtcmCorrections(12), signalPhaseAndTimingMessage(13), signalRequestMessage(14), signalStatusMessage(15), travelerInformation(16);
        BYTE msgCnt;  // INTEGER, 0..127;
        struct SignalRequestMsgSignalRequest request;  // SEQUENCE;
        struct SignalRequestMsgDTime timeOfService;  // SEQUENCE, OPTIONAL;
        struct SignalRequestMsgDTime endOfService;  // SEQUENCE, OPTIONAL;
        struct SignalRequestMsgTransitStatus transitStatus;  // BITSTRING, OPTIONAL;
        struct SignalRequestMsgVehicleIdent vehicleVIN;  // SEQUENCE, OPTIONAL;
        struct SignalRequestMsgBSMblob vehicleData;  // OCTETSTRING;
        struct SignalRequestMsgVehicleRequestStatus status;  // OCTETSTRING, OPTIONAL;
    };
    
}

/*
// init function to create a simple packet handle
*/ 
LONG API_InitSignalRequestMsgPacket()
{
  return C2xInitPacket("SignalRequestMsg"); 
}

/*
// init function to create a simple packet handle and
// initialize the struct with valid data
*/ 
LONG API_InitSignalRequestMsgPacket(struct SignalRequestMsg msgStruct)
{
  long pktHandle;

  pktHandle = API_InitSignalRequestMsgPacket();

  if (pktHandle != 0)
  {
    // create valid message and application data
    if (C2xCompletePacket(pktHandle) == 0) 
    {
      API_GetSignalRequestMsgParams(pktHandle, msgStruct);
    }
  }
  return pktHandle;
}

/*
// init function to create a packet with security layer and
// initialize the struct with valid data
*/ 
LONG API_InitSignalRequestMsgPacket(struct SignalRequestMsg msgStruct, char packetTypeDesignator[], char certificateName[])
{
  long pktHandle, certHdl;

  // initialize the packet
  pktHandle = C2xInitPacket("SignalRequestMsg", packetTypeDesignator);

  if (pktHandle != 0)
  {
    certHdl = C2xSecCertificateGetHandle(certificateName);  // get the certificate handle for the cert with name "certificateName"
    if (certHdl != 0) 
    {
      C2xSecPacketSetSignerHandle(pktHandle, certHdl); // set the certHdl to the packet
    }

    // create valid message and application data
    if (C2xCompletePacket(pktHandle) == 0) 
    {
      // copy application data to the application structure
      API_GetSignalRequestMsgParams(pktHandle, msgStruct);
    }
  }
  return pktHandle;
}
    

int GetSignalRequestMsg_Blob_PreemptParams(LONG packetHandle, struct SignalRequestMsg_Blob_Preempt value, char oldPath[])
{
  char newPath[300];
  int result;

  result = 0;

  snprintf(newPath, elcount(newPath), "%s.%s", oldPath, "preempt_or_prio");
  value.preempt_or_prio = C2xGetTokenInt(packetHandle, "SignalRequestMsg", newPath);
  result = CheckLastError("SignalRequestMsg", gkFuncRefGet, result);

  snprintf(newPath, elcount(newPath), "%s.%s", oldPath, "controller");
  value.controller = C2xGetTokenInt(packetHandle, "SignalRequestMsg", newPath);
  result = CheckLastError("SignalRequestMsg", gkFuncRefGet, result);

  return result;
}

int SetSignalRequestMsg_Blob_PreemptParams(LONG packetHandle, struct SignalRequestMsg_Blob_Preempt value, char oldPath[])
{
  char newPath[300];
  int result;

  result = 0;

  snprintf(newPath, elcount(newPath), "%s.%s", oldPath, "preempt_or_prio");
  C2xSetTokenInt(packetHandle, "SignalRequestMsg", newPath, value.preempt_or_prio);
  result = CheckLastError("SignalRequestMsg", gkFuncRefGet, result);

  snprintf(newPath, elcount(newPath), "%s.%s", oldPath, "controller");
  C2xSetTokenInt(packetHandle, "SignalRequestMsg", newPath, value.controller);
  result = CheckLastError("SignalRequestMsg", gkFuncRefGet, result);

  return result;
}

int GetSignalRequestMsg_Blob_SignalReqSchemeParams(LONG packetHandle, struct SignalRequestMsg_Blob_SignalReqScheme value, char oldPath[])
{
  char newPath[300];
  int result;

  result = 0;

  snprintf(newPath, elcount(newPath), "%s.%s", oldPath, "preempt");
  GetSignalRequestMsg_Blob_PreemptParams(packetHandle, value.preempt, newPath);
  result = CheckLastError("SignalRequestMsg", gkFuncRefGet, result);

  snprintf(newPath, elcount(newPath), "%s.%s", oldPath, "strategy");
  value.strategy = C2xGetTokenInt(packetHandle, "SignalRequestMsg", newPath);
  result = CheckLastError("SignalRequestMsg", gkFuncRefGet, result);

  return result;
}

int SetSignalRequestMsg_Blob_SignalReqSchemeParams(LONG packetHandle, struct SignalRequestMsg_Blob_SignalReqScheme value, char oldPath[])
{
  char newPath[300];
  int result;

  result = 0;

  snprintf(newPath, elcount(newPath), "%s.%s", oldPath, "preempt");
  SetSignalRequestMsg_Blob_PreemptParams(packetHandle, value.preempt, newPath);
  result = CheckLastError("SignalRequestMsg", gkFuncRefGet, result);

  snprintf(newPath, elcount(newPath), "%s.%s", oldPath, "strategy");
  C2xSetTokenInt(packetHandle, "SignalRequestMsg", newPath, value.strategy);
  result = CheckLastError("SignalRequestMsg", gkFuncRefGet, result);

  return result;
}

int GetSignalRequestMsgSignalReqSchemeParams(LONG packetHandle, struct SignalRequestMsgSignalReqScheme value, char oldPath[])
{
  char newPath[300];
  int result;

  result = 0;

  snprintf(newPath, elcount(newPath), "%s.%s", oldPath, "_Blob_SignalReqScheme");
  GetSignalRequestMsg_Blob_SignalReqSchemeParams(packetHandle, value._Blob_SignalReqScheme, newPath);
  result = CheckLastError("SignalRequestMsg", gkFuncRefGet, result);

  return result;
}

int SetSignalRequestMsgSignalReqSchemeParams(LONG packetHandle, struct SignalRequestMsgSignalReqScheme value, char oldPath[])
{
  char newPath[300];
  int result;

  result = 0;

  snprintf(newPath, elcount(newPath), "%s.%s", oldPath, "_Blob_SignalReqScheme");
  SetSignalRequestMsg_Blob_SignalReqSchemeParams(packetHandle, value._Blob_SignalReqScheme, newPath);
  result = CheckLastError("SignalRequestMsg", gkFuncRefGet, result);

  return result;
}

int GetSignalRequestMsg_Blob_LaneNumberParams(LONG packetHandle, struct SignalRequestMsg_Blob_LaneNumber value, char oldPath[])
{
  char newPath[300];
  int result;

  result = 0;

  snprintf(newPath, elcount(newPath), "%s.%s", oldPath, "laneNumber");
  value.laneNumber = C2xGetTokenInt(packetHandle, "SignalRequestMsg", newPath);
  result = CheckLastError("SignalRequestMsg", gkFuncRefGet, result);

  return result;
}

int SetSignalRequestMsg_Blob_LaneNumberParams(LONG packetHandle, struct SignalRequestMsg_Blob_LaneNumber value, char oldPath[])
{
  char newPath[300];
  int result;

  result = 0;

  snprintf(newPath, elcount(newPath), "%s.%s", oldPath, "laneNumber");
  C2xSetTokenInt(packetHandle, "SignalRequestMsg", newPath, value.laneNumber);
  result = CheckLastError("SignalRequestMsg", gkFuncRefGet, result);

  return result;
}

int GetSignalRequestMsgLaneNumberParams(LONG packetHandle, struct SignalRequestMsgLaneNumber value, char oldPath[])
{
  char newPath[300];
  int result;

  result = 0;

  snprintf(newPath, elcount(newPath), "%s.%s", oldPath, "_Blob_LaneNumber");
  GetSignalRequestMsg_Blob_LaneNumberParams(packetHandle, value._Blob_LaneNumber, newPath);
  result = CheckLastError("SignalRequestMsg", gkFuncRefGet, result);

  return result;
}

int SetSignalRequestMsgLaneNumberParams(LONG packetHandle, struct SignalRequestMsgLaneNumber value, char oldPath[])
{
  char newPath[300];
  int result;

  result = 0;

  snprintf(newPath, elcount(newPath), "%s.%s", oldPath, "_Blob_LaneNumber");
  SetSignalRequestMsg_Blob_LaneNumberParams(packetHandle, value._Blob_LaneNumber, newPath);
  result = CheckLastError("SignalRequestMsg", gkFuncRefGet, result);

  return result;
}

int GetSignalRequestMsg_Blob_NTCIPVehicleClassParams(LONG packetHandle, struct SignalRequestMsg_Blob_NTCIPVehicleClass value, char oldPath[])
{
  char newPath[300];
  int result;

  result = 0;

  snprintf(newPath, elcount(newPath), "%s.%s", oldPath, "type");
  value.type = C2xGetTokenInt(packetHandle, "SignalRequestMsg", newPath);
  result = CheckLastError("SignalRequestMsg", gkFuncRefGet, result);

  snprintf(newPath, elcount(newPath), "%s.%s", oldPath, "level");
  value.level = C2xGetTokenInt(packetHandle, "SignalRequestMsg", newPath);
  result = CheckLastError("SignalRequestMsg", gkFuncRefGet, result);

  return result;
}

int SetSignalRequestMsg_Blob_NTCIPVehicleClassParams(LONG packetHandle, struct SignalRequestMsg_Blob_NTCIPVehicleClass value, char oldPath[])
{
  char newPath[300];
  int result;

  result = 0;

  snprintf(newPath, elcount(newPath), "%s.%s", oldPath, "type");
  C2xSetTokenInt(packetHandle, "SignalRequestMsg", newPath, value.type);
  result = CheckLastError("SignalRequestMsg", gkFuncRefGet, result);

  snprintf(newPath, elcount(newPath), "%s.%s", oldPath, "level");
  C2xSetTokenInt(packetHandle, "SignalRequestMsg", newPath, value.level);
  result = CheckLastError("SignalRequestMsg", gkFuncRefGet, result);

  return result;
}

int GetSignalRequestMsgNTCIPVehicleclassParams(LONG packetHandle, struct SignalRequestMsgNTCIPVehicleclass value, char oldPath[])
{
  char newPath[300];
  int result;

  result = 0;

  snprintf(newPath, elcount(newPath), "%s.%s", oldPath, "_Blob_NTCIPVehicleClass");
  GetSignalRequestMsg_Blob_NTCIPVehicleClassParams(packetHandle, value._Blob_NTCIPVehicleClass, newPath);
  result = CheckLastError("SignalRequestMsg", gkFuncRefGet, result);

  return result;
}

int SetSignalRequestMsgNTCIPVehicleclassParams(LONG packetHandle, struct SignalRequestMsgNTCIPVehicleclass value, char oldPath[])
{
  char newPath[300];
  int result;

  result = 0;

  snprintf(newPath, elcount(newPath), "%s.%s", oldPath, "_Blob_NTCIPVehicleClass");
  SetSignalRequestMsg_Blob_NTCIPVehicleClassParams(packetHandle, value._Blob_NTCIPVehicleClass, newPath);
  result = CheckLastError("SignalRequestMsg", gkFuncRefGet, result);

  return result;
}

int GetSignalRequestMsgSignalRequestParams(LONG packetHandle, struct SignalRequestMsgSignalRequest value, char oldPath[])
{
  char newPath[300];
  int result;

  result = 0;

  snprintf(newPath, elcount(newPath), "%s.%s", oldPath, "id");
  value.id = C2xGetTokenInt(packetHandle, "SignalRequestMsg", newPath);
  result = CheckLastError("SignalRequestMsg", gkFuncRefGet, result);

  snprintf(newPath, elcount(newPath), "%s.%s", oldPath, "isCancel");
  value.isCancel.isValidFlag = C2xIsTokenAvailable(packetHandle, "SignalRequestMsg", newPath);
  if(value.isCancel.isValidFlag==1)
  {
    value.isCancel.isValidFlag = 1;
    value.isCancel.stringLength = C2xGetTokenData(packetHandle, "SignalRequestMsg", newPath, elcount(value.isCancel.string), value.isCancel.string);
  }
  snprintf(newPath, elcount(newPath), "%s.%s", oldPath, "requestedAction");
  value.requestedAction.isValidFlag = C2xIsTokenAvailable(packetHandle, "SignalRequestMsg", newPath);
  if(value.requestedAction.isValidFlag==1)
  {
    value.requestedAction.isValidFlag = 1;
    value.requestedAction.stringLength = C2xGetTokenData(packetHandle, "SignalRequestMsg", newPath, elcount(value.requestedAction.string), value.requestedAction.string);
  }
  snprintf(newPath, elcount(newPath), "%s.%s", oldPath, "inLane");
  value.inLane.isValidFlag = C2xIsTokenAvailable(packetHandle, "SignalRequestMsg", newPath);
  if(value.inLane.isValidFlag==1)
  {
    value.inLane.isValidFlag = 1;
    value.inLane.stringLength = C2xGetTokenData(packetHandle, "SignalRequestMsg", newPath, elcount(value.inLane.string), value.inLane.string);
  }
  snprintf(newPath, elcount(newPath), "%s.%s", oldPath, "outLane");
  value.outLane.isValidFlag = C2xIsTokenAvailable(packetHandle, "SignalRequestMsg", newPath);
  if(value.outLane.isValidFlag==1)
  {
    value.outLane.isValidFlag = 1;
    value.outLane.stringLength = C2xGetTokenData(packetHandle, "SignalRequestMsg", newPath, elcount(value.outLane.string), value.outLane.string);
  }
  snprintf(newPath, elcount(newPath), "%s.%s", oldPath, "type");
  value.type.stringLength = C2xGetTokenData(packetHandle, "SignalRequestMsg", newPath, elcount(value.type.string), value.type.string);
  snprintf(newPath, elcount(newPath), "%s.%s", oldPath, "codeWord");
  value.codeWord.isValidFlag = C2xIsTokenAvailable(packetHandle, "SignalRequestMsg", newPath);
  if(value.codeWord.isValidFlag==1)
  {
    value.codeWord.isValidFlag = 1;
    value.codeWord.stringLength = C2xGetTokenData(packetHandle, "SignalRequestMsg", newPath, elcount(value.codeWord.string), value.codeWord.string);
  }
  return result;
}

int SetSignalRequestMsgSignalRequestParams(LONG packetHandle, struct SignalRequestMsgSignalRequest value, char oldPath[])
{
  char newPath[300];
  int result;

  result = 0;

  snprintf(newPath, elcount(newPath), "%s.%s", oldPath, "id");
  C2xSetTokenInt(packetHandle, "SignalRequestMsg", newPath, value.id);
  result = CheckLastError("SignalRequestMsg", gkFuncRefGet, result);

  snprintf(newPath, elcount(newPath), "%s.%s", oldPath, "isCancel");
  if(value.isCancel.isValidFlag==1)
  {
    C2xSetTokenData(packetHandle, "SignalRequestMsg", newPath, value.isCancel.stringLength, value.isCancel.string);
  }
  else
  {
    if( C2xIsTokenAvailable(packetHandle, "SignalRequestMsg", newPath) )
    {
      C2xRemoveToken(packetHandle, "SignalRequestMsg", newPath);
    }
  }

  snprintf(newPath, elcount(newPath), "%s.%s", oldPath, "requestedAction");
  if(value.requestedAction.isValidFlag==1)
  {
    C2xSetTokenData(packetHandle, "SignalRequestMsg", newPath, value.requestedAction.stringLength, value.requestedAction.string);
  }
  else
  {
    if( C2xIsTokenAvailable(packetHandle, "SignalRequestMsg", newPath) )
    {
      C2xRemoveToken(packetHandle, "SignalRequestMsg", newPath);
    }
  }

  snprintf(newPath, elcount(newPath), "%s.%s", oldPath, "inLane");
  if(value.inLane.isValidFlag==1)
  {
    C2xSetTokenData(packetHandle, "SignalRequestMsg", newPath, value.inLane.stringLength, value.inLane.string);
  }
  else
  {
    if( C2xIsTokenAvailable(packetHandle, "SignalRequestMsg", newPath) )
    {
      C2xRemoveToken(packetHandle, "SignalRequestMsg", newPath);
    }
  }

  snprintf(newPath, elcount(newPath), "%s.%s", oldPath, "outLane");
  if(value.outLane.isValidFlag==1)
  {
    C2xSetTokenData(packetHandle, "SignalRequestMsg", newPath, value.outLane.stringLength, value.outLane.string);
  }
  else
  {
    if( C2xIsTokenAvailable(packetHandle, "SignalRequestMsg", newPath) )
    {
      C2xRemoveToken(packetHandle, "SignalRequestMsg", newPath);
    }
  }

  snprintf(newPath, elcount(newPath), "%s.%s", oldPath, "type");
  C2xSetTokenData(packetHandle, "SignalRequestMsg", newPath, value.type.stringLength, value.type.string);

  snprintf(newPath, elcount(newPath), "%s.%s", oldPath, "codeWord");
  if(value.codeWord.isValidFlag==1)
  {
    C2xSetTokenData(packetHandle, "SignalRequestMsg", newPath, value.codeWord.stringLength, value.codeWord.string);
  }
  else
  {
    if( C2xIsTokenAvailable(packetHandle, "SignalRequestMsg", newPath) )
    {
      C2xRemoveToken(packetHandle, "SignalRequestMsg", newPath);
    }
  }

  return result;
}

int GetSignalRequestMsgDTimeParams(LONG packetHandle, struct SignalRequestMsgDTime value, char oldPath[])
{
  char newPath[300];
  int result;

  result = 0;

  snprintf(newPath, elcount(newPath), "%s.%s", oldPath, "hour");
  value.hour = C2xGetTokenInt(packetHandle, "SignalRequestMsg", newPath);
  result = CheckLastError("SignalRequestMsg", gkFuncRefGet, result);

  snprintf(newPath, elcount(newPath), "%s.%s", oldPath, "minute");
  value.minute = C2xGetTokenInt(packetHandle, "SignalRequestMsg", newPath);
  result = CheckLastError("SignalRequestMsg", gkFuncRefGet, result);

  snprintf(newPath, elcount(newPath), "%s.%s", oldPath, "second");
  value.second = C2xGetTokenInt(packetHandle, "SignalRequestMsg", newPath);
  result = CheckLastError("SignalRequestMsg", gkFuncRefGet, result);

  return result;
}

int SetSignalRequestMsgDTimeParams(LONG packetHandle, struct SignalRequestMsgDTime value, char oldPath[])
{
  char newPath[300];
  int result;

  result = 0;

  snprintf(newPath, elcount(newPath), "%s.%s", oldPath, "hour");
  C2xSetTokenInt(packetHandle, "SignalRequestMsg", newPath, value.hour);
  result = CheckLastError("SignalRequestMsg", gkFuncRefGet, result);

  snprintf(newPath, elcount(newPath), "%s.%s", oldPath, "minute");
  C2xSetTokenInt(packetHandle, "SignalRequestMsg", newPath, value.minute);
  result = CheckLastError("SignalRequestMsg", gkFuncRefGet, result);

  snprintf(newPath, elcount(newPath), "%s.%s", oldPath, "second");
  C2xSetTokenInt(packetHandle, "SignalRequestMsg", newPath, value.second);
  result = CheckLastError("SignalRequestMsg", gkFuncRefGet, result);

  return result;
}

int GetSignalRequestMsg_Blob_TemporaryIDParams(LONG packetHandle, struct SignalRequestMsg_Blob_TemporaryID value, char oldPath[])
{
  char newPath[300];
  int result;

  result = 0;

  snprintf(newPath, elcount(newPath), "%s.%s", oldPath, "temporaryID");
  value.temporaryID = C2xGetTokenInt64(packetHandle, "SignalRequestMsg", newPath);
  result = CheckLastError("SignalRequestMsg", gkFuncRefGet, result);

  return result;
}

int SetSignalRequestMsg_Blob_TemporaryIDParams(LONG packetHandle, struct SignalRequestMsg_Blob_TemporaryID value, char oldPath[])
{
  char newPath[300];
  int result;

  result = 0;

  snprintf(newPath, elcount(newPath), "%s.%s", oldPath, "temporaryID");
  C2xSetTokenInt64(packetHandle, "SignalRequestMsg", newPath, value.temporaryID);
  result = CheckLastError("SignalRequestMsg", gkFuncRefGet, result);

  return result;
}

int GetSignalRequestMsgTemporaryIDParams(LONG packetHandle, struct SignalRequestMsgTemporaryID value, char oldPath[])
{
  char newPath[300];
  int result;

  result = 0;

  snprintf(newPath, elcount(newPath), "%s.%s", oldPath, "_Blob_TemporaryID");
  GetSignalRequestMsg_Blob_TemporaryIDParams(packetHandle, value._Blob_TemporaryID, newPath);
  result = CheckLastError("SignalRequestMsg", gkFuncRefGet, result);

  return result;
}

int SetSignalRequestMsgTemporaryIDParams(LONG packetHandle, struct SignalRequestMsgTemporaryID value, char oldPath[])
{
  char newPath[300];
  int result;

  result = 0;

  snprintf(newPath, elcount(newPath), "%s.%s", oldPath, "_Blob_TemporaryID");
  SetSignalRequestMsg_Blob_TemporaryIDParams(packetHandle, value._Blob_TemporaryID, newPath);
  result = CheckLastError("SignalRequestMsg", gkFuncRefGet, result);

  return result;
}

int GetSignalRequestMsg_VehicleIdent_vehicleClassParams(LONG packetHandle, struct SignalRequestMsg_VehicleIdent_vehicleClass value, char oldPath[])
{
  char newPath[300];
  int result;

  result = 0;

  value.choice = C2xGetTokenInt(packetHandle, "SignalRequestMsg", oldPath);

  switch(value.choice)
  {
    case 0:
    {
      snprintf(newPath, elcount(newPath), "%s.%s", oldPath, "vGroup");
      value.vGroup = C2xGetTokenInt(packetHandle, "SignalRequestMsg", newPath);
      result = CheckLastError("SignalRequestMsg", gkFuncRefGet, result);
    }
    break;
    case 1:
    {
      snprintf(newPath, elcount(newPath), "%s.%s", oldPath, "rGroup");
      value.rGroup = C2xGetTokenInt(packetHandle, "SignalRequestMsg", newPath);
      result = CheckLastError("SignalRequestMsg", gkFuncRefGet, result);
    }
    break;
    case 2:
    {
      snprintf(newPath, elcount(newPath), "%s.%s", oldPath, "rEquip");
      value.rEquip = C2xGetTokenInt(packetHandle, "SignalRequestMsg", newPath);
      result = CheckLastError("SignalRequestMsg", gkFuncRefGet, result);
    }
    break;
  }
  return result;
}

int SetSignalRequestMsg_VehicleIdent_vehicleClassParams(LONG packetHandle, struct SignalRequestMsg_VehicleIdent_vehicleClass value, char oldPath[])
{
  char newPath[300];
  int result;

  result = 0;

  switch(value.choice)
  {
    case 0:
    {
      snprintf(newPath, elcount(newPath), "%s.%s", oldPath, "vGroup");
      C2xSetTokenInt(packetHandle, "SignalRequestMsg", newPath, value.vGroup);
      result = CheckLastError("SignalRequestMsg", gkFuncRefGet, result);
    }
    break;
    case 1:
    {
      snprintf(newPath, elcount(newPath), "%s.%s", oldPath, "rGroup");
      C2xSetTokenInt(packetHandle, "SignalRequestMsg", newPath, value.rGroup);
      result = CheckLastError("SignalRequestMsg", gkFuncRefGet, result);
    }
    break;
    case 2:
    {
      snprintf(newPath, elcount(newPath), "%s.%s", oldPath, "rEquip");
      C2xSetTokenInt(packetHandle, "SignalRequestMsg", newPath, value.rEquip);
      result = CheckLastError("SignalRequestMsg", gkFuncRefGet, result);
    }
    break;
  }
  return result;
}

int GetSignalRequestMsgVehicleIdentParams(LONG packetHandle, struct SignalRequestMsgVehicleIdent value, char oldPath[])
{
  char newPath[300];
  int result;

  result = 0;

  snprintf(newPath, elcount(newPath), "%s.%s", oldPath, "name");
  value.name.isValidFlag = C2xIsTokenAvailable(packetHandle, "SignalRequestMsg", newPath);
  if(value.name.isValidFlag==1)
  {
    value.name.stringLength = C2xGetTokenData(packetHandle, "SignalRequestMsg", newPath, elcount(value.name.string), value.name.string);
    result = CheckLastError("SignalRequestMsg", gkFuncRefGet, result);
  }
  snprintf(newPath, elcount(newPath), "%s.%s", oldPath, "vin");
  value.vin.isValidFlag = C2xIsTokenAvailable(packetHandle, "SignalRequestMsg", newPath);
  if(value.vin.isValidFlag==1)
  {
    value.vin.isValidFlag = 1;
    value.vin.stringLength = C2xGetTokenData(packetHandle, "SignalRequestMsg", newPath, elcount(value.vin.string), value.vin.string);
  }
  snprintf(newPath, elcount(newPath), "%s.%s", oldPath, "ownerCode");
  value.ownerCode.isValidFlag = C2xIsTokenAvailable(packetHandle, "SignalRequestMsg", newPath);
  if(value.ownerCode.isValidFlag==1)
  {
    value.ownerCode.stringLength = C2xGetTokenData(packetHandle, "SignalRequestMsg", newPath, elcount(value.ownerCode.string), value.ownerCode.string);
    result = CheckLastError("SignalRequestMsg", gkFuncRefGet, result);
  }
  snprintf(newPath, elcount(newPath), "%s.%s", oldPath, "id");
  value.id.isValidFlag = C2xIsTokenAvailable(packetHandle, "SignalRequestMsg", newPath);
  if(value.id.isValidFlag==1)
  {
    value.id.isValidFlag = 1;
    value.id.stringLength = C2xGetTokenData(packetHandle, "SignalRequestMsg", newPath, elcount(value.id.string), value.id.string);
  }
  snprintf(newPath, elcount(newPath), "%s.%s", oldPath, "vehicleType");
  value.vehicleType.isValidFlag = C2xIsTokenAvailable(packetHandle, "SignalRequestMsg", newPath);
  if(value.vehicleType.isValidFlag==1)
  {
    value.vehicleType.value = C2xGetTokenInt(packetHandle, "SignalRequestMsg", newPath);
    result = CheckLastError("SignalRequestMsg", gkFuncRefGet, result);
  }
  snprintf(newPath, elcount(newPath), "%s.%s", oldPath, "vehicleClass");
  value.vehicleClass.isValidFlag = C2xIsTokenAvailable(packetHandle, "SignalRequestMsg", newPath);
  if(value.vehicleClass.isValidFlag==1)
  {
    GetSignalRequestMsg_VehicleIdent_vehicleClassParams(packetHandle, value.vehicleClass, newPath);
    result = CheckLastError("SignalRequestMsg", gkFuncRefGet, result);
  }
  return result;
}

int SetSignalRequestMsgVehicleIdentParams(LONG packetHandle, struct SignalRequestMsgVehicleIdent value, char oldPath[])
{
  char newPath[300];
  int result;

  result = 0;

  snprintf(newPath, elcount(newPath), "%s.%s", oldPath, "name");
  if(value.name.isValidFlag==1)
  {
    C2xSetTokenData(packetHandle, "SignalRequestMsg", newPath, value.name.stringLength, value.name.string);
    result = CheckLastError("SignalRequestMsg", gkFuncRefGet, result);
  }
  else
  {
    if( C2xIsTokenAvailable(packetHandle, "SignalRequestMsg", newPath) )
    {
      C2xRemoveToken(packetHandle, "SignalRequestMsg", newPath);
    }
  }

  snprintf(newPath, elcount(newPath), "%s.%s", oldPath, "vin");
  if(value.vin.isValidFlag==1)
  {
    C2xSetTokenData(packetHandle, "SignalRequestMsg", newPath, value.vin.stringLength, value.vin.string);
  }
  else
  {
    if( C2xIsTokenAvailable(packetHandle, "SignalRequestMsg", newPath) )
    {
      C2xRemoveToken(packetHandle, "SignalRequestMsg", newPath);
    }
  }

  snprintf(newPath, elcount(newPath), "%s.%s", oldPath, "ownerCode");
  if(value.ownerCode.isValidFlag==1)
  {
    C2xSetTokenData(packetHandle, "SignalRequestMsg", newPath, value.ownerCode.stringLength, value.ownerCode.string);
    result = CheckLastError("SignalRequestMsg", gkFuncRefGet, result);
  }
  else
  {
    if( C2xIsTokenAvailable(packetHandle, "SignalRequestMsg", newPath) )
    {
      C2xRemoveToken(packetHandle, "SignalRequestMsg", newPath);
    }
  }

  snprintf(newPath, elcount(newPath), "%s.%s", oldPath, "id");
  if(value.id.isValidFlag==1)
  {
    C2xSetTokenData(packetHandle, "SignalRequestMsg", newPath, value.id.stringLength, value.id.string);
  }
  else
  {
    if( C2xIsTokenAvailable(packetHandle, "SignalRequestMsg", newPath) )
    {
      C2xRemoveToken(packetHandle, "SignalRequestMsg", newPath);
    }
  }

  snprintf(newPath, elcount(newPath), "%s.%s", oldPath, "vehicleType");
  if(value.vehicleType.isValidFlag==1)
  {
    C2xSetTokenInt(packetHandle, "SignalRequestMsg", newPath, value.vehicleType.value);
    result = CheckLastError("SignalRequestMsg", gkFuncRefGet, result);
  }
  else
  {
    if( C2xIsTokenAvailable(packetHandle, "SignalRequestMsg", newPath) )
    {
      C2xRemoveToken(packetHandle, "SignalRequestMsg", newPath);
    }
  }

  snprintf(newPath, elcount(newPath), "%s.%s", oldPath, "vehicleClass");
  if(value.vehicleClass.isValidFlag==1)
  {
    SetSignalRequestMsg_VehicleIdent_vehicleClassParams(packetHandle, value.vehicleClass, newPath);
    result = CheckLastError("SignalRequestMsg", gkFuncRefGet, result);
  }
  else
  {
    if( C2xIsTokenAvailable(packetHandle, "SignalRequestMsg", newPath) )
    {
      C2xRemoveToken(packetHandle, "SignalRequestMsg", newPath);
    }
  }

  return result;
}

int GetSignalRequestMsg_Blob_Position3DParams(LONG packetHandle, struct SignalRequestMsg_Blob_Position3D value, char oldPath[])
{
  char newPath[300];
  int result;

  result = 0;

  snprintf(newPath, elcount(newPath), "%s.%s", oldPath, "latitude");
  value.latitude = C2xGetTokenInt(packetHandle, "SignalRequestMsg", newPath);
  result = CheckLastError("SignalRequestMsg", gkFuncRefGet, result);

  snprintf(newPath, elcount(newPath), "%s.%s", oldPath, "longitude");
  value.longitude = C2xGetTokenInt(packetHandle, "SignalRequestMsg", newPath);
  result = CheckLastError("SignalRequestMsg", gkFuncRefGet, result);

  snprintf(newPath, elcount(newPath), "%s.%s", oldPath, "elevation");
  value.elevation = C2xGetTokenInt(packetHandle, "SignalRequestMsg", newPath);
  result = CheckLastError("SignalRequestMsg", gkFuncRefGet, result);

  return result;
}

int SetSignalRequestMsg_Blob_Position3DParams(LONG packetHandle, struct SignalRequestMsg_Blob_Position3D value, char oldPath[])
{
  char newPath[300];
  int result;

  result = 0;

  snprintf(newPath, elcount(newPath), "%s.%s", oldPath, "latitude");
  C2xSetTokenInt(packetHandle, "SignalRequestMsg", newPath, value.latitude);
  result = CheckLastError("SignalRequestMsg", gkFuncRefGet, result);

  snprintf(newPath, elcount(newPath), "%s.%s", oldPath, "longitude");
  C2xSetTokenInt(packetHandle, "SignalRequestMsg", newPath, value.longitude);
  result = CheckLastError("SignalRequestMsg", gkFuncRefGet, result);

  snprintf(newPath, elcount(newPath), "%s.%s", oldPath, "elevation");
  C2xSetTokenInt(packetHandle, "SignalRequestMsg", newPath, value.elevation);
  result = CheckLastError("SignalRequestMsg", gkFuncRefGet, result);

  return result;
}

int GetSignalRequestMsg_Blob_PositionalAccuracyParams(LONG packetHandle, struct SignalRequestMsg_Blob_PositionalAccuracy value, char oldPath[])
{
  char newPath[300];
  int result;

  result = 0;

  snprintf(newPath, elcount(newPath), "%s.%s", oldPath, "accuracySemiMajor");
  value.accuracySemiMajor = C2xGetTokenInt(packetHandle, "SignalRequestMsg", newPath);
  result = CheckLastError("SignalRequestMsg", gkFuncRefGet, result);

  snprintf(newPath, elcount(newPath), "%s.%s", oldPath, "accuracySemiMinor");
  value.accuracySemiMinor = C2xGetTokenInt(packetHandle, "SignalRequestMsg", newPath);
  result = CheckLastError("SignalRequestMsg", gkFuncRefGet, result);

  snprintf(newPath, elcount(newPath), "%s.%s", oldPath, "accuracyOrientation");
  value.accuracyOrientation = C2xGetTokenInt(packetHandle, "SignalRequestMsg", newPath);
  result = CheckLastError("SignalRequestMsg", gkFuncRefGet, result);

  return result;
}

int SetSignalRequestMsg_Blob_PositionalAccuracyParams(LONG packetHandle, struct SignalRequestMsg_Blob_PositionalAccuracy value, char oldPath[])
{
  char newPath[300];
  int result;

  result = 0;

  snprintf(newPath, elcount(newPath), "%s.%s", oldPath, "accuracySemiMajor");
  C2xSetTokenInt(packetHandle, "SignalRequestMsg", newPath, value.accuracySemiMajor);
  result = CheckLastError("SignalRequestMsg", gkFuncRefGet, result);

  snprintf(newPath, elcount(newPath), "%s.%s", oldPath, "accuracySemiMinor");
  C2xSetTokenInt(packetHandle, "SignalRequestMsg", newPath, value.accuracySemiMinor);
  result = CheckLastError("SignalRequestMsg", gkFuncRefGet, result);

  snprintf(newPath, elcount(newPath), "%s.%s", oldPath, "accuracyOrientation");
  C2xSetTokenInt(packetHandle, "SignalRequestMsg", newPath, value.accuracyOrientation);
  result = CheckLastError("SignalRequestMsg", gkFuncRefGet, result);

  return result;
}

int GetSignalRequestMsg_Blob_AccelerationSet4WayParams(LONG packetHandle, struct SignalRequestMsg_Blob_AccelerationSet4Way value, char oldPath[])
{
  char newPath[300];
  int result;

  result = 0;

  snprintf(newPath, elcount(newPath), "%s.%s", oldPath, "accelerationLong");
  value.accelerationLong = C2xGetTokenInt(packetHandle, "SignalRequestMsg", newPath);
  result = CheckLastError("SignalRequestMsg", gkFuncRefGet, result);

  snprintf(newPath, elcount(newPath), "%s.%s", oldPath, "accelerationLat");
  value.accelerationLat = C2xGetTokenInt(packetHandle, "SignalRequestMsg", newPath);
  result = CheckLastError("SignalRequestMsg", gkFuncRefGet, result);

  snprintf(newPath, elcount(newPath), "%s.%s", oldPath, "accelerationVert");
  value.accelerationVert = C2xGetTokenInt(packetHandle, "SignalRequestMsg", newPath);
  result = CheckLastError("SignalRequestMsg", gkFuncRefGet, result);

  snprintf(newPath, elcount(newPath), "%s.%s", oldPath, "yawRate");
  value.yawRate = C2xGetTokenInt(packetHandle, "SignalRequestMsg", newPath);
  result = CheckLastError("SignalRequestMsg", gkFuncRefGet, result);

  return result;
}

int SetSignalRequestMsg_Blob_AccelerationSet4WayParams(LONG packetHandle, struct SignalRequestMsg_Blob_AccelerationSet4Way value, char oldPath[])
{
  char newPath[300];
  int result;

  result = 0;

  snprintf(newPath, elcount(newPath), "%s.%s", oldPath, "accelerationLong");
  C2xSetTokenInt(packetHandle, "SignalRequestMsg", newPath, value.accelerationLong);
  result = CheckLastError("SignalRequestMsg", gkFuncRefGet, result);

  snprintf(newPath, elcount(newPath), "%s.%s", oldPath, "accelerationLat");
  C2xSetTokenInt(packetHandle, "SignalRequestMsg", newPath, value.accelerationLat);
  result = CheckLastError("SignalRequestMsg", gkFuncRefGet, result);

  snprintf(newPath, elcount(newPath), "%s.%s", oldPath, "accelerationVert");
  C2xSetTokenInt(packetHandle, "SignalRequestMsg", newPath, value.accelerationVert);
  result = CheckLastError("SignalRequestMsg", gkFuncRefGet, result);

  snprintf(newPath, elcount(newPath), "%s.%s", oldPath, "yawRate");
  C2xSetTokenInt(packetHandle, "SignalRequestMsg", newPath, value.yawRate);
  result = CheckLastError("SignalRequestMsg", gkFuncRefGet, result);

  return result;
}

int GetSignalRequestMsg_Blob_MotionParams(LONG packetHandle, struct SignalRequestMsg_Blob_Motion value, char oldPath[])
{
  char newPath[300];
  int result;

  result = 0;

  snprintf(newPath, elcount(newPath), "%s.%s", oldPath, "transmissionState");
  value.transmissionState = C2xGetTokenInt(packetHandle, "SignalRequestMsg", newPath);
  result = CheckLastError("SignalRequestMsg", gkFuncRefGet, result);

  snprintf(newPath, elcount(newPath), "%s.%s", oldPath, "speed");
  value.speed = C2xGetTokenInt(packetHandle, "SignalRequestMsg", newPath);
  result = CheckLastError("SignalRequestMsg", gkFuncRefGet, result);

  snprintf(newPath, elcount(newPath), "%s.%s", oldPath, "heading");
  value.heading = C2xGetTokenInt(packetHandle, "SignalRequestMsg", newPath);
  result = CheckLastError("SignalRequestMsg", gkFuncRefGet, result);

  snprintf(newPath, elcount(newPath), "%s.%s", oldPath, "steeringWheelAngle");
  value.steeringWheelAngle = C2xGetTokenInt(packetHandle, "SignalRequestMsg", newPath);
  result = CheckLastError("SignalRequestMsg", gkFuncRefGet, result);

  snprintf(newPath, elcount(newPath), "%s.%s", oldPath, "accelSet");
  GetSignalRequestMsg_Blob_AccelerationSet4WayParams(packetHandle, value.accelSet, newPath);
  result = CheckLastError("SignalRequestMsg", gkFuncRefGet, result);

  return result;
}

int SetSignalRequestMsg_Blob_MotionParams(LONG packetHandle, struct SignalRequestMsg_Blob_Motion value, char oldPath[])
{
  char newPath[300];
  int result;

  result = 0;

  snprintf(newPath, elcount(newPath), "%s.%s", oldPath, "transmissionState");
  C2xSetTokenInt(packetHandle, "SignalRequestMsg", newPath, value.transmissionState);
  result = CheckLastError("SignalRequestMsg", gkFuncRefGet, result);

  snprintf(newPath, elcount(newPath), "%s.%s", oldPath, "speed");
  C2xSetTokenInt(packetHandle, "SignalRequestMsg", newPath, value.speed);
  result = CheckLastError("SignalRequestMsg", gkFuncRefGet, result);

  snprintf(newPath, elcount(newPath), "%s.%s", oldPath, "heading");
  C2xSetTokenInt(packetHandle, "SignalRequestMsg", newPath, value.heading);
  result = CheckLastError("SignalRequestMsg", gkFuncRefGet, result);

  snprintf(newPath, elcount(newPath), "%s.%s", oldPath, "steeringWheelAngle");
  C2xSetTokenInt(packetHandle, "SignalRequestMsg", newPath, value.steeringWheelAngle);
  result = CheckLastError("SignalRequestMsg", gkFuncRefGet, result);

  snprintf(newPath, elcount(newPath), "%s.%s", oldPath, "accelSet");
  SetSignalRequestMsg_Blob_AccelerationSet4WayParams(packetHandle, value.accelSet, newPath);
  result = CheckLastError("SignalRequestMsg", gkFuncRefGet, result);

  return result;
}

int GetSignalRequestMsg_Blob_BrakeSystemStatusParams(LONG packetHandle, struct SignalRequestMsg_Blob_BrakeSystemStatus value, char oldPath[])
{
  char newPath[300]; 
  int j;
  int result;

  result = 0;

  snprintf(newPath, elcount(newPath), "%s.%s", oldPath, "wheelBrakes");
  value.wheelBrakes.isValidFlag = 1;
  value.wheelBrakes.stringLength = C2xGetTokenLengthBit(packetHandle, "SignalRequestMsg", newPath);
  if ((result = CheckLastError("SignalRequestMsg", gkFuncRefGet, result))==0)
  {
    for(j=0; j<value.wheelBrakes.stringLength; j++)
    {
      if(C2xGetTokenBitOfBitString(packetHandle, "SignalRequestMsg", newPath, j) == 0)
      {
        value.wheelBrakes.string[j] = '0';
      }
      else
      {
        value.wheelBrakes.string[j] = '1';
      }
      result = CheckLastError("SignalRequestMsg", gkFuncRefGet, result);
    }
  }

  snprintf(newPath, elcount(newPath), "%s.%s", oldPath, "brakesUnavailable");
  value.brakesUnavailable = C2xGetTokenInt64(packetHandle, "SignalRequestMsg", newPath);
  result = CheckLastError("SignalRequestMsg", gkFuncRefGet, result);

  snprintf(newPath, elcount(newPath), "%s.%s", oldPath, "spareBit");
  value.spareBit = C2xGetTokenInt(packetHandle, "SignalRequestMsg", newPath);
  result = CheckLastError("SignalRequestMsg", gkFuncRefGet, result);

  snprintf(newPath, elcount(newPath), "%s.%s", oldPath, "traction");
  value.traction = C2xGetTokenInt(packetHandle, "SignalRequestMsg", newPath);
  result = CheckLastError("SignalRequestMsg", gkFuncRefGet, result);

  snprintf(newPath, elcount(newPath), "%s.%s", oldPath, "antilockBrakingSystem");
  value.antilockBrakingSystem = C2xGetTokenInt(packetHandle, "SignalRequestMsg", newPath);
  result = CheckLastError("SignalRequestMsg", gkFuncRefGet, result);

  snprintf(newPath, elcount(newPath), "%s.%s", oldPath, "scs");
  value.scs = C2xGetTokenInt(packetHandle, "SignalRequestMsg", newPath);
  result = CheckLastError("SignalRequestMsg", gkFuncRefGet, result);

  snprintf(newPath, elcount(newPath), "%s.%s", oldPath, "brakeBoost");
  value.brakeBoost = C2xGetTokenInt(packetHandle, "SignalRequestMsg", newPath);
  result = CheckLastError("SignalRequestMsg", gkFuncRefGet, result);

  snprintf(newPath, elcount(newPath), "%s.%s", oldPath, "auxBrakes");
  value.auxBrakes = C2xGetTokenInt(packetHandle, "SignalRequestMsg", newPath);
  result = CheckLastError("SignalRequestMsg", gkFuncRefGet, result);

  return result;
}

int SetSignalRequestMsg_Blob_BrakeSystemStatusParams(LONG packetHandle, struct SignalRequestMsg_Blob_BrakeSystemStatus value, char oldPath[])
{
  char newPath[300]; 
  int j;
  int result;

  result = 0;

  snprintf(newPath, elcount(newPath), "%s.%s", oldPath, "wheelBrakes");
    for(j=0; j<value.wheelBrakes.stringLength; j++)
    {
      if(value.wheelBrakes.string[j] == '0')
      {
        C2xSetTokenBitOfBitString(packetHandle, "SignalRequestMsg", newPath, j, 0);
      }
      else
      {
        C2xSetTokenBitOfBitString(packetHandle, "SignalRequestMsg", newPath, j, 1);
      }
      result = CheckLastError("SignalRequestMsg", gkFuncRefGet, result);
    }

  snprintf(newPath, elcount(newPath), "%s.%s", oldPath, "brakesUnavailable");
  C2xSetTokenInt64(packetHandle, "SignalRequestMsg", newPath, value.brakesUnavailable);
  result = CheckLastError("SignalRequestMsg", gkFuncRefGet, result);

  snprintf(newPath, elcount(newPath), "%s.%s", oldPath, "spareBit");
  C2xSetTokenInt(packetHandle, "SignalRequestMsg", newPath, value.spareBit);
  result = CheckLastError("SignalRequestMsg", gkFuncRefGet, result);

  snprintf(newPath, elcount(newPath), "%s.%s", oldPath, "traction");
  C2xSetTokenInt(packetHandle, "SignalRequestMsg", newPath, value.traction);
  result = CheckLastError("SignalRequestMsg", gkFuncRefGet, result);

  snprintf(newPath, elcount(newPath), "%s.%s", oldPath, "antilockBrakingSystem");
  C2xSetTokenInt(packetHandle, "SignalRequestMsg", newPath, value.antilockBrakingSystem);
  result = CheckLastError("SignalRequestMsg", gkFuncRefGet, result);

  snprintf(newPath, elcount(newPath), "%s.%s", oldPath, "scs");
  C2xSetTokenInt(packetHandle, "SignalRequestMsg", newPath, value.scs);
  result = CheckLastError("SignalRequestMsg", gkFuncRefGet, result);

  snprintf(newPath, elcount(newPath), "%s.%s", oldPath, "brakeBoost");
  C2xSetTokenInt(packetHandle, "SignalRequestMsg", newPath, value.brakeBoost);
  result = CheckLastError("SignalRequestMsg", gkFuncRefGet, result);

  snprintf(newPath, elcount(newPath), "%s.%s", oldPath, "auxBrakes");
  C2xSetTokenInt(packetHandle, "SignalRequestMsg", newPath, value.auxBrakes);
  result = CheckLastError("SignalRequestMsg", gkFuncRefGet, result);

  return result;
}

int GetSignalRequestMsg_Blob_VehicleSizeParams(LONG packetHandle, struct SignalRequestMsg_Blob_VehicleSize value, char oldPath[])
{
  char newPath[300];
  int result;

  result = 0;

  snprintf(newPath, elcount(newPath), "%s.%s", oldPath, "vehicleWidth");
  value.vehicleWidth = C2xGetTokenInt(packetHandle, "SignalRequestMsg", newPath);
  result = CheckLastError("SignalRequestMsg", gkFuncRefGet, result);

  snprintf(newPath, elcount(newPath), "%s.%s", oldPath, "vehicleLength");
  value.vehicleLength = C2xGetTokenInt(packetHandle, "SignalRequestMsg", newPath);
  result = CheckLastError("SignalRequestMsg", gkFuncRefGet, result);

  return result;
}

int SetSignalRequestMsg_Blob_VehicleSizeParams(LONG packetHandle, struct SignalRequestMsg_Blob_VehicleSize value, char oldPath[])
{
  char newPath[300];
  int result;

  result = 0;

  snprintf(newPath, elcount(newPath), "%s.%s", oldPath, "vehicleWidth");
  C2xSetTokenInt(packetHandle, "SignalRequestMsg", newPath, value.vehicleWidth);
  result = CheckLastError("SignalRequestMsg", gkFuncRefGet, result);

  snprintf(newPath, elcount(newPath), "%s.%s", oldPath, "vehicleLength");
  C2xSetTokenInt(packetHandle, "SignalRequestMsg", newPath, value.vehicleLength);
  result = CheckLastError("SignalRequestMsg", gkFuncRefGet, result);

  return result;
}

int GetSignalRequestMsg_Blob_BSMblobParams(LONG packetHandle, struct SignalRequestMsg_Blob_BSMblob value, char oldPath[])
{
  char newPath[300];
  int result;

  result = 0;

  snprintf(newPath, elcount(newPath), "%s.%s", oldPath, "msgCnt");
  value.msgCnt = C2xGetTokenInt(packetHandle, "SignalRequestMsg", newPath);
  result = CheckLastError("SignalRequestMsg", gkFuncRefGet, result);

  snprintf(newPath, elcount(newPath), "%s.%s", oldPath, "id");
  value.id = C2xGetTokenInt64(packetHandle, "SignalRequestMsg", newPath);
  result = CheckLastError("SignalRequestMsg", gkFuncRefGet, result);

  snprintf(newPath, elcount(newPath), "%s.%s", oldPath, "secMark");
  value.secMark = C2xGetTokenInt(packetHandle, "SignalRequestMsg", newPath);
  result = CheckLastError("SignalRequestMsg", gkFuncRefGet, result);

  snprintf(newPath, elcount(newPath), "%s.%s", oldPath, "pos");
  GetSignalRequestMsg_Blob_Position3DParams(packetHandle, value.pos, newPath);
  result = CheckLastError("SignalRequestMsg", gkFuncRefGet, result);

  snprintf(newPath, elcount(newPath), "%s.%s", oldPath, "accuracy");
  GetSignalRequestMsg_Blob_PositionalAccuracyParams(packetHandle, value.accuracy, newPath);
  result = CheckLastError("SignalRequestMsg", gkFuncRefGet, result);

  snprintf(newPath, elcount(newPath), "%s.%s", oldPath, "motion");
  GetSignalRequestMsg_Blob_MotionParams(packetHandle, value.motion, newPath);
  result = CheckLastError("SignalRequestMsg", gkFuncRefGet, result);

  snprintf(newPath, elcount(newPath), "%s.%s", oldPath, "brakes");
  GetSignalRequestMsg_Blob_BrakeSystemStatusParams(packetHandle, value.brakes, newPath);
  result = CheckLastError("SignalRequestMsg", gkFuncRefGet, result);

  snprintf(newPath, elcount(newPath), "%s.%s", oldPath, "size");
  GetSignalRequestMsg_Blob_VehicleSizeParams(packetHandle, value.size, newPath);
  result = CheckLastError("SignalRequestMsg", gkFuncRefGet, result);

  return result;
}

int SetSignalRequestMsg_Blob_BSMblobParams(LONG packetHandle, struct SignalRequestMsg_Blob_BSMblob value, char oldPath[])
{
  char newPath[300];
  int result;

  result = 0;

  snprintf(newPath, elcount(newPath), "%s.%s", oldPath, "msgCnt");
  C2xSetTokenInt(packetHandle, "SignalRequestMsg", newPath, value.msgCnt);
  result = CheckLastError("SignalRequestMsg", gkFuncRefGet, result);

  snprintf(newPath, elcount(newPath), "%s.%s", oldPath, "id");
  C2xSetTokenInt64(packetHandle, "SignalRequestMsg", newPath, value.id);
  result = CheckLastError("SignalRequestMsg", gkFuncRefGet, result);

  snprintf(newPath, elcount(newPath), "%s.%s", oldPath, "secMark");
  C2xSetTokenInt(packetHandle, "SignalRequestMsg", newPath, value.secMark);
  result = CheckLastError("SignalRequestMsg", gkFuncRefGet, result);

  snprintf(newPath, elcount(newPath), "%s.%s", oldPath, "pos");
  SetSignalRequestMsg_Blob_Position3DParams(packetHandle, value.pos, newPath);
  result = CheckLastError("SignalRequestMsg", gkFuncRefGet, result);

  snprintf(newPath, elcount(newPath), "%s.%s", oldPath, "accuracy");
  SetSignalRequestMsg_Blob_PositionalAccuracyParams(packetHandle, value.accuracy, newPath);
  result = CheckLastError("SignalRequestMsg", gkFuncRefGet, result);

  snprintf(newPath, elcount(newPath), "%s.%s", oldPath, "motion");
  SetSignalRequestMsg_Blob_MotionParams(packetHandle, value.motion, newPath);
  result = CheckLastError("SignalRequestMsg", gkFuncRefGet, result);

  snprintf(newPath, elcount(newPath), "%s.%s", oldPath, "brakes");
  SetSignalRequestMsg_Blob_BrakeSystemStatusParams(packetHandle, value.brakes, newPath);
  result = CheckLastError("SignalRequestMsg", gkFuncRefGet, result);

  snprintf(newPath, elcount(newPath), "%s.%s", oldPath, "size");
  SetSignalRequestMsg_Blob_VehicleSizeParams(packetHandle, value.size, newPath);
  result = CheckLastError("SignalRequestMsg", gkFuncRefGet, result);

  return result;
}

int GetSignalRequestMsgBSMblobParams(LONG packetHandle, struct SignalRequestMsgBSMblob value, char oldPath[])
{
  char newPath[300];
  int result;

  result = 0;

  snprintf(newPath, elcount(newPath), "%s.%s", oldPath, "_Blob_BSMblob");
  GetSignalRequestMsg_Blob_BSMblobParams(packetHandle, value._Blob_BSMblob, newPath);
  result = CheckLastError("SignalRequestMsg", gkFuncRefGet, result);

  return result;
}

int SetSignalRequestMsgBSMblobParams(LONG packetHandle, struct SignalRequestMsgBSMblob value, char oldPath[])
{
  char newPath[300];
  int result;

  result = 0;

  snprintf(newPath, elcount(newPath), "%s.%s", oldPath, "_Blob_BSMblob");
  SetSignalRequestMsg_Blob_BSMblobParams(packetHandle, value._Blob_BSMblob, newPath);
  result = CheckLastError("SignalRequestMsg", gkFuncRefGet, result);

  return result;
}

int GetSignalRequestMsg_Blob_VehicleRequestStatusParams(LONG packetHandle, struct SignalRequestMsg_Blob_VehicleRequestStatus value, char oldPath[])
{
  char newPath[300];
  int result;

  result = 0;

  snprintf(newPath, elcount(newPath), "%s.%s", oldPath, "Brakes_on");
  value.Brakes_on = C2xGetTokenInt64(packetHandle, "SignalRequestMsg", newPath);
  result = CheckLastError("SignalRequestMsg", gkFuncRefGet, result);

  snprintf(newPath, elcount(newPath), "%s.%s", oldPath, "EmergencyUse_or_Operation");
  value.EmergencyUse_or_Operation = C2xGetTokenInt(packetHandle, "SignalRequestMsg", newPath);
  result = CheckLastError("SignalRequestMsg", gkFuncRefGet, result);

  snprintf(newPath, elcount(newPath), "%s.%s", oldPath, "LightsInUse");
  value.LightsInUse = C2xGetTokenInt64(packetHandle, "SignalRequestMsg", newPath);
  result = CheckLastError("SignalRequestMsg", gkFuncRefGet, result);

  snprintf(newPath, elcount(newPath), "%s.%s", oldPath, "MappedValues");
  value.MappedValues = C2xGetTokenInt(packetHandle, "SignalRequestMsg", newPath);
  result = CheckLastError("SignalRequestMsg", gkFuncRefGet, result);

  return result;
}

int SetSignalRequestMsg_Blob_VehicleRequestStatusParams(LONG packetHandle, struct SignalRequestMsg_Blob_VehicleRequestStatus value, char oldPath[])
{
  char newPath[300];
  int result;

  result = 0;

  snprintf(newPath, elcount(newPath), "%s.%s", oldPath, "Brakes_on");
  C2xSetTokenInt64(packetHandle, "SignalRequestMsg", newPath, value.Brakes_on);
  result = CheckLastError("SignalRequestMsg", gkFuncRefGet, result);

  snprintf(newPath, elcount(newPath), "%s.%s", oldPath, "EmergencyUse_or_Operation");
  C2xSetTokenInt(packetHandle, "SignalRequestMsg", newPath, value.EmergencyUse_or_Operation);
  result = CheckLastError("SignalRequestMsg", gkFuncRefGet, result);

  snprintf(newPath, elcount(newPath), "%s.%s", oldPath, "LightsInUse");
  C2xSetTokenInt64(packetHandle, "SignalRequestMsg", newPath, value.LightsInUse);
  result = CheckLastError("SignalRequestMsg", gkFuncRefGet, result);

  snprintf(newPath, elcount(newPath), "%s.%s", oldPath, "MappedValues");
  C2xSetTokenInt(packetHandle, "SignalRequestMsg", newPath, value.MappedValues);
  result = CheckLastError("SignalRequestMsg", gkFuncRefGet, result);

  return result;
}

int GetSignalRequestMsgVehicleRequestStatusParams(LONG packetHandle, struct SignalRequestMsgVehicleRequestStatus value, char oldPath[])
{
  char newPath[300];
  int result;

  result = 0;

  snprintf(newPath, elcount(newPath), "%s.%s", oldPath, "_Blob_VehicleRequestStatus");
  GetSignalRequestMsg_Blob_VehicleRequestStatusParams(packetHandle, value._Blob_VehicleRequestStatus, newPath);
  result = CheckLastError("SignalRequestMsg", gkFuncRefGet, result);

  return result;
}

int SetSignalRequestMsgVehicleRequestStatusParams(LONG packetHandle, struct SignalRequestMsgVehicleRequestStatus value, char oldPath[])
{
  char newPath[300];
  int result;

  result = 0;

  snprintf(newPath, elcount(newPath), "%s.%s", oldPath, "_Blob_VehicleRequestStatus");
  SetSignalRequestMsg_Blob_VehicleRequestStatusParams(packetHandle, value._Blob_VehicleRequestStatus, newPath);
  result = CheckLastError("SignalRequestMsg", gkFuncRefGet, result);

  return result;
}

int API_GetSignalRequestMsgParams(LONG packetHandle, struct SignalRequestMsg value)
{
  int result; 
  int j;
  result = 0;

  value.msgID = C2xGetTokenInt(packetHandle, "SignalRequestMsg", "msgID");
  result = CheckLastError("SignalRequestMsg", gkFuncRefGet, result);

  value.msgCnt = C2xGetTokenInt(packetHandle, "SignalRequestMsg", "msgCnt");
  result = CheckLastError("SignalRequestMsg", gkFuncRefGet, result);

  value.request.isValidFlag = 1;
  GetSignalRequestMsgSignalRequestParams(packetHandle, value.request, "request");
  result = CheckLastError("SignalRequestMsg", gkFuncRefGet, result);

  value.timeOfService.isValidFlag = C2xIsTokenAvailable(packetHandle, "SignalRequestMsg", "timeOfService");
  if(value.timeOfService.isValidFlag == 1)
  {
    value.timeOfService.isValidFlag = 1;
    GetSignalRequestMsgDTimeParams(packetHandle, value.timeOfService, "timeOfService");
    result = CheckLastError("SignalRequestMsg", gkFuncRefGet, result);

  }
  value.endOfService.isValidFlag = C2xIsTokenAvailable(packetHandle, "SignalRequestMsg", "endOfService");
  if(value.endOfService.isValidFlag == 1)
  {
    value.endOfService.isValidFlag = 1;
    GetSignalRequestMsgDTimeParams(packetHandle, value.endOfService, "endOfService");
    result = CheckLastError("SignalRequestMsg", gkFuncRefGet, result);

  }
  value.transitStatus.isValidFlag = C2xIsTokenAvailable(packetHandle, "SignalRequestMsg", "transitStatus");
  if(value.transitStatus.isValidFlag == 1)
  {
    value.transitStatus.stringLength = C2xGetTokenLengthBit(packetHandle, "SignalRequestMsg", "transitStatus");
    if ((result = CheckLastError("SignalRequestMsg", gkFuncRefGet, result))==0)
    {
      for(j=0; j<value.transitStatus.stringLength; j++)
      {
        if(C2xGetTokenBitOfBitString(packetHandle, "SignalRequestMsg", "transitStatus", j) == 0)
        {
          value.transitStatus.string[j] = '0';
        }
        else
        {
          value.transitStatus.string[j] = '1';
        }
        result = CheckLastError("SignalRequestMsg", gkFuncRefGet, result);
      }
    }

    result = CheckLastError("SignalRequestMsg", gkFuncRefGet, result);

  }
  value.vehicleVIN.isValidFlag = C2xIsTokenAvailable(packetHandle, "SignalRequestMsg", "vehicleVIN");
  if(value.vehicleVIN.isValidFlag == 1)
  {
    value.vehicleVIN.isValidFlag = 1;
    GetSignalRequestMsgVehicleIdentParams(packetHandle, value.vehicleVIN, "vehicleVIN");
    result = CheckLastError("SignalRequestMsg", gkFuncRefGet, result);

  }
  value.vehicleData.isValidFlag = 1;
  GetSignalRequestMsgBSMblobParams(packetHandle, value.vehicleData, "vehicleData");
  result = CheckLastError("SignalRequestMsg", gkFuncRefGet, result);

  value.status.isValidFlag = C2xIsTokenAvailable(packetHandle, "SignalRequestMsg", "status");
  if(value.status.isValidFlag == 1)
  {
    value.status.isValidFlag = 1;
    GetSignalRequestMsgVehicleRequestStatusParams(packetHandle, value.status, "status");
    result = CheckLastError("SignalRequestMsg", gkFuncRefGet, result);

  }
  return result;
}

int API_SetSignalRequestMsgParams(LONG packetHandle, struct SignalRequestMsg value)
{
  int result; 
  int j;
  result = 0;

  value.msgID = 14;

  C2xSetTokenInt(packetHandle, "SignalRequestMsg", "msgID", value.msgID);
  result = CheckLastError("SignalRequestMsg", gkFuncRefGet, result);

  C2xSetTokenInt(packetHandle, "SignalRequestMsg", "msgCnt", value.msgCnt);
  result = CheckLastError("SignalRequestMsg", gkFuncRefGet, result);

  SetSignalRequestMsgSignalRequestParams(packetHandle, value.request, "request");
  result = CheckLastError("SignalRequestMsg", gkFuncRefGet, result);

  if (value.timeOfService.isValidFlag==1)
  {
    SetSignalRequestMsgDTimeParams(packetHandle, value.timeOfService, "timeOfService");
    result = CheckLastError("SignalRequestMsg", gkFuncRefGet, result);

  }
  else
  {
    if( C2xIsTokenAvailable(packetHandle, "SignalRequestMsg", "timeOfService") )
    {
      C2xRemoveToken(packetHandle, "SignalRequestMsg", "timeOfService");
    }
  }

  if (value.endOfService.isValidFlag==1)
  {
    SetSignalRequestMsgDTimeParams(packetHandle, value.endOfService, "endOfService");
    result = CheckLastError("SignalRequestMsg", gkFuncRefGet, result);

  }
  else
  {
    if( C2xIsTokenAvailable(packetHandle, "SignalRequestMsg", "endOfService") )
    {
      C2xRemoveToken(packetHandle, "SignalRequestMsg", "endOfService");
    }
  }

  if (value.transitStatus.isValidFlag==1)
  {
      for(j=0; j<value.transitStatus.stringLength; j++)
      {
        if(value.transitStatus.string[j] == '0')
        {
          C2xSetTokenBitOfBitString(packetHandle, "SignalRequestMsg", "transitStatus", j, 0);
        }
        else
        {
          C2xSetTokenBitOfBitString(packetHandle, "SignalRequestMsg", "transitStatus", j, 1);
        }
        result = CheckLastError("SignalRequestMsg", gkFuncRefGet, result);
      }
    result = CheckLastError("SignalRequestMsg", gkFuncRefGet, result);

  }
  else
  {
    if( C2xIsTokenAvailable(packetHandle, "SignalRequestMsg", "transitStatus") )
    {
      C2xRemoveToken(packetHandle, "SignalRequestMsg", "transitStatus");
    }
  }

  if (value.vehicleVIN.isValidFlag==1)
  {
    SetSignalRequestMsgVehicleIdentParams(packetHandle, value.vehicleVIN, "vehicleVIN");
    result = CheckLastError("SignalRequestMsg", gkFuncRefGet, result);

  }
  else
  {
    if( C2xIsTokenAvailable(packetHandle, "SignalRequestMsg", "vehicleVIN") )
    {
      C2xRemoveToken(packetHandle, "SignalRequestMsg", "vehicleVIN");
    }
  }

  SetSignalRequestMsgBSMblobParams(packetHandle, value.vehicleData, "vehicleData");
  result = CheckLastError("SignalRequestMsg", gkFuncRefGet, result);

  if (value.status.isValidFlag==1)
  {
    SetSignalRequestMsgVehicleRequestStatusParams(packetHandle, value.status, "status");
    result = CheckLastError("SignalRequestMsg", gkFuncRefGet, result);

  }
  else
  {
    if( C2xIsTokenAvailable(packetHandle, "SignalRequestMsg", "status") )
    {
      C2xRemoveToken(packetHandle, "SignalRequestMsg", "status");
    }
  }

  return result;
}

