/*@!Encoding:1252*/
/*
//  (c) Vector Informatik GmbH. All rights reserved.
//
//  This file contains definitions of structs and methods that may be used
//  to set and get the values of an ASN.1 defined packet's payload.
//
//  //This example demonstrates how to set a packet's payload:
//  LONG packetHandle;
//  struct ProbeDataManagement payload;
//  //you need to set the values of the variable "payload" yourself
//  packetHandle = API_InitProbeDataManagementPacket();
//  if (packetHandle!=0) {
//    if (API_SetProbeDataManagementParams(packetHandle, payload)==0) {
//      if (C2xCompletePacket(packetHandle)==0) {
//        C2xOutputPacket(packetHandle);
//      }
//    }
//  }
//                                                                             */
includes
{

}
variables
{
    struct ProbeDataManagementSample {
        INT isValidFlag;   // necessary if this struct is used as an optional field of a SEQUENCE
        BYTE sampleStart;  // INTEGER, 0..255;
        BYTE sampleEnd;  // INTEGER, 0..255;
    };
    
    struct ProbeDataManagementHeadingSlice {
        INT isValidFlag;   // necessary if this struct is used as an optional field of a SEQUENCE
        CHAR string[3];
        INT  stringLength;
    };
    
    struct ProbeDataManagement_ProbeDataManagement_term {
        INT isValidFlag;   // necessary if this struct is used as an optional field of a SEQUENCE
        INT choice;
        WORD termtime;  // INTEGER, 1..1800;
        WORD termDistance;  // INTEGER, 1..30000;
    };
    
    struct ProbeDataManagementSnapshotTime {
        INT isValidFlag;   // necessary if this struct is used as an optional field of a SEQUENCE
        BYTE t1;  // INTEGER, 1..99;
        BYTE s1;  // INTEGER, 0..50;
        BYTE t2;  // INTEGER, 1..99;
        BYTE s2;  // INTEGER, 0..50;
    };
    
    struct ProbeDataManagementSnapshotDistance {
        INT isValidFlag;   // necessary if this struct is used as an optional field of a SEQUENCE
        WORD d1;  // INTEGER, 0..999;
        BYTE s1;  // INTEGER, 0..50;
        WORD d2;  // INTEGER, 0..999;
        BYTE s2;  // INTEGER, 0..50;
    };
    
    struct ProbeDataManagement_ProbeDataManagement_snapshot {
        INT isValidFlag;   // necessary if this struct is used as an optional field of a SEQUENCE
        INT choice;
        struct ProbeDataManagementSnapshotTime snapshotTime;  // SEQUENCE;
        struct ProbeDataManagementSnapshotDistance snapshotDistance;  // SEQUENCE;
    };
    
    struct ProbeDataManagementVehicleStatusRequest {
        INT isValidFlag;   // necessary if this struct is used as an optional field of a SEQUENCE
        INT dataType;  // ENUMERATED, unknown(0), lights(1), wipers(2), brakes(3), stab(4), trac(5), abs(6), sunS(7), rainS(8), airTemp(9), steering(10), vertAccelThres(11), vertAccel(12), hozAccelLong(13), hozAccelLat(14), hozAccelCon(15), accel4way(16), confidenceSet(17), obDist(18), obDirect(19), yaw(20), yawRateCon(21), dateTime(22), fullPos(23), position2D(24), position3D(25), vehicle(26), speedHeadC(27), speedC(28);
        struct OPT_BYTE_ASN subType;  // INTEGER, OPTIONAL, 1..15;
        struct OPT_INT_ASN sendOnLessThenValue;  // INTEGER, OPTIONAL, -32767..32767;
        struct OPT_INT_ASN sendOnMoreThenValue;  // INTEGER, OPTIONAL, -32767..32767;
        struct OPT_BOOL_ASN sendAll;  // BOOLEAN, OPTIONAL;
    };
    
    struct ProbeDataManagement_ProbeDataManagement_dataElements {
        INT isValidFlag;   // necessary if this struct is used as an optional field of a SEQUENCE
        INT length;
        struct ProbeDataManagementVehicleStatusRequest arrayValue[32];  // SEQUENCE;
    };
    
    struct ProbeDataManagement {
        INT isValidFlag;   // necessary if this struct is used as an optional field of a SEQUENCE
        INT msgID;  // ENUMERATED, reserved(0), alaCarteMessage(1), basicSafetyMessage(2), basicSafetyMessageVerbose(3), commonSafetyRequest(4), emergencyVehicleAlert(5), intersectionCollisionAlert(6), mapData(7), nmeaCorrections(8), probeDataManagement(9), probeVehicleData(10), roadSideAlert(11), rtcmCorrections(12), signalPhaseAndTimingMessage(13), signalRequestMessage(14), signalStatusMessage(15), travelerInformation(16);
        struct ProbeDataManagementSample sample;  // SEQUENCE;
        struct ProbeDataManagementHeadingSlice directions;  // OCTETSTRING;
        struct ProbeDataManagement_ProbeDataManagement_term term;  // CHOICE;
        struct ProbeDataManagement_ProbeDataManagement_snapshot snapshot;  // CHOICE;
        BYTE txInterval;  // INTEGER, 1..20;
        BYTE cntTthreshold;  // INTEGER, 0..32;
        struct ProbeDataManagement_ProbeDataManagement_dataElements dataElements;  // SEQUENCEOF;
    };
    
}

/*
// init function to create a simple packet handle
*/ 
LONG API_InitProbeDataManagementPacket()
{
  return C2xInitPacket("ProbeDataManagement"); 
}

/*
// init function to create a simple packet handle and
// initialize the struct with valid data
*/ 
LONG API_InitProbeDataManagementPacket(struct ProbeDataManagement msgStruct)
{
  long pktHandle;

  pktHandle = API_InitProbeDataManagementPacket();

  if (pktHandle != 0)
  {
    // create valid message and application data
    if (C2xCompletePacket(pktHandle) == 0) 
    {
      API_GetProbeDataManagementParams(pktHandle, msgStruct);
    }
  }
  return pktHandle;
}

/*
// init function to create a packet with security layer and
// initialize the struct with valid data
*/ 
LONG API_InitProbeDataManagementPacket(struct ProbeDataManagement msgStruct, char packetTypeDesignator[], char certificateName[])
{
  long pktHandle, certHdl;

  // initialize the packet
  pktHandle = C2xInitPacket("ProbeDataManagement", packetTypeDesignator);

  if (pktHandle != 0)
  {
    certHdl = C2xSecCertificateGetHandle(certificateName);  // get the certificate handle for the cert with name "certificateName"
    if (certHdl != 0) 
    {
      C2xSecPacketSetSignerHandle(pktHandle, certHdl); // set the certHdl to the packet
    }

    // create valid message and application data
    if (C2xCompletePacket(pktHandle) == 0) 
    {
      // copy application data to the application structure
      API_GetProbeDataManagementParams(pktHandle, msgStruct);
    }
  }
  return pktHandle;
}
    

int GetProbeDataManagementSampleParams(LONG packetHandle, struct ProbeDataManagementSample value, char oldPath[])
{
  char newPath[300];
  int result;

  result = 0;

  snprintf(newPath, elcount(newPath), "%s.%s", oldPath, "sampleStart");
  value.sampleStart = C2xGetTokenInt(packetHandle, "ProbeDataManagement", newPath);
  result = CheckLastError("ProbeDataManagement", gkFuncRefGet, result);

  snprintf(newPath, elcount(newPath), "%s.%s", oldPath, "sampleEnd");
  value.sampleEnd = C2xGetTokenInt(packetHandle, "ProbeDataManagement", newPath);
  result = CheckLastError("ProbeDataManagement", gkFuncRefGet, result);

  return result;
}

int SetProbeDataManagementSampleParams(LONG packetHandle, struct ProbeDataManagementSample value, char oldPath[])
{
  char newPath[300];
  int result;

  result = 0;

  snprintf(newPath, elcount(newPath), "%s.%s", oldPath, "sampleStart");
  C2xSetTokenInt(packetHandle, "ProbeDataManagement", newPath, value.sampleStart);
  result = CheckLastError("ProbeDataManagement", gkFuncRefGet, result);

  snprintf(newPath, elcount(newPath), "%s.%s", oldPath, "sampleEnd");
  C2xSetTokenInt(packetHandle, "ProbeDataManagement", newPath, value.sampleEnd);
  result = CheckLastError("ProbeDataManagement", gkFuncRefGet, result);

  return result;
}

int GetProbeDataManagement_ProbeDataManagement_termParams(LONG packetHandle, struct ProbeDataManagement_ProbeDataManagement_term value, char oldPath[])
{
  char newPath[300];
  int result;

  result = 0;

  value.choice = C2xGetTokenInt(packetHandle, "ProbeDataManagement", oldPath);

  switch(value.choice)
  {
    case 0:
    {
      snprintf(newPath, elcount(newPath), "%s.%s", oldPath, "termtime");
      value.termtime = C2xGetTokenInt(packetHandle, "ProbeDataManagement", newPath);
      result = CheckLastError("ProbeDataManagement", gkFuncRefGet, result);
    }
    break;
    case 1:
    {
      snprintf(newPath, elcount(newPath), "%s.%s", oldPath, "termDistance");
      value.termDistance = C2xGetTokenInt(packetHandle, "ProbeDataManagement", newPath);
      result = CheckLastError("ProbeDataManagement", gkFuncRefGet, result);
    }
    break;
  }
  return result;
}

int SetProbeDataManagement_ProbeDataManagement_termParams(LONG packetHandle, struct ProbeDataManagement_ProbeDataManagement_term value, char oldPath[])
{
  char newPath[300];
  int result;

  result = 0;

  switch(value.choice)
  {
    case 0:
    {
      snprintf(newPath, elcount(newPath), "%s.%s", oldPath, "termtime");
      C2xSetTokenInt(packetHandle, "ProbeDataManagement", newPath, value.termtime);
      result = CheckLastError("ProbeDataManagement", gkFuncRefGet, result);
    }
    break;
    case 1:
    {
      snprintf(newPath, elcount(newPath), "%s.%s", oldPath, "termDistance");
      C2xSetTokenInt(packetHandle, "ProbeDataManagement", newPath, value.termDistance);
      result = CheckLastError("ProbeDataManagement", gkFuncRefGet, result);
    }
    break;
  }
  return result;
}

int GetProbeDataManagementSnapshotTimeParams(LONG packetHandle, struct ProbeDataManagementSnapshotTime value, char oldPath[])
{
  char newPath[300];
  int result;

  result = 0;

  snprintf(newPath, elcount(newPath), "%s.%s", oldPath, "t1");
  value.t1 = C2xGetTokenInt(packetHandle, "ProbeDataManagement", newPath);
  result = CheckLastError("ProbeDataManagement", gkFuncRefGet, result);

  snprintf(newPath, elcount(newPath), "%s.%s", oldPath, "s1");
  value.s1 = C2xGetTokenInt(packetHandle, "ProbeDataManagement", newPath);
  result = CheckLastError("ProbeDataManagement", gkFuncRefGet, result);

  snprintf(newPath, elcount(newPath), "%s.%s", oldPath, "t2");
  value.t2 = C2xGetTokenInt(packetHandle, "ProbeDataManagement", newPath);
  result = CheckLastError("ProbeDataManagement", gkFuncRefGet, result);

  snprintf(newPath, elcount(newPath), "%s.%s", oldPath, "s2");
  value.s2 = C2xGetTokenInt(packetHandle, "ProbeDataManagement", newPath);
  result = CheckLastError("ProbeDataManagement", gkFuncRefGet, result);

  return result;
}

int SetProbeDataManagementSnapshotTimeParams(LONG packetHandle, struct ProbeDataManagementSnapshotTime value, char oldPath[])
{
  char newPath[300];
  int result;

  result = 0;

  snprintf(newPath, elcount(newPath), "%s.%s", oldPath, "t1");
  C2xSetTokenInt(packetHandle, "ProbeDataManagement", newPath, value.t1);
  result = CheckLastError("ProbeDataManagement", gkFuncRefGet, result);

  snprintf(newPath, elcount(newPath), "%s.%s", oldPath, "s1");
  C2xSetTokenInt(packetHandle, "ProbeDataManagement", newPath, value.s1);
  result = CheckLastError("ProbeDataManagement", gkFuncRefGet, result);

  snprintf(newPath, elcount(newPath), "%s.%s", oldPath, "t2");
  C2xSetTokenInt(packetHandle, "ProbeDataManagement", newPath, value.t2);
  result = CheckLastError("ProbeDataManagement", gkFuncRefGet, result);

  snprintf(newPath, elcount(newPath), "%s.%s", oldPath, "s2");
  C2xSetTokenInt(packetHandle, "ProbeDataManagement", newPath, value.s2);
  result = CheckLastError("ProbeDataManagement", gkFuncRefGet, result);

  return result;
}

int GetProbeDataManagementSnapshotDistanceParams(LONG packetHandle, struct ProbeDataManagementSnapshotDistance value, char oldPath[])
{
  char newPath[300];
  int result;

  result = 0;

  snprintf(newPath, elcount(newPath), "%s.%s", oldPath, "d1");
  value.d1 = C2xGetTokenInt(packetHandle, "ProbeDataManagement", newPath);
  result = CheckLastError("ProbeDataManagement", gkFuncRefGet, result);

  snprintf(newPath, elcount(newPath), "%s.%s", oldPath, "s1");
  value.s1 = C2xGetTokenInt(packetHandle, "ProbeDataManagement", newPath);
  result = CheckLastError("ProbeDataManagement", gkFuncRefGet, result);

  snprintf(newPath, elcount(newPath), "%s.%s", oldPath, "d2");
  value.d2 = C2xGetTokenInt(packetHandle, "ProbeDataManagement", newPath);
  result = CheckLastError("ProbeDataManagement", gkFuncRefGet, result);

  snprintf(newPath, elcount(newPath), "%s.%s", oldPath, "s2");
  value.s2 = C2xGetTokenInt(packetHandle, "ProbeDataManagement", newPath);
  result = CheckLastError("ProbeDataManagement", gkFuncRefGet, result);

  return result;
}

int SetProbeDataManagementSnapshotDistanceParams(LONG packetHandle, struct ProbeDataManagementSnapshotDistance value, char oldPath[])
{
  char newPath[300];
  int result;

  result = 0;

  snprintf(newPath, elcount(newPath), "%s.%s", oldPath, "d1");
  C2xSetTokenInt(packetHandle, "ProbeDataManagement", newPath, value.d1);
  result = CheckLastError("ProbeDataManagement", gkFuncRefGet, result);

  snprintf(newPath, elcount(newPath), "%s.%s", oldPath, "s1");
  C2xSetTokenInt(packetHandle, "ProbeDataManagement", newPath, value.s1);
  result = CheckLastError("ProbeDataManagement", gkFuncRefGet, result);

  snprintf(newPath, elcount(newPath), "%s.%s", oldPath, "d2");
  C2xSetTokenInt(packetHandle, "ProbeDataManagement", newPath, value.d2);
  result = CheckLastError("ProbeDataManagement", gkFuncRefGet, result);

  snprintf(newPath, elcount(newPath), "%s.%s", oldPath, "s2");
  C2xSetTokenInt(packetHandle, "ProbeDataManagement", newPath, value.s2);
  result = CheckLastError("ProbeDataManagement", gkFuncRefGet, result);

  return result;
}

int GetProbeDataManagement_ProbeDataManagement_snapshotParams(LONG packetHandle, struct ProbeDataManagement_ProbeDataManagement_snapshot value, char oldPath[])
{
  char newPath[300];
  int result;

  result = 0;

  value.choice = C2xGetTokenInt(packetHandle, "ProbeDataManagement", oldPath);

  switch(value.choice)
  {
    case 0:
    {
      snprintf(newPath, elcount(newPath), "%s.%s", oldPath, "snapshotTime");
      GetProbeDataManagementSnapshotTimeParams(packetHandle, value.snapshotTime, newPath);
      result = CheckLastError("ProbeDataManagement", gkFuncRefGet, result);
    }
    break;
    case 1:
    {
      snprintf(newPath, elcount(newPath), "%s.%s", oldPath, "snapshotDistance");
      GetProbeDataManagementSnapshotDistanceParams(packetHandle, value.snapshotDistance, newPath);
      result = CheckLastError("ProbeDataManagement", gkFuncRefGet, result);
    }
    break;
  }
  return result;
}

int SetProbeDataManagement_ProbeDataManagement_snapshotParams(LONG packetHandle, struct ProbeDataManagement_ProbeDataManagement_snapshot value, char oldPath[])
{
  char newPath[300];
  int result;

  result = 0;

  switch(value.choice)
  {
    case 0:
    {
      snprintf(newPath, elcount(newPath), "%s.%s", oldPath, "snapshotTime");
      SetProbeDataManagementSnapshotTimeParams(packetHandle, value.snapshotTime, newPath);
      result = CheckLastError("ProbeDataManagement", gkFuncRefGet, result);
    }
    break;
    case 1:
    {
      snprintf(newPath, elcount(newPath), "%s.%s", oldPath, "snapshotDistance");
      SetProbeDataManagementSnapshotDistanceParams(packetHandle, value.snapshotDistance, newPath);
      result = CheckLastError("ProbeDataManagement", gkFuncRefGet, result);
    }
    break;
  }
  return result;
}

int GetProbeDataManagementVehicleStatusRequestParams(LONG packetHandle, struct ProbeDataManagementVehicleStatusRequest value, char oldPath[])
{
  char newPath[300];
  int result;

  result = 0;

  snprintf(newPath, elcount(newPath), "%s.%s", oldPath, "dataType");
  value.dataType = C2xGetTokenInt(packetHandle, "ProbeDataManagement", newPath);
  result = CheckLastError("ProbeDataManagement", gkFuncRefGet, result);

  snprintf(newPath, elcount(newPath), "%s.%s", oldPath, "subType");
  value.subType.isValidFlag = C2xIsTokenAvailable(packetHandle, "ProbeDataManagement", newPath);
  if(value.subType.isValidFlag==1)
  {
    value.subType.value = C2xGetTokenInt(packetHandle, "ProbeDataManagement", newPath);
    result = CheckLastError("ProbeDataManagement", gkFuncRefGet, result);
  }
  snprintf(newPath, elcount(newPath), "%s.%s", oldPath, "sendOnLessThenValue");
  value.sendOnLessThenValue.isValidFlag = C2xIsTokenAvailable(packetHandle, "ProbeDataManagement", newPath);
  if(value.sendOnLessThenValue.isValidFlag==1)
  {
    value.sendOnLessThenValue.value = C2xGetTokenInt(packetHandle, "ProbeDataManagement", newPath);
    result = CheckLastError("ProbeDataManagement", gkFuncRefGet, result);
  }
  snprintf(newPath, elcount(newPath), "%s.%s", oldPath, "sendOnMoreThenValue");
  value.sendOnMoreThenValue.isValidFlag = C2xIsTokenAvailable(packetHandle, "ProbeDataManagement", newPath);
  if(value.sendOnMoreThenValue.isValidFlag==1)
  {
    value.sendOnMoreThenValue.value = C2xGetTokenInt(packetHandle, "ProbeDataManagement", newPath);
    result = CheckLastError("ProbeDataManagement", gkFuncRefGet, result);
  }
  snprintf(newPath, elcount(newPath), "%s.%s", oldPath, "sendAll");
  value.sendAll.isValidFlag = C2xIsTokenAvailable(packetHandle, "ProbeDataManagement", newPath);
  if(value.sendAll.isValidFlag==1)
  {
    value.sendAll.value = C2xGetTokenInt64(packetHandle, "ProbeDataManagement", newPath);
    result = CheckLastError("ProbeDataManagement", gkFuncRefGet, result);
  }
  return result;
}

int SetProbeDataManagementVehicleStatusRequestParams(LONG packetHandle, struct ProbeDataManagementVehicleStatusRequest value, char oldPath[])
{
  char newPath[300];
  int result;

  result = 0;

  snprintf(newPath, elcount(newPath), "%s.%s", oldPath, "dataType");
  C2xSetTokenInt(packetHandle, "ProbeDataManagement", newPath, value.dataType);
  result = CheckLastError("ProbeDataManagement", gkFuncRefGet, result);

  snprintf(newPath, elcount(newPath), "%s.%s", oldPath, "subType");
  if(value.subType.isValidFlag==1)
  {
    C2xSetTokenInt(packetHandle, "ProbeDataManagement", newPath, value.subType.value);
    result = CheckLastError("ProbeDataManagement", gkFuncRefGet, result);
  }
  else
  {
    if( C2xIsTokenAvailable(packetHandle, "ProbeDataManagement", newPath) )
    {
      C2xRemoveToken(packetHandle, "ProbeDataManagement", newPath);
    }
  }

  snprintf(newPath, elcount(newPath), "%s.%s", oldPath, "sendOnLessThenValue");
  if(value.sendOnLessThenValue.isValidFlag==1)
  {
    C2xSetTokenInt(packetHandle, "ProbeDataManagement", newPath, value.sendOnLessThenValue.value);
    result = CheckLastError("ProbeDataManagement", gkFuncRefGet, result);
  }
  else
  {
    if( C2xIsTokenAvailable(packetHandle, "ProbeDataManagement", newPath) )
    {
      C2xRemoveToken(packetHandle, "ProbeDataManagement", newPath);
    }
  }

  snprintf(newPath, elcount(newPath), "%s.%s", oldPath, "sendOnMoreThenValue");
  if(value.sendOnMoreThenValue.isValidFlag==1)
  {
    C2xSetTokenInt(packetHandle, "ProbeDataManagement", newPath, value.sendOnMoreThenValue.value);
    result = CheckLastError("ProbeDataManagement", gkFuncRefGet, result);
  }
  else
  {
    if( C2xIsTokenAvailable(packetHandle, "ProbeDataManagement", newPath) )
    {
      C2xRemoveToken(packetHandle, "ProbeDataManagement", newPath);
    }
  }

  snprintf(newPath, elcount(newPath), "%s.%s", oldPath, "sendAll");
  if(value.sendAll.isValidFlag==1)
  {
    C2xSetTokenInt64(packetHandle, "ProbeDataManagement", newPath, value.sendAll.value);
    result = CheckLastError("ProbeDataManagement", gkFuncRefGet, result);
  }
  else
  {
    if( C2xIsTokenAvailable(packetHandle, "ProbeDataManagement", newPath) )
    {
      C2xRemoveToken(packetHandle, "ProbeDataManagement", newPath);
    }
  }

  return result;
}

int GetProbeDataManagement_ProbeDataManagement_dataElementsParams(LONG packetHandle, struct ProbeDataManagement_ProbeDataManagement_dataElements value, char oldPath[])
{
  char newPath[300]; 
  int i;
  int result;

  result = 0;

  value.length = C2xGetTokenInt(packetHandle, "ProbeDataManagement", oldPath);
  if((result = CheckLastError("ProbeDataManagement", gkFuncRefGet, result))==0)
  {
    for(i=0; i<value.length; i++)
    {
      snprintf(newPath, elcount(newPath), "%s[%d]", oldPath, i);
      GetProbeDataManagementVehicleStatusRequestParams(packetHandle, value.arrayValue[i], newPath);
      result = CheckLastError("ProbeDataManagement", gkFuncRefGet, result);
    }
  }
  return result;
}

int SetProbeDataManagement_ProbeDataManagement_dataElementsParams(LONG packetHandle, struct ProbeDataManagement_ProbeDataManagement_dataElements value, char oldPath[])
{
  char newPath[300]; 
  int i;
  int result;

  result = 0;

  C2xRemoveToken(packetHandle, "ProbeDataManagement", oldPath);
  for(i=0; i<value.length; i++)
  {
    snprintf(newPath, elcount(newPath), "%s[%d]", oldPath, i);
    SetProbeDataManagementVehicleStatusRequestParams(packetHandle, value.arrayValue[i], newPath);
    result = CheckLastError("ProbeDataManagement", gkFuncRefGet, result);
  }
  return result;
}

int API_GetProbeDataManagementParams(LONG packetHandle, struct ProbeDataManagement value)
{
  int result;
  result = 0;

  value.msgID = C2xGetTokenInt(packetHandle, "ProbeDataManagement", "msgID");
  result = CheckLastError("ProbeDataManagement", gkFuncRefGet, result);

  value.sample.isValidFlag = 1;
  GetProbeDataManagementSampleParams(packetHandle, value.sample, "sample");
  result = CheckLastError("ProbeDataManagement", gkFuncRefGet, result);

  value.directions.stringLength = C2xGetTokenData(packetHandle, "ProbeDataManagement", "directions", elcount(value.directions.string), value.directions.string);
  result = CheckLastError("ProbeDataManagement", gkFuncRefGet, result);

  value.term.isValidFlag = 1;
  GetProbeDataManagement_ProbeDataManagement_termParams(packetHandle, value.term, "term");
  result = CheckLastError("ProbeDataManagement", gkFuncRefGet, result);

  value.snapshot.isValidFlag = 1;
  GetProbeDataManagement_ProbeDataManagement_snapshotParams(packetHandle, value.snapshot, "snapshot");
  result = CheckLastError("ProbeDataManagement", gkFuncRefGet, result);

  value.txInterval = C2xGetTokenInt(packetHandle, "ProbeDataManagement", "txInterval");
  result = CheckLastError("ProbeDataManagement", gkFuncRefGet, result);

  value.cntTthreshold = C2xGetTokenInt(packetHandle, "ProbeDataManagement", "cntTthreshold");
  result = CheckLastError("ProbeDataManagement", gkFuncRefGet, result);

  value.dataElements.isValidFlag = 1;
  GetProbeDataManagement_ProbeDataManagement_dataElementsParams(packetHandle, value.dataElements, "dataElements");
  result = CheckLastError("ProbeDataManagement", gkFuncRefGet, result);

  return result;
}

int API_SetProbeDataManagementParams(LONG packetHandle, struct ProbeDataManagement value)
{
  int result;
  result = 0;

  value.msgID = 9;

  C2xSetTokenInt(packetHandle, "ProbeDataManagement", "msgID", value.msgID);
  result = CheckLastError("ProbeDataManagement", gkFuncRefGet, result);

  SetProbeDataManagementSampleParams(packetHandle, value.sample, "sample");
  result = CheckLastError("ProbeDataManagement", gkFuncRefGet, result);

  C2xSetTokenData(packetHandle, "ProbeDataManagement", "directions", value.directions.stringLength, value.directions.string);
  result = CheckLastError("ProbeDataManagement", gkFuncRefGet, result);

  SetProbeDataManagement_ProbeDataManagement_termParams(packetHandle, value.term, "term");
  result = CheckLastError("ProbeDataManagement", gkFuncRefGet, result);

  SetProbeDataManagement_ProbeDataManagement_snapshotParams(packetHandle, value.snapshot, "snapshot");
  result = CheckLastError("ProbeDataManagement", gkFuncRefGet, result);

  C2xSetTokenInt(packetHandle, "ProbeDataManagement", "txInterval", value.txInterval);
  result = CheckLastError("ProbeDataManagement", gkFuncRefGet, result);

  C2xSetTokenInt(packetHandle, "ProbeDataManagement", "cntTthreshold", value.cntTthreshold);
  result = CheckLastError("ProbeDataManagement", gkFuncRefGet, result);

  SetProbeDataManagement_ProbeDataManagement_dataElementsParams(packetHandle, value.dataElements, "dataElements");
  result = CheckLastError("ProbeDataManagement", gkFuncRefGet, result);

  return result;
}

