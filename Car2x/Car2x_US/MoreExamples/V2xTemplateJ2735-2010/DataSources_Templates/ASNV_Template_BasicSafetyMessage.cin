/*@!Encoding:1252*/
/*
//  (c) Vector Informatik GmbH. All rights reserved.
//
//  This file contains definitions of structs and methods that may be used
//  to set and get the values of an ASN.1 defined packet's payload.
//
//  //This example demonstrates how to set a packet's payload:
//  LONG packetHandle;
//  struct BasicSafetyMessage payload;
//  //you need to set the values of the variable "payload" yourself
//  packetHandle = API_InitBasicSafetyMessagePacket();
//  if (packetHandle!=0) {
//    if (API_SetBasicSafetyMessageParams(packetHandle, payload)==0) {
//      if (C2xCompletePacket(packetHandle)==0) {
//        C2xOutputPacket(packetHandle);
//      }
//    }
//  }
//                                                                             */
includes
{

}
variables
{
    struct BasicSafetyMessage_Blob_Position3D {
        INT isValidFlag;   // necessary if this struct is used as an optional field of a SEQUENCE
        LONG latitude;  // INTEGER, -2147483648..2147483647;
        LONG longitude;  // INTEGER, -2147483648..2147483647;
        WORD elevation;  // INTEGER, 0..65535;
    };
    
    struct BasicSafetyMessage_Blob_PositionalAccuracy {
        INT isValidFlag;   // necessary if this struct is used as an optional field of a SEQUENCE
        BYTE accuracySemiMajor;  // INTEGER, 0..255;
        BYTE accuracySemiMinor;  // INTEGER, 0..255;
        WORD accuracyOrientation;  // INTEGER, 0..65535;
    };
    
    struct BasicSafetyMessage_Blob_AccelerationSet4Way {
        INT isValidFlag;   // necessary if this struct is used as an optional field of a SEQUENCE
        INT accelerationLong;  // INTEGER, -32768..32767;
        INT accelerationLat;  // INTEGER, -32768..32767;
        INT accelerationVert;  // INTEGER, -128..127;
        INT yawRate;  // INTEGER, -32768..32767;
    };
    
    struct BasicSafetyMessage_Blob_Motion {
        INT isValidFlag;   // necessary if this struct is used as an optional field of a SEQUENCE
        BYTE transmissionState;  // INTEGER, 0..7, neutral(0), park(1), forwardGears(2), reverseGears(3), reserved1(4), reserved2(5), reserved3(6), unavailable(7);
        WORD speed;  // INTEGER, 0..8191;
        WORD heading;  // INTEGER, 0..65535;
        INT steeringWheelAngle;  // INTEGER, -128..127;
        struct BasicSafetyMessage_Blob_AccelerationSet4Way accelSet;  // SEQUENCE;
    };
    
    struct BasicSafetyMessage_Blob_BrakeSystemStatus_WheelBrakes {
        INT isValidFlag;   // necessary if this struct is used as an optional field of a SEQUENCE
        CHAR string[5];
        INT  stringLength;
    };
    
    struct BasicSafetyMessage_Blob_BrakeSystemStatus {
        INT isValidFlag;   // necessary if this struct is used as an optional field of a SEQUENCE
        struct BasicSafetyMessage_Blob_BrakeSystemStatus_WheelBrakes wheelBrakes;  // BITSTRING;
        INT brakesUnavailable;  // BOOLEAN;
        BYTE spareBit;  // INTEGER, 0..1;
        BYTE traction;  // INTEGER, 0..3, unavailable(0), off(1), on_but_notEngaged(2), engaged(3);
        BYTE antilockBrakingSystem;  // INTEGER, 0..3, unavailable(0), off(1), on_but_notEngaged(2), engaged(3);
        BYTE scs;  // INTEGER, 0..3, unavailable(0), off(1), on(2), reserved(3);
        BYTE brakeBoost;  // INTEGER, 0..3, unavailable(0), off(1), on(2), reserved(3);
        BYTE auxBrakes;  // INTEGER, 0..3, unavailable(0), off(1), on(2), reserved(3);
    };
    
    struct BasicSafetyMessage_Blob_VehicleSize {
        INT isValidFlag;   // necessary if this struct is used as an optional field of a SEQUENCE
        WORD vehicleWidth;  // INTEGER, 0..1023;
        WORD vehicleLength;  // INTEGER, 0..16383;
    };
    
    struct BasicSafetyMessage_Blob_BSMblob {
        INT isValidFlag;   // necessary if this struct is used as an optional field of a SEQUENCE
        BYTE msgCnt;  // INTEGER, 0..255;
        DWORD id;  // INTEGER, 0..4294967295;
        WORD secMark;  // INTEGER, 0..65535;
        struct BasicSafetyMessage_Blob_Position3D pos;  // SEQUENCE;
        struct BasicSafetyMessage_Blob_PositionalAccuracy accuracy;  // SEQUENCE;
        struct BasicSafetyMessage_Blob_Motion motion;  // SEQUENCE;
        struct BasicSafetyMessage_Blob_BrakeSystemStatus brakes;  // SEQUENCE;
        struct BasicSafetyMessage_Blob_VehicleSize size;  // SEQUENCE;
    };
    
    struct BasicSafetyMessageBSMblob {
        INT isValidFlag;   // necessary if this struct is used as an optional field of a SEQUENCE
        CHAR string[39];
        INT  stringLength;
        struct BasicSafetyMessage_Blob_BSMblob _Blob_BSMblob;  // SEQUENCE;
    };
    
    struct BasicSafetyMessageDDateTime {
        INT isValidFlag;   // necessary if this struct is used as an optional field of a SEQUENCE
        struct OPT_WORD_ASN year;  // INTEGER, OPTIONAL, 0..9999;
        struct OPT_BYTE_ASN month;  // INTEGER, OPTIONAL, 0..15;
        struct OPT_BYTE_ASN day;  // INTEGER, OPTIONAL, 0..31;
        struct OPT_BYTE_ASN hour;  // INTEGER, OPTIONAL, 0..31;
        struct OPT_BYTE_ASN minute;  // INTEGER, OPTIONAL, 0..63;
        struct OPT_WORD_ASN second;  // INTEGER, OPTIONAL, 0..65535;
    };
    
    struct BasicSafetyMessageElevation {
        INT isValidFlag;   // necessary if this struct is used as an optional field of a SEQUENCE
        CHAR string[3];
        INT  stringLength;
        WORD _Blob_Elevation;  // INTEGER, 0..65535;
    };
    
    struct BasicSafetyMessage_Blob_TransmissionAndSpeed {
        INT isValidFlag;   // necessary if this struct is used as an optional field of a SEQUENCE
        BYTE transmissionState;  // INTEGER, 0..7, neutral(0), park(1), forwardGears(2), reverseGears(3), reserved1(4), reserved2(5), reserved3(6), unavailable(7);
        WORD speed;  // INTEGER, 0..8191;
    };
    
    struct BasicSafetyMessageTransmissionAndSpeed {
        INT isValidFlag;   // necessary if this struct is used as an optional field of a SEQUENCE
        CHAR string[3];
        INT  stringLength;
        struct BasicSafetyMessage_Blob_TransmissionAndSpeed _Blob_TransmissionAndSpeed;  // SEQUENCE;
    };
    
    struct BasicSafetyMessagePositionalAccuracy {
        INT isValidFlag;   // necessary if this struct is used as an optional field of a SEQUENCE
        CHAR string[5];
        INT  stringLength;
        struct BasicSafetyMessage_Blob_PositionalAccuracy _Blob_PositionalAccuracy;  // SEQUENCE;
    };
    
    struct BasicSafetyMessage_Blob_PositionConfidenceSet {
        INT isValidFlag;   // necessary if this struct is used as an optional field of a SEQUENCE
        BYTE positionConfidence;  // INTEGER, 0..15, unavailable(0), a500m(1), a200m(2), a100m(3), a50m(4), a20m(5), a10m(6), a5m(7), a2m(8), a1m(9), a50cm(10), a20cm(11), a10cm(12), a5cm(13), a2cm(14), a1cm(15);
        BYTE elevationConfidence;  // INTEGER, 0..15, unavailable(0), elev_500_00(1), elev_200_00(2), elev_100_00(3), elev_050_00(4), elev_020_00(5), elev_010_00(6), elev_005_00(7), elev_002_00(8), elev_001_00(9), elev_000_50(10), elev_000_20(11), elev_000_10(12), elev_000_05(13), elev_000_02(14), elev_000_01(15);
    };
    
    struct BasicSafetyMessagePositionConfidenceSet {
        INT isValidFlag;   // necessary if this struct is used as an optional field of a SEQUENCE
        CHAR string[2];
        INT  stringLength;
        struct BasicSafetyMessage_Blob_PositionConfidenceSet _Blob_PositionConfidenceSet;  // SEQUENCE;
    };
    
    struct BasicSafetyMessage_Blob_SpeedandHeadingandThrottleConfidence {
        INT isValidFlag;   // necessary if this struct is used as an optional field of a SEQUENCE
        BYTE headingConfidence;  // INTEGER, 0..7, unavailable(0), prec45deg(1), prec10deg(2), prec05deg(3), prec01deg(4), prec0_1deg(5), prec0_05deg(6), prec0_01deg(7);
        BYTE speedConfidence;  // INTEGER, 0..7, unavailable(0), prec100ms(1), prec10ms(2), prec5ms(3), prec1ms(4), prec0_1ms(5), prec0_05ms(6), prec0_01ms(7);
        BYTE throttleConfidence;  // INTEGER, 0..3, unavailable(0), prec10percent(1), prec1percent(2), prec0_5percent(3);
    };
    
    struct BasicSafetyMessageSpeedandHeadingandThrottleConfidence {
        INT isValidFlag;   // necessary if this struct is used as an optional field of a SEQUENCE
        CHAR string[2];
        INT  stringLength;
        struct BasicSafetyMessage_Blob_SpeedandHeadingandThrottleConfidence _Blob_SpeedandHeadingandThrottleConfidence;  // SEQUENCE;
    };
    
    struct BasicSafetyMessageFullPositionVector {
        INT isValidFlag;   // necessary if this struct is used as an optional field of a SEQUENCE
        struct BasicSafetyMessageDDateTime utcTime;  // SEQUENCE, OPTIONAL;
        LONG lon;  // INTEGER, -1799999999..1800000001;
        LONG lat;  // INTEGER, -900000000..900000001;
        struct BasicSafetyMessageElevation elevation;  // OCTETSTRING, OPTIONAL;
        struct OPT_WORD_ASN heading;  // INTEGER, OPTIONAL, 0..28800;
        struct BasicSafetyMessageTransmissionAndSpeed speed;  // OCTETSTRING, OPTIONAL;
        struct BasicSafetyMessagePositionalAccuracy posAccuracy;  // OCTETSTRING, OPTIONAL;
        struct OPT_ENUM_ASN timeConfidence;  // ENUMERATED, OPTIONAL, unavailable(0), time_100_000(1), time_050_000(2), time_020_000(3), time_010_000(4), time_002_000(5), time_001_000(6), time_000_500(7), time_000_200(8), time_000_100(9), time_000_050(10), time_000_020(11), time_000_010(12), time_000_005(13), time_000_002(14), time_000_001(15), time_000_000_5(16), time_000_000_2(17), time_000_000_1(18), time_000_000_05(19), time_000_000_02(20), time_000_000_01(21), time_000_000_005(22), time_000_000_002(23), time_000_000_001(24), time_000_000_000_5(25), time_000_000_000_2(26), time_000_000_000_1(27), time_000_000_000_05(28), time_000_000_000_02(29), time_000_000_000_01(30), time_000_000_000_005(31), time_000_000_000_002(32), time_000_000_000_001(33), time_000_000_000_000_5(34), time_000_000_000_000_2(35), time_000_000_000_000_1(36), time_000_000_000_000_05(37), time_000_000_000_000_02(38), time_000_000_000_000_01(39);
        struct BasicSafetyMessagePositionConfidenceSet posConfidence;  // OCTETSTRING, OPTIONAL;
        struct BasicSafetyMessageSpeedandHeadingandThrottleConfidence speedConfidence;  // OCTETSTRING, OPTIONAL;
    };
    
    struct BasicSafetyMessageGPSstatus {
        INT isValidFlag;   // necessary if this struct is used as an optional field of a SEQUENCE
        CHAR string[256];
        INT  stringLength;
    };
    
    struct BasicSafetyMessagePathHistoryPointType_01 {
        INT isValidFlag;   // necessary if this struct is used as an optional field of a SEQUENCE
        LONG latOffset;  // INTEGER, -131072..131071;
        LONG longOffset;  // INTEGER, -131072..131071;
        struct OPT_INT_ASN elevationOffset;  // INTEGER, OPTIONAL, -2048..2047;
        struct OPT_WORD_ASN timeOffset;  // INTEGER, OPTIONAL, 1..65535;
        struct BasicSafetyMessagePositionalAccuracy posAccuracy;  // OCTETSTRING, OPTIONAL;
        struct OPT_INT_ASN heading;  // INTEGER, OPTIONAL, -128..127;
        struct BasicSafetyMessageTransmissionAndSpeed speed;  // OCTETSTRING, OPTIONAL;
    };
    
    struct BasicSafetyMessage_PathHistory_crumbData_pathHistoryPointSets_01 {
        INT isValidFlag;   // necessary if this struct is used as an optional field of a SEQUENCE
        INT length;
        struct BasicSafetyMessagePathHistoryPointType_01 arrayValue[23];  // SEQUENCE;
    };
    
    struct BasicSafetyMessage_Blob_PathHistoryPointType_02 {
        INT isValidFlag;   // necessary if this struct is used as an optional field of a SEQUENCE
        LONG latOffset;  // INTEGER, -131072..131071;
        LONG longOffset;  // INTEGER, -131072..131071;
        INT elevationOffset;  // INTEGER, -2048..2047;
        WORD timeOffset;  // INTEGER, 0..65535;
        struct BasicSafetyMessage_Blob_PositionalAccuracy accuracy;  // SEQUENCE;
        INT heading;  // INTEGER, -128..127;
        struct BasicSafetyMessage_Blob_TransmissionAndSpeed speed;  // SEQUENCE;
    };
    
    struct BasicSafetyMessage_Blob_PathHistory_crumbData_pathHistoryPointSets_02 {
        INT isValidFlag;   // necessary if this struct is used as an optional field of a SEQUENCE
        INT length;
        struct BasicSafetyMessage_Blob_PathHistoryPointType_02 arrayValue[32];  // SEQUENCE;
    };
    
    struct BasicSafetyMessage_PathHistory_crumbData_pathHistoryPointSets_02 {
        INT isValidFlag;   // necessary if this struct is used as an optional field of a SEQUENCE
        CHAR string[346];
        INT  stringLength;
        struct BasicSafetyMessage_Blob_PathHistory_crumbData_pathHistoryPointSets_02 _Blob_PathHistory_crumbData_pathHistoryPointSets_02;  // SEQUENCEOF;
    };
    
    struct BasicSafetyMessage_Blob_PathHistoryPointType_03 {
        INT isValidFlag;   // necessary if this struct is used as an optional field of a SEQUENCE
        LONG latOffset;  // INTEGER, -131072..131071;
        LONG longOffset;  // INTEGER, -131072..131071;
        INT elevationOffset;  // INTEGER, -2048..2047;
        WORD timeOffset;  // INTEGER, 0..65535;
        struct BasicSafetyMessage_Blob_PositionalAccuracy accuracy;  // SEQUENCE;
    };
    
    struct BasicSafetyMessage_Blob_PathHistory_crumbData_pathHistoryPointSets_03 {
        INT isValidFlag;   // necessary if this struct is used as an optional field of a SEQUENCE
        INT length;
        struct BasicSafetyMessage_Blob_PathHistoryPointType_03 arrayValue[32];  // SEQUENCE;
    };
    
    struct BasicSafetyMessage_PathHistory_crumbData_pathHistoryPointSets_03 {
        INT isValidFlag;   // necessary if this struct is used as an optional field of a SEQUENCE
        CHAR string[277];
        INT  stringLength;
        struct BasicSafetyMessage_Blob_PathHistory_crumbData_pathHistoryPointSets_03 _Blob_PathHistory_crumbData_pathHistoryPointSets_03;  // SEQUENCEOF;
    };
    
    struct BasicSafetyMessage_Blob_PathHistoryPointType_04 {
        INT isValidFlag;   // necessary if this struct is used as an optional field of a SEQUENCE
        LONG latOffset;  // INTEGER, -131072..131071;
        LONG longOffset;  // INTEGER, -131072..131071;
        INT elevationOffset;  // INTEGER, -2048..2047;
        WORD timeOffset;  // INTEGER, 0..65535;
    };
    
    struct BasicSafetyMessage_Blob_PathHistory_crumbData_pathHistoryPointSets_04 {
        INT isValidFlag;   // necessary if this struct is used as an optional field of a SEQUENCE
        INT length;
        struct BasicSafetyMessage_Blob_PathHistoryPointType_04 arrayValue[32];  // SEQUENCE;
    };
    
    struct BasicSafetyMessage_PathHistory_crumbData_pathHistoryPointSets_04 {
        INT isValidFlag;   // necessary if this struct is used as an optional field of a SEQUENCE
        CHAR string[185];
        INT  stringLength;
        struct BasicSafetyMessage_Blob_PathHistory_crumbData_pathHistoryPointSets_04 _Blob_PathHistory_crumbData_pathHistoryPointSets_04;  // SEQUENCEOF;
    };
    
    struct BasicSafetyMessage_Blob_PathHistoryPointType_05 {
        INT isValidFlag;   // necessary if this struct is used as an optional field of a SEQUENCE
        LONG latOffset;  // INTEGER, -131072..131071;
        LONG longOffset;  // INTEGER, -131072..131071;
        INT elevationOffset;  // INTEGER, -2048..2047;
        struct BasicSafetyMessage_Blob_PositionalAccuracy accuracy;  // SEQUENCE;
    };
    
    struct BasicSafetyMessage_Blob_PathHistory_crumbData_pathHistoryPointSets_05 {
        INT isValidFlag;   // necessary if this struct is used as an optional field of a SEQUENCE
        INT length;
        struct BasicSafetyMessage_Blob_PathHistoryPointType_05 arrayValue[32];  // SEQUENCE;
    };
    
    struct BasicSafetyMessage_PathHistory_crumbData_pathHistoryPointSets_05 {
        INT isValidFlag;   // necessary if this struct is used as an optional field of a SEQUENCE
        CHAR string[231];
        INT  stringLength;
        struct BasicSafetyMessage_Blob_PathHistory_crumbData_pathHistoryPointSets_05 _Blob_PathHistory_crumbData_pathHistoryPointSets_05;  // SEQUENCEOF;
    };
    
    struct BasicSafetyMessage_Blob_PathHistoryPointType_06 {
        INT isValidFlag;   // necessary if this struct is used as an optional field of a SEQUENCE
        LONG latOffset;  // INTEGER, -131072..131071;
        LONG longOffset;  // INTEGER, -131072..131071;
        INT elevationOffset;  // INTEGER, -2048..2047;
    };
    
    struct BasicSafetyMessage_Blob_PathHistory_crumbData_pathHistoryPointSets_06 {
        INT isValidFlag;   // necessary if this struct is used as an optional field of a SEQUENCE
        INT length;
        struct BasicSafetyMessage_Blob_PathHistoryPointType_06 arrayValue[32];  // SEQUENCE;
    };
    
    struct BasicSafetyMessage_PathHistory_crumbData_pathHistoryPointSets_06 {
        INT isValidFlag;   // necessary if this struct is used as an optional field of a SEQUENCE
        CHAR string[139];
        INT  stringLength;
        struct BasicSafetyMessage_Blob_PathHistory_crumbData_pathHistoryPointSets_06 _Blob_PathHistory_crumbData_pathHistoryPointSets_06;  // SEQUENCEOF;
    };
    
    struct BasicSafetyMessage_Blob_PathHistoryPointType_07 {
        INT isValidFlag;   // necessary if this struct is used as an optional field of a SEQUENCE
        LONG latOffset;  // INTEGER, -131072..131071;
        LONG longOffset;  // INTEGER, -131072..131071;
        WORD timeOffset;  // INTEGER, 0..65535;
        struct BasicSafetyMessage_Blob_PositionalAccuracy accuracy;  // SEQUENCE;
    };
    
    struct BasicSafetyMessage_Blob_PathHistory_crumbData_pathHistoryPointSets_07 {
        INT isValidFlag;   // necessary if this struct is used as an optional field of a SEQUENCE
        INT length;
        struct BasicSafetyMessage_Blob_PathHistoryPointType_07 arrayValue[32];  // SEQUENCE;
    };
    
    struct BasicSafetyMessage_PathHistory_crumbData_pathHistoryPointSets_07 {
        INT isValidFlag;   // necessary if this struct is used as an optional field of a SEQUENCE
        CHAR string[243];
        INT  stringLength;
        struct BasicSafetyMessage_Blob_PathHistory_crumbData_pathHistoryPointSets_07 _Blob_PathHistory_crumbData_pathHistoryPointSets_07;  // SEQUENCEOF;
    };
    
    struct BasicSafetyMessage_Blob_PathHistoryPointType_08 {
        INT isValidFlag;   // necessary if this struct is used as an optional field of a SEQUENCE
        LONG latOffset;  // INTEGER, -131072..131071;
        LONG longOffset;  // INTEGER, -131072..131071;
        WORD timeOffset;  // INTEGER, 0..65535;
    };
    
    struct BasicSafetyMessage_Blob_PathHistory_crumbData_pathHistoryPointSets_08 {
        INT isValidFlag;   // necessary if this struct is used as an optional field of a SEQUENCE
        INT length;
        struct BasicSafetyMessage_Blob_PathHistoryPointType_08 arrayValue[32];  // SEQUENCE;
    };
    
    struct BasicSafetyMessage_PathHistory_crumbData_pathHistoryPointSets_08 {
        INT isValidFlag;   // necessary if this struct is used as an optional field of a SEQUENCE
        CHAR string[162];
        INT  stringLength;
        struct BasicSafetyMessage_Blob_PathHistory_crumbData_pathHistoryPointSets_08 _Blob_PathHistory_crumbData_pathHistoryPointSets_08;  // SEQUENCEOF;
    };
    
    struct BasicSafetyMessage_Blob_PathHistoryPointType_09 {
        INT isValidFlag;   // necessary if this struct is used as an optional field of a SEQUENCE
        LONG latOffset;  // INTEGER, -131072..131071;
        LONG longOffset;  // INTEGER, -131072..131071;
        struct BasicSafetyMessage_Blob_PositionalAccuracy accuracy;  // SEQUENCE;
    };
    
    struct BasicSafetyMessage_Blob_PathHistory_crumbData_pathHistoryPointSets_09 {
        INT isValidFlag;   // necessary if this struct is used as an optional field of a SEQUENCE
        INT length;
        struct BasicSafetyMessage_Blob_PathHistoryPointType_09 arrayValue[32];  // SEQUENCE;
    };
    
    struct BasicSafetyMessage_PathHistory_crumbData_pathHistoryPointSets_09 {
        INT isValidFlag;   // necessary if this struct is used as an optional field of a SEQUENCE
        CHAR string[197];
        INT  stringLength;
        struct BasicSafetyMessage_Blob_PathHistory_crumbData_pathHistoryPointSets_09 _Blob_PathHistory_crumbData_pathHistoryPointSets_09;  // SEQUENCEOF;
    };
    
    struct BasicSafetyMessage_Blob_PathHistoryPointType_10 {
        INT isValidFlag;   // necessary if this struct is used as an optional field of a SEQUENCE
        LONG latOffset;  // INTEGER, -131072..131071;
        LONG longOffset;  // INTEGER, -131072..131071;
    };
    
    struct BasicSafetyMessage_Blob_PathHistory_crumbData_pathHistoryPointSets_10 {
        INT isValidFlag;   // necessary if this struct is used as an optional field of a SEQUENCE
        INT length;
        struct BasicSafetyMessage_Blob_PathHistoryPointType_10 arrayValue[32];  // SEQUENCE;
    };
    
    struct BasicSafetyMessage_PathHistory_crumbData_pathHistoryPointSets_10 {
        INT isValidFlag;   // necessary if this struct is used as an optional field of a SEQUENCE
        CHAR string[105];
        INT  stringLength;
        struct BasicSafetyMessage_Blob_PathHistory_crumbData_pathHistoryPointSets_10 _Blob_PathHistory_crumbData_pathHistoryPointSets_10;  // SEQUENCEOF;
    };
    
    struct BasicSafetyMessage_PathHistory_crumbData {
        INT isValidFlag;   // necessary if this struct is used as an optional field of a SEQUENCE
        INT choice;
        struct BasicSafetyMessage_PathHistory_crumbData_pathHistoryPointSets_01 pathHistoryPointSets_01;  // SEQUENCEOF;
        struct BasicSafetyMessage_PathHistory_crumbData_pathHistoryPointSets_02 pathHistoryPointSets_02;  // OCTETSTRING;
        struct BasicSafetyMessage_PathHistory_crumbData_pathHistoryPointSets_03 pathHistoryPointSets_03;  // OCTETSTRING;
        struct BasicSafetyMessage_PathHistory_crumbData_pathHistoryPointSets_04 pathHistoryPointSets_04;  // OCTETSTRING;
        struct BasicSafetyMessage_PathHistory_crumbData_pathHistoryPointSets_05 pathHistoryPointSets_05;  // OCTETSTRING;
        struct BasicSafetyMessage_PathHistory_crumbData_pathHistoryPointSets_06 pathHistoryPointSets_06;  // OCTETSTRING;
        struct BasicSafetyMessage_PathHistory_crumbData_pathHistoryPointSets_07 pathHistoryPointSets_07;  // OCTETSTRING;
        struct BasicSafetyMessage_PathHistory_crumbData_pathHistoryPointSets_08 pathHistoryPointSets_08;  // OCTETSTRING;
        struct BasicSafetyMessage_PathHistory_crumbData_pathHistoryPointSets_09 pathHistoryPointSets_09;  // OCTETSTRING;
        struct BasicSafetyMessage_PathHistory_crumbData_pathHistoryPointSets_10 pathHistoryPointSets_10;  // OCTETSTRING;
    };
    
    struct BasicSafetyMessagePathHistory {
        INT isValidFlag;   // necessary if this struct is used as an optional field of a SEQUENCE
        struct BasicSafetyMessageFullPositionVector initialPosition;  // SEQUENCE, OPTIONAL;
        struct BasicSafetyMessageGPSstatus currGPSstatus;  // BITSTRING, OPTIONAL;
        struct OPT_BYTE_ASN itemCnt;  // INTEGER, OPTIONAL, 0..32;
        struct BasicSafetyMessage_PathHistory_crumbData crumbData;  // CHOICE;
    };
    
    struct BasicSafetyMessagePathPrediction {
        INT isValidFlag;   // necessary if this struct is used as an optional field of a SEQUENCE
        INT radiusOfCurve;  // INTEGER, -32767..32767;
        BYTE confidence;  // INTEGER, 0..200;
    };
    
    struct BasicSafetyMessage_Blob_GPSstatus {
        INT isValidFlag;   // necessary if this struct is used as an optional field of a SEQUENCE
        CHAR string[9];
        INT  stringLength;
    };
    
    struct BasicSafetyMessage_Blob_AntennaOffsetSet {
        INT isValidFlag;   // necessary if this struct is used as an optional field of a SEQUENCE
        INT antOffsetX;  // INTEGER, -8192..8191;
        INT antOffsetY;  // INTEGER, -256..255;
        WORD antOffsetZ;  // INTEGER, 0..511;
    };
    
    struct BasicSafetyMessage_Blob_RTCMHeader {
        INT isValidFlag;   // necessary if this struct is used as an optional field of a SEQUENCE
        struct BasicSafetyMessage_Blob_GPSstatus status;  // BITSTRING;
        struct BasicSafetyMessage_Blob_AntennaOffsetSet offsetSet;  // SEQUENCE;
    };
    
    struct BasicSafetyMessageRTCMHeader {
        INT isValidFlag;   // necessary if this struct is used as an optional field of a SEQUENCE
        CHAR string[6];
        INT  stringLength;
        struct BasicSafetyMessage_Blob_RTCMHeader _Blob_RTCMHeader;  // SEQUENCE;
    };
    
    struct BasicSafetyMessage_RTCMPackage_msg1001 {
        INT isValidFlag;   // necessary if this struct is used as an optional field of a SEQUENCE
        CHAR string[125];
        INT  stringLength;
    };
    
    struct BasicSafetyMessage_RTCMPackage_msg1002 {
        INT isValidFlag;   // necessary if this struct is used as an optional field of a SEQUENCE
        CHAR string[157];
        INT  stringLength;
    };
    
    struct BasicSafetyMessage_RTCMPackage_msg1003 {
        INT isValidFlag;   // necessary if this struct is used as an optional field of a SEQUENCE
        CHAR string[211];
        INT  stringLength;
    };
    
    struct BasicSafetyMessage_RTCMPackage_msg1004 {
        INT isValidFlag;   // necessary if this struct is used as an optional field of a SEQUENCE
        CHAR string[259];
        INT  stringLength;
    };
    
    struct BasicSafetyMessage_RTCMPackage_msg1005 {
        INT isValidFlag;   // necessary if this struct is used as an optional field of a SEQUENCE
        CHAR string[20];
        INT  stringLength;
    };
    
    struct BasicSafetyMessage_RTCMPackage_msg1006 {
        INT isValidFlag;   // necessary if this struct is used as an optional field of a SEQUENCE
        CHAR string[22];
        INT  stringLength;
    };
    
    struct BasicSafetyMessage_RTCMPackage_msg1007 {
        INT isValidFlag;   // necessary if this struct is used as an optional field of a SEQUENCE
        CHAR string[37];
        INT  stringLength;
    };
    
    struct BasicSafetyMessage_RTCMPackage_msg1008 {
        INT isValidFlag;   // necessary if this struct is used as an optional field of a SEQUENCE
        CHAR string[69];
        INT  stringLength;
    };
    
    struct BasicSafetyMessage_RTCMPackage_msg1009 {
        INT isValidFlag;   // necessary if this struct is used as an optional field of a SEQUENCE
        CHAR string[137];
        INT  stringLength;
    };
    
    struct BasicSafetyMessage_RTCMPackage_msg1010 {
        INT isValidFlag;   // necessary if this struct is used as an optional field of a SEQUENCE
        CHAR string[167];
        INT  stringLength;
    };
    
    struct BasicSafetyMessage_RTCMPackage_msg1011 {
        INT isValidFlag;   // necessary if this struct is used as an optional field of a SEQUENCE
        CHAR string[223];
        INT  stringLength;
    };
    
    struct BasicSafetyMessage_RTCMPackage_msg1012 {
        INT isValidFlag;   // necessary if this struct is used as an optional field of a SEQUENCE
        CHAR string[269];
        INT  stringLength;
    };
    
    struct BasicSafetyMessage_RTCMPackage_msg1013 {
        INT isValidFlag;   // necessary if this struct is used as an optional field of a SEQUENCE
        CHAR string[28];
        INT  stringLength;
    };
    
    struct BasicSafetyMessage_RTCMPackage_msg1014 {
        INT isValidFlag;   // necessary if this struct is used as an optional field of a SEQUENCE
        CHAR string[16];
        INT  stringLength;
    };
    
    struct BasicSafetyMessage_RTCMPackage_msg1015 {
        INT isValidFlag;   // necessary if this struct is used as an optional field of a SEQUENCE
        CHAR string[70];
        INT  stringLength;
    };
    
    struct BasicSafetyMessage_RTCMPackage_msg1016 {
        INT isValidFlag;   // necessary if this struct is used as an optional field of a SEQUENCE
        CHAR string[82];
        INT  stringLength;
    };
    
    struct BasicSafetyMessage_RTCMPackage_msg1017 {
        INT isValidFlag;   // necessary if this struct is used as an optional field of a SEQUENCE
        CHAR string[116];
        INT  stringLength;
    };
    
    struct BasicSafetyMessage_RTCMPackage_msg1019 {
        INT isValidFlag;   // necessary if this struct is used as an optional field of a SEQUENCE
        CHAR string[63];
        INT  stringLength;
    };
    
    struct BasicSafetyMessage_RTCMPackage_msg1020 {
        INT isValidFlag;   // necessary if this struct is used as an optional field of a SEQUENCE
        CHAR string[46];
        INT  stringLength;
    };
    
    struct BasicSafetyMessage_RTCMPackage_msg1021 {
        INT isValidFlag;   // necessary if this struct is used as an optional field of a SEQUENCE
        CHAR string[63];
        INT  stringLength;
    };
    
    struct BasicSafetyMessage_RTCMPackage_msg1022 {
        INT isValidFlag;   // necessary if this struct is used as an optional field of a SEQUENCE
        CHAR string[76];
        INT  stringLength;
    };
    
    struct BasicSafetyMessage_RTCMPackage_msg1023 {
        INT isValidFlag;   // necessary if this struct is used as an optional field of a SEQUENCE
        CHAR string[74];
        INT  stringLength;
    };
    
    struct BasicSafetyMessage_RTCMPackage_msg1024 {
        INT isValidFlag;   // necessary if this struct is used as an optional field of a SEQUENCE
        CHAR string[75];
        INT  stringLength;
    };
    
    struct BasicSafetyMessage_RTCMPackage_msg1025 {
        INT isValidFlag;   // necessary if this struct is used as an optional field of a SEQUENCE
        CHAR string[26];
        INT  stringLength;
    };
    
    struct BasicSafetyMessage_RTCMPackage_msg1026 {
        INT isValidFlag;   // necessary if this struct is used as an optional field of a SEQUENCE
        CHAR string[31];
        INT  stringLength;
    };
    
    struct BasicSafetyMessage_RTCMPackage_msg1027 {
        INT isValidFlag;   // necessary if this struct is used as an optional field of a SEQUENCE
        CHAR string[34];
        INT  stringLength;
    };
    
    struct BasicSafetyMessage_RTCMPackage_msg1029 {
        INT isValidFlag;   // necessary if this struct is used as an optional field of a SEQUENCE
        CHAR string[70];
        INT  stringLength;
    };
    
    struct BasicSafetyMessage_RTCMPackage_msg1030 {
        INT isValidFlag;   // necessary if this struct is used as an optional field of a SEQUENCE
        CHAR string[106];
        INT  stringLength;
    };
    
    struct BasicSafetyMessage_RTCMPackage_msg1031 {
        INT isValidFlag;   // necessary if this struct is used as an optional field of a SEQUENCE
        CHAR string[108];
        INT  stringLength;
    };
    
    struct BasicSafetyMessage_RTCMPackage_msg1032 {
        INT isValidFlag;   // necessary if this struct is used as an optional field of a SEQUENCE
        CHAR string[21];
        INT  stringLength;
    };
    
    struct BasicSafetyMessageRTCMPackage {
        INT isValidFlag;   // necessary if this struct is used as an optional field of a SEQUENCE
        struct BasicSafetyMessageFullPositionVector anchorPoint;  // SEQUENCE, OPTIONAL;
        struct BasicSafetyMessageRTCMHeader rtcmHeader;  // OCTETSTRING;
        struct BasicSafetyMessage_RTCMPackage_msg1001 msg1001;  // OCTETSTRING, OPTIONAL;
        struct BasicSafetyMessage_RTCMPackage_msg1002 msg1002;  // OCTETSTRING, OPTIONAL;
        struct BasicSafetyMessage_RTCMPackage_msg1003 msg1003;  // OCTETSTRING, OPTIONAL;
        struct BasicSafetyMessage_RTCMPackage_msg1004 msg1004;  // OCTETSTRING, OPTIONAL;
        struct BasicSafetyMessage_RTCMPackage_msg1005 msg1005;  // OCTETSTRING, OPTIONAL;
        struct BasicSafetyMessage_RTCMPackage_msg1006 msg1006;  // OCTETSTRING, OPTIONAL;
        struct BasicSafetyMessage_RTCMPackage_msg1007 msg1007;  // OCTETSTRING, OPTIONAL;
        struct BasicSafetyMessage_RTCMPackage_msg1008 msg1008;  // OCTETSTRING, OPTIONAL;
        struct BasicSafetyMessage_RTCMPackage_msg1009 msg1009;  // OCTETSTRING, OPTIONAL;
        struct BasicSafetyMessage_RTCMPackage_msg1010 msg1010;  // OCTETSTRING, OPTIONAL;
        struct BasicSafetyMessage_RTCMPackage_msg1011 msg1011;  // OCTETSTRING, OPTIONAL;
        struct BasicSafetyMessage_RTCMPackage_msg1012 msg1012;  // OCTETSTRING, OPTIONAL;
        struct BasicSafetyMessage_RTCMPackage_msg1013 msg1013;  // OCTETSTRING, OPTIONAL;
        struct BasicSafetyMessage_RTCMPackage_msg1014 msg1014;  // OCTETSTRING, OPTIONAL;
        struct BasicSafetyMessage_RTCMPackage_msg1015 msg1015;  // OCTETSTRING, OPTIONAL;
        struct BasicSafetyMessage_RTCMPackage_msg1016 msg1016;  // OCTETSTRING, OPTIONAL;
        struct BasicSafetyMessage_RTCMPackage_msg1017 msg1017;  // OCTETSTRING, OPTIONAL;
        struct BasicSafetyMessage_RTCMPackage_msg1019 msg1019;  // OCTETSTRING, OPTIONAL;
        struct BasicSafetyMessage_RTCMPackage_msg1020 msg1020;  // OCTETSTRING, OPTIONAL;
        struct BasicSafetyMessage_RTCMPackage_msg1021 msg1021;  // OCTETSTRING, OPTIONAL;
        struct BasicSafetyMessage_RTCMPackage_msg1022 msg1022;  // OCTETSTRING, OPTIONAL;
        struct BasicSafetyMessage_RTCMPackage_msg1023 msg1023;  // OCTETSTRING, OPTIONAL;
        struct BasicSafetyMessage_RTCMPackage_msg1024 msg1024;  // OCTETSTRING, OPTIONAL;
        struct BasicSafetyMessage_RTCMPackage_msg1025 msg1025;  // OCTETSTRING, OPTIONAL;
        struct BasicSafetyMessage_RTCMPackage_msg1026 msg1026;  // OCTETSTRING, OPTIONAL;
        struct BasicSafetyMessage_RTCMPackage_msg1027 msg1027;  // OCTETSTRING, OPTIONAL;
        struct BasicSafetyMessage_RTCMPackage_msg1029 msg1029;  // OCTETSTRING, OPTIONAL;
        struct BasicSafetyMessage_RTCMPackage_msg1030 msg1030;  // OCTETSTRING, OPTIONAL;
        struct BasicSafetyMessage_RTCMPackage_msg1031 msg1031;  // OCTETSTRING, OPTIONAL;
        struct BasicSafetyMessage_RTCMPackage_msg1032 msg1032;  // OCTETSTRING, OPTIONAL;
    };
    
    struct BasicSafetyMessageVehicleSafetyExtension {
        INT isValidFlag;   // necessary if this struct is used as an optional field of a SEQUENCE
        struct OPT_WORD_ASN events;  // INTEGER, OPTIONAL, 0..8192, eventHazardLights(1), eventStopLineViolation(2), eventABSactivated(4), eventTractionControlLoss(8), eventStabilityControlactivated(16), eventHazardousMaterials(32), eventEmergencyResponse(64), eventHardBraking(128), eventLightsChanged(256), eventWipersChanged(512), eventFlatTire(1024), eventDisabledVehicle(2048), eventAirBagDeployment(4096);
        struct BasicSafetyMessagePathHistory pathHistory;  // SEQUENCE, OPTIONAL;
        struct BasicSafetyMessagePathPrediction pathPrediction;  // SEQUENCE, OPTIONAL;
        struct BasicSafetyMessageRTCMPackage theRTCM;  // SEQUENCE, OPTIONAL;
    };
    
    struct BasicSafetyMessage_VehicleStatus_wipers {
        INT isValidFlag;   // necessary if this struct is used as an optional field of a SEQUENCE
        INT statusFront;  // ENUMERATED, unavailable(0), off(1), intermittent(2), low(3), high(4), washerInUse(126), automaticPresent(127);
        BYTE rateFront;  // INTEGER, 0..127;
        struct OPT_ENUM_ASN statusRear;  // ENUMERATED, OPTIONAL, unavailable(0), off(1), intermittent(2), low(3), high(4), washerInUse(126), automaticPresent(127);
        struct OPT_BYTE_ASN rateRear;  // INTEGER, OPTIONAL, 0..127;
    };
    
    struct BasicSafetyMessageBrakeSystemStatus {
        INT isValidFlag;   // necessary if this struct is used as an optional field of a SEQUENCE
        CHAR string[3];
        INT  stringLength;
        struct BasicSafetyMessage_Blob_BrakeSystemStatus _Blob_BrakeSystemStatus;  // SEQUENCE;
    };
    
    struct BasicSafetyMessageSteeringWheelAngle {
        INT isValidFlag;   // necessary if this struct is used as an optional field of a SEQUENCE
        CHAR string[2];
        INT  stringLength;
        INT _Blob_SteeringWheelAngle;  // INTEGER, -128..127;
    };
    
    struct BasicSafetyMessage_VehicleStatus_steering {
        INT isValidFlag;   // necessary if this struct is used as an optional field of a SEQUENCE
        struct BasicSafetyMessageSteeringWheelAngle angle;  // OCTETSTRING;
        struct OPT_ENUM_ASN confidence;  // ENUMERATED, OPTIONAL, unavailable(0), prec2deg(1), prec1deg(2), prec0_02deg(3);
        struct OPT_INT_ASN rate;  // INTEGER, OPTIONAL, -127..127;
        struct OPT_INT_ASN wheels;  // INTEGER, OPTIONAL, -127..127;
    };
    
    struct BasicSafetyMessageAccelerationSet4Way {
        INT isValidFlag;   // necessary if this struct is used as an optional field of a SEQUENCE
        CHAR string[8];
        INT  stringLength;
        struct BasicSafetyMessage_Blob_AccelerationSet4Way _Blob_AccelerationSet4Way;  // SEQUENCE;
    };
    
    struct BasicSafetyMessageVerticalAccelerationThreshold {
        INT isValidFlag;   // necessary if this struct is used as an optional field of a SEQUENCE
        CHAR string[256];
        INT  stringLength;
    };
    
    struct BasicSafetyMessageAccelSteerYawRateConfidence {
        INT isValidFlag;   // necessary if this struct is used as an optional field of a SEQUENCE
        INT yawRate;  // ENUMERATED, unavailable(0), degSec_100_00(1), degSec_010_00(2), degSec_005_00(3), degSec_001_00(4), degSec_000_10(5), degSec_000_05(6), degSec_000_01(7);
        INT acceleration;  // ENUMERATED, unavailable(0), accl_100_00(1), accl_010_00(2), accl_005_00(3), accl_001_00(4), accl_000_10(5), accl_000_05(6), accl_000_01(7);
        INT steeringWheelAngle;  // ENUMERATED, unavailable(0), prec2deg(1), prec1deg(2), prec0_02deg(3);
    };
    
    struct BasicSafetyMessageConfidenceSet {
        INT isValidFlag;   // necessary if this struct is used as an optional field of a SEQUENCE
        struct BasicSafetyMessageAccelSteerYawRateConfidence accelConfidence;  // SEQUENCE, OPTIONAL;
        struct BasicSafetyMessageSpeedandHeadingandThrottleConfidence speedConfidence;  // OCTETSTRING, OPTIONAL;
        struct OPT_ENUM_ASN timeConfidence;  // ENUMERATED, OPTIONAL, unavailable(0), time_100_000(1), time_050_000(2), time_020_000(3), time_010_000(4), time_002_000(5), time_001_000(6), time_000_500(7), time_000_200(8), time_000_100(9), time_000_050(10), time_000_020(11), time_000_010(12), time_000_005(13), time_000_002(14), time_000_001(15), time_000_000_5(16), time_000_000_2(17), time_000_000_1(18), time_000_000_05(19), time_000_000_02(20), time_000_000_01(21), time_000_000_005(22), time_000_000_002(23), time_000_000_001(24), time_000_000_000_5(25), time_000_000_000_2(26), time_000_000_000_1(27), time_000_000_000_05(28), time_000_000_000_02(29), time_000_000_000_01(30), time_000_000_000_005(31), time_000_000_000_002(32), time_000_000_000_001(33), time_000_000_000_000_5(34), time_000_000_000_000_2(35), time_000_000_000_000_1(36), time_000_000_000_000_05(37), time_000_000_000_000_02(38), time_000_000_000_000_01(39);
        struct BasicSafetyMessagePositionConfidenceSet posConfidence;  // OCTETSTRING, OPTIONAL;
        struct OPT_ENUM_ASN steerConfidence;  // ENUMERATED, OPTIONAL, unavailable(0), prec2deg(1), prec1deg(2), prec0_02deg(3);
        struct OPT_ENUM_ASN throttleConfidence;  // ENUMERATED, OPTIONAL, unavailable(0), prec10percent(1), prec1percent(2), prec0_5percent(3);
    };
    
    struct BasicSafetyMessage_VehicleStatus_accelSets {
        INT isValidFlag;   // necessary if this struct is used as an optional field of a SEQUENCE
        struct BasicSafetyMessageAccelerationSet4Way accel4way;  // OCTETSTRING, OPTIONAL;
        struct BasicSafetyMessageVerticalAccelerationThreshold vertAccelThres;  // BITSTRING, OPTIONAL;
        struct OPT_ENUM_ASN yawRateCon;  // ENUMERATED, OPTIONAL, unavailable(0), degSec_100_00(1), degSec_010_00(2), degSec_005_00(3), degSec_001_00(4), degSec_000_10(5), degSec_000_05(6), degSec_000_01(7);
        struct OPT_ENUM_ASN hozAccelCon;  // ENUMERATED, OPTIONAL, unavailable(0), accl_100_00(1), accl_010_00(2), accl_005_00(3), accl_001_00(4), accl_000_10(5), accl_000_05(6), accl_000_01(7);
        struct BasicSafetyMessageConfidenceSet confidenceSet;  // SEQUENCE, OPTIONAL;
    };
    
    struct BasicSafetyMessage_VehicleStatus_object {
        INT isValidFlag;   // necessary if this struct is used as an optional field of a SEQUENCE
        WORD obDist;  // INTEGER, 0..32767;
        WORD obDirect;  // INTEGER, 0..28800;
        struct BasicSafetyMessageDDateTime dateTime;  // SEQUENCE;
    };
    
    struct BasicSafetyMessageBumperHeights {
        INT isValidFlag;   // necessary if this struct is used as an optional field of a SEQUENCE
        BYTE frnt;  // INTEGER, 0..127;
        BYTE rear;  // INTEGER, 0..127;
    };
    
    struct BasicSafetyMessage_VehicleStatus_vehicleData {
        INT isValidFlag;   // necessary if this struct is used as an optional field of a SEQUENCE
        BYTE height;  // INTEGER, 0..127;
        struct BasicSafetyMessageBumperHeights bumpers;  // SEQUENCE;
        BYTE mass;  // INTEGER, 1..127;
        WORD trailerWeight;  // INTEGER, 0..65535;
        INT type;  // ENUMERATED, none(0), unknown(1), special(2), moto(3), car(4), carOther(5), bus(6), axleCnt2(7), axleCnt3(8), axleCnt4(9), axleCnt4Trailer(10), axleCnt5Trailer(11), axleCnt6Trailer(12), axleCnt5MultiTrailer(13), axleCnt6MultiTrailer(14), axleCnt7MultiTrailer(15);
    };
    
    struct BasicSafetyMessageDescriptiveName {
        INT isValidFlag;   // necessary if this struct is used as an optional field of a SEQUENCE
        CHAR string[64];
        INT  stringLength;
    };
    
    struct BasicSafetyMessageVINstring {
        INT isValidFlag;   // necessary if this struct is used as an optional field of a SEQUENCE
        CHAR string[18];
        INT  stringLength;
    };
    
    struct BasicSafetyMessage_VehicleIdent_ownerCode {
        INT isValidFlag;   // necessary if this struct is used as an optional field of a SEQUENCE
        CHAR string[33];
        INT  stringLength;
    };
    
    struct BasicSafetyMessage_Blob_TemporaryID {
        INT isValidFlag;   // necessary if this struct is used as an optional field of a SEQUENCE
        DWORD temporaryID;  // INTEGER, 0..4294967295;
    };
    
    struct BasicSafetyMessageTemporaryID {
        INT isValidFlag;   // necessary if this struct is used as an optional field of a SEQUENCE
        CHAR string[5];
        INT  stringLength;
        struct BasicSafetyMessage_Blob_TemporaryID _Blob_TemporaryID;  // SEQUENCE;
    };
    
    struct BasicSafetyMessage_VehicleIdent_vehicleClass {
        INT isValidFlag;   // necessary if this struct is used as an optional field of a SEQUENCE
        INT choice;
        INT vGroup;  // ENUMERATED, all_vehicles(9217), bicycles(9218), motorcycles(9219), cars(9220), light_vehicles(9221), cars_and_light_vehicles(9222), cars_with_trailers(9223), cars_with_recreational_trailers(9224), vehicles_with_trailers(9225), heavy_vehicles(9226), trucks(9227), buses(9228), articulated_buses(9229), school_buses(9230), vehicles_with_semi_trailers(9231), vehicles_with_double_trailers(9232), high_profile_vehicles(9233), wide_vehicles(9234), long_vehicles(9235), hazardous_loads(9236), exceptional_loads(9237), abnormal_loads(9238), convoys(9239), maintenance_vehicles(9240), delivery_vehicles(9241), vehicles_with_even_numbered_license_plates(9242), vehicles_with_odd_numbered_license_plates(9243), vehicles_with_parking_permits(9244), vehicles_with_catalytic_converters(9245), vehicles_without_catalytic_converters(9246), gas_powered_vehicles(9247), diesel_powered_vehicles(9248), lPG_vehicles(9249), military_convoys(9250), military_vehicles(9251);
        INT rGroup;  // ENUMERATED, emergency_vehicle_units(9729), federal_law_enforcement_units(9730), state_police_units(9731), county_police_units(9732), local_police_units(9733), ambulance_units(9734), rescue_units(9735), fire_units(9736), hAZMAT_units(9737), light_tow_unit(9738), heavy_tow_unit(9739), freeway_service_patrols(9740), transportation_response_units(9741), private_contractor_response_units(9742);
        INT rEquip;  // ENUMERATED, ground_fire_suppression(9985), heavy_ground_equipment(9986), aircraft(9988), marine_equipment(9989), support_equipment(9990), medical_rescue_unit(9991), other(9993), ground_fire_suppression_other(9994), engine(9995), truck_or_aerial(9996), quint(9997), tanker_pumper_combination(9998), brush_truck(10000), aircraft_rescue_firefighting(10001), heavy_ground_equipment_other(10004), dozer_or_plow(10005), tractor(10006), tanker_or_tender(10008), aircraft_other(10024), aircraft_fixed_wing_tanker(10025), helitanker(10026), helicopter(10027), marine_equipment_other(10034), fire_boat_with_pump(10035), boat_no_pump(10036), support_apparatus_other(10044), breathing_apparatus_support(10045), light_and_air_unit(10046), medical_rescue_unit_other(10054), rescue_unit(10055), urban_search_rescue_unit(10056), high_angle_rescue(10057), crash_fire_rescue(10058), bLS_unit(10059), aLS_unit(10060), mobile_command_post(10075), chief_officer_car(10076), hAZMAT_unit(10077), type_i_hand_crew(10078), type_ii_hand_crew(10079), privately_owned_vehicle(10083), other_apparatus_resource(10084), ambulance(10085), bomb_squad_van(10086), combine_harvester(10087), construction_vehicle(10088), farm_tractor(10089), grass_cutting_machines(10090), hAZMAT_containment_tow(10091), heavy_tow(10092), light_tow(10094), flatbed_tow(10114), hedge_cutting_machines(10093), mobile_crane(10095), refuse_collection_vehicle(10096), resurfacing_vehicle(10097), road_sweeper(10098), roadside_litter_collection_crews(10099), salvage_vehicle(10100), sand_truck(10101), snowplow(10102), steam_roller(10103), swat_team_van(10104), track_laying_vehicle(10105), unknown_vehicle(10106), white_lining_vehicle(10107), dump_truck(10108), supervisor_vehicle(10109), snow_blower(10110), rotary_snow_blower(10111), road_grader(10112), steam_truck(10113);
    };
    
    struct BasicSafetyMessageVehicleIdent {
        INT isValidFlag;   // necessary if this struct is used as an optional field of a SEQUENCE
        struct BasicSafetyMessageDescriptiveName name;  // IA5STRING, OPTIONAL;
        struct BasicSafetyMessageVINstring vin;  // OCTETSTRING, OPTIONAL;
        struct BasicSafetyMessage_VehicleIdent_ownerCode ownerCode;  // IA5STRING, OPTIONAL;
        struct BasicSafetyMessageTemporaryID id;  // OCTETSTRING, OPTIONAL;
        struct OPT_ENUM_ASN vehicleType;  // ENUMERATED, OPTIONAL, none(0), unknown(1), special(2), moto(3), car(4), carOther(5), bus(6), axleCnt2(7), axleCnt3(8), axleCnt4(9), axleCnt4Trailer(10), axleCnt5Trailer(11), axleCnt6Trailer(12), axleCnt5MultiTrailer(13), axleCnt6MultiTrailer(14), axleCnt7MultiTrailer(15);
        struct BasicSafetyMessage_VehicleIdent_vehicleClass vehicleClass;  // CHOICE, OPTIONAL;
    };
    
    struct BasicSafetyMessageWheelEndElectFault {
        INT isValidFlag;   // necessary if this struct is used as an optional field of a SEQUENCE
        CHAR string[256];
        INT  stringLength;
    };
    
    struct BasicSafetyMessage_J1939data_tires_ {
        INT isValidFlag;   // necessary if this struct is used as an optional field of a SEQUENCE
        struct OPT_BYTE_ASN location;  // INTEGER, OPTIONAL, 0..255;
        struct OPT_BYTE_ASN pressure;  // INTEGER, OPTIONAL, 0..255;
        struct OPT_WORD_ASN temp;  // INTEGER, OPTIONAL, 0..65535;
        struct OPT_ENUM_ASN wheelSensorStatus;  // ENUMERATED, OPTIONAL, off(0), on(1), notDefined(2), notSupoprted(3);
        struct BasicSafetyMessageWheelEndElectFault wheelEndElectFault;  // BITSTRING, OPTIONAL;
        struct OPT_WORD_ASN leakageRate;  // INTEGER, OPTIONAL, 0..65535;
        struct OPT_ENUM_ASN detection;  // ENUMERATED, OPTIONAL, noData(0), overPressure(1), noWarningPressure(2), underPressure(3), extremeUnderPressure(4), undefined(5), errorIndicator(6), notAvailable(7);
    };
    
    struct BasicSafetyMessage_J1939data_tires {
        INT isValidFlag;   // necessary if this struct is used as an optional field of a SEQUENCE
        INT length;
        struct BasicSafetyMessage_J1939data_tires_ arrayValue[16];  // SEQUENCE;
    };
    
    struct BasicSafetyMessage_J1939data_axle_ {
        INT isValidFlag;   // necessary if this struct is used as an optional field of a SEQUENCE
        struct OPT_BYTE_ASN location;  // INTEGER, OPTIONAL, 0..127;
        struct OPT_WORD_ASN weight;  // INTEGER, OPTIONAL, 0..65535;
    };
    
    struct BasicSafetyMessage_J1939data_axle {
        INT isValidFlag;   // necessary if this struct is used as an optional field of a SEQUENCE
        INT length;
        struct BasicSafetyMessage_J1939data_axle_ arrayValue[16];  // SEQUENCE;
    };
    
    struct BasicSafetyMessageJ1939data {
        INT isValidFlag;   // necessary if this struct is used as an optional field of a SEQUENCE
        struct BasicSafetyMessage_J1939data_tires tires;  // SEQUENCEOF, OPTIONAL;
        struct BasicSafetyMessage_J1939data_axle axle;  // SEQUENCEOF, OPTIONAL;
        struct OPT_WORD_ASN trailerWeight;  // INTEGER, OPTIONAL, 0..65535;
        struct OPT_WORD_ASN cargoWeight;  // INTEGER, OPTIONAL, 0..65535;
        struct OPT_BYTE_ASN steeringAxleTemperature;  // INTEGER, OPTIONAL, 0..255;
        struct OPT_BYTE_ASN driveAxleLocation;  // INTEGER, OPTIONAL, 0..255;
        struct OPT_BYTE_ASN driveAxleLiftAirPressure;  // INTEGER, OPTIONAL, 0..255;
        struct OPT_BYTE_ASN driveAxleTemperature;  // INTEGER, OPTIONAL, 0..255;
        struct OPT_BYTE_ASN driveAxleLubePressure;  // INTEGER, OPTIONAL, 0..255;
        struct OPT_BYTE_ASN steeringAxleLubePressure;  // INTEGER, OPTIONAL, 0..255;
    };
    
    struct BasicSafetyMessage_VehicleStatus_weatherReport {
        INT isValidFlag;   // necessary if this struct is used as an optional field of a SEQUENCE
        INT isRaining;  // ENUMERATED, precip(1), noPrecip(2), error(3);
        struct OPT_WORD_ASN rainRate;  // INTEGER, OPTIONAL, 0..65535;
        struct OPT_ENUM_ASN precipSituation;  // ENUMERATED, OPTIONAL, other(1), unknown(2), noPrecipitation(3), unidentifiedSlight(4), unidentifiedModerate(5), unidentifiedHeavy(6), snowSlight(7), snowModerate(8), snowHeavy(9), rainSlight(10), rainModerate(11), rainHeavy(12), frozenPrecipitationSlight(13), frozenPrecipitationModerate(14), frozenPrecipitationHeavy(15);
        struct OPT_WORD_ASN solarRadiation;  // INTEGER, OPTIONAL, 0..65535;
        struct OPT_BYTE_ASN friction;  // INTEGER, OPTIONAL, 0..101;
    };
    
    struct BasicSafetyMessageVehicleStatus {
        INT isValidFlag;   // necessary if this struct is used as an optional field of a SEQUENCE
        struct OPT_WORD_ASN lights;  // INTEGER, OPTIONAL, 0..256, allLightsOff(0), lowBeamHeadlightsOn(1), highBeamHeadlightsOn(2), leftTurnSignalOn(4), rightTurnSignalOn(8), hazardSignalOn(12), automaticLightControlOn(16), daytimeRunningLightsOn(32), fogLightOn(64), parkingLightsOn(128);
        struct OPT_ENUM_ASN lightBar;  // ENUMERATED, OPTIONAL, unavailable(0), notInUse(1), inUse(2), sirenInUse(3), yellowCautionLights(4), schooldBusLights(5), arrowSignsActive(6), slowMovingVehicle(7), freqStops(8), reserved(9);
        struct BasicSafetyMessage_VehicleStatus_wipers wipers;  // SEQUENCE, OPTIONAL;
        struct BasicSafetyMessageBrakeSystemStatus brakeStatus;  // OCTETSTRING, OPTIONAL;
        struct OPT_ENUM_ASN brakePressure;  // ENUMERATED, OPTIONAL, unavailable(0), minPressure(1), bkLvl_2(2), bkLvl_3(3), bkLvl_4(4), bkLvl_5(5), bkLvl_6(6), bkLvl_7(7), bkLvl_8(8), bkLvl_9(9), bkLvl_10(10), bkLvl_11(11), bkLvl_12(12), bkLvl_13(13), bkLvl_14(14), maxPressure(15);
        struct OPT_BYTE_ASN roadFriction;  // INTEGER, OPTIONAL, 0..50;
        struct OPT_WORD_ASN sunData;  // INTEGER, OPTIONAL, 0..1000;
        struct OPT_ENUM_ASN rainData;  // ENUMERATED, OPTIONAL, none(0), lightMist(1), heavyMist(2), lightRainOrDrizzle(3), rain(4), moderateRain(5), heavyRain(6), heavyDownpour(7);
        struct OPT_BYTE_ASN airTemp;  // INTEGER, OPTIONAL, 0..191;
        struct OPT_BYTE_ASN airPres;  // INTEGER, OPTIONAL, 0..255;
        struct BasicSafetyMessage_VehicleStatus_steering steering;  // SEQUENCE, OPTIONAL;
        struct BasicSafetyMessage_VehicleStatus_accelSets accelSets;  // SEQUENCE, OPTIONAL;
        struct BasicSafetyMessage_VehicleStatus_object object;  // SEQUENCE, OPTIONAL;
        struct BasicSafetyMessageFullPositionVector fullPos;  // SEQUENCE, OPTIONAL;
        struct OPT_BYTE_ASN throttlePos;  // INTEGER, OPTIONAL, 0..200;
        struct BasicSafetyMessageSpeedandHeadingandThrottleConfidence speedHeadC;  // OCTETSTRING, OPTIONAL;
        struct OPT_ENUM_ASN speedC;  // ENUMERATED, OPTIONAL, unavailable(0), prec100ms(1), prec10ms(2), prec5ms(3), prec1ms(4), prec0_1ms(5), prec0_05ms(6), prec0_01ms(7);
        struct BasicSafetyMessage_VehicleStatus_vehicleData vehicleData;  // SEQUENCE, OPTIONAL;
        struct BasicSafetyMessageVehicleIdent vehicleIdent;  // SEQUENCE, OPTIONAL;
        struct BasicSafetyMessageJ1939data j1939data;  // SEQUENCE, OPTIONAL;
        struct BasicSafetyMessage_VehicleStatus_weatherReport weatherReport;  // SEQUENCE, OPTIONAL;
        struct BasicSafetyMessageGPSstatus gpsStatus;  // BITSTRING, OPTIONAL;
    };
    
    struct BasicSafetyMessage {
        INT isValidFlag;   // necessary if this struct is used as an optional field of a SEQUENCE
        INT msgID;  // ENUMERATED, reserved(0), alaCarteMessage(1), basicSafetyMessage(2), basicSafetyMessageVerbose(3), commonSafetyRequest(4), emergencyVehicleAlert(5), intersectionCollisionAlert(6), mapData(7), nmeaCorrections(8), probeDataManagement(9), probeVehicleData(10), roadSideAlert(11), rtcmCorrections(12), signalPhaseAndTimingMessage(13), signalRequestMessage(14), signalStatusMessage(15), travelerInformation(16);
        struct BasicSafetyMessageBSMblob blob1;  // OCTETSTRING;
        struct BasicSafetyMessageVehicleSafetyExtension safetyExt;  // SEQUENCE, OPTIONAL;
        struct BasicSafetyMessageVehicleStatus status;  // SEQUENCE, OPTIONAL;
    };
    
}

/*
// init function to create a simple packet handle
*/ 
LONG API_InitBasicSafetyMessagePacket()
{
  return C2xInitPacket("BasicSafetyMessage"); 
}

/*
// init function to create a simple packet handle and
// initialize the struct with valid data
*/ 
LONG API_InitBasicSafetyMessagePacket(struct BasicSafetyMessage msgStruct)
{
  long pktHandle;

  pktHandle = API_InitBasicSafetyMessagePacket();

  if (pktHandle != 0)
  {
    // create valid message and application data
    if (C2xCompletePacket(pktHandle) == 0) 
    {
      API_GetBasicSafetyMessageParams(pktHandle, msgStruct);
    }
  }
  return pktHandle;
}

/*
// init function to create a packet with security layer and
// initialize the struct with valid data
*/ 
LONG API_InitBasicSafetyMessagePacket(struct BasicSafetyMessage msgStruct, char packetTypeDesignator[], char certificateName[])
{
  long pktHandle, certHdl;

  // initialize the packet
  pktHandle = C2xInitPacket("BasicSafetyMessage", packetTypeDesignator);

  if (pktHandle != 0)
  {
    certHdl = C2xSecCertificateGetHandle(certificateName);  // get the certificate handle for the cert with name "certificateName"
    if (certHdl != 0) 
    {
      C2xSecPacketSetSignerHandle(pktHandle, certHdl); // set the certHdl to the packet
    }

    // create valid message and application data
    if (C2xCompletePacket(pktHandle) == 0) 
    {
      // copy application data to the application structure
      API_GetBasicSafetyMessageParams(pktHandle, msgStruct);
    }
  }
  return pktHandle;
}
    

int GetBasicSafetyMessage_Blob_Position3DParams(LONG packetHandle, struct BasicSafetyMessage_Blob_Position3D value, char oldPath[])
{
  char newPath[300];
  int result;

  result = 0;

  snprintf(newPath, elcount(newPath), "%s.%s", oldPath, "latitude");
  value.latitude = C2xGetTokenInt(packetHandle, "BasicSafetyMessage", newPath);
  result = CheckLastError("BasicSafetyMessage", gkFuncRefGet, result);

  snprintf(newPath, elcount(newPath), "%s.%s", oldPath, "longitude");
  value.longitude = C2xGetTokenInt(packetHandle, "BasicSafetyMessage", newPath);
  result = CheckLastError("BasicSafetyMessage", gkFuncRefGet, result);

  snprintf(newPath, elcount(newPath), "%s.%s", oldPath, "elevation");
  value.elevation = C2xGetTokenInt(packetHandle, "BasicSafetyMessage", newPath);
  result = CheckLastError("BasicSafetyMessage", gkFuncRefGet, result);

  return result;
}

int SetBasicSafetyMessage_Blob_Position3DParams(LONG packetHandle, struct BasicSafetyMessage_Blob_Position3D value, char oldPath[])
{
  char newPath[300];
  int result;

  result = 0;

  snprintf(newPath, elcount(newPath), "%s.%s", oldPath, "latitude");
  C2xSetTokenInt(packetHandle, "BasicSafetyMessage", newPath, value.latitude);
  result = CheckLastError("BasicSafetyMessage", gkFuncRefGet, result);

  snprintf(newPath, elcount(newPath), "%s.%s", oldPath, "longitude");
  C2xSetTokenInt(packetHandle, "BasicSafetyMessage", newPath, value.longitude);
  result = CheckLastError("BasicSafetyMessage", gkFuncRefGet, result);

  snprintf(newPath, elcount(newPath), "%s.%s", oldPath, "elevation");
  C2xSetTokenInt(packetHandle, "BasicSafetyMessage", newPath, value.elevation);
  result = CheckLastError("BasicSafetyMessage", gkFuncRefGet, result);

  return result;
}

int GetBasicSafetyMessage_Blob_PositionalAccuracyParams(LONG packetHandle, struct BasicSafetyMessage_Blob_PositionalAccuracy value, char oldPath[])
{
  char newPath[300];
  int result;

  result = 0;

  snprintf(newPath, elcount(newPath), "%s.%s", oldPath, "accuracySemiMajor");
  value.accuracySemiMajor = C2xGetTokenInt(packetHandle, "BasicSafetyMessage", newPath);
  result = CheckLastError("BasicSafetyMessage", gkFuncRefGet, result);

  snprintf(newPath, elcount(newPath), "%s.%s", oldPath, "accuracySemiMinor");
  value.accuracySemiMinor = C2xGetTokenInt(packetHandle, "BasicSafetyMessage", newPath);
  result = CheckLastError("BasicSafetyMessage", gkFuncRefGet, result);

  snprintf(newPath, elcount(newPath), "%s.%s", oldPath, "accuracyOrientation");
  value.accuracyOrientation = C2xGetTokenInt(packetHandle, "BasicSafetyMessage", newPath);
  result = CheckLastError("BasicSafetyMessage", gkFuncRefGet, result);

  return result;
}

int SetBasicSafetyMessage_Blob_PositionalAccuracyParams(LONG packetHandle, struct BasicSafetyMessage_Blob_PositionalAccuracy value, char oldPath[])
{
  char newPath[300];
  int result;

  result = 0;

  snprintf(newPath, elcount(newPath), "%s.%s", oldPath, "accuracySemiMajor");
  C2xSetTokenInt(packetHandle, "BasicSafetyMessage", newPath, value.accuracySemiMajor);
  result = CheckLastError("BasicSafetyMessage", gkFuncRefGet, result);

  snprintf(newPath, elcount(newPath), "%s.%s", oldPath, "accuracySemiMinor");
  C2xSetTokenInt(packetHandle, "BasicSafetyMessage", newPath, value.accuracySemiMinor);
  result = CheckLastError("BasicSafetyMessage", gkFuncRefGet, result);

  snprintf(newPath, elcount(newPath), "%s.%s", oldPath, "accuracyOrientation");
  C2xSetTokenInt(packetHandle, "BasicSafetyMessage", newPath, value.accuracyOrientation);
  result = CheckLastError("BasicSafetyMessage", gkFuncRefGet, result);

  return result;
}

int GetBasicSafetyMessage_Blob_AccelerationSet4WayParams(LONG packetHandle, struct BasicSafetyMessage_Blob_AccelerationSet4Way value, char oldPath[])
{
  char newPath[300];
  int result;

  result = 0;

  snprintf(newPath, elcount(newPath), "%s.%s", oldPath, "accelerationLong");
  value.accelerationLong = C2xGetTokenInt(packetHandle, "BasicSafetyMessage", newPath);
  result = CheckLastError("BasicSafetyMessage", gkFuncRefGet, result);

  snprintf(newPath, elcount(newPath), "%s.%s", oldPath, "accelerationLat");
  value.accelerationLat = C2xGetTokenInt(packetHandle, "BasicSafetyMessage", newPath);
  result = CheckLastError("BasicSafetyMessage", gkFuncRefGet, result);

  snprintf(newPath, elcount(newPath), "%s.%s", oldPath, "accelerationVert");
  value.accelerationVert = C2xGetTokenInt(packetHandle, "BasicSafetyMessage", newPath);
  result = CheckLastError("BasicSafetyMessage", gkFuncRefGet, result);

  snprintf(newPath, elcount(newPath), "%s.%s", oldPath, "yawRate");
  value.yawRate = C2xGetTokenInt(packetHandle, "BasicSafetyMessage", newPath);
  result = CheckLastError("BasicSafetyMessage", gkFuncRefGet, result);

  return result;
}

int SetBasicSafetyMessage_Blob_AccelerationSet4WayParams(LONG packetHandle, struct BasicSafetyMessage_Blob_AccelerationSet4Way value, char oldPath[])
{
  char newPath[300];
  int result;

  result = 0;

  snprintf(newPath, elcount(newPath), "%s.%s", oldPath, "accelerationLong");
  C2xSetTokenInt(packetHandle, "BasicSafetyMessage", newPath, value.accelerationLong);
  result = CheckLastError("BasicSafetyMessage", gkFuncRefGet, result);

  snprintf(newPath, elcount(newPath), "%s.%s", oldPath, "accelerationLat");
  C2xSetTokenInt(packetHandle, "BasicSafetyMessage", newPath, value.accelerationLat);
  result = CheckLastError("BasicSafetyMessage", gkFuncRefGet, result);

  snprintf(newPath, elcount(newPath), "%s.%s", oldPath, "accelerationVert");
  C2xSetTokenInt(packetHandle, "BasicSafetyMessage", newPath, value.accelerationVert);
  result = CheckLastError("BasicSafetyMessage", gkFuncRefGet, result);

  snprintf(newPath, elcount(newPath), "%s.%s", oldPath, "yawRate");
  C2xSetTokenInt(packetHandle, "BasicSafetyMessage", newPath, value.yawRate);
  result = CheckLastError("BasicSafetyMessage", gkFuncRefGet, result);

  return result;
}

int GetBasicSafetyMessage_Blob_MotionParams(LONG packetHandle, struct BasicSafetyMessage_Blob_Motion value, char oldPath[])
{
  char newPath[300];
  int result;

  result = 0;

  snprintf(newPath, elcount(newPath), "%s.%s", oldPath, "transmissionState");
  value.transmissionState = C2xGetTokenInt(packetHandle, "BasicSafetyMessage", newPath);
  result = CheckLastError("BasicSafetyMessage", gkFuncRefGet, result);

  snprintf(newPath, elcount(newPath), "%s.%s", oldPath, "speed");
  value.speed = C2xGetTokenInt(packetHandle, "BasicSafetyMessage", newPath);
  result = CheckLastError("BasicSafetyMessage", gkFuncRefGet, result);

  snprintf(newPath, elcount(newPath), "%s.%s", oldPath, "heading");
  value.heading = C2xGetTokenInt(packetHandle, "BasicSafetyMessage", newPath);
  result = CheckLastError("BasicSafetyMessage", gkFuncRefGet, result);

  snprintf(newPath, elcount(newPath), "%s.%s", oldPath, "steeringWheelAngle");
  value.steeringWheelAngle = C2xGetTokenInt(packetHandle, "BasicSafetyMessage", newPath);
  result = CheckLastError("BasicSafetyMessage", gkFuncRefGet, result);

  snprintf(newPath, elcount(newPath), "%s.%s", oldPath, "accelSet");
  GetBasicSafetyMessage_Blob_AccelerationSet4WayParams(packetHandle, value.accelSet, newPath);
  result = CheckLastError("BasicSafetyMessage", gkFuncRefGet, result);

  return result;
}

int SetBasicSafetyMessage_Blob_MotionParams(LONG packetHandle, struct BasicSafetyMessage_Blob_Motion value, char oldPath[])
{
  char newPath[300];
  int result;

  result = 0;

  snprintf(newPath, elcount(newPath), "%s.%s", oldPath, "transmissionState");
  C2xSetTokenInt(packetHandle, "BasicSafetyMessage", newPath, value.transmissionState);
  result = CheckLastError("BasicSafetyMessage", gkFuncRefGet, result);

  snprintf(newPath, elcount(newPath), "%s.%s", oldPath, "speed");
  C2xSetTokenInt(packetHandle, "BasicSafetyMessage", newPath, value.speed);
  result = CheckLastError("BasicSafetyMessage", gkFuncRefGet, result);

  snprintf(newPath, elcount(newPath), "%s.%s", oldPath, "heading");
  C2xSetTokenInt(packetHandle, "BasicSafetyMessage", newPath, value.heading);
  result = CheckLastError("BasicSafetyMessage", gkFuncRefGet, result);

  snprintf(newPath, elcount(newPath), "%s.%s", oldPath, "steeringWheelAngle");
  C2xSetTokenInt(packetHandle, "BasicSafetyMessage", newPath, value.steeringWheelAngle);
  result = CheckLastError("BasicSafetyMessage", gkFuncRefGet, result);

  snprintf(newPath, elcount(newPath), "%s.%s", oldPath, "accelSet");
  SetBasicSafetyMessage_Blob_AccelerationSet4WayParams(packetHandle, value.accelSet, newPath);
  result = CheckLastError("BasicSafetyMessage", gkFuncRefGet, result);

  return result;
}

int GetBasicSafetyMessage_Blob_BrakeSystemStatusParams(LONG packetHandle, struct BasicSafetyMessage_Blob_BrakeSystemStatus value, char oldPath[])
{
  char newPath[300]; 
  int j; 
  int k;
  int result;

  result = 0;

  snprintf(newPath, elcount(newPath), "%s.%s", oldPath, "wheelBrakes");
  value.wheelBrakes.isValidFlag = 1;
  value.wheelBrakes.stringLength = C2xGetTokenLengthBit(packetHandle, "BasicSafetyMessage", newPath);
  if ((result = CheckLastError("BasicSafetyMessage", gkFuncRefGet, result))==0)
  {
    if(value.wheelBrakes.stringLength > 0)
    {
      for(j=0; j<value.wheelBrakes.stringLength; j++)
      {
        if(C2xGetTokenBitOfBitString(packetHandle, "BasicSafetyMessage", newPath, j) == 0)
        {
          value.wheelBrakes.string[j] = '0';
        }
        else if(C2xGetTokenBitOfBitString(packetHandle, "BasicSafetyMessage", newPath, j) == 1)
        {
          value.wheelBrakes.string[j] = '1';
        }

        if(value.wheelBrakes.stringLength == 1)
        {
          value.wheelBrakes.string[1] = '0';
        }
        result = CheckLastError("BasicSafetyMessage", gkFuncRefGet, result);
      }
    }
    else
    {
      for(k = value.wheelBrakes.stringLength+1; k > -1; k--)
      {
        if(value.wheelBrakes.string[k] == '1')
        {
          value.wheelBrakes.string[k] = '0';
        }
      }
    }
  }

  snprintf(newPath, elcount(newPath), "%s.%s", oldPath, "brakesUnavailable");
  value.brakesUnavailable = C2xGetTokenInt64(packetHandle, "BasicSafetyMessage", newPath);
  result = CheckLastError("BasicSafetyMessage", gkFuncRefGet, result);

  snprintf(newPath, elcount(newPath), "%s.%s", oldPath, "spareBit");
  value.spareBit = C2xGetTokenInt(packetHandle, "BasicSafetyMessage", newPath);
  result = CheckLastError("BasicSafetyMessage", gkFuncRefGet, result);

  snprintf(newPath, elcount(newPath), "%s.%s", oldPath, "traction");
  value.traction = C2xGetTokenInt(packetHandle, "BasicSafetyMessage", newPath);
  result = CheckLastError("BasicSafetyMessage", gkFuncRefGet, result);

  snprintf(newPath, elcount(newPath), "%s.%s", oldPath, "antilockBrakingSystem");
  value.antilockBrakingSystem = C2xGetTokenInt(packetHandle, "BasicSafetyMessage", newPath);
  result = CheckLastError("BasicSafetyMessage", gkFuncRefGet, result);

  snprintf(newPath, elcount(newPath), "%s.%s", oldPath, "scs");
  value.scs = C2xGetTokenInt(packetHandle, "BasicSafetyMessage", newPath);
  result = CheckLastError("BasicSafetyMessage", gkFuncRefGet, result);

  snprintf(newPath, elcount(newPath), "%s.%s", oldPath, "brakeBoost");
  value.brakeBoost = C2xGetTokenInt(packetHandle, "BasicSafetyMessage", newPath);
  result = CheckLastError("BasicSafetyMessage", gkFuncRefGet, result);

  snprintf(newPath, elcount(newPath), "%s.%s", oldPath, "auxBrakes");
  value.auxBrakes = C2xGetTokenInt(packetHandle, "BasicSafetyMessage", newPath);
  result = CheckLastError("BasicSafetyMessage", gkFuncRefGet, result);

  return result;
}

int SetBasicSafetyMessage_Blob_BrakeSystemStatusParams(LONG packetHandle, struct BasicSafetyMessage_Blob_BrakeSystemStatus value, char oldPath[])
{
  char newPath[300]; 
  int j;
  int result;

  result = 0;

  snprintf(newPath, elcount(newPath), "%s.%s", oldPath, "wheelBrakes");
    for(j=0; j<value.wheelBrakes.stringLength; j++)
    {
      if(value.wheelBrakes.string[j] == '0')
      {
        C2xSetTokenBitOfBitString(packetHandle, "BasicSafetyMessage", newPath, j, 0);
      }
      else
      {
        C2xSetTokenBitOfBitString(packetHandle, "BasicSafetyMessage", newPath, j, 1);
      }
      result = CheckLastError("BasicSafetyMessage", gkFuncRefGet, result);
    }

  snprintf(newPath, elcount(newPath), "%s.%s", oldPath, "brakesUnavailable");
  C2xSetTokenInt64(packetHandle, "BasicSafetyMessage", newPath, value.brakesUnavailable);
  result = CheckLastError("BasicSafetyMessage", gkFuncRefGet, result);

  snprintf(newPath, elcount(newPath), "%s.%s", oldPath, "spareBit");
  C2xSetTokenInt(packetHandle, "BasicSafetyMessage", newPath, value.spareBit);
  result = CheckLastError("BasicSafetyMessage", gkFuncRefGet, result);

  snprintf(newPath, elcount(newPath), "%s.%s", oldPath, "traction");
  C2xSetTokenInt(packetHandle, "BasicSafetyMessage", newPath, value.traction);
  result = CheckLastError("BasicSafetyMessage", gkFuncRefGet, result);

  snprintf(newPath, elcount(newPath), "%s.%s", oldPath, "antilockBrakingSystem");
  C2xSetTokenInt(packetHandle, "BasicSafetyMessage", newPath, value.antilockBrakingSystem);
  result = CheckLastError("BasicSafetyMessage", gkFuncRefGet, result);

  snprintf(newPath, elcount(newPath), "%s.%s", oldPath, "scs");
  C2xSetTokenInt(packetHandle, "BasicSafetyMessage", newPath, value.scs);
  result = CheckLastError("BasicSafetyMessage", gkFuncRefGet, result);

  snprintf(newPath, elcount(newPath), "%s.%s", oldPath, "brakeBoost");
  C2xSetTokenInt(packetHandle, "BasicSafetyMessage", newPath, value.brakeBoost);
  result = CheckLastError("BasicSafetyMessage", gkFuncRefGet, result);

  snprintf(newPath, elcount(newPath), "%s.%s", oldPath, "auxBrakes");
  C2xSetTokenInt(packetHandle, "BasicSafetyMessage", newPath, value.auxBrakes);
  result = CheckLastError("BasicSafetyMessage", gkFuncRefGet, result);

  return result;
}

int GetBasicSafetyMessage_Blob_VehicleSizeParams(LONG packetHandle, struct BasicSafetyMessage_Blob_VehicleSize value, char oldPath[])
{
  char newPath[300];
  int result;

  result = 0;

  snprintf(newPath, elcount(newPath), "%s.%s", oldPath, "vehicleWidth");
  value.vehicleWidth = C2xGetTokenInt(packetHandle, "BasicSafetyMessage", newPath);
  result = CheckLastError("BasicSafetyMessage", gkFuncRefGet, result);

  snprintf(newPath, elcount(newPath), "%s.%s", oldPath, "vehicleLength");
  value.vehicleLength = C2xGetTokenInt(packetHandle, "BasicSafetyMessage", newPath);
  result = CheckLastError("BasicSafetyMessage", gkFuncRefGet, result);

  return result;
}

int SetBasicSafetyMessage_Blob_VehicleSizeParams(LONG packetHandle, struct BasicSafetyMessage_Blob_VehicleSize value, char oldPath[])
{
  char newPath[300];
  int result;

  result = 0;

  snprintf(newPath, elcount(newPath), "%s.%s", oldPath, "vehicleWidth");
  C2xSetTokenInt(packetHandle, "BasicSafetyMessage", newPath, value.vehicleWidth);
  result = CheckLastError("BasicSafetyMessage", gkFuncRefGet, result);

  snprintf(newPath, elcount(newPath), "%s.%s", oldPath, "vehicleLength");
  C2xSetTokenInt(packetHandle, "BasicSafetyMessage", newPath, value.vehicleLength);
  result = CheckLastError("BasicSafetyMessage", gkFuncRefGet, result);

  return result;
}

int GetBasicSafetyMessage_Blob_BSMblobParams(LONG packetHandle, struct BasicSafetyMessage_Blob_BSMblob value, char oldPath[])
{
  char newPath[300];
  int result;

  result = 0;

  snprintf(newPath, elcount(newPath), "%s.%s", oldPath, "msgCnt");
  value.msgCnt = C2xGetTokenInt(packetHandle, "BasicSafetyMessage", newPath);
  result = CheckLastError("BasicSafetyMessage", gkFuncRefGet, result);

  snprintf(newPath, elcount(newPath), "%s.%s", oldPath, "id");
  value.id = C2xGetTokenInt64(packetHandle, "BasicSafetyMessage", newPath);
  result = CheckLastError("BasicSafetyMessage", gkFuncRefGet, result);

  snprintf(newPath, elcount(newPath), "%s.%s", oldPath, "secMark");
  value.secMark = C2xGetTokenInt(packetHandle, "BasicSafetyMessage", newPath);
  result = CheckLastError("BasicSafetyMessage", gkFuncRefGet, result);

  snprintf(newPath, elcount(newPath), "%s.%s", oldPath, "pos");
  GetBasicSafetyMessage_Blob_Position3DParams(packetHandle, value.pos, newPath);
  result = CheckLastError("BasicSafetyMessage", gkFuncRefGet, result);

  snprintf(newPath, elcount(newPath), "%s.%s", oldPath, "accuracy");
  GetBasicSafetyMessage_Blob_PositionalAccuracyParams(packetHandle, value.accuracy, newPath);
  result = CheckLastError("BasicSafetyMessage", gkFuncRefGet, result);

  snprintf(newPath, elcount(newPath), "%s.%s", oldPath, "motion");
  GetBasicSafetyMessage_Blob_MotionParams(packetHandle, value.motion, newPath);
  result = CheckLastError("BasicSafetyMessage", gkFuncRefGet, result);

  snprintf(newPath, elcount(newPath), "%s.%s", oldPath, "brakes");
  GetBasicSafetyMessage_Blob_BrakeSystemStatusParams(packetHandle, value.brakes, newPath);
  result = CheckLastError("BasicSafetyMessage", gkFuncRefGet, result);

  snprintf(newPath, elcount(newPath), "%s.%s", oldPath, "size");
  GetBasicSafetyMessage_Blob_VehicleSizeParams(packetHandle, value.size, newPath);
  result = CheckLastError("BasicSafetyMessage", gkFuncRefGet, result);

  return result;
}

int SetBasicSafetyMessage_Blob_BSMblobParams(LONG packetHandle, struct BasicSafetyMessage_Blob_BSMblob value, char oldPath[])
{
  char newPath[300];
  int result;

  result = 0;

  snprintf(newPath, elcount(newPath), "%s.%s", oldPath, "msgCnt");
  C2xSetTokenInt(packetHandle, "BasicSafetyMessage", newPath, value.msgCnt);
  result = CheckLastError("BasicSafetyMessage", gkFuncRefGet, result);

  snprintf(newPath, elcount(newPath), "%s.%s", oldPath, "id");
  C2xSetTokenInt64(packetHandle, "BasicSafetyMessage", newPath, value.id);
  result = CheckLastError("BasicSafetyMessage", gkFuncRefGet, result);

  snprintf(newPath, elcount(newPath), "%s.%s", oldPath, "secMark");
  C2xSetTokenInt(packetHandle, "BasicSafetyMessage", newPath, value.secMark);
  result = CheckLastError("BasicSafetyMessage", gkFuncRefGet, result);

  snprintf(newPath, elcount(newPath), "%s.%s", oldPath, "pos");
  SetBasicSafetyMessage_Blob_Position3DParams(packetHandle, value.pos, newPath);
  result = CheckLastError("BasicSafetyMessage", gkFuncRefGet, result);

  snprintf(newPath, elcount(newPath), "%s.%s", oldPath, "accuracy");
  SetBasicSafetyMessage_Blob_PositionalAccuracyParams(packetHandle, value.accuracy, newPath);
  result = CheckLastError("BasicSafetyMessage", gkFuncRefGet, result);

  snprintf(newPath, elcount(newPath), "%s.%s", oldPath, "motion");
  SetBasicSafetyMessage_Blob_MotionParams(packetHandle, value.motion, newPath);
  result = CheckLastError("BasicSafetyMessage", gkFuncRefGet, result);

  snprintf(newPath, elcount(newPath), "%s.%s", oldPath, "brakes");
  SetBasicSafetyMessage_Blob_BrakeSystemStatusParams(packetHandle, value.brakes, newPath);
  result = CheckLastError("BasicSafetyMessage", gkFuncRefGet, result);

  snprintf(newPath, elcount(newPath), "%s.%s", oldPath, "size");
  SetBasicSafetyMessage_Blob_VehicleSizeParams(packetHandle, value.size, newPath);
  result = CheckLastError("BasicSafetyMessage", gkFuncRefGet, result);

  return result;
}

int GetBasicSafetyMessageBSMblobParams(LONG packetHandle, struct BasicSafetyMessageBSMblob value, char oldPath[])
{
  char newPath[300];
  int result;

  result = 0;

  snprintf(newPath, elcount(newPath), "%s.%s", oldPath, "_Blob_BSMblob");
  GetBasicSafetyMessage_Blob_BSMblobParams(packetHandle, value._Blob_BSMblob, newPath);
  result = CheckLastError("BasicSafetyMessage", gkFuncRefGet, result);

  return result;
}

int SetBasicSafetyMessageBSMblobParams(LONG packetHandle, struct BasicSafetyMessageBSMblob value, char oldPath[])
{
  char newPath[300];
  int result;

  result = 0;

  snprintf(newPath, elcount(newPath), "%s.%s", oldPath, "_Blob_BSMblob");
  SetBasicSafetyMessage_Blob_BSMblobParams(packetHandle, value._Blob_BSMblob, newPath);
  result = CheckLastError("BasicSafetyMessage", gkFuncRefGet, result);

  return result;
}

int GetBasicSafetyMessageDDateTimeParams(LONG packetHandle, struct BasicSafetyMessageDDateTime value, char oldPath[])
{
  char newPath[300];
  int result;

  result = 0;

  snprintf(newPath, elcount(newPath), "%s.%s", oldPath, "year");
  value.year.isValidFlag = C2xIsTokenAvailable(packetHandle, "BasicSafetyMessage", newPath);
  if(value.year.isValidFlag==1)
  {
    value.year.value = C2xGetTokenInt(packetHandle, "BasicSafetyMessage", newPath);
    result = CheckLastError("BasicSafetyMessage", gkFuncRefGet, result);
  }
  snprintf(newPath, elcount(newPath), "%s.%s", oldPath, "month");
  value.month.isValidFlag = C2xIsTokenAvailable(packetHandle, "BasicSafetyMessage", newPath);
  if(value.month.isValidFlag==1)
  {
    value.month.value = C2xGetTokenInt(packetHandle, "BasicSafetyMessage", newPath);
    result = CheckLastError("BasicSafetyMessage", gkFuncRefGet, result);
  }
  snprintf(newPath, elcount(newPath), "%s.%s", oldPath, "day");
  value.day.isValidFlag = C2xIsTokenAvailable(packetHandle, "BasicSafetyMessage", newPath);
  if(value.day.isValidFlag==1)
  {
    value.day.value = C2xGetTokenInt(packetHandle, "BasicSafetyMessage", newPath);
    result = CheckLastError("BasicSafetyMessage", gkFuncRefGet, result);
  }
  snprintf(newPath, elcount(newPath), "%s.%s", oldPath, "hour");
  value.hour.isValidFlag = C2xIsTokenAvailable(packetHandle, "BasicSafetyMessage", newPath);
  if(value.hour.isValidFlag==1)
  {
    value.hour.value = C2xGetTokenInt(packetHandle, "BasicSafetyMessage", newPath);
    result = CheckLastError("BasicSafetyMessage", gkFuncRefGet, result);
  }
  snprintf(newPath, elcount(newPath), "%s.%s", oldPath, "minute");
  value.minute.isValidFlag = C2xIsTokenAvailable(packetHandle, "BasicSafetyMessage", newPath);
  if(value.minute.isValidFlag==1)
  {
    value.minute.value = C2xGetTokenInt(packetHandle, "BasicSafetyMessage", newPath);
    result = CheckLastError("BasicSafetyMessage", gkFuncRefGet, result);
  }
  snprintf(newPath, elcount(newPath), "%s.%s", oldPath, "second");
  value.second.isValidFlag = C2xIsTokenAvailable(packetHandle, "BasicSafetyMessage", newPath);
  if(value.second.isValidFlag==1)
  {
    value.second.value = C2xGetTokenInt(packetHandle, "BasicSafetyMessage", newPath);
    result = CheckLastError("BasicSafetyMessage", gkFuncRefGet, result);
  }
  return result;
}

int SetBasicSafetyMessageDDateTimeParams(LONG packetHandle, struct BasicSafetyMessageDDateTime value, char oldPath[])
{
  char newPath[300];
  int result;

  result = 0;

  snprintf(newPath, elcount(newPath), "%s.%s", oldPath, "year");
  if(value.year.isValidFlag==1)
  {
    C2xSetTokenInt(packetHandle, "BasicSafetyMessage", newPath, value.year.value);
    result = CheckLastError("BasicSafetyMessage", gkFuncRefGet, result);
  }
  else
  {
    if( C2xIsTokenAvailable(packetHandle, "BasicSafetyMessage", newPath) )
    {
      C2xRemoveToken(packetHandle, "BasicSafetyMessage", newPath);
    }
  }

  snprintf(newPath, elcount(newPath), "%s.%s", oldPath, "month");
  if(value.month.isValidFlag==1)
  {
    C2xSetTokenInt(packetHandle, "BasicSafetyMessage", newPath, value.month.value);
    result = CheckLastError("BasicSafetyMessage", gkFuncRefGet, result);
  }
  else
  {
    if( C2xIsTokenAvailable(packetHandle, "BasicSafetyMessage", newPath) )
    {
      C2xRemoveToken(packetHandle, "BasicSafetyMessage", newPath);
    }
  }

  snprintf(newPath, elcount(newPath), "%s.%s", oldPath, "day");
  if(value.day.isValidFlag==1)
  {
    C2xSetTokenInt(packetHandle, "BasicSafetyMessage", newPath, value.day.value);
    result = CheckLastError("BasicSafetyMessage", gkFuncRefGet, result);
  }
  else
  {
    if( C2xIsTokenAvailable(packetHandle, "BasicSafetyMessage", newPath) )
    {
      C2xRemoveToken(packetHandle, "BasicSafetyMessage", newPath);
    }
  }

  snprintf(newPath, elcount(newPath), "%s.%s", oldPath, "hour");
  if(value.hour.isValidFlag==1)
  {
    C2xSetTokenInt(packetHandle, "BasicSafetyMessage", newPath, value.hour.value);
    result = CheckLastError("BasicSafetyMessage", gkFuncRefGet, result);
  }
  else
  {
    if( C2xIsTokenAvailable(packetHandle, "BasicSafetyMessage", newPath) )
    {
      C2xRemoveToken(packetHandle, "BasicSafetyMessage", newPath);
    }
  }

  snprintf(newPath, elcount(newPath), "%s.%s", oldPath, "minute");
  if(value.minute.isValidFlag==1)
  {
    C2xSetTokenInt(packetHandle, "BasicSafetyMessage", newPath, value.minute.value);
    result = CheckLastError("BasicSafetyMessage", gkFuncRefGet, result);
  }
  else
  {
    if( C2xIsTokenAvailable(packetHandle, "BasicSafetyMessage", newPath) )
    {
      C2xRemoveToken(packetHandle, "BasicSafetyMessage", newPath);
    }
  }

  snprintf(newPath, elcount(newPath), "%s.%s", oldPath, "second");
  if(value.second.isValidFlag==1)
  {
    C2xSetTokenInt(packetHandle, "BasicSafetyMessage", newPath, value.second.value);
    result = CheckLastError("BasicSafetyMessage", gkFuncRefGet, result);
  }
  else
  {
    if( C2xIsTokenAvailable(packetHandle, "BasicSafetyMessage", newPath) )
    {
      C2xRemoveToken(packetHandle, "BasicSafetyMessage", newPath);
    }
  }

  return result;
}

int GetBasicSafetyMessageElevationParams(LONG packetHandle, struct BasicSafetyMessageElevation value, char oldPath[])
{
  char newPath[300];
  int result;

  result = 0;

  snprintf(newPath, elcount(newPath), "%s.%s", oldPath, "_Blob_Elevation");
  value._Blob_Elevation = C2xGetTokenInt(packetHandle, "BasicSafetyMessage", newPath);
  result = CheckLastError("BasicSafetyMessage", gkFuncRefGet, result);

  return result;
}

int SetBasicSafetyMessageElevationParams(LONG packetHandle, struct BasicSafetyMessageElevation value, char oldPath[])
{
  char newPath[300];
  int result;

  result = 0;

  snprintf(newPath, elcount(newPath), "%s.%s", oldPath, "_Blob_Elevation");
  C2xSetTokenInt(packetHandle, "BasicSafetyMessage", newPath, value._Blob_Elevation);
  result = CheckLastError("BasicSafetyMessage", gkFuncRefGet, result);

  return result;
}

int GetBasicSafetyMessage_Blob_TransmissionAndSpeedParams(LONG packetHandle, struct BasicSafetyMessage_Blob_TransmissionAndSpeed value, char oldPath[])
{
  char newPath[300];
  int result;

  result = 0;

  snprintf(newPath, elcount(newPath), "%s.%s", oldPath, "transmissionState");
  value.transmissionState = C2xGetTokenInt(packetHandle, "BasicSafetyMessage", newPath);
  result = CheckLastError("BasicSafetyMessage", gkFuncRefGet, result);

  snprintf(newPath, elcount(newPath), "%s.%s", oldPath, "speed");
  value.speed = C2xGetTokenInt(packetHandle, "BasicSafetyMessage", newPath);
  result = CheckLastError("BasicSafetyMessage", gkFuncRefGet, result);

  return result;
}

int SetBasicSafetyMessage_Blob_TransmissionAndSpeedParams(LONG packetHandle, struct BasicSafetyMessage_Blob_TransmissionAndSpeed value, char oldPath[])
{
  char newPath[300];
  int result;

  result = 0;

  snprintf(newPath, elcount(newPath), "%s.%s", oldPath, "transmissionState");
  C2xSetTokenInt(packetHandle, "BasicSafetyMessage", newPath, value.transmissionState);
  result = CheckLastError("BasicSafetyMessage", gkFuncRefGet, result);

  snprintf(newPath, elcount(newPath), "%s.%s", oldPath, "speed");
  C2xSetTokenInt(packetHandle, "BasicSafetyMessage", newPath, value.speed);
  result = CheckLastError("BasicSafetyMessage", gkFuncRefGet, result);

  return result;
}

int GetBasicSafetyMessageTransmissionAndSpeedParams(LONG packetHandle, struct BasicSafetyMessageTransmissionAndSpeed value, char oldPath[])
{
  char newPath[300];
  int result;

  result = 0;

  snprintf(newPath, elcount(newPath), "%s.%s", oldPath, "_Blob_TransmissionAndSpeed");
  GetBasicSafetyMessage_Blob_TransmissionAndSpeedParams(packetHandle, value._Blob_TransmissionAndSpeed, newPath);
  result = CheckLastError("BasicSafetyMessage", gkFuncRefGet, result);

  return result;
}

int SetBasicSafetyMessageTransmissionAndSpeedParams(LONG packetHandle, struct BasicSafetyMessageTransmissionAndSpeed value, char oldPath[])
{
  char newPath[300];
  int result;

  result = 0;

  snprintf(newPath, elcount(newPath), "%s.%s", oldPath, "_Blob_TransmissionAndSpeed");
  SetBasicSafetyMessage_Blob_TransmissionAndSpeedParams(packetHandle, value._Blob_TransmissionAndSpeed, newPath);
  result = CheckLastError("BasicSafetyMessage", gkFuncRefGet, result);

  return result;
}

int GetBasicSafetyMessagePositionalAccuracyParams(LONG packetHandle, struct BasicSafetyMessagePositionalAccuracy value, char oldPath[])
{
  char newPath[300];
  int result;

  result = 0;

  snprintf(newPath, elcount(newPath), "%s.%s", oldPath, "_Blob_PositionalAccuracy");
  GetBasicSafetyMessage_Blob_PositionalAccuracyParams(packetHandle, value._Blob_PositionalAccuracy, newPath);
  result = CheckLastError("BasicSafetyMessage", gkFuncRefGet, result);

  return result;
}

int SetBasicSafetyMessagePositionalAccuracyParams(LONG packetHandle, struct BasicSafetyMessagePositionalAccuracy value, char oldPath[])
{
  char newPath[300];
  int result;

  result = 0;

  snprintf(newPath, elcount(newPath), "%s.%s", oldPath, "_Blob_PositionalAccuracy");
  SetBasicSafetyMessage_Blob_PositionalAccuracyParams(packetHandle, value._Blob_PositionalAccuracy, newPath);
  result = CheckLastError("BasicSafetyMessage", gkFuncRefGet, result);

  return result;
}

int GetBasicSafetyMessage_Blob_PositionConfidenceSetParams(LONG packetHandle, struct BasicSafetyMessage_Blob_PositionConfidenceSet value, char oldPath[])
{
  char newPath[300];
  int result;

  result = 0;

  snprintf(newPath, elcount(newPath), "%s.%s", oldPath, "positionConfidence");
  value.positionConfidence = C2xGetTokenInt(packetHandle, "BasicSafetyMessage", newPath);
  result = CheckLastError("BasicSafetyMessage", gkFuncRefGet, result);

  snprintf(newPath, elcount(newPath), "%s.%s", oldPath, "elevationConfidence");
  value.elevationConfidence = C2xGetTokenInt(packetHandle, "BasicSafetyMessage", newPath);
  result = CheckLastError("BasicSafetyMessage", gkFuncRefGet, result);

  return result;
}

int SetBasicSafetyMessage_Blob_PositionConfidenceSetParams(LONG packetHandle, struct BasicSafetyMessage_Blob_PositionConfidenceSet value, char oldPath[])
{
  char newPath[300];
  int result;

  result = 0;

  snprintf(newPath, elcount(newPath), "%s.%s", oldPath, "positionConfidence");
  C2xSetTokenInt(packetHandle, "BasicSafetyMessage", newPath, value.positionConfidence);
  result = CheckLastError("BasicSafetyMessage", gkFuncRefGet, result);

  snprintf(newPath, elcount(newPath), "%s.%s", oldPath, "elevationConfidence");
  C2xSetTokenInt(packetHandle, "BasicSafetyMessage", newPath, value.elevationConfidence);
  result = CheckLastError("BasicSafetyMessage", gkFuncRefGet, result);

  return result;
}

int GetBasicSafetyMessagePositionConfidenceSetParams(LONG packetHandle, struct BasicSafetyMessagePositionConfidenceSet value, char oldPath[])
{
  char newPath[300];
  int result;

  result = 0;

  snprintf(newPath, elcount(newPath), "%s.%s", oldPath, "_Blob_PositionConfidenceSet");
  GetBasicSafetyMessage_Blob_PositionConfidenceSetParams(packetHandle, value._Blob_PositionConfidenceSet, newPath);
  result = CheckLastError("BasicSafetyMessage", gkFuncRefGet, result);

  return result;
}

int SetBasicSafetyMessagePositionConfidenceSetParams(LONG packetHandle, struct BasicSafetyMessagePositionConfidenceSet value, char oldPath[])
{
  char newPath[300];
  int result;

  result = 0;

  snprintf(newPath, elcount(newPath), "%s.%s", oldPath, "_Blob_PositionConfidenceSet");
  SetBasicSafetyMessage_Blob_PositionConfidenceSetParams(packetHandle, value._Blob_PositionConfidenceSet, newPath);
  result = CheckLastError("BasicSafetyMessage", gkFuncRefGet, result);

  return result;
}

int GetBasicSafetyMessage_Blob_SpeedandHeadingandThrottleConfidenceParams(LONG packetHandle, struct BasicSafetyMessage_Blob_SpeedandHeadingandThrottleConfidence value, char oldPath[])
{
  char newPath[300];
  int result;

  result = 0;

  snprintf(newPath, elcount(newPath), "%s.%s", oldPath, "headingConfidence");
  value.headingConfidence = C2xGetTokenInt(packetHandle, "BasicSafetyMessage", newPath);
  result = CheckLastError("BasicSafetyMessage", gkFuncRefGet, result);

  snprintf(newPath, elcount(newPath), "%s.%s", oldPath, "speedConfidence");
  value.speedConfidence = C2xGetTokenInt(packetHandle, "BasicSafetyMessage", newPath);
  result = CheckLastError("BasicSafetyMessage", gkFuncRefGet, result);

  snprintf(newPath, elcount(newPath), "%s.%s", oldPath, "throttleConfidence");
  value.throttleConfidence = C2xGetTokenInt(packetHandle, "BasicSafetyMessage", newPath);
  result = CheckLastError("BasicSafetyMessage", gkFuncRefGet, result);

  return result;
}

int SetBasicSafetyMessage_Blob_SpeedandHeadingandThrottleConfidenceParams(LONG packetHandle, struct BasicSafetyMessage_Blob_SpeedandHeadingandThrottleConfidence value, char oldPath[])
{
  char newPath[300];
  int result;

  result = 0;

  snprintf(newPath, elcount(newPath), "%s.%s", oldPath, "headingConfidence");
  C2xSetTokenInt(packetHandle, "BasicSafetyMessage", newPath, value.headingConfidence);
  result = CheckLastError("BasicSafetyMessage", gkFuncRefGet, result);

  snprintf(newPath, elcount(newPath), "%s.%s", oldPath, "speedConfidence");
  C2xSetTokenInt(packetHandle, "BasicSafetyMessage", newPath, value.speedConfidence);
  result = CheckLastError("BasicSafetyMessage", gkFuncRefGet, result);

  snprintf(newPath, elcount(newPath), "%s.%s", oldPath, "throttleConfidence");
  C2xSetTokenInt(packetHandle, "BasicSafetyMessage", newPath, value.throttleConfidence);
  result = CheckLastError("BasicSafetyMessage", gkFuncRefGet, result);

  return result;
}

int GetBasicSafetyMessageSpeedandHeadingandThrottleConfidenceParams(LONG packetHandle, struct BasicSafetyMessageSpeedandHeadingandThrottleConfidence value, char oldPath[])
{
  char newPath[300];
  int result;

  result = 0;

  snprintf(newPath, elcount(newPath), "%s.%s", oldPath, "_Blob_SpeedandHeadingandThrottleConfidence");
  GetBasicSafetyMessage_Blob_SpeedandHeadingandThrottleConfidenceParams(packetHandle, value._Blob_SpeedandHeadingandThrottleConfidence, newPath);
  result = CheckLastError("BasicSafetyMessage", gkFuncRefGet, result);

  return result;
}

int SetBasicSafetyMessageSpeedandHeadingandThrottleConfidenceParams(LONG packetHandle, struct BasicSafetyMessageSpeedandHeadingandThrottleConfidence value, char oldPath[])
{
  char newPath[300];
  int result;

  result = 0;

  snprintf(newPath, elcount(newPath), "%s.%s", oldPath, "_Blob_SpeedandHeadingandThrottleConfidence");
  SetBasicSafetyMessage_Blob_SpeedandHeadingandThrottleConfidenceParams(packetHandle, value._Blob_SpeedandHeadingandThrottleConfidence, newPath);
  result = CheckLastError("BasicSafetyMessage", gkFuncRefGet, result);

  return result;
}

int GetBasicSafetyMessageFullPositionVectorParams(LONG packetHandle, struct BasicSafetyMessageFullPositionVector value, char oldPath[])
{
  char newPath[300];
  int result;

  result = 0;

  snprintf(newPath, elcount(newPath), "%s.%s", oldPath, "utcTime");
  value.utcTime.isValidFlag = C2xIsTokenAvailable(packetHandle, "BasicSafetyMessage", newPath);
  if(value.utcTime.isValidFlag==1)
  {
    GetBasicSafetyMessageDDateTimeParams(packetHandle, value.utcTime, newPath);
    result = CheckLastError("BasicSafetyMessage", gkFuncRefGet, result);
  }
  snprintf(newPath, elcount(newPath), "%s.%s", oldPath, "lon");
  value.lon = C2xGetTokenInt(packetHandle, "BasicSafetyMessage", newPath);
  result = CheckLastError("BasicSafetyMessage", gkFuncRefGet, result);

  snprintf(newPath, elcount(newPath), "%s.%s", oldPath, "lat");
  value.lat = C2xGetTokenInt(packetHandle, "BasicSafetyMessage", newPath);
  result = CheckLastError("BasicSafetyMessage", gkFuncRefGet, result);

  snprintf(newPath, elcount(newPath), "%s.%s", oldPath, "elevation");
  value.elevation.isValidFlag = C2xIsTokenAvailable(packetHandle, "BasicSafetyMessage", newPath);
  if(value.elevation.isValidFlag==1)
  {
    value.elevation.isValidFlag = 1;
    value.elevation.stringLength = C2xGetTokenData(packetHandle, "BasicSafetyMessage", newPath, elcount(value.elevation.string), value.elevation.string);
  }
  snprintf(newPath, elcount(newPath), "%s.%s", oldPath, "heading");
  value.heading.isValidFlag = C2xIsTokenAvailable(packetHandle, "BasicSafetyMessage", newPath);
  if(value.heading.isValidFlag==1)
  {
    value.heading.value = C2xGetTokenInt(packetHandle, "BasicSafetyMessage", newPath);
    result = CheckLastError("BasicSafetyMessage", gkFuncRefGet, result);
  }
  snprintf(newPath, elcount(newPath), "%s.%s", oldPath, "speed");
  value.speed.isValidFlag = C2xIsTokenAvailable(packetHandle, "BasicSafetyMessage", newPath);
  if(value.speed.isValidFlag==1)
  {
    value.speed.isValidFlag = 1;
    value.speed.stringLength = C2xGetTokenData(packetHandle, "BasicSafetyMessage", newPath, elcount(value.speed.string), value.speed.string);
  }
  snprintf(newPath, elcount(newPath), "%s.%s", oldPath, "posAccuracy");
  value.posAccuracy.isValidFlag = C2xIsTokenAvailable(packetHandle, "BasicSafetyMessage", newPath);
  if(value.posAccuracy.isValidFlag==1)
  {
    value.posAccuracy.isValidFlag = 1;
    value.posAccuracy.stringLength = C2xGetTokenData(packetHandle, "BasicSafetyMessage", newPath, elcount(value.posAccuracy.string), value.posAccuracy.string);
  }
  snprintf(newPath, elcount(newPath), "%s.%s", oldPath, "timeConfidence");
  value.timeConfidence.isValidFlag = C2xIsTokenAvailable(packetHandle, "BasicSafetyMessage", newPath);
  if(value.timeConfidence.isValidFlag==1)
  {
    value.timeConfidence.value = C2xGetTokenInt(packetHandle, "BasicSafetyMessage", newPath);
    result = CheckLastError("BasicSafetyMessage", gkFuncRefGet, result);
  }
  snprintf(newPath, elcount(newPath), "%s.%s", oldPath, "posConfidence");
  value.posConfidence.isValidFlag = C2xIsTokenAvailable(packetHandle, "BasicSafetyMessage", newPath);
  if(value.posConfidence.isValidFlag==1)
  {
    value.posConfidence.isValidFlag = 1;
    value.posConfidence.stringLength = C2xGetTokenData(packetHandle, "BasicSafetyMessage", newPath, elcount(value.posConfidence.string), value.posConfidence.string);
  }
  snprintf(newPath, elcount(newPath), "%s.%s", oldPath, "speedConfidence");
  value.speedConfidence.isValidFlag = C2xIsTokenAvailable(packetHandle, "BasicSafetyMessage", newPath);
  if(value.speedConfidence.isValidFlag==1)
  {
    value.speedConfidence.isValidFlag = 1;
    value.speedConfidence.stringLength = C2xGetTokenData(packetHandle, "BasicSafetyMessage", newPath, elcount(value.speedConfidence.string), value.speedConfidence.string);
  }
  return result;
}

int SetBasicSafetyMessageFullPositionVectorParams(LONG packetHandle, struct BasicSafetyMessageFullPositionVector value, char oldPath[])
{
  char newPath[300];
  int result;

  result = 0;

  snprintf(newPath, elcount(newPath), "%s.%s", oldPath, "utcTime");
  if(value.utcTime.isValidFlag==1)
  {
    SetBasicSafetyMessageDDateTimeParams(packetHandle, value.utcTime, newPath);
    result = CheckLastError("BasicSafetyMessage", gkFuncRefGet, result);
  }
  else
  {
    if( C2xIsTokenAvailable(packetHandle, "BasicSafetyMessage", newPath) )
    {
      C2xRemoveToken(packetHandle, "BasicSafetyMessage", newPath);
    }
  }

  snprintf(newPath, elcount(newPath), "%s.%s", oldPath, "lon");
  C2xSetTokenInt(packetHandle, "BasicSafetyMessage", newPath, value.lon);
  result = CheckLastError("BasicSafetyMessage", gkFuncRefGet, result);

  snprintf(newPath, elcount(newPath), "%s.%s", oldPath, "lat");
  C2xSetTokenInt(packetHandle, "BasicSafetyMessage", newPath, value.lat);
  result = CheckLastError("BasicSafetyMessage", gkFuncRefGet, result);

  snprintf(newPath, elcount(newPath), "%s.%s", oldPath, "elevation");
  if(value.elevation.isValidFlag==1)
  {
    C2xSetTokenData(packetHandle, "BasicSafetyMessage", newPath, value.elevation.stringLength, value.elevation.string);
  }
  else
  {
    if( C2xIsTokenAvailable(packetHandle, "BasicSafetyMessage", newPath) )
    {
      C2xRemoveToken(packetHandle, "BasicSafetyMessage", newPath);
    }
  }

  snprintf(newPath, elcount(newPath), "%s.%s", oldPath, "heading");
  if(value.heading.isValidFlag==1)
  {
    C2xSetTokenInt(packetHandle, "BasicSafetyMessage", newPath, value.heading.value);
    result = CheckLastError("BasicSafetyMessage", gkFuncRefGet, result);
  }
  else
  {
    if( C2xIsTokenAvailable(packetHandle, "BasicSafetyMessage", newPath) )
    {
      C2xRemoveToken(packetHandle, "BasicSafetyMessage", newPath);
    }
  }

  snprintf(newPath, elcount(newPath), "%s.%s", oldPath, "speed");
  if(value.speed.isValidFlag==1)
  {
    C2xSetTokenData(packetHandle, "BasicSafetyMessage", newPath, value.speed.stringLength, value.speed.string);
  }
  else
  {
    if( C2xIsTokenAvailable(packetHandle, "BasicSafetyMessage", newPath) )
    {
      C2xRemoveToken(packetHandle, "BasicSafetyMessage", newPath);
    }
  }

  snprintf(newPath, elcount(newPath), "%s.%s", oldPath, "posAccuracy");
  if(value.posAccuracy.isValidFlag==1)
  {
    C2xSetTokenData(packetHandle, "BasicSafetyMessage", newPath, value.posAccuracy.stringLength, value.posAccuracy.string);
  }
  else
  {
    if( C2xIsTokenAvailable(packetHandle, "BasicSafetyMessage", newPath) )
    {
      C2xRemoveToken(packetHandle, "BasicSafetyMessage", newPath);
    }
  }

  snprintf(newPath, elcount(newPath), "%s.%s", oldPath, "timeConfidence");
  if(value.timeConfidence.isValidFlag==1)
  {
    C2xSetTokenInt(packetHandle, "BasicSafetyMessage", newPath, value.timeConfidence.value);
    result = CheckLastError("BasicSafetyMessage", gkFuncRefGet, result);
  }
  else
  {
    if( C2xIsTokenAvailable(packetHandle, "BasicSafetyMessage", newPath) )
    {
      C2xRemoveToken(packetHandle, "BasicSafetyMessage", newPath);
    }
  }

  snprintf(newPath, elcount(newPath), "%s.%s", oldPath, "posConfidence");
  if(value.posConfidence.isValidFlag==1)
  {
    C2xSetTokenData(packetHandle, "BasicSafetyMessage", newPath, value.posConfidence.stringLength, value.posConfidence.string);
  }
  else
  {
    if( C2xIsTokenAvailable(packetHandle, "BasicSafetyMessage", newPath) )
    {
      C2xRemoveToken(packetHandle, "BasicSafetyMessage", newPath);
    }
  }

  snprintf(newPath, elcount(newPath), "%s.%s", oldPath, "speedConfidence");
  if(value.speedConfidence.isValidFlag==1)
  {
    C2xSetTokenData(packetHandle, "BasicSafetyMessage", newPath, value.speedConfidence.stringLength, value.speedConfidence.string);
  }
  else
  {
    if( C2xIsTokenAvailable(packetHandle, "BasicSafetyMessage", newPath) )
    {
      C2xRemoveToken(packetHandle, "BasicSafetyMessage", newPath);
    }
  }

  return result;
}

int GetBasicSafetyMessagePathHistoryPointType_01Params(LONG packetHandle, struct BasicSafetyMessagePathHistoryPointType_01 value, char oldPath[])
{
  char newPath[300];
  int result;

  result = 0;

  snprintf(newPath, elcount(newPath), "%s.%s", oldPath, "latOffset");
  value.latOffset = C2xGetTokenInt(packetHandle, "BasicSafetyMessage", newPath);
  result = CheckLastError("BasicSafetyMessage", gkFuncRefGet, result);

  snprintf(newPath, elcount(newPath), "%s.%s", oldPath, "longOffset");
  value.longOffset = C2xGetTokenInt(packetHandle, "BasicSafetyMessage", newPath);
  result = CheckLastError("BasicSafetyMessage", gkFuncRefGet, result);

  snprintf(newPath, elcount(newPath), "%s.%s", oldPath, "elevationOffset");
  value.elevationOffset.isValidFlag = C2xIsTokenAvailable(packetHandle, "BasicSafetyMessage", newPath);
  if(value.elevationOffset.isValidFlag==1)
  {
    value.elevationOffset.value = C2xGetTokenInt(packetHandle, "BasicSafetyMessage", newPath);
    result = CheckLastError("BasicSafetyMessage", gkFuncRefGet, result);
  }
  snprintf(newPath, elcount(newPath), "%s.%s", oldPath, "timeOffset");
  value.timeOffset.isValidFlag = C2xIsTokenAvailable(packetHandle, "BasicSafetyMessage", newPath);
  if(value.timeOffset.isValidFlag==1)
  {
    value.timeOffset.value = C2xGetTokenInt(packetHandle, "BasicSafetyMessage", newPath);
    result = CheckLastError("BasicSafetyMessage", gkFuncRefGet, result);
  }
  snprintf(newPath, elcount(newPath), "%s.%s", oldPath, "posAccuracy");
  value.posAccuracy.isValidFlag = C2xIsTokenAvailable(packetHandle, "BasicSafetyMessage", newPath);
  if(value.posAccuracy.isValidFlag==1)
  {
    value.posAccuracy.isValidFlag = 1;
    value.posAccuracy.stringLength = C2xGetTokenData(packetHandle, "BasicSafetyMessage", newPath, elcount(value.posAccuracy.string), value.posAccuracy.string);
  }
  snprintf(newPath, elcount(newPath), "%s.%s", oldPath, "heading");
  value.heading.isValidFlag = C2xIsTokenAvailable(packetHandle, "BasicSafetyMessage", newPath);
  if(value.heading.isValidFlag==1)
  {
    value.heading.value = C2xGetTokenInt(packetHandle, "BasicSafetyMessage", newPath);
    result = CheckLastError("BasicSafetyMessage", gkFuncRefGet, result);
  }
  snprintf(newPath, elcount(newPath), "%s.%s", oldPath, "speed");
  value.speed.isValidFlag = C2xIsTokenAvailable(packetHandle, "BasicSafetyMessage", newPath);
  if(value.speed.isValidFlag==1)
  {
    value.speed.isValidFlag = 1;
    value.speed.stringLength = C2xGetTokenData(packetHandle, "BasicSafetyMessage", newPath, elcount(value.speed.string), value.speed.string);
  }
  return result;
}

int SetBasicSafetyMessagePathHistoryPointType_01Params(LONG packetHandle, struct BasicSafetyMessagePathHistoryPointType_01 value, char oldPath[])
{
  char newPath[300];
  int result;

  result = 0;

  snprintf(newPath, elcount(newPath), "%s.%s", oldPath, "latOffset");
  C2xSetTokenInt(packetHandle, "BasicSafetyMessage", newPath, value.latOffset);
  result = CheckLastError("BasicSafetyMessage", gkFuncRefGet, result);

  snprintf(newPath, elcount(newPath), "%s.%s", oldPath, "longOffset");
  C2xSetTokenInt(packetHandle, "BasicSafetyMessage", newPath, value.longOffset);
  result = CheckLastError("BasicSafetyMessage", gkFuncRefGet, result);

  snprintf(newPath, elcount(newPath), "%s.%s", oldPath, "elevationOffset");
  if(value.elevationOffset.isValidFlag==1)
  {
    C2xSetTokenInt(packetHandle, "BasicSafetyMessage", newPath, value.elevationOffset.value);
    result = CheckLastError("BasicSafetyMessage", gkFuncRefGet, result);
  }
  else
  {
    if( C2xIsTokenAvailable(packetHandle, "BasicSafetyMessage", newPath) )
    {
      C2xRemoveToken(packetHandle, "BasicSafetyMessage", newPath);
    }
  }

  snprintf(newPath, elcount(newPath), "%s.%s", oldPath, "timeOffset");
  if(value.timeOffset.isValidFlag==1)
  {
    C2xSetTokenInt(packetHandle, "BasicSafetyMessage", newPath, value.timeOffset.value);
    result = CheckLastError("BasicSafetyMessage", gkFuncRefGet, result);
  }
  else
  {
    if( C2xIsTokenAvailable(packetHandle, "BasicSafetyMessage", newPath) )
    {
      C2xRemoveToken(packetHandle, "BasicSafetyMessage", newPath);
    }
  }

  snprintf(newPath, elcount(newPath), "%s.%s", oldPath, "posAccuracy");
  if(value.posAccuracy.isValidFlag==1)
  {
    C2xSetTokenData(packetHandle, "BasicSafetyMessage", newPath, value.posAccuracy.stringLength, value.posAccuracy.string);
  }
  else
  {
    if( C2xIsTokenAvailable(packetHandle, "BasicSafetyMessage", newPath) )
    {
      C2xRemoveToken(packetHandle, "BasicSafetyMessage", newPath);
    }
  }

  snprintf(newPath, elcount(newPath), "%s.%s", oldPath, "heading");
  if(value.heading.isValidFlag==1)
  {
    C2xSetTokenInt(packetHandle, "BasicSafetyMessage", newPath, value.heading.value);
    result = CheckLastError("BasicSafetyMessage", gkFuncRefGet, result);
  }
  else
  {
    if( C2xIsTokenAvailable(packetHandle, "BasicSafetyMessage", newPath) )
    {
      C2xRemoveToken(packetHandle, "BasicSafetyMessage", newPath);
    }
  }

  snprintf(newPath, elcount(newPath), "%s.%s", oldPath, "speed");
  if(value.speed.isValidFlag==1)
  {
    C2xSetTokenData(packetHandle, "BasicSafetyMessage", newPath, value.speed.stringLength, value.speed.string);
  }
  else
  {
    if( C2xIsTokenAvailable(packetHandle, "BasicSafetyMessage", newPath) )
    {
      C2xRemoveToken(packetHandle, "BasicSafetyMessage", newPath);
    }
  }

  return result;
}

int GetBasicSafetyMessage_PathHistory_crumbData_pathHistoryPointSets_01Params(LONG packetHandle, struct BasicSafetyMessage_PathHistory_crumbData_pathHistoryPointSets_01 value, char oldPath[])
{
  char newPath[300]; 
  int i;
  int result;

  result = 0;

  value.length = C2xGetTokenInt(packetHandle, "BasicSafetyMessage", oldPath);
  if((result = CheckLastError("BasicSafetyMessage", gkFuncRefGet, result))==0)
  {
    for(i=0; i<value.length; i++)
    {
      snprintf(newPath, elcount(newPath), "%s[%d]", oldPath, i);
      GetBasicSafetyMessagePathHistoryPointType_01Params(packetHandle, value.arrayValue[i], newPath);
      result = CheckLastError("BasicSafetyMessage", gkFuncRefGet, result);
    }
  }
  return result;
}

int SetBasicSafetyMessage_PathHistory_crumbData_pathHistoryPointSets_01Params(LONG packetHandle, struct BasicSafetyMessage_PathHistory_crumbData_pathHistoryPointSets_01 value, char oldPath[])
{
  char newPath[300]; 
  int i;
  int result;

  result = 0;

  C2xRemoveToken(packetHandle, "BasicSafetyMessage", oldPath);
  for(i=0; i<value.length; i++)
  {
    snprintf(newPath, elcount(newPath), "%s[%d]", oldPath, i);
    SetBasicSafetyMessagePathHistoryPointType_01Params(packetHandle, value.arrayValue[i], newPath);
    result = CheckLastError("BasicSafetyMessage", gkFuncRefGet, result);
  }
  return result;
}

int GetBasicSafetyMessage_Blob_PathHistoryPointType_02Params(LONG packetHandle, struct BasicSafetyMessage_Blob_PathHistoryPointType_02 value, char oldPath[])
{
  char newPath[300];
  int result;

  result = 0;

  snprintf(newPath, elcount(newPath), "%s.%s", oldPath, "latOffset");
  value.latOffset = C2xGetTokenInt(packetHandle, "BasicSafetyMessage", newPath);
  result = CheckLastError("BasicSafetyMessage", gkFuncRefGet, result);

  snprintf(newPath, elcount(newPath), "%s.%s", oldPath, "longOffset");
  value.longOffset = C2xGetTokenInt(packetHandle, "BasicSafetyMessage", newPath);
  result = CheckLastError("BasicSafetyMessage", gkFuncRefGet, result);

  snprintf(newPath, elcount(newPath), "%s.%s", oldPath, "elevationOffset");
  value.elevationOffset = C2xGetTokenInt(packetHandle, "BasicSafetyMessage", newPath);
  result = CheckLastError("BasicSafetyMessage", gkFuncRefGet, result);

  snprintf(newPath, elcount(newPath), "%s.%s", oldPath, "timeOffset");
  value.timeOffset = C2xGetTokenInt(packetHandle, "BasicSafetyMessage", newPath);
  result = CheckLastError("BasicSafetyMessage", gkFuncRefGet, result);

  snprintf(newPath, elcount(newPath), "%s.%s", oldPath, "accuracy");
  GetBasicSafetyMessage_Blob_PositionalAccuracyParams(packetHandle, value.accuracy, newPath);
  result = CheckLastError("BasicSafetyMessage", gkFuncRefGet, result);

  snprintf(newPath, elcount(newPath), "%s.%s", oldPath, "heading");
  value.heading = C2xGetTokenInt(packetHandle, "BasicSafetyMessage", newPath);
  result = CheckLastError("BasicSafetyMessage", gkFuncRefGet, result);

  snprintf(newPath, elcount(newPath), "%s.%s", oldPath, "speed");
  GetBasicSafetyMessage_Blob_TransmissionAndSpeedParams(packetHandle, value.speed, newPath);
  result = CheckLastError("BasicSafetyMessage", gkFuncRefGet, result);

  return result;
}

int SetBasicSafetyMessage_Blob_PathHistoryPointType_02Params(LONG packetHandle, struct BasicSafetyMessage_Blob_PathHistoryPointType_02 value, char oldPath[])
{
  char newPath[300];
  int result;

  result = 0;

  snprintf(newPath, elcount(newPath), "%s.%s", oldPath, "latOffset");
  C2xSetTokenInt(packetHandle, "BasicSafetyMessage", newPath, value.latOffset);
  result = CheckLastError("BasicSafetyMessage", gkFuncRefGet, result);

  snprintf(newPath, elcount(newPath), "%s.%s", oldPath, "longOffset");
  C2xSetTokenInt(packetHandle, "BasicSafetyMessage", newPath, value.longOffset);
  result = CheckLastError("BasicSafetyMessage", gkFuncRefGet, result);

  snprintf(newPath, elcount(newPath), "%s.%s", oldPath, "elevationOffset");
  C2xSetTokenInt(packetHandle, "BasicSafetyMessage", newPath, value.elevationOffset);
  result = CheckLastError("BasicSafetyMessage", gkFuncRefGet, result);

  snprintf(newPath, elcount(newPath), "%s.%s", oldPath, "timeOffset");
  C2xSetTokenInt(packetHandle, "BasicSafetyMessage", newPath, value.timeOffset);
  result = CheckLastError("BasicSafetyMessage", gkFuncRefGet, result);

  snprintf(newPath, elcount(newPath), "%s.%s", oldPath, "accuracy");
  SetBasicSafetyMessage_Blob_PositionalAccuracyParams(packetHandle, value.accuracy, newPath);
  result = CheckLastError("BasicSafetyMessage", gkFuncRefGet, result);

  snprintf(newPath, elcount(newPath), "%s.%s", oldPath, "heading");
  C2xSetTokenInt(packetHandle, "BasicSafetyMessage", newPath, value.heading);
  result = CheckLastError("BasicSafetyMessage", gkFuncRefGet, result);

  snprintf(newPath, elcount(newPath), "%s.%s", oldPath, "speed");
  SetBasicSafetyMessage_Blob_TransmissionAndSpeedParams(packetHandle, value.speed, newPath);
  result = CheckLastError("BasicSafetyMessage", gkFuncRefGet, result);

  return result;
}

int GetBasicSafetyMessage_Blob_PathHistory_crumbData_pathHistoryPointSets_02Params(LONG packetHandle, struct BasicSafetyMessage_Blob_PathHistory_crumbData_pathHistoryPointSets_02 value, char oldPath[])
{
  char newPath[300]; 
  int i;
  int result;

  result = 0;

  value.length = C2xGetTokenInt(packetHandle, "BasicSafetyMessage", oldPath);
  if((result = CheckLastError("BasicSafetyMessage", gkFuncRefGet, result))==0)
  {
    for(i=0; i<value.length; i++)
    {
      snprintf(newPath, elcount(newPath), "%s[%d]", oldPath, i);
      GetBasicSafetyMessage_Blob_PathHistoryPointType_02Params(packetHandle, value.arrayValue[i], newPath);
      result = CheckLastError("BasicSafetyMessage", gkFuncRefGet, result);
    }
  }
  return result;
}

int SetBasicSafetyMessage_Blob_PathHistory_crumbData_pathHistoryPointSets_02Params(LONG packetHandle, struct BasicSafetyMessage_Blob_PathHistory_crumbData_pathHistoryPointSets_02 value, char oldPath[])
{
  char newPath[300]; 
  int i;
  int result;

  result = 0;

  C2xRemoveToken(packetHandle, "BasicSafetyMessage", oldPath);
  for(i=0; i<value.length; i++)
  {
    snprintf(newPath, elcount(newPath), "%s[%d]", oldPath, i);
    SetBasicSafetyMessage_Blob_PathHistoryPointType_02Params(packetHandle, value.arrayValue[i], newPath);
    result = CheckLastError("BasicSafetyMessage", gkFuncRefGet, result);
  }
  return result;
}

int GetBasicSafetyMessage_PathHistory_crumbData_pathHistoryPointSets_02Params(LONG packetHandle, struct BasicSafetyMessage_PathHistory_crumbData_pathHistoryPointSets_02 value, char oldPath[])
{
  char newPath[300];
  int result;

  result = 0;

  snprintf(newPath, elcount(newPath), "%s.%s", oldPath, "_Blob_PathHistory_crumbData_pathHistoryPointSets_02");
  GetBasicSafetyMessage_Blob_PathHistory_crumbData_pathHistoryPointSets_02Params(packetHandle, value._Blob_PathHistory_crumbData_pathHistoryPointSets_02, newPath);
  result = CheckLastError("BasicSafetyMessage", gkFuncRefGet, result);

  return result;
}

int SetBasicSafetyMessage_PathHistory_crumbData_pathHistoryPointSets_02Params(LONG packetHandle, struct BasicSafetyMessage_PathHistory_crumbData_pathHistoryPointSets_02 value, char oldPath[])
{
  char newPath[300];
  int result;

  result = 0;

  snprintf(newPath, elcount(newPath), "%s.%s", oldPath, "_Blob_PathHistory_crumbData_pathHistoryPointSets_02");
  SetBasicSafetyMessage_Blob_PathHistory_crumbData_pathHistoryPointSets_02Params(packetHandle, value._Blob_PathHistory_crumbData_pathHistoryPointSets_02, newPath);
  result = CheckLastError("BasicSafetyMessage", gkFuncRefGet, result);

  return result;
}

int GetBasicSafetyMessage_Blob_PathHistoryPointType_03Params(LONG packetHandle, struct BasicSafetyMessage_Blob_PathHistoryPointType_03 value, char oldPath[])
{
  char newPath[300];
  int result;

  result = 0;

  snprintf(newPath, elcount(newPath), "%s.%s", oldPath, "latOffset");
  value.latOffset = C2xGetTokenInt(packetHandle, "BasicSafetyMessage", newPath);
  result = CheckLastError("BasicSafetyMessage", gkFuncRefGet, result);

  snprintf(newPath, elcount(newPath), "%s.%s", oldPath, "longOffset");
  value.longOffset = C2xGetTokenInt(packetHandle, "BasicSafetyMessage", newPath);
  result = CheckLastError("BasicSafetyMessage", gkFuncRefGet, result);

  snprintf(newPath, elcount(newPath), "%s.%s", oldPath, "elevationOffset");
  value.elevationOffset = C2xGetTokenInt(packetHandle, "BasicSafetyMessage", newPath);
  result = CheckLastError("BasicSafetyMessage", gkFuncRefGet, result);

  snprintf(newPath, elcount(newPath), "%s.%s", oldPath, "timeOffset");
  value.timeOffset = C2xGetTokenInt(packetHandle, "BasicSafetyMessage", newPath);
  result = CheckLastError("BasicSafetyMessage", gkFuncRefGet, result);

  snprintf(newPath, elcount(newPath), "%s.%s", oldPath, "accuracy");
  GetBasicSafetyMessage_Blob_PositionalAccuracyParams(packetHandle, value.accuracy, newPath);
  result = CheckLastError("BasicSafetyMessage", gkFuncRefGet, result);

  return result;
}

int SetBasicSafetyMessage_Blob_PathHistoryPointType_03Params(LONG packetHandle, struct BasicSafetyMessage_Blob_PathHistoryPointType_03 value, char oldPath[])
{
  char newPath[300];
  int result;

  result = 0;

  snprintf(newPath, elcount(newPath), "%s.%s", oldPath, "latOffset");
  C2xSetTokenInt(packetHandle, "BasicSafetyMessage", newPath, value.latOffset);
  result = CheckLastError("BasicSafetyMessage", gkFuncRefGet, result);

  snprintf(newPath, elcount(newPath), "%s.%s", oldPath, "longOffset");
  C2xSetTokenInt(packetHandle, "BasicSafetyMessage", newPath, value.longOffset);
  result = CheckLastError("BasicSafetyMessage", gkFuncRefGet, result);

  snprintf(newPath, elcount(newPath), "%s.%s", oldPath, "elevationOffset");
  C2xSetTokenInt(packetHandle, "BasicSafetyMessage", newPath, value.elevationOffset);
  result = CheckLastError("BasicSafetyMessage", gkFuncRefGet, result);

  snprintf(newPath, elcount(newPath), "%s.%s", oldPath, "timeOffset");
  C2xSetTokenInt(packetHandle, "BasicSafetyMessage", newPath, value.timeOffset);
  result = CheckLastError("BasicSafetyMessage", gkFuncRefGet, result);

  snprintf(newPath, elcount(newPath), "%s.%s", oldPath, "accuracy");
  SetBasicSafetyMessage_Blob_PositionalAccuracyParams(packetHandle, value.accuracy, newPath);
  result = CheckLastError("BasicSafetyMessage", gkFuncRefGet, result);

  return result;
}

int GetBasicSafetyMessage_Blob_PathHistory_crumbData_pathHistoryPointSets_03Params(LONG packetHandle, struct BasicSafetyMessage_Blob_PathHistory_crumbData_pathHistoryPointSets_03 value, char oldPath[])
{
  char newPath[300]; 
  int i;
  int result;

  result = 0;

  value.length = C2xGetTokenInt(packetHandle, "BasicSafetyMessage", oldPath);
  if((result = CheckLastError("BasicSafetyMessage", gkFuncRefGet, result))==0)
  {
    for(i=0; i<value.length; i++)
    {
      snprintf(newPath, elcount(newPath), "%s[%d]", oldPath, i);
      GetBasicSafetyMessage_Blob_PathHistoryPointType_03Params(packetHandle, value.arrayValue[i], newPath);
      result = CheckLastError("BasicSafetyMessage", gkFuncRefGet, result);
    }
  }
  return result;
}

int SetBasicSafetyMessage_Blob_PathHistory_crumbData_pathHistoryPointSets_03Params(LONG packetHandle, struct BasicSafetyMessage_Blob_PathHistory_crumbData_pathHistoryPointSets_03 value, char oldPath[])
{
  char newPath[300]; 
  int i;
  int result;

  result = 0;

  C2xRemoveToken(packetHandle, "BasicSafetyMessage", oldPath);
  for(i=0; i<value.length; i++)
  {
    snprintf(newPath, elcount(newPath), "%s[%d]", oldPath, i);
    SetBasicSafetyMessage_Blob_PathHistoryPointType_03Params(packetHandle, value.arrayValue[i], newPath);
    result = CheckLastError("BasicSafetyMessage", gkFuncRefGet, result);
  }
  return result;
}

int GetBasicSafetyMessage_PathHistory_crumbData_pathHistoryPointSets_03Params(LONG packetHandle, struct BasicSafetyMessage_PathHistory_crumbData_pathHistoryPointSets_03 value, char oldPath[])
{
  char newPath[300];
  int result;

  result = 0;

  snprintf(newPath, elcount(newPath), "%s.%s", oldPath, "_Blob_PathHistory_crumbData_pathHistoryPointSets_03");
  GetBasicSafetyMessage_Blob_PathHistory_crumbData_pathHistoryPointSets_03Params(packetHandle, value._Blob_PathHistory_crumbData_pathHistoryPointSets_03, newPath);
  result = CheckLastError("BasicSafetyMessage", gkFuncRefGet, result);

  return result;
}

int SetBasicSafetyMessage_PathHistory_crumbData_pathHistoryPointSets_03Params(LONG packetHandle, struct BasicSafetyMessage_PathHistory_crumbData_pathHistoryPointSets_03 value, char oldPath[])
{
  char newPath[300];
  int result;

  result = 0;

  snprintf(newPath, elcount(newPath), "%s.%s", oldPath, "_Blob_PathHistory_crumbData_pathHistoryPointSets_03");
  SetBasicSafetyMessage_Blob_PathHistory_crumbData_pathHistoryPointSets_03Params(packetHandle, value._Blob_PathHistory_crumbData_pathHistoryPointSets_03, newPath);
  result = CheckLastError("BasicSafetyMessage", gkFuncRefGet, result);

  return result;
}

int GetBasicSafetyMessage_Blob_PathHistoryPointType_04Params(LONG packetHandle, struct BasicSafetyMessage_Blob_PathHistoryPointType_04 value, char oldPath[])
{
  char newPath[300];
  int result;

  result = 0;

  snprintf(newPath, elcount(newPath), "%s.%s", oldPath, "latOffset");
  value.latOffset = C2xGetTokenInt(packetHandle, "BasicSafetyMessage", newPath);
  result = CheckLastError("BasicSafetyMessage", gkFuncRefGet, result);

  snprintf(newPath, elcount(newPath), "%s.%s", oldPath, "longOffset");
  value.longOffset = C2xGetTokenInt(packetHandle, "BasicSafetyMessage", newPath);
  result = CheckLastError("BasicSafetyMessage", gkFuncRefGet, result);

  snprintf(newPath, elcount(newPath), "%s.%s", oldPath, "elevationOffset");
  value.elevationOffset = C2xGetTokenInt(packetHandle, "BasicSafetyMessage", newPath);
  result = CheckLastError("BasicSafetyMessage", gkFuncRefGet, result);

  snprintf(newPath, elcount(newPath), "%s.%s", oldPath, "timeOffset");
  value.timeOffset = C2xGetTokenInt(packetHandle, "BasicSafetyMessage", newPath);
  result = CheckLastError("BasicSafetyMessage", gkFuncRefGet, result);

  return result;
}

int SetBasicSafetyMessage_Blob_PathHistoryPointType_04Params(LONG packetHandle, struct BasicSafetyMessage_Blob_PathHistoryPointType_04 value, char oldPath[])
{
  char newPath[300];
  int result;

  result = 0;

  snprintf(newPath, elcount(newPath), "%s.%s", oldPath, "latOffset");
  C2xSetTokenInt(packetHandle, "BasicSafetyMessage", newPath, value.latOffset);
  result = CheckLastError("BasicSafetyMessage", gkFuncRefGet, result);

  snprintf(newPath, elcount(newPath), "%s.%s", oldPath, "longOffset");
  C2xSetTokenInt(packetHandle, "BasicSafetyMessage", newPath, value.longOffset);
  result = CheckLastError("BasicSafetyMessage", gkFuncRefGet, result);

  snprintf(newPath, elcount(newPath), "%s.%s", oldPath, "elevationOffset");
  C2xSetTokenInt(packetHandle, "BasicSafetyMessage", newPath, value.elevationOffset);
  result = CheckLastError("BasicSafetyMessage", gkFuncRefGet, result);

  snprintf(newPath, elcount(newPath), "%s.%s", oldPath, "timeOffset");
  C2xSetTokenInt(packetHandle, "BasicSafetyMessage", newPath, value.timeOffset);
  result = CheckLastError("BasicSafetyMessage", gkFuncRefGet, result);

  return result;
}

int GetBasicSafetyMessage_Blob_PathHistory_crumbData_pathHistoryPointSets_04Params(LONG packetHandle, struct BasicSafetyMessage_Blob_PathHistory_crumbData_pathHistoryPointSets_04 value, char oldPath[])
{
  char newPath[300]; 
  int i;
  int result;

  result = 0;

  value.length = C2xGetTokenInt(packetHandle, "BasicSafetyMessage", oldPath);
  if((result = CheckLastError("BasicSafetyMessage", gkFuncRefGet, result))==0)
  {
    for(i=0; i<value.length; i++)
    {
      snprintf(newPath, elcount(newPath), "%s[%d]", oldPath, i);
      GetBasicSafetyMessage_Blob_PathHistoryPointType_04Params(packetHandle, value.arrayValue[i], newPath);
      result = CheckLastError("BasicSafetyMessage", gkFuncRefGet, result);
    }
  }
  return result;
}

int SetBasicSafetyMessage_Blob_PathHistory_crumbData_pathHistoryPointSets_04Params(LONG packetHandle, struct BasicSafetyMessage_Blob_PathHistory_crumbData_pathHistoryPointSets_04 value, char oldPath[])
{
  char newPath[300]; 
  int i;
  int result;

  result = 0;

  C2xRemoveToken(packetHandle, "BasicSafetyMessage", oldPath);
  for(i=0; i<value.length; i++)
  {
    snprintf(newPath, elcount(newPath), "%s[%d]", oldPath, i);
    SetBasicSafetyMessage_Blob_PathHistoryPointType_04Params(packetHandle, value.arrayValue[i], newPath);
    result = CheckLastError("BasicSafetyMessage", gkFuncRefGet, result);
  }
  return result;
}

int GetBasicSafetyMessage_PathHistory_crumbData_pathHistoryPointSets_04Params(LONG packetHandle, struct BasicSafetyMessage_PathHistory_crumbData_pathHistoryPointSets_04 value, char oldPath[])
{
  char newPath[300];
  int result;

  result = 0;

  snprintf(newPath, elcount(newPath), "%s.%s", oldPath, "_Blob_PathHistory_crumbData_pathHistoryPointSets_04");
  GetBasicSafetyMessage_Blob_PathHistory_crumbData_pathHistoryPointSets_04Params(packetHandle, value._Blob_PathHistory_crumbData_pathHistoryPointSets_04, newPath);
  result = CheckLastError("BasicSafetyMessage", gkFuncRefGet, result);

  return result;
}

int SetBasicSafetyMessage_PathHistory_crumbData_pathHistoryPointSets_04Params(LONG packetHandle, struct BasicSafetyMessage_PathHistory_crumbData_pathHistoryPointSets_04 value, char oldPath[])
{
  char newPath[300];
  int result;

  result = 0;

  snprintf(newPath, elcount(newPath), "%s.%s", oldPath, "_Blob_PathHistory_crumbData_pathHistoryPointSets_04");
  SetBasicSafetyMessage_Blob_PathHistory_crumbData_pathHistoryPointSets_04Params(packetHandle, value._Blob_PathHistory_crumbData_pathHistoryPointSets_04, newPath);
  result = CheckLastError("BasicSafetyMessage", gkFuncRefGet, result);

  return result;
}

int GetBasicSafetyMessage_Blob_PathHistoryPointType_05Params(LONG packetHandle, struct BasicSafetyMessage_Blob_PathHistoryPointType_05 value, char oldPath[])
{
  char newPath[300];
  int result;

  result = 0;

  snprintf(newPath, elcount(newPath), "%s.%s", oldPath, "latOffset");
  value.latOffset = C2xGetTokenInt(packetHandle, "BasicSafetyMessage", newPath);
  result = CheckLastError("BasicSafetyMessage", gkFuncRefGet, result);

  snprintf(newPath, elcount(newPath), "%s.%s", oldPath, "longOffset");
  value.longOffset = C2xGetTokenInt(packetHandle, "BasicSafetyMessage", newPath);
  result = CheckLastError("BasicSafetyMessage", gkFuncRefGet, result);

  snprintf(newPath, elcount(newPath), "%s.%s", oldPath, "elevationOffset");
  value.elevationOffset = C2xGetTokenInt(packetHandle, "BasicSafetyMessage", newPath);
  result = CheckLastError("BasicSafetyMessage", gkFuncRefGet, result);

  snprintf(newPath, elcount(newPath), "%s.%s", oldPath, "accuracy");
  GetBasicSafetyMessage_Blob_PositionalAccuracyParams(packetHandle, value.accuracy, newPath);
  result = CheckLastError("BasicSafetyMessage", gkFuncRefGet, result);

  return result;
}

int SetBasicSafetyMessage_Blob_PathHistoryPointType_05Params(LONG packetHandle, struct BasicSafetyMessage_Blob_PathHistoryPointType_05 value, char oldPath[])
{
  char newPath[300];
  int result;

  result = 0;

  snprintf(newPath, elcount(newPath), "%s.%s", oldPath, "latOffset");
  C2xSetTokenInt(packetHandle, "BasicSafetyMessage", newPath, value.latOffset);
  result = CheckLastError("BasicSafetyMessage", gkFuncRefGet, result);

  snprintf(newPath, elcount(newPath), "%s.%s", oldPath, "longOffset");
  C2xSetTokenInt(packetHandle, "BasicSafetyMessage", newPath, value.longOffset);
  result = CheckLastError("BasicSafetyMessage", gkFuncRefGet, result);

  snprintf(newPath, elcount(newPath), "%s.%s", oldPath, "elevationOffset");
  C2xSetTokenInt(packetHandle, "BasicSafetyMessage", newPath, value.elevationOffset);
  result = CheckLastError("BasicSafetyMessage", gkFuncRefGet, result);

  snprintf(newPath, elcount(newPath), "%s.%s", oldPath, "accuracy");
  SetBasicSafetyMessage_Blob_PositionalAccuracyParams(packetHandle, value.accuracy, newPath);
  result = CheckLastError("BasicSafetyMessage", gkFuncRefGet, result);

  return result;
}

int GetBasicSafetyMessage_Blob_PathHistory_crumbData_pathHistoryPointSets_05Params(LONG packetHandle, struct BasicSafetyMessage_Blob_PathHistory_crumbData_pathHistoryPointSets_05 value, char oldPath[])
{
  char newPath[300]; 
  int i;
  int result;

  result = 0;

  value.length = C2xGetTokenInt(packetHandle, "BasicSafetyMessage", oldPath);
  if((result = CheckLastError("BasicSafetyMessage", gkFuncRefGet, result))==0)
  {
    for(i=0; i<value.length; i++)
    {
      snprintf(newPath, elcount(newPath), "%s[%d]", oldPath, i);
      GetBasicSafetyMessage_Blob_PathHistoryPointType_05Params(packetHandle, value.arrayValue[i], newPath);
      result = CheckLastError("BasicSafetyMessage", gkFuncRefGet, result);
    }
  }
  return result;
}

int SetBasicSafetyMessage_Blob_PathHistory_crumbData_pathHistoryPointSets_05Params(LONG packetHandle, struct BasicSafetyMessage_Blob_PathHistory_crumbData_pathHistoryPointSets_05 value, char oldPath[])
{
  char newPath[300]; 
  int i;
  int result;

  result = 0;

  C2xRemoveToken(packetHandle, "BasicSafetyMessage", oldPath);
  for(i=0; i<value.length; i++)
  {
    snprintf(newPath, elcount(newPath), "%s[%d]", oldPath, i);
    SetBasicSafetyMessage_Blob_PathHistoryPointType_05Params(packetHandle, value.arrayValue[i], newPath);
    result = CheckLastError("BasicSafetyMessage", gkFuncRefGet, result);
  }
  return result;
}

int GetBasicSafetyMessage_PathHistory_crumbData_pathHistoryPointSets_05Params(LONG packetHandle, struct BasicSafetyMessage_PathHistory_crumbData_pathHistoryPointSets_05 value, char oldPath[])
{
  char newPath[300];
  int result;

  result = 0;

  snprintf(newPath, elcount(newPath), "%s.%s", oldPath, "_Blob_PathHistory_crumbData_pathHistoryPointSets_05");
  GetBasicSafetyMessage_Blob_PathHistory_crumbData_pathHistoryPointSets_05Params(packetHandle, value._Blob_PathHistory_crumbData_pathHistoryPointSets_05, newPath);
  result = CheckLastError("BasicSafetyMessage", gkFuncRefGet, result);

  return result;
}

int SetBasicSafetyMessage_PathHistory_crumbData_pathHistoryPointSets_05Params(LONG packetHandle, struct BasicSafetyMessage_PathHistory_crumbData_pathHistoryPointSets_05 value, char oldPath[])
{
  char newPath[300];
  int result;

  result = 0;

  snprintf(newPath, elcount(newPath), "%s.%s", oldPath, "_Blob_PathHistory_crumbData_pathHistoryPointSets_05");
  SetBasicSafetyMessage_Blob_PathHistory_crumbData_pathHistoryPointSets_05Params(packetHandle, value._Blob_PathHistory_crumbData_pathHistoryPointSets_05, newPath);
  result = CheckLastError("BasicSafetyMessage", gkFuncRefGet, result);

  return result;
}

int GetBasicSafetyMessage_Blob_PathHistoryPointType_06Params(LONG packetHandle, struct BasicSafetyMessage_Blob_PathHistoryPointType_06 value, char oldPath[])
{
  char newPath[300];
  int result;

  result = 0;

  snprintf(newPath, elcount(newPath), "%s.%s", oldPath, "latOffset");
  value.latOffset = C2xGetTokenInt(packetHandle, "BasicSafetyMessage", newPath);
  result = CheckLastError("BasicSafetyMessage", gkFuncRefGet, result);

  snprintf(newPath, elcount(newPath), "%s.%s", oldPath, "longOffset");
  value.longOffset = C2xGetTokenInt(packetHandle, "BasicSafetyMessage", newPath);
  result = CheckLastError("BasicSafetyMessage", gkFuncRefGet, result);

  snprintf(newPath, elcount(newPath), "%s.%s", oldPath, "elevationOffset");
  value.elevationOffset = C2xGetTokenInt(packetHandle, "BasicSafetyMessage", newPath);
  result = CheckLastError("BasicSafetyMessage", gkFuncRefGet, result);

  return result;
}

int SetBasicSafetyMessage_Blob_PathHistoryPointType_06Params(LONG packetHandle, struct BasicSafetyMessage_Blob_PathHistoryPointType_06 value, char oldPath[])
{
  char newPath[300];
  int result;

  result = 0;

  snprintf(newPath, elcount(newPath), "%s.%s", oldPath, "latOffset");
  C2xSetTokenInt(packetHandle, "BasicSafetyMessage", newPath, value.latOffset);
  result = CheckLastError("BasicSafetyMessage", gkFuncRefGet, result);

  snprintf(newPath, elcount(newPath), "%s.%s", oldPath, "longOffset");
  C2xSetTokenInt(packetHandle, "BasicSafetyMessage", newPath, value.longOffset);
  result = CheckLastError("BasicSafetyMessage", gkFuncRefGet, result);

  snprintf(newPath, elcount(newPath), "%s.%s", oldPath, "elevationOffset");
  C2xSetTokenInt(packetHandle, "BasicSafetyMessage", newPath, value.elevationOffset);
  result = CheckLastError("BasicSafetyMessage", gkFuncRefGet, result);

  return result;
}

int GetBasicSafetyMessage_Blob_PathHistory_crumbData_pathHistoryPointSets_06Params(LONG packetHandle, struct BasicSafetyMessage_Blob_PathHistory_crumbData_pathHistoryPointSets_06 value, char oldPath[])
{
  char newPath[300]; 
  int i;
  int result;

  result = 0;

  value.length = C2xGetTokenInt(packetHandle, "BasicSafetyMessage", oldPath);
  if((result = CheckLastError("BasicSafetyMessage", gkFuncRefGet, result))==0)
  {
    for(i=0; i<value.length; i++)
    {
      snprintf(newPath, elcount(newPath), "%s[%d]", oldPath, i);
      GetBasicSafetyMessage_Blob_PathHistoryPointType_06Params(packetHandle, value.arrayValue[i], newPath);
      result = CheckLastError("BasicSafetyMessage", gkFuncRefGet, result);
    }
  }
  return result;
}

int SetBasicSafetyMessage_Blob_PathHistory_crumbData_pathHistoryPointSets_06Params(LONG packetHandle, struct BasicSafetyMessage_Blob_PathHistory_crumbData_pathHistoryPointSets_06 value, char oldPath[])
{
  char newPath[300]; 
  int i;
  int result;

  result = 0;

  C2xRemoveToken(packetHandle, "BasicSafetyMessage", oldPath);
  for(i=0; i<value.length; i++)
  {
    snprintf(newPath, elcount(newPath), "%s[%d]", oldPath, i);
    SetBasicSafetyMessage_Blob_PathHistoryPointType_06Params(packetHandle, value.arrayValue[i], newPath);
    result = CheckLastError("BasicSafetyMessage", gkFuncRefGet, result);
  }
  return result;
}

int GetBasicSafetyMessage_PathHistory_crumbData_pathHistoryPointSets_06Params(LONG packetHandle, struct BasicSafetyMessage_PathHistory_crumbData_pathHistoryPointSets_06 value, char oldPath[])
{
  char newPath[300];
  int result;

  result = 0;

  snprintf(newPath, elcount(newPath), "%s.%s", oldPath, "_Blob_PathHistory_crumbData_pathHistoryPointSets_06");
  GetBasicSafetyMessage_Blob_PathHistory_crumbData_pathHistoryPointSets_06Params(packetHandle, value._Blob_PathHistory_crumbData_pathHistoryPointSets_06, newPath);
  result = CheckLastError("BasicSafetyMessage", gkFuncRefGet, result);

  return result;
}

int SetBasicSafetyMessage_PathHistory_crumbData_pathHistoryPointSets_06Params(LONG packetHandle, struct BasicSafetyMessage_PathHistory_crumbData_pathHistoryPointSets_06 value, char oldPath[])
{
  char newPath[300];
  int result;

  result = 0;

  snprintf(newPath, elcount(newPath), "%s.%s", oldPath, "_Blob_PathHistory_crumbData_pathHistoryPointSets_06");
  SetBasicSafetyMessage_Blob_PathHistory_crumbData_pathHistoryPointSets_06Params(packetHandle, value._Blob_PathHistory_crumbData_pathHistoryPointSets_06, newPath);
  result = CheckLastError("BasicSafetyMessage", gkFuncRefGet, result);

  return result;
}

int GetBasicSafetyMessage_Blob_PathHistoryPointType_07Params(LONG packetHandle, struct BasicSafetyMessage_Blob_PathHistoryPointType_07 value, char oldPath[])
{
  char newPath[300];
  int result;

  result = 0;

  snprintf(newPath, elcount(newPath), "%s.%s", oldPath, "latOffset");
  value.latOffset = C2xGetTokenInt(packetHandle, "BasicSafetyMessage", newPath);
  result = CheckLastError("BasicSafetyMessage", gkFuncRefGet, result);

  snprintf(newPath, elcount(newPath), "%s.%s", oldPath, "longOffset");
  value.longOffset = C2xGetTokenInt(packetHandle, "BasicSafetyMessage", newPath);
  result = CheckLastError("BasicSafetyMessage", gkFuncRefGet, result);

  snprintf(newPath, elcount(newPath), "%s.%s", oldPath, "timeOffset");
  value.timeOffset = C2xGetTokenInt(packetHandle, "BasicSafetyMessage", newPath);
  result = CheckLastError("BasicSafetyMessage", gkFuncRefGet, result);

  snprintf(newPath, elcount(newPath), "%s.%s", oldPath, "accuracy");
  GetBasicSafetyMessage_Blob_PositionalAccuracyParams(packetHandle, value.accuracy, newPath);
  result = CheckLastError("BasicSafetyMessage", gkFuncRefGet, result);

  return result;
}

int SetBasicSafetyMessage_Blob_PathHistoryPointType_07Params(LONG packetHandle, struct BasicSafetyMessage_Blob_PathHistoryPointType_07 value, char oldPath[])
{
  char newPath[300];
  int result;

  result = 0;

  snprintf(newPath, elcount(newPath), "%s.%s", oldPath, "latOffset");
  C2xSetTokenInt(packetHandle, "BasicSafetyMessage", newPath, value.latOffset);
  result = CheckLastError("BasicSafetyMessage", gkFuncRefGet, result);

  snprintf(newPath, elcount(newPath), "%s.%s", oldPath, "longOffset");
  C2xSetTokenInt(packetHandle, "BasicSafetyMessage", newPath, value.longOffset);
  result = CheckLastError("BasicSafetyMessage", gkFuncRefGet, result);

  snprintf(newPath, elcount(newPath), "%s.%s", oldPath, "timeOffset");
  C2xSetTokenInt(packetHandle, "BasicSafetyMessage", newPath, value.timeOffset);
  result = CheckLastError("BasicSafetyMessage", gkFuncRefGet, result);

  snprintf(newPath, elcount(newPath), "%s.%s", oldPath, "accuracy");
  SetBasicSafetyMessage_Blob_PositionalAccuracyParams(packetHandle, value.accuracy, newPath);
  result = CheckLastError("BasicSafetyMessage", gkFuncRefGet, result);

  return result;
}

int GetBasicSafetyMessage_Blob_PathHistory_crumbData_pathHistoryPointSets_07Params(LONG packetHandle, struct BasicSafetyMessage_Blob_PathHistory_crumbData_pathHistoryPointSets_07 value, char oldPath[])
{
  char newPath[300]; 
  int i;
  int result;

  result = 0;

  value.length = C2xGetTokenInt(packetHandle, "BasicSafetyMessage", oldPath);
  if((result = CheckLastError("BasicSafetyMessage", gkFuncRefGet, result))==0)
  {
    for(i=0; i<value.length; i++)
    {
      snprintf(newPath, elcount(newPath), "%s[%d]", oldPath, i);
      GetBasicSafetyMessage_Blob_PathHistoryPointType_07Params(packetHandle, value.arrayValue[i], newPath);
      result = CheckLastError("BasicSafetyMessage", gkFuncRefGet, result);
    }
  }
  return result;
}

int SetBasicSafetyMessage_Blob_PathHistory_crumbData_pathHistoryPointSets_07Params(LONG packetHandle, struct BasicSafetyMessage_Blob_PathHistory_crumbData_pathHistoryPointSets_07 value, char oldPath[])
{
  char newPath[300]; 
  int i;
  int result;

  result = 0;

  C2xRemoveToken(packetHandle, "BasicSafetyMessage", oldPath);
  for(i=0; i<value.length; i++)
  {
    snprintf(newPath, elcount(newPath), "%s[%d]", oldPath, i);
    SetBasicSafetyMessage_Blob_PathHistoryPointType_07Params(packetHandle, value.arrayValue[i], newPath);
    result = CheckLastError("BasicSafetyMessage", gkFuncRefGet, result);
  }
  return result;
}

int GetBasicSafetyMessage_PathHistory_crumbData_pathHistoryPointSets_07Params(LONG packetHandle, struct BasicSafetyMessage_PathHistory_crumbData_pathHistoryPointSets_07 value, char oldPath[])
{
  char newPath[300];
  int result;

  result = 0;

  snprintf(newPath, elcount(newPath), "%s.%s", oldPath, "_Blob_PathHistory_crumbData_pathHistoryPointSets_07");
  GetBasicSafetyMessage_Blob_PathHistory_crumbData_pathHistoryPointSets_07Params(packetHandle, value._Blob_PathHistory_crumbData_pathHistoryPointSets_07, newPath);
  result = CheckLastError("BasicSafetyMessage", gkFuncRefGet, result);

  return result;
}

int SetBasicSafetyMessage_PathHistory_crumbData_pathHistoryPointSets_07Params(LONG packetHandle, struct BasicSafetyMessage_PathHistory_crumbData_pathHistoryPointSets_07 value, char oldPath[])
{
  char newPath[300];
  int result;

  result = 0;

  snprintf(newPath, elcount(newPath), "%s.%s", oldPath, "_Blob_PathHistory_crumbData_pathHistoryPointSets_07");
  SetBasicSafetyMessage_Blob_PathHistory_crumbData_pathHistoryPointSets_07Params(packetHandle, value._Blob_PathHistory_crumbData_pathHistoryPointSets_07, newPath);
  result = CheckLastError("BasicSafetyMessage", gkFuncRefGet, result);

  return result;
}

int GetBasicSafetyMessage_Blob_PathHistoryPointType_08Params(LONG packetHandle, struct BasicSafetyMessage_Blob_PathHistoryPointType_08 value, char oldPath[])
{
  char newPath[300];
  int result;

  result = 0;

  snprintf(newPath, elcount(newPath), "%s.%s", oldPath, "latOffset");
  value.latOffset = C2xGetTokenInt(packetHandle, "BasicSafetyMessage", newPath);
  result = CheckLastError("BasicSafetyMessage", gkFuncRefGet, result);

  snprintf(newPath, elcount(newPath), "%s.%s", oldPath, "longOffset");
  value.longOffset = C2xGetTokenInt(packetHandle, "BasicSafetyMessage", newPath);
  result = CheckLastError("BasicSafetyMessage", gkFuncRefGet, result);

  snprintf(newPath, elcount(newPath), "%s.%s", oldPath, "timeOffset");
  value.timeOffset = C2xGetTokenInt(packetHandle, "BasicSafetyMessage", newPath);
  result = CheckLastError("BasicSafetyMessage", gkFuncRefGet, result);

  return result;
}

int SetBasicSafetyMessage_Blob_PathHistoryPointType_08Params(LONG packetHandle, struct BasicSafetyMessage_Blob_PathHistoryPointType_08 value, char oldPath[])
{
  char newPath[300];
  int result;

  result = 0;

  snprintf(newPath, elcount(newPath), "%s.%s", oldPath, "latOffset");
  C2xSetTokenInt(packetHandle, "BasicSafetyMessage", newPath, value.latOffset);
  result = CheckLastError("BasicSafetyMessage", gkFuncRefGet, result);

  snprintf(newPath, elcount(newPath), "%s.%s", oldPath, "longOffset");
  C2xSetTokenInt(packetHandle, "BasicSafetyMessage", newPath, value.longOffset);
  result = CheckLastError("BasicSafetyMessage", gkFuncRefGet, result);

  snprintf(newPath, elcount(newPath), "%s.%s", oldPath, "timeOffset");
  C2xSetTokenInt(packetHandle, "BasicSafetyMessage", newPath, value.timeOffset);
  result = CheckLastError("BasicSafetyMessage", gkFuncRefGet, result);

  return result;
}

int GetBasicSafetyMessage_Blob_PathHistory_crumbData_pathHistoryPointSets_08Params(LONG packetHandle, struct BasicSafetyMessage_Blob_PathHistory_crumbData_pathHistoryPointSets_08 value, char oldPath[])
{
  char newPath[300]; 
  int i;
  int result;

  result = 0;

  value.length = C2xGetTokenInt(packetHandle, "BasicSafetyMessage", oldPath);
  if((result = CheckLastError("BasicSafetyMessage", gkFuncRefGet, result))==0)
  {
    for(i=0; i<value.length; i++)
    {
      snprintf(newPath, elcount(newPath), "%s[%d]", oldPath, i);
      GetBasicSafetyMessage_Blob_PathHistoryPointType_08Params(packetHandle, value.arrayValue[i], newPath);
      result = CheckLastError("BasicSafetyMessage", gkFuncRefGet, result);
    }
  }
  return result;
}

int SetBasicSafetyMessage_Blob_PathHistory_crumbData_pathHistoryPointSets_08Params(LONG packetHandle, struct BasicSafetyMessage_Blob_PathHistory_crumbData_pathHistoryPointSets_08 value, char oldPath[])
{
  char newPath[300]; 
  int i;
  int result;

  result = 0;

  C2xRemoveToken(packetHandle, "BasicSafetyMessage", oldPath);
  for(i=0; i<value.length; i++)
  {
    snprintf(newPath, elcount(newPath), "%s[%d]", oldPath, i);
    SetBasicSafetyMessage_Blob_PathHistoryPointType_08Params(packetHandle, value.arrayValue[i], newPath);
    result = CheckLastError("BasicSafetyMessage", gkFuncRefGet, result);
  }
  return result;
}

int GetBasicSafetyMessage_PathHistory_crumbData_pathHistoryPointSets_08Params(LONG packetHandle, struct BasicSafetyMessage_PathHistory_crumbData_pathHistoryPointSets_08 value, char oldPath[])
{
  char newPath[300];
  int result;

  result = 0;

  snprintf(newPath, elcount(newPath), "%s.%s", oldPath, "_Blob_PathHistory_crumbData_pathHistoryPointSets_08");
  GetBasicSafetyMessage_Blob_PathHistory_crumbData_pathHistoryPointSets_08Params(packetHandle, value._Blob_PathHistory_crumbData_pathHistoryPointSets_08, newPath);
  result = CheckLastError("BasicSafetyMessage", gkFuncRefGet, result);

  return result;
}

int SetBasicSafetyMessage_PathHistory_crumbData_pathHistoryPointSets_08Params(LONG packetHandle, struct BasicSafetyMessage_PathHistory_crumbData_pathHistoryPointSets_08 value, char oldPath[])
{
  char newPath[300];
  int result;

  result = 0;

  snprintf(newPath, elcount(newPath), "%s.%s", oldPath, "_Blob_PathHistory_crumbData_pathHistoryPointSets_08");
  SetBasicSafetyMessage_Blob_PathHistory_crumbData_pathHistoryPointSets_08Params(packetHandle, value._Blob_PathHistory_crumbData_pathHistoryPointSets_08, newPath);
  result = CheckLastError("BasicSafetyMessage", gkFuncRefGet, result);

  return result;
}

int GetBasicSafetyMessage_Blob_PathHistoryPointType_09Params(LONG packetHandle, struct BasicSafetyMessage_Blob_PathHistoryPointType_09 value, char oldPath[])
{
  char newPath[300];
  int result;

  result = 0;

  snprintf(newPath, elcount(newPath), "%s.%s", oldPath, "latOffset");
  value.latOffset = C2xGetTokenInt(packetHandle, "BasicSafetyMessage", newPath);
  result = CheckLastError("BasicSafetyMessage", gkFuncRefGet, result);

  snprintf(newPath, elcount(newPath), "%s.%s", oldPath, "longOffset");
  value.longOffset = C2xGetTokenInt(packetHandle, "BasicSafetyMessage", newPath);
  result = CheckLastError("BasicSafetyMessage", gkFuncRefGet, result);

  snprintf(newPath, elcount(newPath), "%s.%s", oldPath, "accuracy");
  GetBasicSafetyMessage_Blob_PositionalAccuracyParams(packetHandle, value.accuracy, newPath);
  result = CheckLastError("BasicSafetyMessage", gkFuncRefGet, result);

  return result;
}

int SetBasicSafetyMessage_Blob_PathHistoryPointType_09Params(LONG packetHandle, struct BasicSafetyMessage_Blob_PathHistoryPointType_09 value, char oldPath[])
{
  char newPath[300];
  int result;

  result = 0;

  snprintf(newPath, elcount(newPath), "%s.%s", oldPath, "latOffset");
  C2xSetTokenInt(packetHandle, "BasicSafetyMessage", newPath, value.latOffset);
  result = CheckLastError("BasicSafetyMessage", gkFuncRefGet, result);

  snprintf(newPath, elcount(newPath), "%s.%s", oldPath, "longOffset");
  C2xSetTokenInt(packetHandle, "BasicSafetyMessage", newPath, value.longOffset);
  result = CheckLastError("BasicSafetyMessage", gkFuncRefGet, result);

  snprintf(newPath, elcount(newPath), "%s.%s", oldPath, "accuracy");
  SetBasicSafetyMessage_Blob_PositionalAccuracyParams(packetHandle, value.accuracy, newPath);
  result = CheckLastError("BasicSafetyMessage", gkFuncRefGet, result);

  return result;
}

int GetBasicSafetyMessage_Blob_PathHistory_crumbData_pathHistoryPointSets_09Params(LONG packetHandle, struct BasicSafetyMessage_Blob_PathHistory_crumbData_pathHistoryPointSets_09 value, char oldPath[])
{
  char newPath[300]; 
  int i;
  int result;

  result = 0;

  value.length = C2xGetTokenInt(packetHandle, "BasicSafetyMessage", oldPath);
  if((result = CheckLastError("BasicSafetyMessage", gkFuncRefGet, result))==0)
  {
    for(i=0; i<value.length; i++)
    {
      snprintf(newPath, elcount(newPath), "%s[%d]", oldPath, i);
      GetBasicSafetyMessage_Blob_PathHistoryPointType_09Params(packetHandle, value.arrayValue[i], newPath);
      result = CheckLastError("BasicSafetyMessage", gkFuncRefGet, result);
    }
  }
  return result;
}

int SetBasicSafetyMessage_Blob_PathHistory_crumbData_pathHistoryPointSets_09Params(LONG packetHandle, struct BasicSafetyMessage_Blob_PathHistory_crumbData_pathHistoryPointSets_09 value, char oldPath[])
{
  char newPath[300]; 
  int i;
  int result;

  result = 0;

  C2xRemoveToken(packetHandle, "BasicSafetyMessage", oldPath);
  for(i=0; i<value.length; i++)
  {
    snprintf(newPath, elcount(newPath), "%s[%d]", oldPath, i);
    SetBasicSafetyMessage_Blob_PathHistoryPointType_09Params(packetHandle, value.arrayValue[i], newPath);
    result = CheckLastError("BasicSafetyMessage", gkFuncRefGet, result);
  }
  return result;
}

int GetBasicSafetyMessage_PathHistory_crumbData_pathHistoryPointSets_09Params(LONG packetHandle, struct BasicSafetyMessage_PathHistory_crumbData_pathHistoryPointSets_09 value, char oldPath[])
{
  char newPath[300];
  int result;

  result = 0;

  snprintf(newPath, elcount(newPath), "%s.%s", oldPath, "_Blob_PathHistory_crumbData_pathHistoryPointSets_09");
  GetBasicSafetyMessage_Blob_PathHistory_crumbData_pathHistoryPointSets_09Params(packetHandle, value._Blob_PathHistory_crumbData_pathHistoryPointSets_09, newPath);
  result = CheckLastError("BasicSafetyMessage", gkFuncRefGet, result);

  return result;
}

int SetBasicSafetyMessage_PathHistory_crumbData_pathHistoryPointSets_09Params(LONG packetHandle, struct BasicSafetyMessage_PathHistory_crumbData_pathHistoryPointSets_09 value, char oldPath[])
{
  char newPath[300];
  int result;

  result = 0;

  snprintf(newPath, elcount(newPath), "%s.%s", oldPath, "_Blob_PathHistory_crumbData_pathHistoryPointSets_09");
  SetBasicSafetyMessage_Blob_PathHistory_crumbData_pathHistoryPointSets_09Params(packetHandle, value._Blob_PathHistory_crumbData_pathHistoryPointSets_09, newPath);
  result = CheckLastError("BasicSafetyMessage", gkFuncRefGet, result);

  return result;
}

int GetBasicSafetyMessage_Blob_PathHistoryPointType_10Params(LONG packetHandle, struct BasicSafetyMessage_Blob_PathHistoryPointType_10 value, char oldPath[])
{
  char newPath[300];
  int result;

  result = 0;

  snprintf(newPath, elcount(newPath), "%s.%s", oldPath, "latOffset");
  value.latOffset = C2xGetTokenInt(packetHandle, "BasicSafetyMessage", newPath);
  result = CheckLastError("BasicSafetyMessage", gkFuncRefGet, result);

  snprintf(newPath, elcount(newPath), "%s.%s", oldPath, "longOffset");
  value.longOffset = C2xGetTokenInt(packetHandle, "BasicSafetyMessage", newPath);
  result = CheckLastError("BasicSafetyMessage", gkFuncRefGet, result);

  return result;
}

int SetBasicSafetyMessage_Blob_PathHistoryPointType_10Params(LONG packetHandle, struct BasicSafetyMessage_Blob_PathHistoryPointType_10 value, char oldPath[])
{
  char newPath[300];
  int result;

  result = 0;

  snprintf(newPath, elcount(newPath), "%s.%s", oldPath, "latOffset");
  C2xSetTokenInt(packetHandle, "BasicSafetyMessage", newPath, value.latOffset);
  result = CheckLastError("BasicSafetyMessage", gkFuncRefGet, result);

  snprintf(newPath, elcount(newPath), "%s.%s", oldPath, "longOffset");
  C2xSetTokenInt(packetHandle, "BasicSafetyMessage", newPath, value.longOffset);
  result = CheckLastError("BasicSafetyMessage", gkFuncRefGet, result);

  return result;
}

int GetBasicSafetyMessage_Blob_PathHistory_crumbData_pathHistoryPointSets_10Params(LONG packetHandle, struct BasicSafetyMessage_Blob_PathHistory_crumbData_pathHistoryPointSets_10 value, char oldPath[])
{
  char newPath[300]; 
  int i;
  int result;

  result = 0;

  value.length = C2xGetTokenInt(packetHandle, "BasicSafetyMessage", oldPath);
  if((result = CheckLastError("BasicSafetyMessage", gkFuncRefGet, result))==0)
  {
    for(i=0; i<value.length; i++)
    {
      snprintf(newPath, elcount(newPath), "%s[%d]", oldPath, i);
      GetBasicSafetyMessage_Blob_PathHistoryPointType_10Params(packetHandle, value.arrayValue[i], newPath);
      result = CheckLastError("BasicSafetyMessage", gkFuncRefGet, result);
    }
  }
  return result;
}

int SetBasicSafetyMessage_Blob_PathHistory_crumbData_pathHistoryPointSets_10Params(LONG packetHandle, struct BasicSafetyMessage_Blob_PathHistory_crumbData_pathHistoryPointSets_10 value, char oldPath[])
{
  char newPath[300]; 
  int i;
  int result;

  result = 0;

  C2xRemoveToken(packetHandle, "BasicSafetyMessage", oldPath);
  for(i=0; i<value.length; i++)
  {
    snprintf(newPath, elcount(newPath), "%s[%d]", oldPath, i);
    SetBasicSafetyMessage_Blob_PathHistoryPointType_10Params(packetHandle, value.arrayValue[i], newPath);
    result = CheckLastError("BasicSafetyMessage", gkFuncRefGet, result);
  }
  return result;
}

int GetBasicSafetyMessage_PathHistory_crumbData_pathHistoryPointSets_10Params(LONG packetHandle, struct BasicSafetyMessage_PathHistory_crumbData_pathHistoryPointSets_10 value, char oldPath[])
{
  char newPath[300];
  int result;

  result = 0;

  snprintf(newPath, elcount(newPath), "%s.%s", oldPath, "_Blob_PathHistory_crumbData_pathHistoryPointSets_10");
  GetBasicSafetyMessage_Blob_PathHistory_crumbData_pathHistoryPointSets_10Params(packetHandle, value._Blob_PathHistory_crumbData_pathHistoryPointSets_10, newPath);
  result = CheckLastError("BasicSafetyMessage", gkFuncRefGet, result);

  return result;
}

int SetBasicSafetyMessage_PathHistory_crumbData_pathHistoryPointSets_10Params(LONG packetHandle, struct BasicSafetyMessage_PathHistory_crumbData_pathHistoryPointSets_10 value, char oldPath[])
{
  char newPath[300];
  int result;

  result = 0;

  snprintf(newPath, elcount(newPath), "%s.%s", oldPath, "_Blob_PathHistory_crumbData_pathHistoryPointSets_10");
  SetBasicSafetyMessage_Blob_PathHistory_crumbData_pathHistoryPointSets_10Params(packetHandle, value._Blob_PathHistory_crumbData_pathHistoryPointSets_10, newPath);
  result = CheckLastError("BasicSafetyMessage", gkFuncRefGet, result);

  return result;
}

int GetBasicSafetyMessage_PathHistory_crumbDataParams(LONG packetHandle, struct BasicSafetyMessage_PathHistory_crumbData value, char oldPath[])
{
  char newPath[300];
  int result;

  result = 0;

  value.choice = C2xGetTokenInt(packetHandle, "BasicSafetyMessage", oldPath);

  switch(value.choice)
  {
    case 0:
    {
      snprintf(newPath, elcount(newPath), "%s.%s", oldPath, "pathHistoryPointSets_01");
      GetBasicSafetyMessage_PathHistory_crumbData_pathHistoryPointSets_01Params(packetHandle, value.pathHistoryPointSets_01, newPath);
      result = CheckLastError("BasicSafetyMessage", gkFuncRefGet, result);
    }
    break;
    case 1:
    {
      snprintf(newPath, elcount(newPath), "%s.%s", oldPath, "pathHistoryPointSets_02");
      GetBasicSafetyMessage_PathHistory_crumbData_pathHistoryPointSets_02Params(packetHandle, value.pathHistoryPointSets_02, newPath);
      result = CheckLastError("BasicSafetyMessage", gkFuncRefGet, result);
    }
    break;
    case 2:
    {
      snprintf(newPath, elcount(newPath), "%s.%s", oldPath, "pathHistoryPointSets_03");
      GetBasicSafetyMessage_PathHistory_crumbData_pathHistoryPointSets_03Params(packetHandle, value.pathHistoryPointSets_03, newPath);
      result = CheckLastError("BasicSafetyMessage", gkFuncRefGet, result);
    }
    break;
    case 3:
    {
      snprintf(newPath, elcount(newPath), "%s.%s", oldPath, "pathHistoryPointSets_04");
      GetBasicSafetyMessage_PathHistory_crumbData_pathHistoryPointSets_04Params(packetHandle, value.pathHistoryPointSets_04, newPath);
      result = CheckLastError("BasicSafetyMessage", gkFuncRefGet, result);
    }
    break;
    case 4:
    {
      snprintf(newPath, elcount(newPath), "%s.%s", oldPath, "pathHistoryPointSets_05");
      GetBasicSafetyMessage_PathHistory_crumbData_pathHistoryPointSets_05Params(packetHandle, value.pathHistoryPointSets_05, newPath);
      result = CheckLastError("BasicSafetyMessage", gkFuncRefGet, result);
    }
    break;
    case 5:
    {
      snprintf(newPath, elcount(newPath), "%s.%s", oldPath, "pathHistoryPointSets_06");
      GetBasicSafetyMessage_PathHistory_crumbData_pathHistoryPointSets_06Params(packetHandle, value.pathHistoryPointSets_06, newPath);
      result = CheckLastError("BasicSafetyMessage", gkFuncRefGet, result);
    }
    break;
    case 6:
    {
      snprintf(newPath, elcount(newPath), "%s.%s", oldPath, "pathHistoryPointSets_07");
      GetBasicSafetyMessage_PathHistory_crumbData_pathHistoryPointSets_07Params(packetHandle, value.pathHistoryPointSets_07, newPath);
      result = CheckLastError("BasicSafetyMessage", gkFuncRefGet, result);
    }
    break;
    case 7:
    {
      snprintf(newPath, elcount(newPath), "%s.%s", oldPath, "pathHistoryPointSets_08");
      GetBasicSafetyMessage_PathHistory_crumbData_pathHistoryPointSets_08Params(packetHandle, value.pathHistoryPointSets_08, newPath);
      result = CheckLastError("BasicSafetyMessage", gkFuncRefGet, result);
    }
    break;
    case 8:
    {
      snprintf(newPath, elcount(newPath), "%s.%s", oldPath, "pathHistoryPointSets_09");
      GetBasicSafetyMessage_PathHistory_crumbData_pathHistoryPointSets_09Params(packetHandle, value.pathHistoryPointSets_09, newPath);
      result = CheckLastError("BasicSafetyMessage", gkFuncRefGet, result);
    }
    break;
    case 9:
    {
      snprintf(newPath, elcount(newPath), "%s.%s", oldPath, "pathHistoryPointSets_10");
      GetBasicSafetyMessage_PathHistory_crumbData_pathHistoryPointSets_10Params(packetHandle, value.pathHistoryPointSets_10, newPath);
      result = CheckLastError("BasicSafetyMessage", gkFuncRefGet, result);
    }
    break;
  }
  return result;
}

int SetBasicSafetyMessage_PathHistory_crumbDataParams(LONG packetHandle, struct BasicSafetyMessage_PathHistory_crumbData value, char oldPath[])
{
  char newPath[300];
  int result;

  result = 0;

  switch(value.choice)
  {
    case 0:
    {
      snprintf(newPath, elcount(newPath), "%s.%s", oldPath, "pathHistoryPointSets_01");
      SetBasicSafetyMessage_PathHistory_crumbData_pathHistoryPointSets_01Params(packetHandle, value.pathHistoryPointSets_01, newPath);
      result = CheckLastError("BasicSafetyMessage", gkFuncRefGet, result);
    }
    break;
    case 1:
    {
      snprintf(newPath, elcount(newPath), "%s.%s", oldPath, "pathHistoryPointSets_02");
      SetBasicSafetyMessage_PathHistory_crumbData_pathHistoryPointSets_02Params(packetHandle, value.pathHistoryPointSets_02, newPath);
      result = CheckLastError("BasicSafetyMessage", gkFuncRefGet, result);
    }
    break;
    case 2:
    {
      snprintf(newPath, elcount(newPath), "%s.%s", oldPath, "pathHistoryPointSets_03");
      SetBasicSafetyMessage_PathHistory_crumbData_pathHistoryPointSets_03Params(packetHandle, value.pathHistoryPointSets_03, newPath);
      result = CheckLastError("BasicSafetyMessage", gkFuncRefGet, result);
    }
    break;
    case 3:
    {
      snprintf(newPath, elcount(newPath), "%s.%s", oldPath, "pathHistoryPointSets_04");
      SetBasicSafetyMessage_PathHistory_crumbData_pathHistoryPointSets_04Params(packetHandle, value.pathHistoryPointSets_04, newPath);
      result = CheckLastError("BasicSafetyMessage", gkFuncRefGet, result);
    }
    break;
    case 4:
    {
      snprintf(newPath, elcount(newPath), "%s.%s", oldPath, "pathHistoryPointSets_05");
      SetBasicSafetyMessage_PathHistory_crumbData_pathHistoryPointSets_05Params(packetHandle, value.pathHistoryPointSets_05, newPath);
      result = CheckLastError("BasicSafetyMessage", gkFuncRefGet, result);
    }
    break;
    case 5:
    {
      snprintf(newPath, elcount(newPath), "%s.%s", oldPath, "pathHistoryPointSets_06");
      SetBasicSafetyMessage_PathHistory_crumbData_pathHistoryPointSets_06Params(packetHandle, value.pathHistoryPointSets_06, newPath);
      result = CheckLastError("BasicSafetyMessage", gkFuncRefGet, result);
    }
    break;
    case 6:
    {
      snprintf(newPath, elcount(newPath), "%s.%s", oldPath, "pathHistoryPointSets_07");
      SetBasicSafetyMessage_PathHistory_crumbData_pathHistoryPointSets_07Params(packetHandle, value.pathHistoryPointSets_07, newPath);
      result = CheckLastError("BasicSafetyMessage", gkFuncRefGet, result);
    }
    break;
    case 7:
    {
      snprintf(newPath, elcount(newPath), "%s.%s", oldPath, "pathHistoryPointSets_08");
      SetBasicSafetyMessage_PathHistory_crumbData_pathHistoryPointSets_08Params(packetHandle, value.pathHistoryPointSets_08, newPath);
      result = CheckLastError("BasicSafetyMessage", gkFuncRefGet, result);
    }
    break;
    case 8:
    {
      snprintf(newPath, elcount(newPath), "%s.%s", oldPath, "pathHistoryPointSets_09");
      SetBasicSafetyMessage_PathHistory_crumbData_pathHistoryPointSets_09Params(packetHandle, value.pathHistoryPointSets_09, newPath);
      result = CheckLastError("BasicSafetyMessage", gkFuncRefGet, result);
    }
    break;
    case 9:
    {
      snprintf(newPath, elcount(newPath), "%s.%s", oldPath, "pathHistoryPointSets_10");
      SetBasicSafetyMessage_PathHistory_crumbData_pathHistoryPointSets_10Params(packetHandle, value.pathHistoryPointSets_10, newPath);
      result = CheckLastError("BasicSafetyMessage", gkFuncRefGet, result);
    }
    break;
  }
  return result;
}

int GetBasicSafetyMessagePathHistoryParams(LONG packetHandle, struct BasicSafetyMessagePathHistory value, char oldPath[])
{
  char newPath[300]; 
  int j; 
  int k;
  int result;

  result = 0;

  snprintf(newPath, elcount(newPath), "%s.%s", oldPath, "initialPosition");
  value.initialPosition.isValidFlag = C2xIsTokenAvailable(packetHandle, "BasicSafetyMessage", newPath);
  if(value.initialPosition.isValidFlag==1)
  {
    GetBasicSafetyMessageFullPositionVectorParams(packetHandle, value.initialPosition, newPath);
    result = CheckLastError("BasicSafetyMessage", gkFuncRefGet, result);
  }
  snprintf(newPath, elcount(newPath), "%s.%s", oldPath, "currGPSstatus");
  value.currGPSstatus.isValidFlag = C2xIsTokenAvailable(packetHandle, "BasicSafetyMessage", newPath);
  if(value.currGPSstatus.isValidFlag==1)
  {
    value.currGPSstatus.isValidFlag = 1;
    value.currGPSstatus.stringLength = C2xGetTokenLengthBit(packetHandle, "BasicSafetyMessage", newPath);
    if ((result = CheckLastError("BasicSafetyMessage", gkFuncRefGet, result))==0)
    {
      if(value.currGPSstatus.stringLength > 0)
      {
        for(j=0; j<value.currGPSstatus.stringLength; j++)
        {
          if(C2xGetTokenBitOfBitString(packetHandle, "BasicSafetyMessage", newPath, j) == 0)
          {
            value.currGPSstatus.string[j] = '0';
          }
          else if(C2xGetTokenBitOfBitString(packetHandle, "BasicSafetyMessage", newPath, j) == 1)
          {
            value.currGPSstatus.string[j] = '1';
          }

          if(value.currGPSstatus.stringLength == 1)
          {
            value.currGPSstatus.string[1] = '0';
          }
          result = CheckLastError("BasicSafetyMessage", gkFuncRefGet, result);
        }
      }
      else
      {
        for(k = value.currGPSstatus.stringLength+1; k > -1; k--)
        {
          if(value.currGPSstatus.string[k] == '1')
          {
            value.currGPSstatus.string[k] = '0';
          }
        }
      }
    }

  }
  snprintf(newPath, elcount(newPath), "%s.%s", oldPath, "itemCnt");
  value.itemCnt.isValidFlag = C2xIsTokenAvailable(packetHandle, "BasicSafetyMessage", newPath);
  if(value.itemCnt.isValidFlag==1)
  {
    value.itemCnt.value = C2xGetTokenInt(packetHandle, "BasicSafetyMessage", newPath);
    result = CheckLastError("BasicSafetyMessage", gkFuncRefGet, result);
  }
  snprintf(newPath, elcount(newPath), "%s.%s", oldPath, "crumbData");
  GetBasicSafetyMessage_PathHistory_crumbDataParams(packetHandle, value.crumbData, newPath);
  result = CheckLastError("BasicSafetyMessage", gkFuncRefGet, result);

  return result;
}

int SetBasicSafetyMessagePathHistoryParams(LONG packetHandle, struct BasicSafetyMessagePathHistory value, char oldPath[])
{
  char newPath[300]; 
  int j;
  int result;

  result = 0;

  snprintf(newPath, elcount(newPath), "%s.%s", oldPath, "initialPosition");
  if(value.initialPosition.isValidFlag==1)
  {
    SetBasicSafetyMessageFullPositionVectorParams(packetHandle, value.initialPosition, newPath);
    result = CheckLastError("BasicSafetyMessage", gkFuncRefGet, result);
  }
  else
  {
    if( C2xIsTokenAvailable(packetHandle, "BasicSafetyMessage", newPath) )
    {
      C2xRemoveToken(packetHandle, "BasicSafetyMessage", newPath);
    }
  }

  snprintf(newPath, elcount(newPath), "%s.%s", oldPath, "currGPSstatus");
  if(value.currGPSstatus.isValidFlag==1)
  {
      for(j=0; j<value.currGPSstatus.stringLength; j++)
      {
        if(value.currGPSstatus.string[j] == '0')
        {
          C2xSetTokenBitOfBitString(packetHandle, "BasicSafetyMessage", newPath, j, 0);
        }
        else
        {
          C2xSetTokenBitOfBitString(packetHandle, "BasicSafetyMessage", newPath, j, 1);
        }
        result = CheckLastError("BasicSafetyMessage", gkFuncRefGet, result);
      }
  }
  else
  {
    if( C2xIsTokenAvailable(packetHandle, "BasicSafetyMessage", newPath) )
    {
      C2xRemoveToken(packetHandle, "BasicSafetyMessage", newPath);
    }
  }

  snprintf(newPath, elcount(newPath), "%s.%s", oldPath, "itemCnt");
  if(value.itemCnt.isValidFlag==1)
  {
    C2xSetTokenInt(packetHandle, "BasicSafetyMessage", newPath, value.itemCnt.value);
    result = CheckLastError("BasicSafetyMessage", gkFuncRefGet, result);
  }
  else
  {
    if( C2xIsTokenAvailable(packetHandle, "BasicSafetyMessage", newPath) )
    {
      C2xRemoveToken(packetHandle, "BasicSafetyMessage", newPath);
    }
  }

  snprintf(newPath, elcount(newPath), "%s.%s", oldPath, "crumbData");
  SetBasicSafetyMessage_PathHistory_crumbDataParams(packetHandle, value.crumbData, newPath);
  result = CheckLastError("BasicSafetyMessage", gkFuncRefGet, result);

  return result;
}

int GetBasicSafetyMessagePathPredictionParams(LONG packetHandle, struct BasicSafetyMessagePathPrediction value, char oldPath[])
{
  char newPath[300];
  int result;

  result = 0;

  snprintf(newPath, elcount(newPath), "%s.%s", oldPath, "radiusOfCurve");
  value.radiusOfCurve = C2xGetTokenInt(packetHandle, "BasicSafetyMessage", newPath);
  result = CheckLastError("BasicSafetyMessage", gkFuncRefGet, result);

  snprintf(newPath, elcount(newPath), "%s.%s", oldPath, "confidence");
  value.confidence = C2xGetTokenInt(packetHandle, "BasicSafetyMessage", newPath);
  result = CheckLastError("BasicSafetyMessage", gkFuncRefGet, result);

  return result;
}

int SetBasicSafetyMessagePathPredictionParams(LONG packetHandle, struct BasicSafetyMessagePathPrediction value, char oldPath[])
{
  char newPath[300];
  int result;

  result = 0;

  snprintf(newPath, elcount(newPath), "%s.%s", oldPath, "radiusOfCurve");
  C2xSetTokenInt(packetHandle, "BasicSafetyMessage", newPath, value.radiusOfCurve);
  result = CheckLastError("BasicSafetyMessage", gkFuncRefGet, result);

  snprintf(newPath, elcount(newPath), "%s.%s", oldPath, "confidence");
  C2xSetTokenInt(packetHandle, "BasicSafetyMessage", newPath, value.confidence);
  result = CheckLastError("BasicSafetyMessage", gkFuncRefGet, result);

  return result;
}

int GetBasicSafetyMessage_Blob_AntennaOffsetSetParams(LONG packetHandle, struct BasicSafetyMessage_Blob_AntennaOffsetSet value, char oldPath[])
{
  char newPath[300];
  int result;

  result = 0;

  snprintf(newPath, elcount(newPath), "%s.%s", oldPath, "antOffsetX");
  value.antOffsetX = C2xGetTokenInt(packetHandle, "BasicSafetyMessage", newPath);
  result = CheckLastError("BasicSafetyMessage", gkFuncRefGet, result);

  snprintf(newPath, elcount(newPath), "%s.%s", oldPath, "antOffsetY");
  value.antOffsetY = C2xGetTokenInt(packetHandle, "BasicSafetyMessage", newPath);
  result = CheckLastError("BasicSafetyMessage", gkFuncRefGet, result);

  snprintf(newPath, elcount(newPath), "%s.%s", oldPath, "antOffsetZ");
  value.antOffsetZ = C2xGetTokenInt(packetHandle, "BasicSafetyMessage", newPath);
  result = CheckLastError("BasicSafetyMessage", gkFuncRefGet, result);

  return result;
}

int SetBasicSafetyMessage_Blob_AntennaOffsetSetParams(LONG packetHandle, struct BasicSafetyMessage_Blob_AntennaOffsetSet value, char oldPath[])
{
  char newPath[300];
  int result;

  result = 0;

  snprintf(newPath, elcount(newPath), "%s.%s", oldPath, "antOffsetX");
  C2xSetTokenInt(packetHandle, "BasicSafetyMessage", newPath, value.antOffsetX);
  result = CheckLastError("BasicSafetyMessage", gkFuncRefGet, result);

  snprintf(newPath, elcount(newPath), "%s.%s", oldPath, "antOffsetY");
  C2xSetTokenInt(packetHandle, "BasicSafetyMessage", newPath, value.antOffsetY);
  result = CheckLastError("BasicSafetyMessage", gkFuncRefGet, result);

  snprintf(newPath, elcount(newPath), "%s.%s", oldPath, "antOffsetZ");
  C2xSetTokenInt(packetHandle, "BasicSafetyMessage", newPath, value.antOffsetZ);
  result = CheckLastError("BasicSafetyMessage", gkFuncRefGet, result);

  return result;
}

int GetBasicSafetyMessage_Blob_RTCMHeaderParams(LONG packetHandle, struct BasicSafetyMessage_Blob_RTCMHeader value, char oldPath[])
{
  char newPath[300]; 
  int j; 
  int k;
  int result;

  result = 0;

  snprintf(newPath, elcount(newPath), "%s.%s", oldPath, "status");
  value.status.isValidFlag = 1;
  value.status.stringLength = C2xGetTokenLengthBit(packetHandle, "BasicSafetyMessage", newPath);
  if ((result = CheckLastError("BasicSafetyMessage", gkFuncRefGet, result))==0)
  {
    if(value.status.stringLength > 0)
    {
      for(j=0; j<value.status.stringLength; j++)
      {
        if(C2xGetTokenBitOfBitString(packetHandle, "BasicSafetyMessage", newPath, j) == 0)
        {
          value.status.string[j] = '0';
        }
        else if(C2xGetTokenBitOfBitString(packetHandle, "BasicSafetyMessage", newPath, j) == 1)
        {
          value.status.string[j] = '1';
        }

        if(value.status.stringLength == 1)
        {
          value.status.string[1] = '0';
        }
        result = CheckLastError("BasicSafetyMessage", gkFuncRefGet, result);
      }
    }
    else
    {
      for(k = value.status.stringLength+1; k > -1; k--)
      {
        if(value.status.string[k] == '1')
        {
          value.status.string[k] = '0';
        }
      }
    }
  }

  snprintf(newPath, elcount(newPath), "%s.%s", oldPath, "offsetSet");
  GetBasicSafetyMessage_Blob_AntennaOffsetSetParams(packetHandle, value.offsetSet, newPath);
  result = CheckLastError("BasicSafetyMessage", gkFuncRefGet, result);

  return result;
}

int SetBasicSafetyMessage_Blob_RTCMHeaderParams(LONG packetHandle, struct BasicSafetyMessage_Blob_RTCMHeader value, char oldPath[])
{
  char newPath[300]; 
  int j;
  int result;

  result = 0;

  snprintf(newPath, elcount(newPath), "%s.%s", oldPath, "status");
    for(j=0; j<value.status.stringLength; j++)
    {
      if(value.status.string[j] == '0')
      {
        C2xSetTokenBitOfBitString(packetHandle, "BasicSafetyMessage", newPath, j, 0);
      }
      else
      {
        C2xSetTokenBitOfBitString(packetHandle, "BasicSafetyMessage", newPath, j, 1);
      }
      result = CheckLastError("BasicSafetyMessage", gkFuncRefGet, result);
    }

  snprintf(newPath, elcount(newPath), "%s.%s", oldPath, "offsetSet");
  SetBasicSafetyMessage_Blob_AntennaOffsetSetParams(packetHandle, value.offsetSet, newPath);
  result = CheckLastError("BasicSafetyMessage", gkFuncRefGet, result);

  return result;
}

int GetBasicSafetyMessageRTCMHeaderParams(LONG packetHandle, struct BasicSafetyMessageRTCMHeader value, char oldPath[])
{
  char newPath[300];
  int result;

  result = 0;

  snprintf(newPath, elcount(newPath), "%s.%s", oldPath, "_Blob_RTCMHeader");
  GetBasicSafetyMessage_Blob_RTCMHeaderParams(packetHandle, value._Blob_RTCMHeader, newPath);
  result = CheckLastError("BasicSafetyMessage", gkFuncRefGet, result);

  return result;
}

int SetBasicSafetyMessageRTCMHeaderParams(LONG packetHandle, struct BasicSafetyMessageRTCMHeader value, char oldPath[])
{
  char newPath[300];
  int result;

  result = 0;

  snprintf(newPath, elcount(newPath), "%s.%s", oldPath, "_Blob_RTCMHeader");
  SetBasicSafetyMessage_Blob_RTCMHeaderParams(packetHandle, value._Blob_RTCMHeader, newPath);
  result = CheckLastError("BasicSafetyMessage", gkFuncRefGet, result);

  return result;
}

int GetBasicSafetyMessageRTCMPackageParams(LONG packetHandle, struct BasicSafetyMessageRTCMPackage value, char oldPath[])
{
  char newPath[300];
  int result;

  result = 0;

  snprintf(newPath, elcount(newPath), "%s.%s", oldPath, "anchorPoint");
  value.anchorPoint.isValidFlag = C2xIsTokenAvailable(packetHandle, "BasicSafetyMessage", newPath);
  if(value.anchorPoint.isValidFlag==1)
  {
    GetBasicSafetyMessageFullPositionVectorParams(packetHandle, value.anchorPoint, newPath);
    result = CheckLastError("BasicSafetyMessage", gkFuncRefGet, result);
  }
  snprintf(newPath, elcount(newPath), "%s.%s", oldPath, "rtcmHeader");
  value.rtcmHeader.stringLength = C2xGetTokenData(packetHandle, "BasicSafetyMessage", newPath, elcount(value.rtcmHeader.string), value.rtcmHeader.string);
  snprintf(newPath, elcount(newPath), "%s.%s", oldPath, "msg1001");
  value.msg1001.isValidFlag = C2xIsTokenAvailable(packetHandle, "BasicSafetyMessage", newPath);
  if(value.msg1001.isValidFlag==1)
  {
    value.msg1001.isValidFlag = 1;
    value.msg1001.stringLength = C2xGetTokenData(packetHandle, "BasicSafetyMessage", newPath, elcount(value.msg1001.string), value.msg1001.string);
  }
  snprintf(newPath, elcount(newPath), "%s.%s", oldPath, "msg1002");
  value.msg1002.isValidFlag = C2xIsTokenAvailable(packetHandle, "BasicSafetyMessage", newPath);
  if(value.msg1002.isValidFlag==1)
  {
    value.msg1002.isValidFlag = 1;
    value.msg1002.stringLength = C2xGetTokenData(packetHandle, "BasicSafetyMessage", newPath, elcount(value.msg1002.string), value.msg1002.string);
  }
  snprintf(newPath, elcount(newPath), "%s.%s", oldPath, "msg1003");
  value.msg1003.isValidFlag = C2xIsTokenAvailable(packetHandle, "BasicSafetyMessage", newPath);
  if(value.msg1003.isValidFlag==1)
  {
    value.msg1003.isValidFlag = 1;
    value.msg1003.stringLength = C2xGetTokenData(packetHandle, "BasicSafetyMessage", newPath, elcount(value.msg1003.string), value.msg1003.string);
  }
  snprintf(newPath, elcount(newPath), "%s.%s", oldPath, "msg1004");
  value.msg1004.isValidFlag = C2xIsTokenAvailable(packetHandle, "BasicSafetyMessage", newPath);
  if(value.msg1004.isValidFlag==1)
  {
    value.msg1004.isValidFlag = 1;
    value.msg1004.stringLength = C2xGetTokenData(packetHandle, "BasicSafetyMessage", newPath, elcount(value.msg1004.string), value.msg1004.string);
  }
  snprintf(newPath, elcount(newPath), "%s.%s", oldPath, "msg1005");
  value.msg1005.isValidFlag = C2xIsTokenAvailable(packetHandle, "BasicSafetyMessage", newPath);
  if(value.msg1005.isValidFlag==1)
  {
    value.msg1005.isValidFlag = 1;
    value.msg1005.stringLength = C2xGetTokenData(packetHandle, "BasicSafetyMessage", newPath, elcount(value.msg1005.string), value.msg1005.string);
  }
  snprintf(newPath, elcount(newPath), "%s.%s", oldPath, "msg1006");
  value.msg1006.isValidFlag = C2xIsTokenAvailable(packetHandle, "BasicSafetyMessage", newPath);
  if(value.msg1006.isValidFlag==1)
  {
    value.msg1006.isValidFlag = 1;
    value.msg1006.stringLength = C2xGetTokenData(packetHandle, "BasicSafetyMessage", newPath, elcount(value.msg1006.string), value.msg1006.string);
  }
  snprintf(newPath, elcount(newPath), "%s.%s", oldPath, "msg1007");
  value.msg1007.isValidFlag = C2xIsTokenAvailable(packetHandle, "BasicSafetyMessage", newPath);
  if(value.msg1007.isValidFlag==1)
  {
    value.msg1007.isValidFlag = 1;
    value.msg1007.stringLength = C2xGetTokenData(packetHandle, "BasicSafetyMessage", newPath, elcount(value.msg1007.string), value.msg1007.string);
  }
  snprintf(newPath, elcount(newPath), "%s.%s", oldPath, "msg1008");
  value.msg1008.isValidFlag = C2xIsTokenAvailable(packetHandle, "BasicSafetyMessage", newPath);
  if(value.msg1008.isValidFlag==1)
  {
    value.msg1008.isValidFlag = 1;
    value.msg1008.stringLength = C2xGetTokenData(packetHandle, "BasicSafetyMessage", newPath, elcount(value.msg1008.string), value.msg1008.string);
  }
  snprintf(newPath, elcount(newPath), "%s.%s", oldPath, "msg1009");
  value.msg1009.isValidFlag = C2xIsTokenAvailable(packetHandle, "BasicSafetyMessage", newPath);
  if(value.msg1009.isValidFlag==1)
  {
    value.msg1009.isValidFlag = 1;
    value.msg1009.stringLength = C2xGetTokenData(packetHandle, "BasicSafetyMessage", newPath, elcount(value.msg1009.string), value.msg1009.string);
  }
  snprintf(newPath, elcount(newPath), "%s.%s", oldPath, "msg1010");
  value.msg1010.isValidFlag = C2xIsTokenAvailable(packetHandle, "BasicSafetyMessage", newPath);
  if(value.msg1010.isValidFlag==1)
  {
    value.msg1010.isValidFlag = 1;
    value.msg1010.stringLength = C2xGetTokenData(packetHandle, "BasicSafetyMessage", newPath, elcount(value.msg1010.string), value.msg1010.string);
  }
  snprintf(newPath, elcount(newPath), "%s.%s", oldPath, "msg1011");
  value.msg1011.isValidFlag = C2xIsTokenAvailable(packetHandle, "BasicSafetyMessage", newPath);
  if(value.msg1011.isValidFlag==1)
  {
    value.msg1011.isValidFlag = 1;
    value.msg1011.stringLength = C2xGetTokenData(packetHandle, "BasicSafetyMessage", newPath, elcount(value.msg1011.string), value.msg1011.string);
  }
  snprintf(newPath, elcount(newPath), "%s.%s", oldPath, "msg1012");
  value.msg1012.isValidFlag = C2xIsTokenAvailable(packetHandle, "BasicSafetyMessage", newPath);
  if(value.msg1012.isValidFlag==1)
  {
    value.msg1012.isValidFlag = 1;
    value.msg1012.stringLength = C2xGetTokenData(packetHandle, "BasicSafetyMessage", newPath, elcount(value.msg1012.string), value.msg1012.string);
  }
  snprintf(newPath, elcount(newPath), "%s.%s", oldPath, "msg1013");
  value.msg1013.isValidFlag = C2xIsTokenAvailable(packetHandle, "BasicSafetyMessage", newPath);
  if(value.msg1013.isValidFlag==1)
  {
    value.msg1013.isValidFlag = 1;
    value.msg1013.stringLength = C2xGetTokenData(packetHandle, "BasicSafetyMessage", newPath, elcount(value.msg1013.string), value.msg1013.string);
  }
  snprintf(newPath, elcount(newPath), "%s.%s", oldPath, "msg1014");
  value.msg1014.isValidFlag = C2xIsTokenAvailable(packetHandle, "BasicSafetyMessage", newPath);
  if(value.msg1014.isValidFlag==1)
  {
    value.msg1014.isValidFlag = 1;
    value.msg1014.stringLength = C2xGetTokenData(packetHandle, "BasicSafetyMessage", newPath, elcount(value.msg1014.string), value.msg1014.string);
  }
  snprintf(newPath, elcount(newPath), "%s.%s", oldPath, "msg1015");
  value.msg1015.isValidFlag = C2xIsTokenAvailable(packetHandle, "BasicSafetyMessage", newPath);
  if(value.msg1015.isValidFlag==1)
  {
    value.msg1015.isValidFlag = 1;
    value.msg1015.stringLength = C2xGetTokenData(packetHandle, "BasicSafetyMessage", newPath, elcount(value.msg1015.string), value.msg1015.string);
  }
  snprintf(newPath, elcount(newPath), "%s.%s", oldPath, "msg1016");
  value.msg1016.isValidFlag = C2xIsTokenAvailable(packetHandle, "BasicSafetyMessage", newPath);
  if(value.msg1016.isValidFlag==1)
  {
    value.msg1016.isValidFlag = 1;
    value.msg1016.stringLength = C2xGetTokenData(packetHandle, "BasicSafetyMessage", newPath, elcount(value.msg1016.string), value.msg1016.string);
  }
  snprintf(newPath, elcount(newPath), "%s.%s", oldPath, "msg1017");
  value.msg1017.isValidFlag = C2xIsTokenAvailable(packetHandle, "BasicSafetyMessage", newPath);
  if(value.msg1017.isValidFlag==1)
  {
    value.msg1017.isValidFlag = 1;
    value.msg1017.stringLength = C2xGetTokenData(packetHandle, "BasicSafetyMessage", newPath, elcount(value.msg1017.string), value.msg1017.string);
  }
  snprintf(newPath, elcount(newPath), "%s.%s", oldPath, "msg1019");
  value.msg1019.isValidFlag = C2xIsTokenAvailable(packetHandle, "BasicSafetyMessage", newPath);
  if(value.msg1019.isValidFlag==1)
  {
    value.msg1019.isValidFlag = 1;
    value.msg1019.stringLength = C2xGetTokenData(packetHandle, "BasicSafetyMessage", newPath, elcount(value.msg1019.string), value.msg1019.string);
  }
  snprintf(newPath, elcount(newPath), "%s.%s", oldPath, "msg1020");
  value.msg1020.isValidFlag = C2xIsTokenAvailable(packetHandle, "BasicSafetyMessage", newPath);
  if(value.msg1020.isValidFlag==1)
  {
    value.msg1020.isValidFlag = 1;
    value.msg1020.stringLength = C2xGetTokenData(packetHandle, "BasicSafetyMessage", newPath, elcount(value.msg1020.string), value.msg1020.string);
  }
  snprintf(newPath, elcount(newPath), "%s.%s", oldPath, "msg1021");
  value.msg1021.isValidFlag = C2xIsTokenAvailable(packetHandle, "BasicSafetyMessage", newPath);
  if(value.msg1021.isValidFlag==1)
  {
    value.msg1021.isValidFlag = 1;
    value.msg1021.stringLength = C2xGetTokenData(packetHandle, "BasicSafetyMessage", newPath, elcount(value.msg1021.string), value.msg1021.string);
  }
  snprintf(newPath, elcount(newPath), "%s.%s", oldPath, "msg1022");
  value.msg1022.isValidFlag = C2xIsTokenAvailable(packetHandle, "BasicSafetyMessage", newPath);
  if(value.msg1022.isValidFlag==1)
  {
    value.msg1022.isValidFlag = 1;
    value.msg1022.stringLength = C2xGetTokenData(packetHandle, "BasicSafetyMessage", newPath, elcount(value.msg1022.string), value.msg1022.string);
  }
  snprintf(newPath, elcount(newPath), "%s.%s", oldPath, "msg1023");
  value.msg1023.isValidFlag = C2xIsTokenAvailable(packetHandle, "BasicSafetyMessage", newPath);
  if(value.msg1023.isValidFlag==1)
  {
    value.msg1023.isValidFlag = 1;
    value.msg1023.stringLength = C2xGetTokenData(packetHandle, "BasicSafetyMessage", newPath, elcount(value.msg1023.string), value.msg1023.string);
  }
  snprintf(newPath, elcount(newPath), "%s.%s", oldPath, "msg1024");
  value.msg1024.isValidFlag = C2xIsTokenAvailable(packetHandle, "BasicSafetyMessage", newPath);
  if(value.msg1024.isValidFlag==1)
  {
    value.msg1024.isValidFlag = 1;
    value.msg1024.stringLength = C2xGetTokenData(packetHandle, "BasicSafetyMessage", newPath, elcount(value.msg1024.string), value.msg1024.string);
  }
  snprintf(newPath, elcount(newPath), "%s.%s", oldPath, "msg1025");
  value.msg1025.isValidFlag = C2xIsTokenAvailable(packetHandle, "BasicSafetyMessage", newPath);
  if(value.msg1025.isValidFlag==1)
  {
    value.msg1025.isValidFlag = 1;
    value.msg1025.stringLength = C2xGetTokenData(packetHandle, "BasicSafetyMessage", newPath, elcount(value.msg1025.string), value.msg1025.string);
  }
  snprintf(newPath, elcount(newPath), "%s.%s", oldPath, "msg1026");
  value.msg1026.isValidFlag = C2xIsTokenAvailable(packetHandle, "BasicSafetyMessage", newPath);
  if(value.msg1026.isValidFlag==1)
  {
    value.msg1026.isValidFlag = 1;
    value.msg1026.stringLength = C2xGetTokenData(packetHandle, "BasicSafetyMessage", newPath, elcount(value.msg1026.string), value.msg1026.string);
  }
  snprintf(newPath, elcount(newPath), "%s.%s", oldPath, "msg1027");
  value.msg1027.isValidFlag = C2xIsTokenAvailable(packetHandle, "BasicSafetyMessage", newPath);
  if(value.msg1027.isValidFlag==1)
  {
    value.msg1027.isValidFlag = 1;
    value.msg1027.stringLength = C2xGetTokenData(packetHandle, "BasicSafetyMessage", newPath, elcount(value.msg1027.string), value.msg1027.string);
  }
  snprintf(newPath, elcount(newPath), "%s.%s", oldPath, "msg1029");
  value.msg1029.isValidFlag = C2xIsTokenAvailable(packetHandle, "BasicSafetyMessage", newPath);
  if(value.msg1029.isValidFlag==1)
  {
    value.msg1029.isValidFlag = 1;
    value.msg1029.stringLength = C2xGetTokenData(packetHandle, "BasicSafetyMessage", newPath, elcount(value.msg1029.string), value.msg1029.string);
  }
  snprintf(newPath, elcount(newPath), "%s.%s", oldPath, "msg1030");
  value.msg1030.isValidFlag = C2xIsTokenAvailable(packetHandle, "BasicSafetyMessage", newPath);
  if(value.msg1030.isValidFlag==1)
  {
    value.msg1030.isValidFlag = 1;
    value.msg1030.stringLength = C2xGetTokenData(packetHandle, "BasicSafetyMessage", newPath, elcount(value.msg1030.string), value.msg1030.string);
  }
  snprintf(newPath, elcount(newPath), "%s.%s", oldPath, "msg1031");
  value.msg1031.isValidFlag = C2xIsTokenAvailable(packetHandle, "BasicSafetyMessage", newPath);
  if(value.msg1031.isValidFlag==1)
  {
    value.msg1031.isValidFlag = 1;
    value.msg1031.stringLength = C2xGetTokenData(packetHandle, "BasicSafetyMessage", newPath, elcount(value.msg1031.string), value.msg1031.string);
  }
  snprintf(newPath, elcount(newPath), "%s.%s", oldPath, "msg1032");
  value.msg1032.isValidFlag = C2xIsTokenAvailable(packetHandle, "BasicSafetyMessage", newPath);
  if(value.msg1032.isValidFlag==1)
  {
    value.msg1032.isValidFlag = 1;
    value.msg1032.stringLength = C2xGetTokenData(packetHandle, "BasicSafetyMessage", newPath, elcount(value.msg1032.string), value.msg1032.string);
  }
  return result;
}

int SetBasicSafetyMessageRTCMPackageParams(LONG packetHandle, struct BasicSafetyMessageRTCMPackage value, char oldPath[])
{
  char newPath[300];
  int result;

  result = 0;

  snprintf(newPath, elcount(newPath), "%s.%s", oldPath, "anchorPoint");
  if(value.anchorPoint.isValidFlag==1)
  {
    SetBasicSafetyMessageFullPositionVectorParams(packetHandle, value.anchorPoint, newPath);
    result = CheckLastError("BasicSafetyMessage", gkFuncRefGet, result);
  }
  else
  {
    if( C2xIsTokenAvailable(packetHandle, "BasicSafetyMessage", newPath) )
    {
      C2xRemoveToken(packetHandle, "BasicSafetyMessage", newPath);
    }
  }

  snprintf(newPath, elcount(newPath), "%s.%s", oldPath, "rtcmHeader");
  C2xSetTokenData(packetHandle, "BasicSafetyMessage", newPath, value.rtcmHeader.stringLength, value.rtcmHeader.string);

  snprintf(newPath, elcount(newPath), "%s.%s", oldPath, "msg1001");
  if(value.msg1001.isValidFlag==1)
  {
    C2xSetTokenData(packetHandle, "BasicSafetyMessage", newPath, value.msg1001.stringLength, value.msg1001.string);
  }
  else
  {
    if( C2xIsTokenAvailable(packetHandle, "BasicSafetyMessage", newPath) )
    {
      C2xRemoveToken(packetHandle, "BasicSafetyMessage", newPath);
    }
  }

  snprintf(newPath, elcount(newPath), "%s.%s", oldPath, "msg1002");
  if(value.msg1002.isValidFlag==1)
  {
    C2xSetTokenData(packetHandle, "BasicSafetyMessage", newPath, value.msg1002.stringLength, value.msg1002.string);
  }
  else
  {
    if( C2xIsTokenAvailable(packetHandle, "BasicSafetyMessage", newPath) )
    {
      C2xRemoveToken(packetHandle, "BasicSafetyMessage", newPath);
    }
  }

  snprintf(newPath, elcount(newPath), "%s.%s", oldPath, "msg1003");
  if(value.msg1003.isValidFlag==1)
  {
    C2xSetTokenData(packetHandle, "BasicSafetyMessage", newPath, value.msg1003.stringLength, value.msg1003.string);
  }
  else
  {
    if( C2xIsTokenAvailable(packetHandle, "BasicSafetyMessage", newPath) )
    {
      C2xRemoveToken(packetHandle, "BasicSafetyMessage", newPath);
    }
  }

  snprintf(newPath, elcount(newPath), "%s.%s", oldPath, "msg1004");
  if(value.msg1004.isValidFlag==1)
  {
    C2xSetTokenData(packetHandle, "BasicSafetyMessage", newPath, value.msg1004.stringLength, value.msg1004.string);
  }
  else
  {
    if( C2xIsTokenAvailable(packetHandle, "BasicSafetyMessage", newPath) )
    {
      C2xRemoveToken(packetHandle, "BasicSafetyMessage", newPath);
    }
  }

  snprintf(newPath, elcount(newPath), "%s.%s", oldPath, "msg1005");
  if(value.msg1005.isValidFlag==1)
  {
    C2xSetTokenData(packetHandle, "BasicSafetyMessage", newPath, value.msg1005.stringLength, value.msg1005.string);
  }
  else
  {
    if( C2xIsTokenAvailable(packetHandle, "BasicSafetyMessage", newPath) )
    {
      C2xRemoveToken(packetHandle, "BasicSafetyMessage", newPath);
    }
  }

  snprintf(newPath, elcount(newPath), "%s.%s", oldPath, "msg1006");
  if(value.msg1006.isValidFlag==1)
  {
    C2xSetTokenData(packetHandle, "BasicSafetyMessage", newPath, value.msg1006.stringLength, value.msg1006.string);
  }
  else
  {
    if( C2xIsTokenAvailable(packetHandle, "BasicSafetyMessage", newPath) )
    {
      C2xRemoveToken(packetHandle, "BasicSafetyMessage", newPath);
    }
  }

  snprintf(newPath, elcount(newPath), "%s.%s", oldPath, "msg1007");
  if(value.msg1007.isValidFlag==1)
  {
    C2xSetTokenData(packetHandle, "BasicSafetyMessage", newPath, value.msg1007.stringLength, value.msg1007.string);
  }
  else
  {
    if( C2xIsTokenAvailable(packetHandle, "BasicSafetyMessage", newPath) )
    {
      C2xRemoveToken(packetHandle, "BasicSafetyMessage", newPath);
    }
  }

  snprintf(newPath, elcount(newPath), "%s.%s", oldPath, "msg1008");
  if(value.msg1008.isValidFlag==1)
  {
    C2xSetTokenData(packetHandle, "BasicSafetyMessage", newPath, value.msg1008.stringLength, value.msg1008.string);
  }
  else
  {
    if( C2xIsTokenAvailable(packetHandle, "BasicSafetyMessage", newPath) )
    {
      C2xRemoveToken(packetHandle, "BasicSafetyMessage", newPath);
    }
  }

  snprintf(newPath, elcount(newPath), "%s.%s", oldPath, "msg1009");
  if(value.msg1009.isValidFlag==1)
  {
    C2xSetTokenData(packetHandle, "BasicSafetyMessage", newPath, value.msg1009.stringLength, value.msg1009.string);
  }
  else
  {
    if( C2xIsTokenAvailable(packetHandle, "BasicSafetyMessage", newPath) )
    {
      C2xRemoveToken(packetHandle, "BasicSafetyMessage", newPath);
    }
  }

  snprintf(newPath, elcount(newPath), "%s.%s", oldPath, "msg1010");
  if(value.msg1010.isValidFlag==1)
  {
    C2xSetTokenData(packetHandle, "BasicSafetyMessage", newPath, value.msg1010.stringLength, value.msg1010.string);
  }
  else
  {
    if( C2xIsTokenAvailable(packetHandle, "BasicSafetyMessage", newPath) )
    {
      C2xRemoveToken(packetHandle, "BasicSafetyMessage", newPath);
    }
  }

  snprintf(newPath, elcount(newPath), "%s.%s", oldPath, "msg1011");
  if(value.msg1011.isValidFlag==1)
  {
    C2xSetTokenData(packetHandle, "BasicSafetyMessage", newPath, value.msg1011.stringLength, value.msg1011.string);
  }
  else
  {
    if( C2xIsTokenAvailable(packetHandle, "BasicSafetyMessage", newPath) )
    {
      C2xRemoveToken(packetHandle, "BasicSafetyMessage", newPath);
    }
  }

  snprintf(newPath, elcount(newPath), "%s.%s", oldPath, "msg1012");
  if(value.msg1012.isValidFlag==1)
  {
    C2xSetTokenData(packetHandle, "BasicSafetyMessage", newPath, value.msg1012.stringLength, value.msg1012.string);
  }
  else
  {
    if( C2xIsTokenAvailable(packetHandle, "BasicSafetyMessage", newPath) )
    {
      C2xRemoveToken(packetHandle, "BasicSafetyMessage", newPath);
    }
  }

  snprintf(newPath, elcount(newPath), "%s.%s", oldPath, "msg1013");
  if(value.msg1013.isValidFlag==1)
  {
    C2xSetTokenData(packetHandle, "BasicSafetyMessage", newPath, value.msg1013.stringLength, value.msg1013.string);
  }
  else
  {
    if( C2xIsTokenAvailable(packetHandle, "BasicSafetyMessage", newPath) )
    {
      C2xRemoveToken(packetHandle, "BasicSafetyMessage", newPath);
    }
  }

  snprintf(newPath, elcount(newPath), "%s.%s", oldPath, "msg1014");
  if(value.msg1014.isValidFlag==1)
  {
    C2xSetTokenData(packetHandle, "BasicSafetyMessage", newPath, value.msg1014.stringLength, value.msg1014.string);
  }
  else
  {
    if( C2xIsTokenAvailable(packetHandle, "BasicSafetyMessage", newPath) )
    {
      C2xRemoveToken(packetHandle, "BasicSafetyMessage", newPath);
    }
  }

  snprintf(newPath, elcount(newPath), "%s.%s", oldPath, "msg1015");
  if(value.msg1015.isValidFlag==1)
  {
    C2xSetTokenData(packetHandle, "BasicSafetyMessage", newPath, value.msg1015.stringLength, value.msg1015.string);
  }
  else
  {
    if( C2xIsTokenAvailable(packetHandle, "BasicSafetyMessage", newPath) )
    {
      C2xRemoveToken(packetHandle, "BasicSafetyMessage", newPath);
    }
  }

  snprintf(newPath, elcount(newPath), "%s.%s", oldPath, "msg1016");
  if(value.msg1016.isValidFlag==1)
  {
    C2xSetTokenData(packetHandle, "BasicSafetyMessage", newPath, value.msg1016.stringLength, value.msg1016.string);
  }
  else
  {
    if( C2xIsTokenAvailable(packetHandle, "BasicSafetyMessage", newPath) )
    {
      C2xRemoveToken(packetHandle, "BasicSafetyMessage", newPath);
    }
  }

  snprintf(newPath, elcount(newPath), "%s.%s", oldPath, "msg1017");
  if(value.msg1017.isValidFlag==1)
  {
    C2xSetTokenData(packetHandle, "BasicSafetyMessage", newPath, value.msg1017.stringLength, value.msg1017.string);
  }
  else
  {
    if( C2xIsTokenAvailable(packetHandle, "BasicSafetyMessage", newPath) )
    {
      C2xRemoveToken(packetHandle, "BasicSafetyMessage", newPath);
    }
  }

  snprintf(newPath, elcount(newPath), "%s.%s", oldPath, "msg1019");
  if(value.msg1019.isValidFlag==1)
  {
    C2xSetTokenData(packetHandle, "BasicSafetyMessage", newPath, value.msg1019.stringLength, value.msg1019.string);
  }
  else
  {
    if( C2xIsTokenAvailable(packetHandle, "BasicSafetyMessage", newPath) )
    {
      C2xRemoveToken(packetHandle, "BasicSafetyMessage", newPath);
    }
  }

  snprintf(newPath, elcount(newPath), "%s.%s", oldPath, "msg1020");
  if(value.msg1020.isValidFlag==1)
  {
    C2xSetTokenData(packetHandle, "BasicSafetyMessage", newPath, value.msg1020.stringLength, value.msg1020.string);
  }
  else
  {
    if( C2xIsTokenAvailable(packetHandle, "BasicSafetyMessage", newPath) )
    {
      C2xRemoveToken(packetHandle, "BasicSafetyMessage", newPath);
    }
  }

  snprintf(newPath, elcount(newPath), "%s.%s", oldPath, "msg1021");
  if(value.msg1021.isValidFlag==1)
  {
    C2xSetTokenData(packetHandle, "BasicSafetyMessage", newPath, value.msg1021.stringLength, value.msg1021.string);
  }
  else
  {
    if( C2xIsTokenAvailable(packetHandle, "BasicSafetyMessage", newPath) )
    {
      C2xRemoveToken(packetHandle, "BasicSafetyMessage", newPath);
    }
  }

  snprintf(newPath, elcount(newPath), "%s.%s", oldPath, "msg1022");
  if(value.msg1022.isValidFlag==1)
  {
    C2xSetTokenData(packetHandle, "BasicSafetyMessage", newPath, value.msg1022.stringLength, value.msg1022.string);
  }
  else
  {
    if( C2xIsTokenAvailable(packetHandle, "BasicSafetyMessage", newPath) )
    {
      C2xRemoveToken(packetHandle, "BasicSafetyMessage", newPath);
    }
  }

  snprintf(newPath, elcount(newPath), "%s.%s", oldPath, "msg1023");
  if(value.msg1023.isValidFlag==1)
  {
    C2xSetTokenData(packetHandle, "BasicSafetyMessage", newPath, value.msg1023.stringLength, value.msg1023.string);
  }
  else
  {
    if( C2xIsTokenAvailable(packetHandle, "BasicSafetyMessage", newPath) )
    {
      C2xRemoveToken(packetHandle, "BasicSafetyMessage", newPath);
    }
  }

  snprintf(newPath, elcount(newPath), "%s.%s", oldPath, "msg1024");
  if(value.msg1024.isValidFlag==1)
  {
    C2xSetTokenData(packetHandle, "BasicSafetyMessage", newPath, value.msg1024.stringLength, value.msg1024.string);
  }
  else
  {
    if( C2xIsTokenAvailable(packetHandle, "BasicSafetyMessage", newPath) )
    {
      C2xRemoveToken(packetHandle, "BasicSafetyMessage", newPath);
    }
  }

  snprintf(newPath, elcount(newPath), "%s.%s", oldPath, "msg1025");
  if(value.msg1025.isValidFlag==1)
  {
    C2xSetTokenData(packetHandle, "BasicSafetyMessage", newPath, value.msg1025.stringLength, value.msg1025.string);
  }
  else
  {
    if( C2xIsTokenAvailable(packetHandle, "BasicSafetyMessage", newPath) )
    {
      C2xRemoveToken(packetHandle, "BasicSafetyMessage", newPath);
    }
  }

  snprintf(newPath, elcount(newPath), "%s.%s", oldPath, "msg1026");
  if(value.msg1026.isValidFlag==1)
  {
    C2xSetTokenData(packetHandle, "BasicSafetyMessage", newPath, value.msg1026.stringLength, value.msg1026.string);
  }
  else
  {
    if( C2xIsTokenAvailable(packetHandle, "BasicSafetyMessage", newPath) )
    {
      C2xRemoveToken(packetHandle, "BasicSafetyMessage", newPath);
    }
  }

  snprintf(newPath, elcount(newPath), "%s.%s", oldPath, "msg1027");
  if(value.msg1027.isValidFlag==1)
  {
    C2xSetTokenData(packetHandle, "BasicSafetyMessage", newPath, value.msg1027.stringLength, value.msg1027.string);
  }
  else
  {
    if( C2xIsTokenAvailable(packetHandle, "BasicSafetyMessage", newPath) )
    {
      C2xRemoveToken(packetHandle, "BasicSafetyMessage", newPath);
    }
  }

  snprintf(newPath, elcount(newPath), "%s.%s", oldPath, "msg1029");
  if(value.msg1029.isValidFlag==1)
  {
    C2xSetTokenData(packetHandle, "BasicSafetyMessage", newPath, value.msg1029.stringLength, value.msg1029.string);
  }
  else
  {
    if( C2xIsTokenAvailable(packetHandle, "BasicSafetyMessage", newPath) )
    {
      C2xRemoveToken(packetHandle, "BasicSafetyMessage", newPath);
    }
  }

  snprintf(newPath, elcount(newPath), "%s.%s", oldPath, "msg1030");
  if(value.msg1030.isValidFlag==1)
  {
    C2xSetTokenData(packetHandle, "BasicSafetyMessage", newPath, value.msg1030.stringLength, value.msg1030.string);
  }
  else
  {
    if( C2xIsTokenAvailable(packetHandle, "BasicSafetyMessage", newPath) )
    {
      C2xRemoveToken(packetHandle, "BasicSafetyMessage", newPath);
    }
  }

  snprintf(newPath, elcount(newPath), "%s.%s", oldPath, "msg1031");
  if(value.msg1031.isValidFlag==1)
  {
    C2xSetTokenData(packetHandle, "BasicSafetyMessage", newPath, value.msg1031.stringLength, value.msg1031.string);
  }
  else
  {
    if( C2xIsTokenAvailable(packetHandle, "BasicSafetyMessage", newPath) )
    {
      C2xRemoveToken(packetHandle, "BasicSafetyMessage", newPath);
    }
  }

  snprintf(newPath, elcount(newPath), "%s.%s", oldPath, "msg1032");
  if(value.msg1032.isValidFlag==1)
  {
    C2xSetTokenData(packetHandle, "BasicSafetyMessage", newPath, value.msg1032.stringLength, value.msg1032.string);
  }
  else
  {
    if( C2xIsTokenAvailable(packetHandle, "BasicSafetyMessage", newPath) )
    {
      C2xRemoveToken(packetHandle, "BasicSafetyMessage", newPath);
    }
  }

  return result;
}

int GetBasicSafetyMessageVehicleSafetyExtensionParams(LONG packetHandle, struct BasicSafetyMessageVehicleSafetyExtension value, char oldPath[])
{
  char newPath[300];
  int result;

  result = 0;

  snprintf(newPath, elcount(newPath), "%s.%s", oldPath, "events");
  value.events.isValidFlag = C2xIsTokenAvailable(packetHandle, "BasicSafetyMessage", newPath);
  if(value.events.isValidFlag==1)
  {
    value.events.value = C2xGetTokenInt(packetHandle, "BasicSafetyMessage", newPath);
    result = CheckLastError("BasicSafetyMessage", gkFuncRefGet, result);
  }
  snprintf(newPath, elcount(newPath), "%s.%s", oldPath, "pathHistory");
  value.pathHistory.isValidFlag = C2xIsTokenAvailable(packetHandle, "BasicSafetyMessage", newPath);
  if(value.pathHistory.isValidFlag==1)
  {
    GetBasicSafetyMessagePathHistoryParams(packetHandle, value.pathHistory, newPath);
    result = CheckLastError("BasicSafetyMessage", gkFuncRefGet, result);
  }
  snprintf(newPath, elcount(newPath), "%s.%s", oldPath, "pathPrediction");
  value.pathPrediction.isValidFlag = C2xIsTokenAvailable(packetHandle, "BasicSafetyMessage", newPath);
  if(value.pathPrediction.isValidFlag==1)
  {
    GetBasicSafetyMessagePathPredictionParams(packetHandle, value.pathPrediction, newPath);
    result = CheckLastError("BasicSafetyMessage", gkFuncRefGet, result);
  }
  snprintf(newPath, elcount(newPath), "%s.%s", oldPath, "theRTCM");
  value.theRTCM.isValidFlag = C2xIsTokenAvailable(packetHandle, "BasicSafetyMessage", newPath);
  if(value.theRTCM.isValidFlag==1)
  {
    GetBasicSafetyMessageRTCMPackageParams(packetHandle, value.theRTCM, newPath);
    result = CheckLastError("BasicSafetyMessage", gkFuncRefGet, result);
  }
  return result;
}

int SetBasicSafetyMessageVehicleSafetyExtensionParams(LONG packetHandle, struct BasicSafetyMessageVehicleSafetyExtension value, char oldPath[])
{
  char newPath[300];
  int result;

  result = 0;

  snprintf(newPath, elcount(newPath), "%s.%s", oldPath, "events");
  if(value.events.isValidFlag==1)
  {
    C2xSetTokenInt(packetHandle, "BasicSafetyMessage", newPath, value.events.value);
    result = CheckLastError("BasicSafetyMessage", gkFuncRefGet, result);
  }
  else
  {
    if( C2xIsTokenAvailable(packetHandle, "BasicSafetyMessage", newPath) )
    {
      C2xRemoveToken(packetHandle, "BasicSafetyMessage", newPath);
    }
  }

  snprintf(newPath, elcount(newPath), "%s.%s", oldPath, "pathHistory");
  if(value.pathHistory.isValidFlag==1)
  {
    SetBasicSafetyMessagePathHistoryParams(packetHandle, value.pathHistory, newPath);
    result = CheckLastError("BasicSafetyMessage", gkFuncRefGet, result);
  }
  else
  {
    if( C2xIsTokenAvailable(packetHandle, "BasicSafetyMessage", newPath) )
    {
      C2xRemoveToken(packetHandle, "BasicSafetyMessage", newPath);
    }
  }

  snprintf(newPath, elcount(newPath), "%s.%s", oldPath, "pathPrediction");
  if(value.pathPrediction.isValidFlag==1)
  {
    SetBasicSafetyMessagePathPredictionParams(packetHandle, value.pathPrediction, newPath);
    result = CheckLastError("BasicSafetyMessage", gkFuncRefGet, result);
  }
  else
  {
    if( C2xIsTokenAvailable(packetHandle, "BasicSafetyMessage", newPath) )
    {
      C2xRemoveToken(packetHandle, "BasicSafetyMessage", newPath);
    }
  }

  snprintf(newPath, elcount(newPath), "%s.%s", oldPath, "theRTCM");
  if(value.theRTCM.isValidFlag==1)
  {
    SetBasicSafetyMessageRTCMPackageParams(packetHandle, value.theRTCM, newPath);
    result = CheckLastError("BasicSafetyMessage", gkFuncRefGet, result);
  }
  else
  {
    if( C2xIsTokenAvailable(packetHandle, "BasicSafetyMessage", newPath) )
    {
      C2xRemoveToken(packetHandle, "BasicSafetyMessage", newPath);
    }
  }

  return result;
}

int GetBasicSafetyMessage_VehicleStatus_wipersParams(LONG packetHandle, struct BasicSafetyMessage_VehicleStatus_wipers value, char oldPath[])
{
  char newPath[300];
  int result;

  result = 0;

  snprintf(newPath, elcount(newPath), "%s.%s", oldPath, "statusFront");
  value.statusFront = C2xGetTokenInt(packetHandle, "BasicSafetyMessage", newPath);
  result = CheckLastError("BasicSafetyMessage", gkFuncRefGet, result);

  snprintf(newPath, elcount(newPath), "%s.%s", oldPath, "rateFront");
  value.rateFront = C2xGetTokenInt(packetHandle, "BasicSafetyMessage", newPath);
  result = CheckLastError("BasicSafetyMessage", gkFuncRefGet, result);

  snprintf(newPath, elcount(newPath), "%s.%s", oldPath, "statusRear");
  value.statusRear.isValidFlag = C2xIsTokenAvailable(packetHandle, "BasicSafetyMessage", newPath);
  if(value.statusRear.isValidFlag==1)
  {
    value.statusRear.value = C2xGetTokenInt(packetHandle, "BasicSafetyMessage", newPath);
    result = CheckLastError("BasicSafetyMessage", gkFuncRefGet, result);
  }
  snprintf(newPath, elcount(newPath), "%s.%s", oldPath, "rateRear");
  value.rateRear.isValidFlag = C2xIsTokenAvailable(packetHandle, "BasicSafetyMessage", newPath);
  if(value.rateRear.isValidFlag==1)
  {
    value.rateRear.value = C2xGetTokenInt(packetHandle, "BasicSafetyMessage", newPath);
    result = CheckLastError("BasicSafetyMessage", gkFuncRefGet, result);
  }
  return result;
}

int SetBasicSafetyMessage_VehicleStatus_wipersParams(LONG packetHandle, struct BasicSafetyMessage_VehicleStatus_wipers value, char oldPath[])
{
  char newPath[300];
  int result;

  result = 0;

  snprintf(newPath, elcount(newPath), "%s.%s", oldPath, "statusFront");
  C2xSetTokenInt(packetHandle, "BasicSafetyMessage", newPath, value.statusFront);
  result = CheckLastError("BasicSafetyMessage", gkFuncRefGet, result);

  snprintf(newPath, elcount(newPath), "%s.%s", oldPath, "rateFront");
  C2xSetTokenInt(packetHandle, "BasicSafetyMessage", newPath, value.rateFront);
  result = CheckLastError("BasicSafetyMessage", gkFuncRefGet, result);

  snprintf(newPath, elcount(newPath), "%s.%s", oldPath, "statusRear");
  if(value.statusRear.isValidFlag==1)
  {
    C2xSetTokenInt(packetHandle, "BasicSafetyMessage", newPath, value.statusRear.value);
    result = CheckLastError("BasicSafetyMessage", gkFuncRefGet, result);
  }
  else
  {
    if( C2xIsTokenAvailable(packetHandle, "BasicSafetyMessage", newPath) )
    {
      C2xRemoveToken(packetHandle, "BasicSafetyMessage", newPath);
    }
  }

  snprintf(newPath, elcount(newPath), "%s.%s", oldPath, "rateRear");
  if(value.rateRear.isValidFlag==1)
  {
    C2xSetTokenInt(packetHandle, "BasicSafetyMessage", newPath, value.rateRear.value);
    result = CheckLastError("BasicSafetyMessage", gkFuncRefGet, result);
  }
  else
  {
    if( C2xIsTokenAvailable(packetHandle, "BasicSafetyMessage", newPath) )
    {
      C2xRemoveToken(packetHandle, "BasicSafetyMessage", newPath);
    }
  }

  return result;
}

int GetBasicSafetyMessageBrakeSystemStatusParams(LONG packetHandle, struct BasicSafetyMessageBrakeSystemStatus value, char oldPath[])
{
  char newPath[300];
  int result;

  result = 0;

  snprintf(newPath, elcount(newPath), "%s.%s", oldPath, "_Blob_BrakeSystemStatus");
  GetBasicSafetyMessage_Blob_BrakeSystemStatusParams(packetHandle, value._Blob_BrakeSystemStatus, newPath);
  result = CheckLastError("BasicSafetyMessage", gkFuncRefGet, result);

  return result;
}

int SetBasicSafetyMessageBrakeSystemStatusParams(LONG packetHandle, struct BasicSafetyMessageBrakeSystemStatus value, char oldPath[])
{
  char newPath[300];
  int result;

  result = 0;

  snprintf(newPath, elcount(newPath), "%s.%s", oldPath, "_Blob_BrakeSystemStatus");
  SetBasicSafetyMessage_Blob_BrakeSystemStatusParams(packetHandle, value._Blob_BrakeSystemStatus, newPath);
  result = CheckLastError("BasicSafetyMessage", gkFuncRefGet, result);

  return result;
}

int GetBasicSafetyMessageSteeringWheelAngleParams(LONG packetHandle, struct BasicSafetyMessageSteeringWheelAngle value, char oldPath[])
{
  char newPath[300];
  int result;

  result = 0;

  snprintf(newPath, elcount(newPath), "%s.%s", oldPath, "_Blob_SteeringWheelAngle");
  value._Blob_SteeringWheelAngle = C2xGetTokenInt(packetHandle, "BasicSafetyMessage", newPath);
  result = CheckLastError("BasicSafetyMessage", gkFuncRefGet, result);

  return result;
}

int SetBasicSafetyMessageSteeringWheelAngleParams(LONG packetHandle, struct BasicSafetyMessageSteeringWheelAngle value, char oldPath[])
{
  char newPath[300];
  int result;

  result = 0;

  snprintf(newPath, elcount(newPath), "%s.%s", oldPath, "_Blob_SteeringWheelAngle");
  C2xSetTokenInt(packetHandle, "BasicSafetyMessage", newPath, value._Blob_SteeringWheelAngle);
  result = CheckLastError("BasicSafetyMessage", gkFuncRefGet, result);

  return result;
}

int GetBasicSafetyMessage_VehicleStatus_steeringParams(LONG packetHandle, struct BasicSafetyMessage_VehicleStatus_steering value, char oldPath[])
{
  char newPath[300];
  char buffer[300];
  int result;

  result = 0;

  snprintf(newPath, elcount(newPath), "%s.%s", oldPath, "angle");
  value.angle.stringLength = C2xGetTokenData(packetHandle, "BasicSafetyMessage", newPath, elcount(value.angle.string), value.angle.string);
  snprintf(newPath, elcount(newPath), "%s.%s", oldPath, "confidence");
  value.confidence.isValidFlag = C2xIsTokenAvailable(packetHandle, "BasicSafetyMessage", newPath);
  if(value.confidence.isValidFlag==1)
  {
    value.confidence.value = C2xGetTokenInt(packetHandle, "BasicSafetyMessage", newPath);
    result = CheckLastError("BasicSafetyMessage", gkFuncRefGet, result);
  }
  snprintf(newPath, elcount(newPath), "%s.%s", oldPath, "rate");
  value.rate.isValidFlag = C2xIsTokenAvailable(packetHandle, "BasicSafetyMessage", newPath);
  if(value.rate.isValidFlag==1)
  {
    value.rate.value = C2xGetTokenInt(packetHandle, "BasicSafetyMessage", newPath);
    result = CheckLastError("BasicSafetyMessage", gkFuncRefGet, result);
  }
  snprintf(newPath, elcount(newPath), "%s.%s", oldPath, "wheels");
  value.wheels.isValidFlag = C2xIsTokenAvailable(packetHandle, "BasicSafetyMessage", newPath);
  if(value.wheels.isValidFlag==1)
  {
    value.wheels.value = C2xGetTokenInt(packetHandle, "BasicSafetyMessage", newPath);
    result = CheckLastError("BasicSafetyMessage", gkFuncRefGet, result);
  }
  return result;
}

int SetBasicSafetyMessage_VehicleStatus_steeringParams(LONG packetHandle, struct BasicSafetyMessage_VehicleStatus_steering value, char oldPath[])
{
  char newPath[300];
  char buffer[300];
  int result;

  result = 0;

  snprintf(newPath, elcount(newPath), "%s.%s", oldPath, "angle");
  C2xSetTokenData(packetHandle, "BasicSafetyMessage", newPath, value.angle.stringLength, value.angle.string);

  snprintf(newPath, elcount(newPath), "%s.%s", oldPath, "confidence");
  if(value.confidence.isValidFlag==1)
  {
    C2xSetTokenInt(packetHandle, "BasicSafetyMessage", newPath, value.confidence.value);
    result = CheckLastError("BasicSafetyMessage", gkFuncRefGet, result);
  }
  else
  {
    if( C2xIsTokenAvailable(packetHandle, "BasicSafetyMessage", newPath) )
    {
      C2xRemoveToken(packetHandle, "BasicSafetyMessage", newPath);
    }
  }

  snprintf(newPath, elcount(newPath), "%s.%s", oldPath, "rate");
  if(value.rate.isValidFlag==1)
  {
    C2xSetTokenInt(packetHandle, "BasicSafetyMessage", newPath, value.rate.value);
    result = CheckLastError("BasicSafetyMessage", gkFuncRefGet, result);
  }
  else
  {
    if( C2xIsTokenAvailable(packetHandle, "BasicSafetyMessage", newPath) )
    {
      C2xRemoveToken(packetHandle, "BasicSafetyMessage", newPath);
    }
  }

  snprintf(newPath, elcount(newPath), "%s.%s", oldPath, "wheels");
  if(value.wheels.isValidFlag==1)
  {
    C2xSetTokenInt(packetHandle, "BasicSafetyMessage", newPath, value.wheels.value);
    result = CheckLastError("BasicSafetyMessage", gkFuncRefGet, result);
  }
  else
  {
    if( C2xIsTokenAvailable(packetHandle, "BasicSafetyMessage", newPath) )
    {
      C2xRemoveToken(packetHandle, "BasicSafetyMessage", newPath);
    }
  }

  return result;
}

int GetBasicSafetyMessageAccelerationSet4WayParams(LONG packetHandle, struct BasicSafetyMessageAccelerationSet4Way value, char oldPath[])
{
  char newPath[300];
  int result;

  result = 0;

  snprintf(newPath, elcount(newPath), "%s.%s", oldPath, "_Blob_AccelerationSet4Way");
  GetBasicSafetyMessage_Blob_AccelerationSet4WayParams(packetHandle, value._Blob_AccelerationSet4Way, newPath);
  result = CheckLastError("BasicSafetyMessage", gkFuncRefGet, result);

  return result;
}

int SetBasicSafetyMessageAccelerationSet4WayParams(LONG packetHandle, struct BasicSafetyMessageAccelerationSet4Way value, char oldPath[])
{
  char newPath[300];
  int result;

  result = 0;

  snprintf(newPath, elcount(newPath), "%s.%s", oldPath, "_Blob_AccelerationSet4Way");
  SetBasicSafetyMessage_Blob_AccelerationSet4WayParams(packetHandle, value._Blob_AccelerationSet4Way, newPath);
  result = CheckLastError("BasicSafetyMessage", gkFuncRefGet, result);

  return result;
}

int GetBasicSafetyMessageAccelSteerYawRateConfidenceParams(LONG packetHandle, struct BasicSafetyMessageAccelSteerYawRateConfidence value, char oldPath[])
{
  char newPath[300];
  int result;

  result = 0;

  snprintf(newPath, elcount(newPath), "%s.%s", oldPath, "yawRate");
  value.yawRate = C2xGetTokenInt(packetHandle, "BasicSafetyMessage", newPath);
  result = CheckLastError("BasicSafetyMessage", gkFuncRefGet, result);

  snprintf(newPath, elcount(newPath), "%s.%s", oldPath, "acceleration");
  value.acceleration = C2xGetTokenInt(packetHandle, "BasicSafetyMessage", newPath);
  result = CheckLastError("BasicSafetyMessage", gkFuncRefGet, result);

  snprintf(newPath, elcount(newPath), "%s.%s", oldPath, "steeringWheelAngle");
  value.steeringWheelAngle = C2xGetTokenInt(packetHandle, "BasicSafetyMessage", newPath);
  result = CheckLastError("BasicSafetyMessage", gkFuncRefGet, result);

  return result;
}

int SetBasicSafetyMessageAccelSteerYawRateConfidenceParams(LONG packetHandle, struct BasicSafetyMessageAccelSteerYawRateConfidence value, char oldPath[])
{
  char newPath[300];
  int result;

  result = 0;

  snprintf(newPath, elcount(newPath), "%s.%s", oldPath, "yawRate");
  C2xSetTokenInt(packetHandle, "BasicSafetyMessage", newPath, value.yawRate);
  result = CheckLastError("BasicSafetyMessage", gkFuncRefGet, result);

  snprintf(newPath, elcount(newPath), "%s.%s", oldPath, "acceleration");
  C2xSetTokenInt(packetHandle, "BasicSafetyMessage", newPath, value.acceleration);
  result = CheckLastError("BasicSafetyMessage", gkFuncRefGet, result);

  snprintf(newPath, elcount(newPath), "%s.%s", oldPath, "steeringWheelAngle");
  C2xSetTokenInt(packetHandle, "BasicSafetyMessage", newPath, value.steeringWheelAngle);
  result = CheckLastError("BasicSafetyMessage", gkFuncRefGet, result);

  return result;
}

int GetBasicSafetyMessageConfidenceSetParams(LONG packetHandle, struct BasicSafetyMessageConfidenceSet value, char oldPath[])
{
  char newPath[300];
  int result;

  result = 0;

  snprintf(newPath, elcount(newPath), "%s.%s", oldPath, "accelConfidence");
  value.accelConfidence.isValidFlag = C2xIsTokenAvailable(packetHandle, "BasicSafetyMessage", newPath);
  if(value.accelConfidence.isValidFlag==1)
  {
    GetBasicSafetyMessageAccelSteerYawRateConfidenceParams(packetHandle, value.accelConfidence, newPath);
    result = CheckLastError("BasicSafetyMessage", gkFuncRefGet, result);
  }
  snprintf(newPath, elcount(newPath), "%s.%s", oldPath, "speedConfidence");
  value.speedConfidence.isValidFlag = C2xIsTokenAvailable(packetHandle, "BasicSafetyMessage", newPath);
  if(value.speedConfidence.isValidFlag==1)
  {
    value.speedConfidence.isValidFlag = 1;
    value.speedConfidence.stringLength = C2xGetTokenData(packetHandle, "BasicSafetyMessage", newPath, elcount(value.speedConfidence.string), value.speedConfidence.string);
  }
  snprintf(newPath, elcount(newPath), "%s.%s", oldPath, "timeConfidence");
  value.timeConfidence.isValidFlag = C2xIsTokenAvailable(packetHandle, "BasicSafetyMessage", newPath);
  if(value.timeConfidence.isValidFlag==1)
  {
    value.timeConfidence.value = C2xGetTokenInt(packetHandle, "BasicSafetyMessage", newPath);
    result = CheckLastError("BasicSafetyMessage", gkFuncRefGet, result);
  }
  snprintf(newPath, elcount(newPath), "%s.%s", oldPath, "posConfidence");
  value.posConfidence.isValidFlag = C2xIsTokenAvailable(packetHandle, "BasicSafetyMessage", newPath);
  if(value.posConfidence.isValidFlag==1)
  {
    value.posConfidence.isValidFlag = 1;
    value.posConfidence.stringLength = C2xGetTokenData(packetHandle, "BasicSafetyMessage", newPath, elcount(value.posConfidence.string), value.posConfidence.string);
  }
  snprintf(newPath, elcount(newPath), "%s.%s", oldPath, "steerConfidence");
  value.steerConfidence.isValidFlag = C2xIsTokenAvailable(packetHandle, "BasicSafetyMessage", newPath);
  if(value.steerConfidence.isValidFlag==1)
  {
    value.steerConfidence.value = C2xGetTokenInt(packetHandle, "BasicSafetyMessage", newPath);
    result = CheckLastError("BasicSafetyMessage", gkFuncRefGet, result);
  }
  snprintf(newPath, elcount(newPath), "%s.%s", oldPath, "throttleConfidence");
  value.throttleConfidence.isValidFlag = C2xIsTokenAvailable(packetHandle, "BasicSafetyMessage", newPath);
  if(value.throttleConfidence.isValidFlag==1)
  {
    value.throttleConfidence.value = C2xGetTokenInt(packetHandle, "BasicSafetyMessage", newPath);
    result = CheckLastError("BasicSafetyMessage", gkFuncRefGet, result);
  }
  return result;
}

int SetBasicSafetyMessageConfidenceSetParams(LONG packetHandle, struct BasicSafetyMessageConfidenceSet value, char oldPath[])
{
  char newPath[300];
  int result;

  result = 0;

  snprintf(newPath, elcount(newPath), "%s.%s", oldPath, "accelConfidence");
  if(value.accelConfidence.isValidFlag==1)
  {
    SetBasicSafetyMessageAccelSteerYawRateConfidenceParams(packetHandle, value.accelConfidence, newPath);
    result = CheckLastError("BasicSafetyMessage", gkFuncRefGet, result);
  }
  else
  {
    if( C2xIsTokenAvailable(packetHandle, "BasicSafetyMessage", newPath) )
    {
      C2xRemoveToken(packetHandle, "BasicSafetyMessage", newPath);
    }
  }

  snprintf(newPath, elcount(newPath), "%s.%s", oldPath, "speedConfidence");
  if(value.speedConfidence.isValidFlag==1)
  {
    C2xSetTokenData(packetHandle, "BasicSafetyMessage", newPath, value.speedConfidence.stringLength, value.speedConfidence.string);
  }
  else
  {
    if( C2xIsTokenAvailable(packetHandle, "BasicSafetyMessage", newPath) )
    {
      C2xRemoveToken(packetHandle, "BasicSafetyMessage", newPath);
    }
  }

  snprintf(newPath, elcount(newPath), "%s.%s", oldPath, "timeConfidence");
  if(value.timeConfidence.isValidFlag==1)
  {
    C2xSetTokenInt(packetHandle, "BasicSafetyMessage", newPath, value.timeConfidence.value);
    result = CheckLastError("BasicSafetyMessage", gkFuncRefGet, result);
  }
  else
  {
    if( C2xIsTokenAvailable(packetHandle, "BasicSafetyMessage", newPath) )
    {
      C2xRemoveToken(packetHandle, "BasicSafetyMessage", newPath);
    }
  }

  snprintf(newPath, elcount(newPath), "%s.%s", oldPath, "posConfidence");
  if(value.posConfidence.isValidFlag==1)
  {
    C2xSetTokenData(packetHandle, "BasicSafetyMessage", newPath, value.posConfidence.stringLength, value.posConfidence.string);
  }
  else
  {
    if( C2xIsTokenAvailable(packetHandle, "BasicSafetyMessage", newPath) )
    {
      C2xRemoveToken(packetHandle, "BasicSafetyMessage", newPath);
    }
  }

  snprintf(newPath, elcount(newPath), "%s.%s", oldPath, "steerConfidence");
  if(value.steerConfidence.isValidFlag==1)
  {
    C2xSetTokenInt(packetHandle, "BasicSafetyMessage", newPath, value.steerConfidence.value);
    result = CheckLastError("BasicSafetyMessage", gkFuncRefGet, result);
  }
  else
  {
    if( C2xIsTokenAvailable(packetHandle, "BasicSafetyMessage", newPath) )
    {
      C2xRemoveToken(packetHandle, "BasicSafetyMessage", newPath);
    }
  }

  snprintf(newPath, elcount(newPath), "%s.%s", oldPath, "throttleConfidence");
  if(value.throttleConfidence.isValidFlag==1)
  {
    C2xSetTokenInt(packetHandle, "BasicSafetyMessage", newPath, value.throttleConfidence.value);
    result = CheckLastError("BasicSafetyMessage", gkFuncRefGet, result);
  }
  else
  {
    if( C2xIsTokenAvailable(packetHandle, "BasicSafetyMessage", newPath) )
    {
      C2xRemoveToken(packetHandle, "BasicSafetyMessage", newPath);
    }
  }

  return result;
}

int GetBasicSafetyMessage_VehicleStatus_accelSetsParams(LONG packetHandle, struct BasicSafetyMessage_VehicleStatus_accelSets value, char oldPath[])
{
  char newPath[300]; 
  int j; 
  int k;
  char buffer[300];
  int result;

  result = 0;

  snprintf(newPath, elcount(newPath), "%s.%s", oldPath, "accel4way");
  value.accel4way.isValidFlag = C2xIsTokenAvailable(packetHandle, "BasicSafetyMessage", newPath);
  if(value.accel4way.isValidFlag==1)
  {
    value.accel4way.isValidFlag = 1;
    value.accel4way.stringLength = C2xGetTokenData(packetHandle, "BasicSafetyMessage", newPath, elcount(value.accel4way.string), value.accel4way.string);
  }
  snprintf(newPath, elcount(newPath), "%s.%s", oldPath, "vertAccelThres");
  value.vertAccelThres.isValidFlag = C2xIsTokenAvailable(packetHandle, "BasicSafetyMessage", newPath);
  if(value.vertAccelThres.isValidFlag==1)
  {
    value.vertAccelThres.isValidFlag = 1;
    value.vertAccelThres.stringLength = C2xGetTokenLengthBit(packetHandle, "BasicSafetyMessage", newPath);
    if ((result = CheckLastError("BasicSafetyMessage", gkFuncRefGet, result))==0)
    {
      if(value.vertAccelThres.stringLength > 0)
      {
        for(j=0; j<value.vertAccelThres.stringLength; j++)
        {
          if(C2xGetTokenBitOfBitString(packetHandle, "BasicSafetyMessage", newPath, j) == 0)
          {
            value.vertAccelThres.string[j] = '0';
          }
          else if(C2xGetTokenBitOfBitString(packetHandle, "BasicSafetyMessage", newPath, j) == 1)
          {
            value.vertAccelThres.string[j] = '1';
          }

          if(value.vertAccelThres.stringLength == 1)
          {
            value.vertAccelThres.string[1] = '0';
          }
          result = CheckLastError("BasicSafetyMessage", gkFuncRefGet, result);
        }
      }
      else
      {
        for(k = value.vertAccelThres.stringLength+1; k > -1; k--)
        {
          if(value.vertAccelThres.string[k] == '1')
          {
            value.vertAccelThres.string[k] = '0';
          }
        }
      }
    }

  }
  snprintf(newPath, elcount(newPath), "%s.%s", oldPath, "yawRateCon");
  value.yawRateCon.isValidFlag = C2xIsTokenAvailable(packetHandle, "BasicSafetyMessage", newPath);
  if(value.yawRateCon.isValidFlag==1)
  {
    value.yawRateCon.value = C2xGetTokenInt(packetHandle, "BasicSafetyMessage", newPath);
    result = CheckLastError("BasicSafetyMessage", gkFuncRefGet, result);
  }
  snprintf(newPath, elcount(newPath), "%s.%s", oldPath, "hozAccelCon");
  value.hozAccelCon.isValidFlag = C2xIsTokenAvailable(packetHandle, "BasicSafetyMessage", newPath);
  if(value.hozAccelCon.isValidFlag==1)
  {
    value.hozAccelCon.value = C2xGetTokenInt(packetHandle, "BasicSafetyMessage", newPath);
    result = CheckLastError("BasicSafetyMessage", gkFuncRefGet, result);
  }
  snprintf(newPath, elcount(newPath), "%s.%s", oldPath, "confidenceSet");
  value.confidenceSet.isValidFlag = C2xIsTokenAvailable(packetHandle, "BasicSafetyMessage", newPath);
  if(value.confidenceSet.isValidFlag==1)
  {
    GetBasicSafetyMessageConfidenceSetParams(packetHandle, value.confidenceSet, newPath);
    result = CheckLastError("BasicSafetyMessage", gkFuncRefGet, result);
  }
  return result;
}

int SetBasicSafetyMessage_VehicleStatus_accelSetsParams(LONG packetHandle, struct BasicSafetyMessage_VehicleStatus_accelSets value, char oldPath[])
{
  char newPath[300]; 
  int j;
  char buffer[300];
  int result;

  result = 0;

  snprintf(newPath, elcount(newPath), "%s.%s", oldPath, "accel4way");
  if(value.accel4way.isValidFlag==1)
  {
    C2xSetTokenData(packetHandle, "BasicSafetyMessage", newPath, value.accel4way.stringLength, value.accel4way.string);
  }
  else
  {
    if( C2xIsTokenAvailable(packetHandle, "BasicSafetyMessage", newPath) )
    {
      C2xRemoveToken(packetHandle, "BasicSafetyMessage", newPath);
    }
  }

  snprintf(newPath, elcount(newPath), "%s.%s", oldPath, "vertAccelThres");
  if(value.vertAccelThres.isValidFlag==1)
  {
      for(j=0; j<value.vertAccelThres.stringLength; j++)
      {
        if(value.vertAccelThres.string[j] == '0')
        {
          C2xSetTokenBitOfBitString(packetHandle, "BasicSafetyMessage", newPath, j, 0);
        }
        else
        {
          C2xSetTokenBitOfBitString(packetHandle, "BasicSafetyMessage", newPath, j, 1);
        }
        result = CheckLastError("BasicSafetyMessage", gkFuncRefGet, result);
      }
  }
  else
  {
    if( C2xIsTokenAvailable(packetHandle, "BasicSafetyMessage", newPath) )
    {
      C2xRemoveToken(packetHandle, "BasicSafetyMessage", newPath);
    }
  }

  snprintf(newPath, elcount(newPath), "%s.%s", oldPath, "yawRateCon");
  if(value.yawRateCon.isValidFlag==1)
  {
    C2xSetTokenInt(packetHandle, "BasicSafetyMessage", newPath, value.yawRateCon.value);
    result = CheckLastError("BasicSafetyMessage", gkFuncRefGet, result);
  }
  else
  {
    if( C2xIsTokenAvailable(packetHandle, "BasicSafetyMessage", newPath) )
    {
      C2xRemoveToken(packetHandle, "BasicSafetyMessage", newPath);
    }
  }

  snprintf(newPath, elcount(newPath), "%s.%s", oldPath, "hozAccelCon");
  if(value.hozAccelCon.isValidFlag==1)
  {
    C2xSetTokenInt(packetHandle, "BasicSafetyMessage", newPath, value.hozAccelCon.value);
    result = CheckLastError("BasicSafetyMessage", gkFuncRefGet, result);
  }
  else
  {
    if( C2xIsTokenAvailable(packetHandle, "BasicSafetyMessage", newPath) )
    {
      C2xRemoveToken(packetHandle, "BasicSafetyMessage", newPath);
    }
  }

  snprintf(newPath, elcount(newPath), "%s.%s", oldPath, "confidenceSet");
  if(value.confidenceSet.isValidFlag==1)
  {
    SetBasicSafetyMessageConfidenceSetParams(packetHandle, value.confidenceSet, newPath);
    result = CheckLastError("BasicSafetyMessage", gkFuncRefGet, result);
  }
  else
  {
    if( C2xIsTokenAvailable(packetHandle, "BasicSafetyMessage", newPath) )
    {
      C2xRemoveToken(packetHandle, "BasicSafetyMessage", newPath);
    }
  }

  return result;
}

int GetBasicSafetyMessage_VehicleStatus_objectParams(LONG packetHandle, struct BasicSafetyMessage_VehicleStatus_object value, char oldPath[])
{
  char newPath[300];
  int result;

  result = 0;

  snprintf(newPath, elcount(newPath), "%s.%s", oldPath, "obDist");
  value.obDist = C2xGetTokenInt(packetHandle, "BasicSafetyMessage", newPath);
  result = CheckLastError("BasicSafetyMessage", gkFuncRefGet, result);

  snprintf(newPath, elcount(newPath), "%s.%s", oldPath, "obDirect");
  value.obDirect = C2xGetTokenInt(packetHandle, "BasicSafetyMessage", newPath);
  result = CheckLastError("BasicSafetyMessage", gkFuncRefGet, result);

  snprintf(newPath, elcount(newPath), "%s.%s", oldPath, "dateTime");
  GetBasicSafetyMessageDDateTimeParams(packetHandle, value.dateTime, newPath);
  result = CheckLastError("BasicSafetyMessage", gkFuncRefGet, result);

  return result;
}

int SetBasicSafetyMessage_VehicleStatus_objectParams(LONG packetHandle, struct BasicSafetyMessage_VehicleStatus_object value, char oldPath[])
{
  char newPath[300];
  int result;

  result = 0;

  snprintf(newPath, elcount(newPath), "%s.%s", oldPath, "obDist");
  C2xSetTokenInt(packetHandle, "BasicSafetyMessage", newPath, value.obDist);
  result = CheckLastError("BasicSafetyMessage", gkFuncRefGet, result);

  snprintf(newPath, elcount(newPath), "%s.%s", oldPath, "obDirect");
  C2xSetTokenInt(packetHandle, "BasicSafetyMessage", newPath, value.obDirect);
  result = CheckLastError("BasicSafetyMessage", gkFuncRefGet, result);

  snprintf(newPath, elcount(newPath), "%s.%s", oldPath, "dateTime");
  SetBasicSafetyMessageDDateTimeParams(packetHandle, value.dateTime, newPath);
  result = CheckLastError("BasicSafetyMessage", gkFuncRefGet, result);

  return result;
}

int GetBasicSafetyMessageBumperHeightsParams(LONG packetHandle, struct BasicSafetyMessageBumperHeights value, char oldPath[])
{
  char newPath[300];
  int result;

  result = 0;

  snprintf(newPath, elcount(newPath), "%s.%s", oldPath, "frnt");
  value.frnt = C2xGetTokenInt(packetHandle, "BasicSafetyMessage", newPath);
  result = CheckLastError("BasicSafetyMessage", gkFuncRefGet, result);

  snprintf(newPath, elcount(newPath), "%s.%s", oldPath, "rear");
  value.rear = C2xGetTokenInt(packetHandle, "BasicSafetyMessage", newPath);
  result = CheckLastError("BasicSafetyMessage", gkFuncRefGet, result);

  return result;
}

int SetBasicSafetyMessageBumperHeightsParams(LONG packetHandle, struct BasicSafetyMessageBumperHeights value, char oldPath[])
{
  char newPath[300];
  int result;

  result = 0;

  snprintf(newPath, elcount(newPath), "%s.%s", oldPath, "frnt");
  C2xSetTokenInt(packetHandle, "BasicSafetyMessage", newPath, value.frnt);
  result = CheckLastError("BasicSafetyMessage", gkFuncRefGet, result);

  snprintf(newPath, elcount(newPath), "%s.%s", oldPath, "rear");
  C2xSetTokenInt(packetHandle, "BasicSafetyMessage", newPath, value.rear);
  result = CheckLastError("BasicSafetyMessage", gkFuncRefGet, result);

  return result;
}

int GetBasicSafetyMessage_VehicleStatus_vehicleDataParams(LONG packetHandle, struct BasicSafetyMessage_VehicleStatus_vehicleData value, char oldPath[])
{
  char newPath[300];
  int result;

  result = 0;

  snprintf(newPath, elcount(newPath), "%s.%s", oldPath, "height");
  value.height = C2xGetTokenInt(packetHandle, "BasicSafetyMessage", newPath);
  result = CheckLastError("BasicSafetyMessage", gkFuncRefGet, result);

  snprintf(newPath, elcount(newPath), "%s.%s", oldPath, "bumpers");
  GetBasicSafetyMessageBumperHeightsParams(packetHandle, value.bumpers, newPath);
  result = CheckLastError("BasicSafetyMessage", gkFuncRefGet, result);

  snprintf(newPath, elcount(newPath), "%s.%s", oldPath, "mass");
  value.mass = C2xGetTokenInt(packetHandle, "BasicSafetyMessage", newPath);
  result = CheckLastError("BasicSafetyMessage", gkFuncRefGet, result);

  snprintf(newPath, elcount(newPath), "%s.%s", oldPath, "trailerWeight");
  value.trailerWeight = C2xGetTokenInt(packetHandle, "BasicSafetyMessage", newPath);
  result = CheckLastError("BasicSafetyMessage", gkFuncRefGet, result);

  snprintf(newPath, elcount(newPath), "%s.%s", oldPath, "type");
  value.type = C2xGetTokenInt(packetHandle, "BasicSafetyMessage", newPath);
  result = CheckLastError("BasicSafetyMessage", gkFuncRefGet, result);

  return result;
}

int SetBasicSafetyMessage_VehicleStatus_vehicleDataParams(LONG packetHandle, struct BasicSafetyMessage_VehicleStatus_vehicleData value, char oldPath[])
{
  char newPath[300];
  int result;

  result = 0;

  snprintf(newPath, elcount(newPath), "%s.%s", oldPath, "height");
  C2xSetTokenInt(packetHandle, "BasicSafetyMessage", newPath, value.height);
  result = CheckLastError("BasicSafetyMessage", gkFuncRefGet, result);

  snprintf(newPath, elcount(newPath), "%s.%s", oldPath, "bumpers");
  SetBasicSafetyMessageBumperHeightsParams(packetHandle, value.bumpers, newPath);
  result = CheckLastError("BasicSafetyMessage", gkFuncRefGet, result);

  snprintf(newPath, elcount(newPath), "%s.%s", oldPath, "mass");
  C2xSetTokenInt(packetHandle, "BasicSafetyMessage", newPath, value.mass);
  result = CheckLastError("BasicSafetyMessage", gkFuncRefGet, result);

  snprintf(newPath, elcount(newPath), "%s.%s", oldPath, "trailerWeight");
  C2xSetTokenInt(packetHandle, "BasicSafetyMessage", newPath, value.trailerWeight);
  result = CheckLastError("BasicSafetyMessage", gkFuncRefGet, result);

  snprintf(newPath, elcount(newPath), "%s.%s", oldPath, "type");
  C2xSetTokenInt(packetHandle, "BasicSafetyMessage", newPath, value.type);
  result = CheckLastError("BasicSafetyMessage", gkFuncRefGet, result);

  return result;
}

int GetBasicSafetyMessage_Blob_TemporaryIDParams(LONG packetHandle, struct BasicSafetyMessage_Blob_TemporaryID value, char oldPath[])
{
  char newPath[300];
  int result;

  result = 0;

  snprintf(newPath, elcount(newPath), "%s.%s", oldPath, "temporaryID");
  value.temporaryID = C2xGetTokenInt64(packetHandle, "BasicSafetyMessage", newPath);
  result = CheckLastError("BasicSafetyMessage", gkFuncRefGet, result);

  return result;
}

int SetBasicSafetyMessage_Blob_TemporaryIDParams(LONG packetHandle, struct BasicSafetyMessage_Blob_TemporaryID value, char oldPath[])
{
  char newPath[300];
  int result;

  result = 0;

  snprintf(newPath, elcount(newPath), "%s.%s", oldPath, "temporaryID");
  C2xSetTokenInt64(packetHandle, "BasicSafetyMessage", newPath, value.temporaryID);
  result = CheckLastError("BasicSafetyMessage", gkFuncRefGet, result);

  return result;
}

int GetBasicSafetyMessageTemporaryIDParams(LONG packetHandle, struct BasicSafetyMessageTemporaryID value, char oldPath[])
{
  char newPath[300];
  int result;

  result = 0;

  snprintf(newPath, elcount(newPath), "%s.%s", oldPath, "_Blob_TemporaryID");
  GetBasicSafetyMessage_Blob_TemporaryIDParams(packetHandle, value._Blob_TemporaryID, newPath);
  result = CheckLastError("BasicSafetyMessage", gkFuncRefGet, result);

  return result;
}

int SetBasicSafetyMessageTemporaryIDParams(LONG packetHandle, struct BasicSafetyMessageTemporaryID value, char oldPath[])
{
  char newPath[300];
  int result;

  result = 0;

  snprintf(newPath, elcount(newPath), "%s.%s", oldPath, "_Blob_TemporaryID");
  SetBasicSafetyMessage_Blob_TemporaryIDParams(packetHandle, value._Blob_TemporaryID, newPath);
  result = CheckLastError("BasicSafetyMessage", gkFuncRefGet, result);

  return result;
}

int GetBasicSafetyMessage_VehicleIdent_vehicleClassParams(LONG packetHandle, struct BasicSafetyMessage_VehicleIdent_vehicleClass value, char oldPath[])
{
  char newPath[300];
  int result;

  result = 0;

  value.choice = C2xGetTokenInt(packetHandle, "BasicSafetyMessage", oldPath);

  switch(value.choice)
  {
    case 0:
    {
      snprintf(newPath, elcount(newPath), "%s.%s", oldPath, "vGroup");
      value.vGroup = C2xGetTokenInt(packetHandle, "BasicSafetyMessage", newPath);
      result = CheckLastError("BasicSafetyMessage", gkFuncRefGet, result);
    }
    break;
    case 1:
    {
      snprintf(newPath, elcount(newPath), "%s.%s", oldPath, "rGroup");
      value.rGroup = C2xGetTokenInt(packetHandle, "BasicSafetyMessage", newPath);
      result = CheckLastError("BasicSafetyMessage", gkFuncRefGet, result);
    }
    break;
    case 2:
    {
      snprintf(newPath, elcount(newPath), "%s.%s", oldPath, "rEquip");
      value.rEquip = C2xGetTokenInt(packetHandle, "BasicSafetyMessage", newPath);
      result = CheckLastError("BasicSafetyMessage", gkFuncRefGet, result);
    }
    break;
  }
  return result;
}

int SetBasicSafetyMessage_VehicleIdent_vehicleClassParams(LONG packetHandle, struct BasicSafetyMessage_VehicleIdent_vehicleClass value, char oldPath[])
{
  char newPath[300];
  int result;

  result = 0;

  switch(value.choice)
  {
    case 0:
    {
      snprintf(newPath, elcount(newPath), "%s.%s", oldPath, "vGroup");
      C2xSetTokenInt(packetHandle, "BasicSafetyMessage", newPath, value.vGroup);
      result = CheckLastError("BasicSafetyMessage", gkFuncRefGet, result);
    }
    break;
    case 1:
    {
      snprintf(newPath, elcount(newPath), "%s.%s", oldPath, "rGroup");
      C2xSetTokenInt(packetHandle, "BasicSafetyMessage", newPath, value.rGroup);
      result = CheckLastError("BasicSafetyMessage", gkFuncRefGet, result);
    }
    break;
    case 2:
    {
      snprintf(newPath, elcount(newPath), "%s.%s", oldPath, "rEquip");
      C2xSetTokenInt(packetHandle, "BasicSafetyMessage", newPath, value.rEquip);
      result = CheckLastError("BasicSafetyMessage", gkFuncRefGet, result);
    }
    break;
  }
  return result;
}

int GetBasicSafetyMessageVehicleIdentParams(LONG packetHandle, struct BasicSafetyMessageVehicleIdent value, char oldPath[])
{
  char newPath[300];
  int result;

  result = 0;

  snprintf(newPath, elcount(newPath), "%s.%s", oldPath, "name");
  value.name.isValidFlag = C2xIsTokenAvailable(packetHandle, "BasicSafetyMessage", newPath);
  if(value.name.isValidFlag==1)
  {
    value.name.stringLength = C2xGetTokenData(packetHandle, "BasicSafetyMessage", newPath, elcount(value.name.string), value.name.string);
    result = CheckLastError("BasicSafetyMessage", gkFuncRefGet, result);
  }
  snprintf(newPath, elcount(newPath), "%s.%s", oldPath, "vin");
  value.vin.isValidFlag = C2xIsTokenAvailable(packetHandle, "BasicSafetyMessage", newPath);
  if(value.vin.isValidFlag==1)
  {
    value.vin.isValidFlag = 1;
    value.vin.stringLength = C2xGetTokenData(packetHandle, "BasicSafetyMessage", newPath, elcount(value.vin.string), value.vin.string);
  }
  snprintf(newPath, elcount(newPath), "%s.%s", oldPath, "ownerCode");
  value.ownerCode.isValidFlag = C2xIsTokenAvailable(packetHandle, "BasicSafetyMessage", newPath);
  if(value.ownerCode.isValidFlag==1)
  {
    value.ownerCode.stringLength = C2xGetTokenData(packetHandle, "BasicSafetyMessage", newPath, elcount(value.ownerCode.string), value.ownerCode.string);
    result = CheckLastError("BasicSafetyMessage", gkFuncRefGet, result);
  }
  snprintf(newPath, elcount(newPath), "%s.%s", oldPath, "id");
  value.id.isValidFlag = C2xIsTokenAvailable(packetHandle, "BasicSafetyMessage", newPath);
  if(value.id.isValidFlag==1)
  {
    value.id.isValidFlag = 1;
    value.id.stringLength = C2xGetTokenData(packetHandle, "BasicSafetyMessage", newPath, elcount(value.id.string), value.id.string);
  }
  snprintf(newPath, elcount(newPath), "%s.%s", oldPath, "vehicleType");
  value.vehicleType.isValidFlag = C2xIsTokenAvailable(packetHandle, "BasicSafetyMessage", newPath);
  if(value.vehicleType.isValidFlag==1)
  {
    value.vehicleType.value = C2xGetTokenInt(packetHandle, "BasicSafetyMessage", newPath);
    result = CheckLastError("BasicSafetyMessage", gkFuncRefGet, result);
  }
  snprintf(newPath, elcount(newPath), "%s.%s", oldPath, "vehicleClass");
  value.vehicleClass.isValidFlag = C2xIsTokenAvailable(packetHandle, "BasicSafetyMessage", newPath);
  if(value.vehicleClass.isValidFlag==1)
  {
    GetBasicSafetyMessage_VehicleIdent_vehicleClassParams(packetHandle, value.vehicleClass, newPath);
    result = CheckLastError("BasicSafetyMessage", gkFuncRefGet, result);
  }
  return result;
}

int SetBasicSafetyMessageVehicleIdentParams(LONG packetHandle, struct BasicSafetyMessageVehicleIdent value, char oldPath[])
{
  char newPath[300];
  int result;

  result = 0;

  snprintf(newPath, elcount(newPath), "%s.%s", oldPath, "name");
  if(value.name.isValidFlag==1)
  {
    C2xSetTokenData(packetHandle, "BasicSafetyMessage", newPath, value.name.stringLength, value.name.string);
    result = CheckLastError("BasicSafetyMessage", gkFuncRefGet, result);
  }
  else
  {
    if( C2xIsTokenAvailable(packetHandle, "BasicSafetyMessage", newPath) )
    {
      C2xRemoveToken(packetHandle, "BasicSafetyMessage", newPath);
    }
  }

  snprintf(newPath, elcount(newPath), "%s.%s", oldPath, "vin");
  if(value.vin.isValidFlag==1)
  {
    C2xSetTokenData(packetHandle, "BasicSafetyMessage", newPath, value.vin.stringLength, value.vin.string);
  }
  else
  {
    if( C2xIsTokenAvailable(packetHandle, "BasicSafetyMessage", newPath) )
    {
      C2xRemoveToken(packetHandle, "BasicSafetyMessage", newPath);
    }
  }

  snprintf(newPath, elcount(newPath), "%s.%s", oldPath, "ownerCode");
  if(value.ownerCode.isValidFlag==1)
  {
    C2xSetTokenData(packetHandle, "BasicSafetyMessage", newPath, value.ownerCode.stringLength, value.ownerCode.string);
    result = CheckLastError("BasicSafetyMessage", gkFuncRefGet, result);
  }
  else
  {
    if( C2xIsTokenAvailable(packetHandle, "BasicSafetyMessage", newPath) )
    {
      C2xRemoveToken(packetHandle, "BasicSafetyMessage", newPath);
    }
  }

  snprintf(newPath, elcount(newPath), "%s.%s", oldPath, "id");
  if(value.id.isValidFlag==1)
  {
    C2xSetTokenData(packetHandle, "BasicSafetyMessage", newPath, value.id.stringLength, value.id.string);
  }
  else
  {
    if( C2xIsTokenAvailable(packetHandle, "BasicSafetyMessage", newPath) )
    {
      C2xRemoveToken(packetHandle, "BasicSafetyMessage", newPath);
    }
  }

  snprintf(newPath, elcount(newPath), "%s.%s", oldPath, "vehicleType");
  if(value.vehicleType.isValidFlag==1)
  {
    C2xSetTokenInt(packetHandle, "BasicSafetyMessage", newPath, value.vehicleType.value);
    result = CheckLastError("BasicSafetyMessage", gkFuncRefGet, result);
  }
  else
  {
    if( C2xIsTokenAvailable(packetHandle, "BasicSafetyMessage", newPath) )
    {
      C2xRemoveToken(packetHandle, "BasicSafetyMessage", newPath);
    }
  }

  snprintf(newPath, elcount(newPath), "%s.%s", oldPath, "vehicleClass");
  if(value.vehicleClass.isValidFlag==1)
  {
    SetBasicSafetyMessage_VehicleIdent_vehicleClassParams(packetHandle, value.vehicleClass, newPath);
    result = CheckLastError("BasicSafetyMessage", gkFuncRefGet, result);
  }
  else
  {
    if( C2xIsTokenAvailable(packetHandle, "BasicSafetyMessage", newPath) )
    {
      C2xRemoveToken(packetHandle, "BasicSafetyMessage", newPath);
    }
  }

  return result;
}

int GetBasicSafetyMessage_J1939data_tires_Params(LONG packetHandle, struct BasicSafetyMessage_J1939data_tires_ value, char oldPath[])
{
  char newPath[300]; 
  int j; 
  int k;
  int result;

  result = 0;

  snprintf(newPath, elcount(newPath), "%s.%s", oldPath, "location");
  value.location.isValidFlag = C2xIsTokenAvailable(packetHandle, "BasicSafetyMessage", newPath);
  if(value.location.isValidFlag==1)
  {
    value.location.value = C2xGetTokenInt(packetHandle, "BasicSafetyMessage", newPath);
    result = CheckLastError("BasicSafetyMessage", gkFuncRefGet, result);
  }
  snprintf(newPath, elcount(newPath), "%s.%s", oldPath, "pressure");
  value.pressure.isValidFlag = C2xIsTokenAvailable(packetHandle, "BasicSafetyMessage", newPath);
  if(value.pressure.isValidFlag==1)
  {
    value.pressure.value = C2xGetTokenInt(packetHandle, "BasicSafetyMessage", newPath);
    result = CheckLastError("BasicSafetyMessage", gkFuncRefGet, result);
  }
  snprintf(newPath, elcount(newPath), "%s.%s", oldPath, "temp");
  value.temp.isValidFlag = C2xIsTokenAvailable(packetHandle, "BasicSafetyMessage", newPath);
  if(value.temp.isValidFlag==1)
  {
    value.temp.value = C2xGetTokenInt(packetHandle, "BasicSafetyMessage", newPath);
    result = CheckLastError("BasicSafetyMessage", gkFuncRefGet, result);
  }
  snprintf(newPath, elcount(newPath), "%s.%s", oldPath, "wheelSensorStatus");
  value.wheelSensorStatus.isValidFlag = C2xIsTokenAvailable(packetHandle, "BasicSafetyMessage", newPath);
  if(value.wheelSensorStatus.isValidFlag==1)
  {
    value.wheelSensorStatus.value = C2xGetTokenInt(packetHandle, "BasicSafetyMessage", newPath);
    result = CheckLastError("BasicSafetyMessage", gkFuncRefGet, result);
  }
  snprintf(newPath, elcount(newPath), "%s.%s", oldPath, "wheelEndElectFault");
  value.wheelEndElectFault.isValidFlag = C2xIsTokenAvailable(packetHandle, "BasicSafetyMessage", newPath);
  if(value.wheelEndElectFault.isValidFlag==1)
  {
    value.wheelEndElectFault.isValidFlag = 1;
    value.wheelEndElectFault.stringLength = C2xGetTokenLengthBit(packetHandle, "BasicSafetyMessage", newPath);
    if ((result = CheckLastError("BasicSafetyMessage", gkFuncRefGet, result))==0)
    {
      if(value.wheelEndElectFault.stringLength > 0)
      {
        for(j=0; j<value.wheelEndElectFault.stringLength; j++)
        {
          if(C2xGetTokenBitOfBitString(packetHandle, "BasicSafetyMessage", newPath, j) == 0)
          {
            value.wheelEndElectFault.string[j] = '0';
          }
          else if(C2xGetTokenBitOfBitString(packetHandle, "BasicSafetyMessage", newPath, j) == 1)
          {
            value.wheelEndElectFault.string[j] = '1';
          }

          if(value.wheelEndElectFault.stringLength == 1)
          {
            value.wheelEndElectFault.string[1] = '0';
          }
          result = CheckLastError("BasicSafetyMessage", gkFuncRefGet, result);
        }
      }
      else
      {
        for(k = value.wheelEndElectFault.stringLength+1; k > -1; k--)
        {
          if(value.wheelEndElectFault.string[k] == '1')
          {
            value.wheelEndElectFault.string[k] = '0';
          }
        }
      }
    }

  }
  snprintf(newPath, elcount(newPath), "%s.%s", oldPath, "leakageRate");
  value.leakageRate.isValidFlag = C2xIsTokenAvailable(packetHandle, "BasicSafetyMessage", newPath);
  if(value.leakageRate.isValidFlag==1)
  {
    value.leakageRate.value = C2xGetTokenInt(packetHandle, "BasicSafetyMessage", newPath);
    result = CheckLastError("BasicSafetyMessage", gkFuncRefGet, result);
  }
  snprintf(newPath, elcount(newPath), "%s.%s", oldPath, "detection");
  value.detection.isValidFlag = C2xIsTokenAvailable(packetHandle, "BasicSafetyMessage", newPath);
  if(value.detection.isValidFlag==1)
  {
    value.detection.value = C2xGetTokenInt(packetHandle, "BasicSafetyMessage", newPath);
    result = CheckLastError("BasicSafetyMessage", gkFuncRefGet, result);
  }
  return result;
}

int SetBasicSafetyMessage_J1939data_tires_Params(LONG packetHandle, struct BasicSafetyMessage_J1939data_tires_ value, char oldPath[])
{
  char newPath[300]; 
  int j;
  int result;

  result = 0;

  snprintf(newPath, elcount(newPath), "%s.%s", oldPath, "location");
  if(value.location.isValidFlag==1)
  {
    C2xSetTokenInt(packetHandle, "BasicSafetyMessage", newPath, value.location.value);
    result = CheckLastError("BasicSafetyMessage", gkFuncRefGet, result);
  }
  else
  {
    if( C2xIsTokenAvailable(packetHandle, "BasicSafetyMessage", newPath) )
    {
      C2xRemoveToken(packetHandle, "BasicSafetyMessage", newPath);
    }
  }

  snprintf(newPath, elcount(newPath), "%s.%s", oldPath, "pressure");
  if(value.pressure.isValidFlag==1)
  {
    C2xSetTokenInt(packetHandle, "BasicSafetyMessage", newPath, value.pressure.value);
    result = CheckLastError("BasicSafetyMessage", gkFuncRefGet, result);
  }
  else
  {
    if( C2xIsTokenAvailable(packetHandle, "BasicSafetyMessage", newPath) )
    {
      C2xRemoveToken(packetHandle, "BasicSafetyMessage", newPath);
    }
  }

  snprintf(newPath, elcount(newPath), "%s.%s", oldPath, "temp");
  if(value.temp.isValidFlag==1)
  {
    C2xSetTokenInt(packetHandle, "BasicSafetyMessage", newPath, value.temp.value);
    result = CheckLastError("BasicSafetyMessage", gkFuncRefGet, result);
  }
  else
  {
    if( C2xIsTokenAvailable(packetHandle, "BasicSafetyMessage", newPath) )
    {
      C2xRemoveToken(packetHandle, "BasicSafetyMessage", newPath);
    }
  }

  snprintf(newPath, elcount(newPath), "%s.%s", oldPath, "wheelSensorStatus");
  if(value.wheelSensorStatus.isValidFlag==1)
  {
    C2xSetTokenInt(packetHandle, "BasicSafetyMessage", newPath, value.wheelSensorStatus.value);
    result = CheckLastError("BasicSafetyMessage", gkFuncRefGet, result);
  }
  else
  {
    if( C2xIsTokenAvailable(packetHandle, "BasicSafetyMessage", newPath) )
    {
      C2xRemoveToken(packetHandle, "BasicSafetyMessage", newPath);
    }
  }

  snprintf(newPath, elcount(newPath), "%s.%s", oldPath, "wheelEndElectFault");
  if(value.wheelEndElectFault.isValidFlag==1)
  {
      for(j=0; j<value.wheelEndElectFault.stringLength; j++)
      {
        if(value.wheelEndElectFault.string[j] == '0')
        {
          C2xSetTokenBitOfBitString(packetHandle, "BasicSafetyMessage", newPath, j, 0);
        }
        else
        {
          C2xSetTokenBitOfBitString(packetHandle, "BasicSafetyMessage", newPath, j, 1);
        }
        result = CheckLastError("BasicSafetyMessage", gkFuncRefGet, result);
      }
  }
  else
  {
    if( C2xIsTokenAvailable(packetHandle, "BasicSafetyMessage", newPath) )
    {
      C2xRemoveToken(packetHandle, "BasicSafetyMessage", newPath);
    }
  }

  snprintf(newPath, elcount(newPath), "%s.%s", oldPath, "leakageRate");
  if(value.leakageRate.isValidFlag==1)
  {
    C2xSetTokenInt(packetHandle, "BasicSafetyMessage", newPath, value.leakageRate.value);
    result = CheckLastError("BasicSafetyMessage", gkFuncRefGet, result);
  }
  else
  {
    if( C2xIsTokenAvailable(packetHandle, "BasicSafetyMessage", newPath) )
    {
      C2xRemoveToken(packetHandle, "BasicSafetyMessage", newPath);
    }
  }

  snprintf(newPath, elcount(newPath), "%s.%s", oldPath, "detection");
  if(value.detection.isValidFlag==1)
  {
    C2xSetTokenInt(packetHandle, "BasicSafetyMessage", newPath, value.detection.value);
    result = CheckLastError("BasicSafetyMessage", gkFuncRefGet, result);
  }
  else
  {
    if( C2xIsTokenAvailable(packetHandle, "BasicSafetyMessage", newPath) )
    {
      C2xRemoveToken(packetHandle, "BasicSafetyMessage", newPath);
    }
  }

  return result;
}

int GetBasicSafetyMessage_J1939data_tiresParams(LONG packetHandle, struct BasicSafetyMessage_J1939data_tires value, char oldPath[])
{
  char newPath[300]; 
  int i;
  int result;

  result = 0;

  value.length = C2xGetTokenInt(packetHandle, "BasicSafetyMessage", oldPath);
  if((result = CheckLastError("BasicSafetyMessage", gkFuncRefGet, result))==0)
  {
    for(i=0; i<value.length; i++)
    {
      snprintf(newPath, elcount(newPath), "%s[%d]", oldPath, i);
      GetBasicSafetyMessage_J1939data_tires_Params(packetHandle, value.arrayValue[i], newPath);
      result = CheckLastError("BasicSafetyMessage", gkFuncRefGet, result);
    }
  }
  return result;
}

int SetBasicSafetyMessage_J1939data_tiresParams(LONG packetHandle, struct BasicSafetyMessage_J1939data_tires value, char oldPath[])
{
  char newPath[300]; 
  int i;
  int result;

  result = 0;

  C2xRemoveToken(packetHandle, "BasicSafetyMessage", oldPath);
  for(i=0; i<value.length; i++)
  {
    snprintf(newPath, elcount(newPath), "%s[%d]", oldPath, i);
    SetBasicSafetyMessage_J1939data_tires_Params(packetHandle, value.arrayValue[i], newPath);
    result = CheckLastError("BasicSafetyMessage", gkFuncRefGet, result);
  }
  return result;
}

int GetBasicSafetyMessage_J1939data_axle_Params(LONG packetHandle, struct BasicSafetyMessage_J1939data_axle_ value, char oldPath[])
{
  char newPath[300];
  int result;

  result = 0;

  snprintf(newPath, elcount(newPath), "%s.%s", oldPath, "location");
  value.location.isValidFlag = C2xIsTokenAvailable(packetHandle, "BasicSafetyMessage", newPath);
  if(value.location.isValidFlag==1)
  {
    value.location.value = C2xGetTokenInt(packetHandle, "BasicSafetyMessage", newPath);
    result = CheckLastError("BasicSafetyMessage", gkFuncRefGet, result);
  }
  snprintf(newPath, elcount(newPath), "%s.%s", oldPath, "weight");
  value.weight.isValidFlag = C2xIsTokenAvailable(packetHandle, "BasicSafetyMessage", newPath);
  if(value.weight.isValidFlag==1)
  {
    value.weight.value = C2xGetTokenInt(packetHandle, "BasicSafetyMessage", newPath);
    result = CheckLastError("BasicSafetyMessage", gkFuncRefGet, result);
  }
  return result;
}

int SetBasicSafetyMessage_J1939data_axle_Params(LONG packetHandle, struct BasicSafetyMessage_J1939data_axle_ value, char oldPath[])
{
  char newPath[300];
  int result;

  result = 0;

  snprintf(newPath, elcount(newPath), "%s.%s", oldPath, "location");
  if(value.location.isValidFlag==1)
  {
    C2xSetTokenInt(packetHandle, "BasicSafetyMessage", newPath, value.location.value);
    result = CheckLastError("BasicSafetyMessage", gkFuncRefGet, result);
  }
  else
  {
    if( C2xIsTokenAvailable(packetHandle, "BasicSafetyMessage", newPath) )
    {
      C2xRemoveToken(packetHandle, "BasicSafetyMessage", newPath);
    }
  }

  snprintf(newPath, elcount(newPath), "%s.%s", oldPath, "weight");
  if(value.weight.isValidFlag==1)
  {
    C2xSetTokenInt(packetHandle, "BasicSafetyMessage", newPath, value.weight.value);
    result = CheckLastError("BasicSafetyMessage", gkFuncRefGet, result);
  }
  else
  {
    if( C2xIsTokenAvailable(packetHandle, "BasicSafetyMessage", newPath) )
    {
      C2xRemoveToken(packetHandle, "BasicSafetyMessage", newPath);
    }
  }

  return result;
}

int GetBasicSafetyMessage_J1939data_axleParams(LONG packetHandle, struct BasicSafetyMessage_J1939data_axle value, char oldPath[])
{
  char newPath[300]; 
  int i;
  int result;

  result = 0;

  value.length = C2xGetTokenInt(packetHandle, "BasicSafetyMessage", oldPath);
  if((result = CheckLastError("BasicSafetyMessage", gkFuncRefGet, result))==0)
  {
    for(i=0; i<value.length; i++)
    {
      snprintf(newPath, elcount(newPath), "%s[%d]", oldPath, i);
      GetBasicSafetyMessage_J1939data_axle_Params(packetHandle, value.arrayValue[i], newPath);
      result = CheckLastError("BasicSafetyMessage", gkFuncRefGet, result);
    }
  }
  return result;
}

int SetBasicSafetyMessage_J1939data_axleParams(LONG packetHandle, struct BasicSafetyMessage_J1939data_axle value, char oldPath[])
{
  char newPath[300]; 
  int i;
  int result;

  result = 0;

  C2xRemoveToken(packetHandle, "BasicSafetyMessage", oldPath);
  for(i=0; i<value.length; i++)
  {
    snprintf(newPath, elcount(newPath), "%s[%d]", oldPath, i);
    SetBasicSafetyMessage_J1939data_axle_Params(packetHandle, value.arrayValue[i], newPath);
    result = CheckLastError("BasicSafetyMessage", gkFuncRefGet, result);
  }
  return result;
}

int GetBasicSafetyMessageJ1939dataParams(LONG packetHandle, struct BasicSafetyMessageJ1939data value, char oldPath[])
{
  char newPath[300];
  int result;

  result = 0;

  snprintf(newPath, elcount(newPath), "%s.%s", oldPath, "tires");
  value.tires.isValidFlag = C2xIsTokenAvailable(packetHandle, "BasicSafetyMessage", newPath);
  if(value.tires.isValidFlag==1)
  {
    GetBasicSafetyMessage_J1939data_tiresParams(packetHandle, value.tires, newPath);
    result = CheckLastError("BasicSafetyMessage", gkFuncRefGet, result);
  }
  snprintf(newPath, elcount(newPath), "%s.%s", oldPath, "axle");
  value.axle.isValidFlag = C2xIsTokenAvailable(packetHandle, "BasicSafetyMessage", newPath);
  if(value.axle.isValidFlag==1)
  {
    GetBasicSafetyMessage_J1939data_axleParams(packetHandle, value.axle, newPath);
    result = CheckLastError("BasicSafetyMessage", gkFuncRefGet, result);
  }
  snprintf(newPath, elcount(newPath), "%s.%s", oldPath, "trailerWeight");
  value.trailerWeight.isValidFlag = C2xIsTokenAvailable(packetHandle, "BasicSafetyMessage", newPath);
  if(value.trailerWeight.isValidFlag==1)
  {
    value.trailerWeight.value = C2xGetTokenInt(packetHandle, "BasicSafetyMessage", newPath);
    result = CheckLastError("BasicSafetyMessage", gkFuncRefGet, result);
  }
  snprintf(newPath, elcount(newPath), "%s.%s", oldPath, "cargoWeight");
  value.cargoWeight.isValidFlag = C2xIsTokenAvailable(packetHandle, "BasicSafetyMessage", newPath);
  if(value.cargoWeight.isValidFlag==1)
  {
    value.cargoWeight.value = C2xGetTokenInt(packetHandle, "BasicSafetyMessage", newPath);
    result = CheckLastError("BasicSafetyMessage", gkFuncRefGet, result);
  }
  snprintf(newPath, elcount(newPath), "%s.%s", oldPath, "steeringAxleTemperature");
  value.steeringAxleTemperature.isValidFlag = C2xIsTokenAvailable(packetHandle, "BasicSafetyMessage", newPath);
  if(value.steeringAxleTemperature.isValidFlag==1)
  {
    value.steeringAxleTemperature.value = C2xGetTokenInt(packetHandle, "BasicSafetyMessage", newPath);
    result = CheckLastError("BasicSafetyMessage", gkFuncRefGet, result);
  }
  snprintf(newPath, elcount(newPath), "%s.%s", oldPath, "driveAxleLocation");
  value.driveAxleLocation.isValidFlag = C2xIsTokenAvailable(packetHandle, "BasicSafetyMessage", newPath);
  if(value.driveAxleLocation.isValidFlag==1)
  {
    value.driveAxleLocation.value = C2xGetTokenInt(packetHandle, "BasicSafetyMessage", newPath);
    result = CheckLastError("BasicSafetyMessage", gkFuncRefGet, result);
  }
  snprintf(newPath, elcount(newPath), "%s.%s", oldPath, "driveAxleLiftAirPressure");
  value.driveAxleLiftAirPressure.isValidFlag = C2xIsTokenAvailable(packetHandle, "BasicSafetyMessage", newPath);
  if(value.driveAxleLiftAirPressure.isValidFlag==1)
  {
    value.driveAxleLiftAirPressure.value = C2xGetTokenInt(packetHandle, "BasicSafetyMessage", newPath);
    result = CheckLastError("BasicSafetyMessage", gkFuncRefGet, result);
  }
  snprintf(newPath, elcount(newPath), "%s.%s", oldPath, "driveAxleTemperature");
  value.driveAxleTemperature.isValidFlag = C2xIsTokenAvailable(packetHandle, "BasicSafetyMessage", newPath);
  if(value.driveAxleTemperature.isValidFlag==1)
  {
    value.driveAxleTemperature.value = C2xGetTokenInt(packetHandle, "BasicSafetyMessage", newPath);
    result = CheckLastError("BasicSafetyMessage", gkFuncRefGet, result);
  }
  snprintf(newPath, elcount(newPath), "%s.%s", oldPath, "driveAxleLubePressure");
  value.driveAxleLubePressure.isValidFlag = C2xIsTokenAvailable(packetHandle, "BasicSafetyMessage", newPath);
  if(value.driveAxleLubePressure.isValidFlag==1)
  {
    value.driveAxleLubePressure.value = C2xGetTokenInt(packetHandle, "BasicSafetyMessage", newPath);
    result = CheckLastError("BasicSafetyMessage", gkFuncRefGet, result);
  }
  snprintf(newPath, elcount(newPath), "%s.%s", oldPath, "steeringAxleLubePressure");
  value.steeringAxleLubePressure.isValidFlag = C2xIsTokenAvailable(packetHandle, "BasicSafetyMessage", newPath);
  if(value.steeringAxleLubePressure.isValidFlag==1)
  {
    value.steeringAxleLubePressure.value = C2xGetTokenInt(packetHandle, "BasicSafetyMessage", newPath);
    result = CheckLastError("BasicSafetyMessage", gkFuncRefGet, result);
  }
  return result;
}

int SetBasicSafetyMessageJ1939dataParams(LONG packetHandle, struct BasicSafetyMessageJ1939data value, char oldPath[])
{
  char newPath[300];
  int result;

  result = 0;

  snprintf(newPath, elcount(newPath), "%s.%s", oldPath, "tires");
  if(value.tires.isValidFlag==1)
  {
    SetBasicSafetyMessage_J1939data_tiresParams(packetHandle, value.tires, newPath);
    result = CheckLastError("BasicSafetyMessage", gkFuncRefGet, result);
  }
  else
  {
    if( C2xIsTokenAvailable(packetHandle, "BasicSafetyMessage", newPath) )
    {
      C2xRemoveToken(packetHandle, "BasicSafetyMessage", newPath);
    }
  }

  snprintf(newPath, elcount(newPath), "%s.%s", oldPath, "axle");
  if(value.axle.isValidFlag==1)
  {
    SetBasicSafetyMessage_J1939data_axleParams(packetHandle, value.axle, newPath);
    result = CheckLastError("BasicSafetyMessage", gkFuncRefGet, result);
  }
  else
  {
    if( C2xIsTokenAvailable(packetHandle, "BasicSafetyMessage", newPath) )
    {
      C2xRemoveToken(packetHandle, "BasicSafetyMessage", newPath);
    }
  }

  snprintf(newPath, elcount(newPath), "%s.%s", oldPath, "trailerWeight");
  if(value.trailerWeight.isValidFlag==1)
  {
    C2xSetTokenInt(packetHandle, "BasicSafetyMessage", newPath, value.trailerWeight.value);
    result = CheckLastError("BasicSafetyMessage", gkFuncRefGet, result);
  }
  else
  {
    if( C2xIsTokenAvailable(packetHandle, "BasicSafetyMessage", newPath) )
    {
      C2xRemoveToken(packetHandle, "BasicSafetyMessage", newPath);
    }
  }

  snprintf(newPath, elcount(newPath), "%s.%s", oldPath, "cargoWeight");
  if(value.cargoWeight.isValidFlag==1)
  {
    C2xSetTokenInt(packetHandle, "BasicSafetyMessage", newPath, value.cargoWeight.value);
    result = CheckLastError("BasicSafetyMessage", gkFuncRefGet, result);
  }
  else
  {
    if( C2xIsTokenAvailable(packetHandle, "BasicSafetyMessage", newPath) )
    {
      C2xRemoveToken(packetHandle, "BasicSafetyMessage", newPath);
    }
  }

  snprintf(newPath, elcount(newPath), "%s.%s", oldPath, "steeringAxleTemperature");
  if(value.steeringAxleTemperature.isValidFlag==1)
  {
    C2xSetTokenInt(packetHandle, "BasicSafetyMessage", newPath, value.steeringAxleTemperature.value);
    result = CheckLastError("BasicSafetyMessage", gkFuncRefGet, result);
  }
  else
  {
    if( C2xIsTokenAvailable(packetHandle, "BasicSafetyMessage", newPath) )
    {
      C2xRemoveToken(packetHandle, "BasicSafetyMessage", newPath);
    }
  }

  snprintf(newPath, elcount(newPath), "%s.%s", oldPath, "driveAxleLocation");
  if(value.driveAxleLocation.isValidFlag==1)
  {
    C2xSetTokenInt(packetHandle, "BasicSafetyMessage", newPath, value.driveAxleLocation.value);
    result = CheckLastError("BasicSafetyMessage", gkFuncRefGet, result);
  }
  else
  {
    if( C2xIsTokenAvailable(packetHandle, "BasicSafetyMessage", newPath) )
    {
      C2xRemoveToken(packetHandle, "BasicSafetyMessage", newPath);
    }
  }

  snprintf(newPath, elcount(newPath), "%s.%s", oldPath, "driveAxleLiftAirPressure");
  if(value.driveAxleLiftAirPressure.isValidFlag==1)
  {
    C2xSetTokenInt(packetHandle, "BasicSafetyMessage", newPath, value.driveAxleLiftAirPressure.value);
    result = CheckLastError("BasicSafetyMessage", gkFuncRefGet, result);
  }
  else
  {
    if( C2xIsTokenAvailable(packetHandle, "BasicSafetyMessage", newPath) )
    {
      C2xRemoveToken(packetHandle, "BasicSafetyMessage", newPath);
    }
  }

  snprintf(newPath, elcount(newPath), "%s.%s", oldPath, "driveAxleTemperature");
  if(value.driveAxleTemperature.isValidFlag==1)
  {
    C2xSetTokenInt(packetHandle, "BasicSafetyMessage", newPath, value.driveAxleTemperature.value);
    result = CheckLastError("BasicSafetyMessage", gkFuncRefGet, result);
  }
  else
  {
    if( C2xIsTokenAvailable(packetHandle, "BasicSafetyMessage", newPath) )
    {
      C2xRemoveToken(packetHandle, "BasicSafetyMessage", newPath);
    }
  }

  snprintf(newPath, elcount(newPath), "%s.%s", oldPath, "driveAxleLubePressure");
  if(value.driveAxleLubePressure.isValidFlag==1)
  {
    C2xSetTokenInt(packetHandle, "BasicSafetyMessage", newPath, value.driveAxleLubePressure.value);
    result = CheckLastError("BasicSafetyMessage", gkFuncRefGet, result);
  }
  else
  {
    if( C2xIsTokenAvailable(packetHandle, "BasicSafetyMessage", newPath) )
    {
      C2xRemoveToken(packetHandle, "BasicSafetyMessage", newPath);
    }
  }

  snprintf(newPath, elcount(newPath), "%s.%s", oldPath, "steeringAxleLubePressure");
  if(value.steeringAxleLubePressure.isValidFlag==1)
  {
    C2xSetTokenInt(packetHandle, "BasicSafetyMessage", newPath, value.steeringAxleLubePressure.value);
    result = CheckLastError("BasicSafetyMessage", gkFuncRefGet, result);
  }
  else
  {
    if( C2xIsTokenAvailable(packetHandle, "BasicSafetyMessage", newPath) )
    {
      C2xRemoveToken(packetHandle, "BasicSafetyMessage", newPath);
    }
  }

  return result;
}

int GetBasicSafetyMessage_VehicleStatus_weatherReportParams(LONG packetHandle, struct BasicSafetyMessage_VehicleStatus_weatherReport value, char oldPath[])
{
  char newPath[300];
  int result;

  result = 0;

  snprintf(newPath, elcount(newPath), "%s.%s", oldPath, "isRaining");
  value.isRaining = C2xGetTokenInt(packetHandle, "BasicSafetyMessage", newPath);
  result = CheckLastError("BasicSafetyMessage", gkFuncRefGet, result);

  snprintf(newPath, elcount(newPath), "%s.%s", oldPath, "rainRate");
  value.rainRate.isValidFlag = C2xIsTokenAvailable(packetHandle, "BasicSafetyMessage", newPath);
  if(value.rainRate.isValidFlag==1)
  {
    value.rainRate.value = C2xGetTokenInt(packetHandle, "BasicSafetyMessage", newPath);
    result = CheckLastError("BasicSafetyMessage", gkFuncRefGet, result);
  }
  snprintf(newPath, elcount(newPath), "%s.%s", oldPath, "precipSituation");
  value.precipSituation.isValidFlag = C2xIsTokenAvailable(packetHandle, "BasicSafetyMessage", newPath);
  if(value.precipSituation.isValidFlag==1)
  {
    value.precipSituation.value = C2xGetTokenInt(packetHandle, "BasicSafetyMessage", newPath);
    result = CheckLastError("BasicSafetyMessage", gkFuncRefGet, result);
  }
  snprintf(newPath, elcount(newPath), "%s.%s", oldPath, "solarRadiation");
  value.solarRadiation.isValidFlag = C2xIsTokenAvailable(packetHandle, "BasicSafetyMessage", newPath);
  if(value.solarRadiation.isValidFlag==1)
  {
    value.solarRadiation.value = C2xGetTokenInt(packetHandle, "BasicSafetyMessage", newPath);
    result = CheckLastError("BasicSafetyMessage", gkFuncRefGet, result);
  }
  snprintf(newPath, elcount(newPath), "%s.%s", oldPath, "friction");
  value.friction.isValidFlag = C2xIsTokenAvailable(packetHandle, "BasicSafetyMessage", newPath);
  if(value.friction.isValidFlag==1)
  {
    value.friction.value = C2xGetTokenInt(packetHandle, "BasicSafetyMessage", newPath);
    result = CheckLastError("BasicSafetyMessage", gkFuncRefGet, result);
  }
  return result;
}

int SetBasicSafetyMessage_VehicleStatus_weatherReportParams(LONG packetHandle, struct BasicSafetyMessage_VehicleStatus_weatherReport value, char oldPath[])
{
  char newPath[300];
  int result;

  result = 0;

  snprintf(newPath, elcount(newPath), "%s.%s", oldPath, "isRaining");
  C2xSetTokenInt(packetHandle, "BasicSafetyMessage", newPath, value.isRaining);
  result = CheckLastError("BasicSafetyMessage", gkFuncRefGet, result);

  snprintf(newPath, elcount(newPath), "%s.%s", oldPath, "rainRate");
  if(value.rainRate.isValidFlag==1)
  {
    C2xSetTokenInt(packetHandle, "BasicSafetyMessage", newPath, value.rainRate.value);
    result = CheckLastError("BasicSafetyMessage", gkFuncRefGet, result);
  }
  else
  {
    if( C2xIsTokenAvailable(packetHandle, "BasicSafetyMessage", newPath) )
    {
      C2xRemoveToken(packetHandle, "BasicSafetyMessage", newPath);
    }
  }

  snprintf(newPath, elcount(newPath), "%s.%s", oldPath, "precipSituation");
  if(value.precipSituation.isValidFlag==1)
  {
    C2xSetTokenInt(packetHandle, "BasicSafetyMessage", newPath, value.precipSituation.value);
    result = CheckLastError("BasicSafetyMessage", gkFuncRefGet, result);
  }
  else
  {
    if( C2xIsTokenAvailable(packetHandle, "BasicSafetyMessage", newPath) )
    {
      C2xRemoveToken(packetHandle, "BasicSafetyMessage", newPath);
    }
  }

  snprintf(newPath, elcount(newPath), "%s.%s", oldPath, "solarRadiation");
  if(value.solarRadiation.isValidFlag==1)
  {
    C2xSetTokenInt(packetHandle, "BasicSafetyMessage", newPath, value.solarRadiation.value);
    result = CheckLastError("BasicSafetyMessage", gkFuncRefGet, result);
  }
  else
  {
    if( C2xIsTokenAvailable(packetHandle, "BasicSafetyMessage", newPath) )
    {
      C2xRemoveToken(packetHandle, "BasicSafetyMessage", newPath);
    }
  }

  snprintf(newPath, elcount(newPath), "%s.%s", oldPath, "friction");
  if(value.friction.isValidFlag==1)
  {
    C2xSetTokenInt(packetHandle, "BasicSafetyMessage", newPath, value.friction.value);
    result = CheckLastError("BasicSafetyMessage", gkFuncRefGet, result);
  }
  else
  {
    if( C2xIsTokenAvailable(packetHandle, "BasicSafetyMessage", newPath) )
    {
      C2xRemoveToken(packetHandle, "BasicSafetyMessage", newPath);
    }
  }

  return result;
}

int GetBasicSafetyMessageVehicleStatusParams(LONG packetHandle, struct BasicSafetyMessageVehicleStatus value, char oldPath[])
{
  char newPath[300]; 
  int j; 
  int k;
  int result;

  result = 0;

  snprintf(newPath, elcount(newPath), "%s.%s", oldPath, "lights");
  value.lights.isValidFlag = C2xIsTokenAvailable(packetHandle, "BasicSafetyMessage", newPath);
  if(value.lights.isValidFlag==1)
  {
    value.lights.value = C2xGetTokenInt(packetHandle, "BasicSafetyMessage", newPath);
    result = CheckLastError("BasicSafetyMessage", gkFuncRefGet, result);
  }
  snprintf(newPath, elcount(newPath), "%s.%s", oldPath, "lightBar");
  value.lightBar.isValidFlag = C2xIsTokenAvailable(packetHandle, "BasicSafetyMessage", newPath);
  if(value.lightBar.isValidFlag==1)
  {
    value.lightBar.value = C2xGetTokenInt(packetHandle, "BasicSafetyMessage", newPath);
    result = CheckLastError("BasicSafetyMessage", gkFuncRefGet, result);
  }
  snprintf(newPath, elcount(newPath), "%s.%s", oldPath, "wipers");
  value.wipers.isValidFlag = C2xIsTokenAvailable(packetHandle, "BasicSafetyMessage", newPath);
  if(value.wipers.isValidFlag==1)
  {
    GetBasicSafetyMessage_VehicleStatus_wipersParams(packetHandle, value.wipers, newPath);
    result = CheckLastError("BasicSafetyMessage", gkFuncRefGet, result);
  }
  snprintf(newPath, elcount(newPath), "%s.%s", oldPath, "brakeStatus");
  value.brakeStatus.isValidFlag = C2xIsTokenAvailable(packetHandle, "BasicSafetyMessage", newPath);
  if(value.brakeStatus.isValidFlag==1)
  {
    value.brakeStatus.isValidFlag = 1;
    value.brakeStatus.stringLength = C2xGetTokenData(packetHandle, "BasicSafetyMessage", newPath, elcount(value.brakeStatus.string), value.brakeStatus.string);
  }
  snprintf(newPath, elcount(newPath), "%s.%s", oldPath, "brakePressure");
  value.brakePressure.isValidFlag = C2xIsTokenAvailable(packetHandle, "BasicSafetyMessage", newPath);
  if(value.brakePressure.isValidFlag==1)
  {
    value.brakePressure.value = C2xGetTokenInt(packetHandle, "BasicSafetyMessage", newPath);
    result = CheckLastError("BasicSafetyMessage", gkFuncRefGet, result);
  }
  snprintf(newPath, elcount(newPath), "%s.%s", oldPath, "roadFriction");
  value.roadFriction.isValidFlag = C2xIsTokenAvailable(packetHandle, "BasicSafetyMessage", newPath);
  if(value.roadFriction.isValidFlag==1)
  {
    value.roadFriction.value = C2xGetTokenInt(packetHandle, "BasicSafetyMessage", newPath);
    result = CheckLastError("BasicSafetyMessage", gkFuncRefGet, result);
  }
  snprintf(newPath, elcount(newPath), "%s.%s", oldPath, "sunData");
  value.sunData.isValidFlag = C2xIsTokenAvailable(packetHandle, "BasicSafetyMessage", newPath);
  if(value.sunData.isValidFlag==1)
  {
    value.sunData.value = C2xGetTokenInt(packetHandle, "BasicSafetyMessage", newPath);
    result = CheckLastError("BasicSafetyMessage", gkFuncRefGet, result);
  }
  snprintf(newPath, elcount(newPath), "%s.%s", oldPath, "rainData");
  value.rainData.isValidFlag = C2xIsTokenAvailable(packetHandle, "BasicSafetyMessage", newPath);
  if(value.rainData.isValidFlag==1)
  {
    value.rainData.value = C2xGetTokenInt(packetHandle, "BasicSafetyMessage", newPath);
    result = CheckLastError("BasicSafetyMessage", gkFuncRefGet, result);
  }
  snprintf(newPath, elcount(newPath), "%s.%s", oldPath, "airTemp");
  value.airTemp.isValidFlag = C2xIsTokenAvailable(packetHandle, "BasicSafetyMessage", newPath);
  if(value.airTemp.isValidFlag==1)
  {
    value.airTemp.value = C2xGetTokenInt(packetHandle, "BasicSafetyMessage", newPath);
    result = CheckLastError("BasicSafetyMessage", gkFuncRefGet, result);
  }
  snprintf(newPath, elcount(newPath), "%s.%s", oldPath, "airPres");
  value.airPres.isValidFlag = C2xIsTokenAvailable(packetHandle, "BasicSafetyMessage", newPath);
  if(value.airPres.isValidFlag==1)
  {
    value.airPres.value = C2xGetTokenInt(packetHandle, "BasicSafetyMessage", newPath);
    result = CheckLastError("BasicSafetyMessage", gkFuncRefGet, result);
  }
  snprintf(newPath, elcount(newPath), "%s.%s", oldPath, "steering");
  value.steering.isValidFlag = C2xIsTokenAvailable(packetHandle, "BasicSafetyMessage", newPath);
  if(value.steering.isValidFlag==1)
  {
    GetBasicSafetyMessage_VehicleStatus_steeringParams(packetHandle, value.steering, newPath);
    result = CheckLastError("BasicSafetyMessage", gkFuncRefGet, result);
  }
  snprintf(newPath, elcount(newPath), "%s.%s", oldPath, "accelSets");
  value.accelSets.isValidFlag = C2xIsTokenAvailable(packetHandle, "BasicSafetyMessage", newPath);
  if(value.accelSets.isValidFlag==1)
  {
    GetBasicSafetyMessage_VehicleStatus_accelSetsParams(packetHandle, value.accelSets, newPath);
    result = CheckLastError("BasicSafetyMessage", gkFuncRefGet, result);
  }
  snprintf(newPath, elcount(newPath), "%s.%s", oldPath, "object");
  value.object.isValidFlag = C2xIsTokenAvailable(packetHandle, "BasicSafetyMessage", newPath);
  if(value.object.isValidFlag==1)
  {
    GetBasicSafetyMessage_VehicleStatus_objectParams(packetHandle, value.object, newPath);
    result = CheckLastError("BasicSafetyMessage", gkFuncRefGet, result);
  }
  snprintf(newPath, elcount(newPath), "%s.%s", oldPath, "fullPos");
  value.fullPos.isValidFlag = C2xIsTokenAvailable(packetHandle, "BasicSafetyMessage", newPath);
  if(value.fullPos.isValidFlag==1)
  {
    GetBasicSafetyMessageFullPositionVectorParams(packetHandle, value.fullPos, newPath);
    result = CheckLastError("BasicSafetyMessage", gkFuncRefGet, result);
  }
  snprintf(newPath, elcount(newPath), "%s.%s", oldPath, "throttlePos");
  value.throttlePos.isValidFlag = C2xIsTokenAvailable(packetHandle, "BasicSafetyMessage", newPath);
  if(value.throttlePos.isValidFlag==1)
  {
    value.throttlePos.value = C2xGetTokenInt(packetHandle, "BasicSafetyMessage", newPath);
    result = CheckLastError("BasicSafetyMessage", gkFuncRefGet, result);
  }
  snprintf(newPath, elcount(newPath), "%s.%s", oldPath, "speedHeadC");
  value.speedHeadC.isValidFlag = C2xIsTokenAvailable(packetHandle, "BasicSafetyMessage", newPath);
  if(value.speedHeadC.isValidFlag==1)
  {
    value.speedHeadC.isValidFlag = 1;
    value.speedHeadC.stringLength = C2xGetTokenData(packetHandle, "BasicSafetyMessage", newPath, elcount(value.speedHeadC.string), value.speedHeadC.string);
  }
  snprintf(newPath, elcount(newPath), "%s.%s", oldPath, "speedC");
  value.speedC.isValidFlag = C2xIsTokenAvailable(packetHandle, "BasicSafetyMessage", newPath);
  if(value.speedC.isValidFlag==1)
  {
    value.speedC.value = C2xGetTokenInt(packetHandle, "BasicSafetyMessage", newPath);
    result = CheckLastError("BasicSafetyMessage", gkFuncRefGet, result);
  }
  snprintf(newPath, elcount(newPath), "%s.%s", oldPath, "vehicleData");
  value.vehicleData.isValidFlag = C2xIsTokenAvailable(packetHandle, "BasicSafetyMessage", newPath);
  if(value.vehicleData.isValidFlag==1)
  {
    GetBasicSafetyMessage_VehicleStatus_vehicleDataParams(packetHandle, value.vehicleData, newPath);
    result = CheckLastError("BasicSafetyMessage", gkFuncRefGet, result);
  }
  snprintf(newPath, elcount(newPath), "%s.%s", oldPath, "vehicleIdent");
  value.vehicleIdent.isValidFlag = C2xIsTokenAvailable(packetHandle, "BasicSafetyMessage", newPath);
  if(value.vehicleIdent.isValidFlag==1)
  {
    GetBasicSafetyMessageVehicleIdentParams(packetHandle, value.vehicleIdent, newPath);
    result = CheckLastError("BasicSafetyMessage", gkFuncRefGet, result);
  }
  snprintf(newPath, elcount(newPath), "%s.%s", oldPath, "j1939data");
  value.j1939data.isValidFlag = C2xIsTokenAvailable(packetHandle, "BasicSafetyMessage", newPath);
  if(value.j1939data.isValidFlag==1)
  {
    GetBasicSafetyMessageJ1939dataParams(packetHandle, value.j1939data, newPath);
    result = CheckLastError("BasicSafetyMessage", gkFuncRefGet, result);
  }
  snprintf(newPath, elcount(newPath), "%s.%s", oldPath, "weatherReport");
  value.weatherReport.isValidFlag = C2xIsTokenAvailable(packetHandle, "BasicSafetyMessage", newPath);
  if(value.weatherReport.isValidFlag==1)
  {
    GetBasicSafetyMessage_VehicleStatus_weatherReportParams(packetHandle, value.weatherReport, newPath);
    result = CheckLastError("BasicSafetyMessage", gkFuncRefGet, result);
  }
  snprintf(newPath, elcount(newPath), "%s.%s", oldPath, "gpsStatus");
  value.gpsStatus.isValidFlag = C2xIsTokenAvailable(packetHandle, "BasicSafetyMessage", newPath);
  if(value.gpsStatus.isValidFlag==1)
  {
    value.gpsStatus.isValidFlag = 1;
    value.gpsStatus.stringLength = C2xGetTokenLengthBit(packetHandle, "BasicSafetyMessage", newPath);
    if ((result = CheckLastError("BasicSafetyMessage", gkFuncRefGet, result))==0)
    {
      if(value.gpsStatus.stringLength > 0)
      {
        for(j=0; j<value.gpsStatus.stringLength; j++)
        {
          if(C2xGetTokenBitOfBitString(packetHandle, "BasicSafetyMessage", newPath, j) == 0)
          {
            value.gpsStatus.string[j] = '0';
          }
          else if(C2xGetTokenBitOfBitString(packetHandle, "BasicSafetyMessage", newPath, j) == 1)
          {
            value.gpsStatus.string[j] = '1';
          }

          if(value.gpsStatus.stringLength == 1)
          {
            value.gpsStatus.string[1] = '0';
          }
          result = CheckLastError("BasicSafetyMessage", gkFuncRefGet, result);
        }
      }
      else
      {
        for(k = value.gpsStatus.stringLength+1; k > -1; k--)
        {
          if(value.gpsStatus.string[k] == '1')
          {
            value.gpsStatus.string[k] = '0';
          }
        }
      }
    }

  }
  return result;
}

int SetBasicSafetyMessageVehicleStatusParams(LONG packetHandle, struct BasicSafetyMessageVehicleStatus value, char oldPath[])
{
  char newPath[300]; 
  int j;
  int result;

  result = 0;

  snprintf(newPath, elcount(newPath), "%s.%s", oldPath, "lights");
  if(value.lights.isValidFlag==1)
  {
    C2xSetTokenInt(packetHandle, "BasicSafetyMessage", newPath, value.lights.value);
    result = CheckLastError("BasicSafetyMessage", gkFuncRefGet, result);
  }
  else
  {
    if( C2xIsTokenAvailable(packetHandle, "BasicSafetyMessage", newPath) )
    {
      C2xRemoveToken(packetHandle, "BasicSafetyMessage", newPath);
    }
  }

  snprintf(newPath, elcount(newPath), "%s.%s", oldPath, "lightBar");
  if(value.lightBar.isValidFlag==1)
  {
    C2xSetTokenInt(packetHandle, "BasicSafetyMessage", newPath, value.lightBar.value);
    result = CheckLastError("BasicSafetyMessage", gkFuncRefGet, result);
  }
  else
  {
    if( C2xIsTokenAvailable(packetHandle, "BasicSafetyMessage", newPath) )
    {
      C2xRemoveToken(packetHandle, "BasicSafetyMessage", newPath);
    }
  }

  snprintf(newPath, elcount(newPath), "%s.%s", oldPath, "wipers");
  if(value.wipers.isValidFlag==1)
  {
    SetBasicSafetyMessage_VehicleStatus_wipersParams(packetHandle, value.wipers, newPath);
    result = CheckLastError("BasicSafetyMessage", gkFuncRefGet, result);
  }
  else
  {
    if( C2xIsTokenAvailable(packetHandle, "BasicSafetyMessage", newPath) )
    {
      C2xRemoveToken(packetHandle, "BasicSafetyMessage", newPath);
    }
  }

  snprintf(newPath, elcount(newPath), "%s.%s", oldPath, "brakeStatus");
  if(value.brakeStatus.isValidFlag==1)
  {
    C2xSetTokenData(packetHandle, "BasicSafetyMessage", newPath, value.brakeStatus.stringLength, value.brakeStatus.string);
  }
  else
  {
    if( C2xIsTokenAvailable(packetHandle, "BasicSafetyMessage", newPath) )
    {
      C2xRemoveToken(packetHandle, "BasicSafetyMessage", newPath);
    }
  }

  snprintf(newPath, elcount(newPath), "%s.%s", oldPath, "brakePressure");
  if(value.brakePressure.isValidFlag==1)
  {
    C2xSetTokenInt(packetHandle, "BasicSafetyMessage", newPath, value.brakePressure.value);
    result = CheckLastError("BasicSafetyMessage", gkFuncRefGet, result);
  }
  else
  {
    if( C2xIsTokenAvailable(packetHandle, "BasicSafetyMessage", newPath) )
    {
      C2xRemoveToken(packetHandle, "BasicSafetyMessage", newPath);
    }
  }

  snprintf(newPath, elcount(newPath), "%s.%s", oldPath, "roadFriction");
  if(value.roadFriction.isValidFlag==1)
  {
    C2xSetTokenInt(packetHandle, "BasicSafetyMessage", newPath, value.roadFriction.value);
    result = CheckLastError("BasicSafetyMessage", gkFuncRefGet, result);
  }
  else
  {
    if( C2xIsTokenAvailable(packetHandle, "BasicSafetyMessage", newPath) )
    {
      C2xRemoveToken(packetHandle, "BasicSafetyMessage", newPath);
    }
  }

  snprintf(newPath, elcount(newPath), "%s.%s", oldPath, "sunData");
  if(value.sunData.isValidFlag==1)
  {
    C2xSetTokenInt(packetHandle, "BasicSafetyMessage", newPath, value.sunData.value);
    result = CheckLastError("BasicSafetyMessage", gkFuncRefGet, result);
  }
  else
  {
    if( C2xIsTokenAvailable(packetHandle, "BasicSafetyMessage", newPath) )
    {
      C2xRemoveToken(packetHandle, "BasicSafetyMessage", newPath);
    }
  }

  snprintf(newPath, elcount(newPath), "%s.%s", oldPath, "rainData");
  if(value.rainData.isValidFlag==1)
  {
    C2xSetTokenInt(packetHandle, "BasicSafetyMessage", newPath, value.rainData.value);
    result = CheckLastError("BasicSafetyMessage", gkFuncRefGet, result);
  }
  else
  {
    if( C2xIsTokenAvailable(packetHandle, "BasicSafetyMessage", newPath) )
    {
      C2xRemoveToken(packetHandle, "BasicSafetyMessage", newPath);
    }
  }

  snprintf(newPath, elcount(newPath), "%s.%s", oldPath, "airTemp");
  if(value.airTemp.isValidFlag==1)
  {
    C2xSetTokenInt(packetHandle, "BasicSafetyMessage", newPath, value.airTemp.value);
    result = CheckLastError("BasicSafetyMessage", gkFuncRefGet, result);
  }
  else
  {
    if( C2xIsTokenAvailable(packetHandle, "BasicSafetyMessage", newPath) )
    {
      C2xRemoveToken(packetHandle, "BasicSafetyMessage", newPath);
    }
  }

  snprintf(newPath, elcount(newPath), "%s.%s", oldPath, "airPres");
  if(value.airPres.isValidFlag==1)
  {
    C2xSetTokenInt(packetHandle, "BasicSafetyMessage", newPath, value.airPres.value);
    result = CheckLastError("BasicSafetyMessage", gkFuncRefGet, result);
  }
  else
  {
    if( C2xIsTokenAvailable(packetHandle, "BasicSafetyMessage", newPath) )
    {
      C2xRemoveToken(packetHandle, "BasicSafetyMessage", newPath);
    }
  }

  snprintf(newPath, elcount(newPath), "%s.%s", oldPath, "steering");
  if(value.steering.isValidFlag==1)
  {
    SetBasicSafetyMessage_VehicleStatus_steeringParams(packetHandle, value.steering, newPath);
    result = CheckLastError("BasicSafetyMessage", gkFuncRefGet, result);
  }
  else
  {
    if( C2xIsTokenAvailable(packetHandle, "BasicSafetyMessage", newPath) )
    {
      C2xRemoveToken(packetHandle, "BasicSafetyMessage", newPath);
    }
  }

  snprintf(newPath, elcount(newPath), "%s.%s", oldPath, "accelSets");
  if(value.accelSets.isValidFlag==1)
  {
    SetBasicSafetyMessage_VehicleStatus_accelSetsParams(packetHandle, value.accelSets, newPath);
    result = CheckLastError("BasicSafetyMessage", gkFuncRefGet, result);
  }
  else
  {
    if( C2xIsTokenAvailable(packetHandle, "BasicSafetyMessage", newPath) )
    {
      C2xRemoveToken(packetHandle, "BasicSafetyMessage", newPath);
    }
  }

  snprintf(newPath, elcount(newPath), "%s.%s", oldPath, "object");
  if(value.object.isValidFlag==1)
  {
    SetBasicSafetyMessage_VehicleStatus_objectParams(packetHandle, value.object, newPath);
    result = CheckLastError("BasicSafetyMessage", gkFuncRefGet, result);
  }
  else
  {
    if( C2xIsTokenAvailable(packetHandle, "BasicSafetyMessage", newPath) )
    {
      C2xRemoveToken(packetHandle, "BasicSafetyMessage", newPath);
    }
  }

  snprintf(newPath, elcount(newPath), "%s.%s", oldPath, "fullPos");
  if(value.fullPos.isValidFlag==1)
  {
    SetBasicSafetyMessageFullPositionVectorParams(packetHandle, value.fullPos, newPath);
    result = CheckLastError("BasicSafetyMessage", gkFuncRefGet, result);
  }
  else
  {
    if( C2xIsTokenAvailable(packetHandle, "BasicSafetyMessage", newPath) )
    {
      C2xRemoveToken(packetHandle, "BasicSafetyMessage", newPath);
    }
  }

  snprintf(newPath, elcount(newPath), "%s.%s", oldPath, "throttlePos");
  if(value.throttlePos.isValidFlag==1)
  {
    C2xSetTokenInt(packetHandle, "BasicSafetyMessage", newPath, value.throttlePos.value);
    result = CheckLastError("BasicSafetyMessage", gkFuncRefGet, result);
  }
  else
  {
    if( C2xIsTokenAvailable(packetHandle, "BasicSafetyMessage", newPath) )
    {
      C2xRemoveToken(packetHandle, "BasicSafetyMessage", newPath);
    }
  }

  snprintf(newPath, elcount(newPath), "%s.%s", oldPath, "speedHeadC");
  if(value.speedHeadC.isValidFlag==1)
  {
    C2xSetTokenData(packetHandle, "BasicSafetyMessage", newPath, value.speedHeadC.stringLength, value.speedHeadC.string);
  }
  else
  {
    if( C2xIsTokenAvailable(packetHandle, "BasicSafetyMessage", newPath) )
    {
      C2xRemoveToken(packetHandle, "BasicSafetyMessage", newPath);
    }
  }

  snprintf(newPath, elcount(newPath), "%s.%s", oldPath, "speedC");
  if(value.speedC.isValidFlag==1)
  {
    C2xSetTokenInt(packetHandle, "BasicSafetyMessage", newPath, value.speedC.value);
    result = CheckLastError("BasicSafetyMessage", gkFuncRefGet, result);
  }
  else
  {
    if( C2xIsTokenAvailable(packetHandle, "BasicSafetyMessage", newPath) )
    {
      C2xRemoveToken(packetHandle, "BasicSafetyMessage", newPath);
    }
  }

  snprintf(newPath, elcount(newPath), "%s.%s", oldPath, "vehicleData");
  if(value.vehicleData.isValidFlag==1)
  {
    SetBasicSafetyMessage_VehicleStatus_vehicleDataParams(packetHandle, value.vehicleData, newPath);
    result = CheckLastError("BasicSafetyMessage", gkFuncRefGet, result);
  }
  else
  {
    if( C2xIsTokenAvailable(packetHandle, "BasicSafetyMessage", newPath) )
    {
      C2xRemoveToken(packetHandle, "BasicSafetyMessage", newPath);
    }
  }

  snprintf(newPath, elcount(newPath), "%s.%s", oldPath, "vehicleIdent");
  if(value.vehicleIdent.isValidFlag==1)
  {
    SetBasicSafetyMessageVehicleIdentParams(packetHandle, value.vehicleIdent, newPath);
    result = CheckLastError("BasicSafetyMessage", gkFuncRefGet, result);
  }
  else
  {
    if( C2xIsTokenAvailable(packetHandle, "BasicSafetyMessage", newPath) )
    {
      C2xRemoveToken(packetHandle, "BasicSafetyMessage", newPath);
    }
  }

  snprintf(newPath, elcount(newPath), "%s.%s", oldPath, "j1939data");
  if(value.j1939data.isValidFlag==1)
  {
    SetBasicSafetyMessageJ1939dataParams(packetHandle, value.j1939data, newPath);
    result = CheckLastError("BasicSafetyMessage", gkFuncRefGet, result);
  }
  else
  {
    if( C2xIsTokenAvailable(packetHandle, "BasicSafetyMessage", newPath) )
    {
      C2xRemoveToken(packetHandle, "BasicSafetyMessage", newPath);
    }
  }

  snprintf(newPath, elcount(newPath), "%s.%s", oldPath, "weatherReport");
  if(value.weatherReport.isValidFlag==1)
  {
    SetBasicSafetyMessage_VehicleStatus_weatherReportParams(packetHandle, value.weatherReport, newPath);
    result = CheckLastError("BasicSafetyMessage", gkFuncRefGet, result);
  }
  else
  {
    if( C2xIsTokenAvailable(packetHandle, "BasicSafetyMessage", newPath) )
    {
      C2xRemoveToken(packetHandle, "BasicSafetyMessage", newPath);
    }
  }

  snprintf(newPath, elcount(newPath), "%s.%s", oldPath, "gpsStatus");
  if(value.gpsStatus.isValidFlag==1)
  {
      for(j=0; j<value.gpsStatus.stringLength; j++)
      {
        if(value.gpsStatus.string[j] == '0')
        {
          C2xSetTokenBitOfBitString(packetHandle, "BasicSafetyMessage", newPath, j, 0);
        }
        else
        {
          C2xSetTokenBitOfBitString(packetHandle, "BasicSafetyMessage", newPath, j, 1);
        }
        result = CheckLastError("BasicSafetyMessage", gkFuncRefGet, result);
      }
  }
  else
  {
    if( C2xIsTokenAvailable(packetHandle, "BasicSafetyMessage", newPath) )
    {
      C2xRemoveToken(packetHandle, "BasicSafetyMessage", newPath);
    }
  }

  return result;
}

int API_GetBasicSafetyMessageParams(LONG packetHandle, struct BasicSafetyMessage value)
{
  int result;
  result = 0;

  value.msgID = C2xGetTokenInt(packetHandle, "BasicSafetyMessage", "msgID");
  result = CheckLastError("BasicSafetyMessage", gkFuncRefGet, result);

  value.blob1.isValidFlag = 1;
  GetBasicSafetyMessageBSMblobParams(packetHandle, value.blob1, "blob1");
  result = CheckLastError("BasicSafetyMessage", gkFuncRefGet, result);

  value.safetyExt.isValidFlag = C2xIsTokenAvailable(packetHandle, "BasicSafetyMessage", "safetyExt");
  if(value.safetyExt.isValidFlag == 1)
  {
    value.safetyExt.isValidFlag = 1;
    GetBasicSafetyMessageVehicleSafetyExtensionParams(packetHandle, value.safetyExt, "safetyExt");
    result = CheckLastError("BasicSafetyMessage", gkFuncRefGet, result);

  }
  value.status.isValidFlag = C2xIsTokenAvailable(packetHandle, "BasicSafetyMessage", "status");
  if(value.status.isValidFlag == 1)
  {
    value.status.isValidFlag = 1;
    GetBasicSafetyMessageVehicleStatusParams(packetHandle, value.status, "status");
    result = CheckLastError("BasicSafetyMessage", gkFuncRefGet, result);

  }
  return result;
}

int API_SetBasicSafetyMessageParams(LONG packetHandle, struct BasicSafetyMessage value)
{
  int result;
  result = 0;

  value.msgID = 2;

  C2xSetTokenInt(packetHandle, "BasicSafetyMessage", "msgID", value.msgID);
  result = CheckLastError("BasicSafetyMessage", gkFuncRefGet, result);

  SetBasicSafetyMessageBSMblobParams(packetHandle, value.blob1, "blob1");
  result = CheckLastError("BasicSafetyMessage", gkFuncRefGet, result);

  if (value.safetyExt.isValidFlag==1)
  {
    SetBasicSafetyMessageVehicleSafetyExtensionParams(packetHandle, value.safetyExt, "safetyExt");
    result = CheckLastError("BasicSafetyMessage", gkFuncRefGet, result);

  }
  else
  {
    if( C2xIsTokenAvailable(packetHandle, "BasicSafetyMessage", "safetyExt") )
    {
      C2xRemoveToken(packetHandle, "BasicSafetyMessage", "safetyExt");
    }
  }

  if (value.status.isValidFlag==1)
  {
    SetBasicSafetyMessageVehicleStatusParams(packetHandle, value.status, "status");
    result = CheckLastError("BasicSafetyMessage", gkFuncRefGet, result);

  }
  else
  {
    if( C2xIsTokenAvailable(packetHandle, "BasicSafetyMessage", "status") )
    {
      C2xRemoveToken(packetHandle, "BasicSafetyMessage", "status");
    }
  }

  return result;
}

