/*@!Encoding:1252*/
/*
//  (c) Vector Informatik GmbH. All rights reserved.
//
//  This file contains definitions of structs and methods that may be used
//  to set and get the values of an ASN.1 defined packet's payload.
//
//  //This example demonstrates how to set a packet's payload:
//  LONG packetHandle;
//  struct SignalStatusMessage payload;
//  //you need to set the values of the variable "payload" yourself
//  packetHandle = API_InitSignalStatusMessagePacket();
//  if (packetHandle!=0) {
//    if (API_SetSignalStatusMessageParams(packetHandle, payload)==0) {
//      if (C2xCompletePacket(packetHandle)==0) {
//        C2xOutputPacket(packetHandle);
//      }
//    }
//  }
//                                                                             */
includes
{

}
variables
{
    struct SignalStatusMessageIntersectionStatusObject {
        INT isValidFlag;   // necessary if this struct is used as an optional field of a SEQUENCE
        CHAR string[17];
        INT  stringLength;
    };
    
    struct SignalStatusMessage_Blob_SignalState {
        INT isValidFlag;   // necessary if this struct is used as an optional field of a SEQUENCE
        INT isActive;  // BOOLEAN;
        BYTE Preempt_or_Priority_Value;  // INTEGER, 0..7;
        BYTE Preempt_or_Priority_State;  // INTEGER, 0..15;
    };
    
    struct SignalStatusMessageSignalState {
        INT isValidFlag;   // necessary if this struct is used as an optional field of a SEQUENCE
        CHAR string[2];
        INT  stringLength;
        struct SignalStatusMessage_Blob_SignalState _Blob_SignalState;  // SEQUENCE;
    };
    
    struct SignalStatusMessage_SignalStatusMessage_priority {
        INT isValidFlag;   // necessary if this struct is used as an optional field of a SEQUENCE
        INT length;
        struct SignalStatusMessageSignalState arrayValue[7];  // OCTETSTRING;
    };
    
    struct SignalStatusMessageDescriptiveName {
        INT isValidFlag;   // necessary if this struct is used as an optional field of a SEQUENCE
        CHAR string[64];
        INT  stringLength;
    };
    
    struct SignalStatusMessageVINstring {
        INT isValidFlag;   // necessary if this struct is used as an optional field of a SEQUENCE
        CHAR string[18];
        INT  stringLength;
    };
    
    struct SignalStatusMessage_VehicleIdent_ownerCode {
        INT isValidFlag;   // necessary if this struct is used as an optional field of a SEQUENCE
        CHAR string[33];
        INT  stringLength;
    };
    
    struct SignalStatusMessage_Blob_TemporaryID {
        INT isValidFlag;   // necessary if this struct is used as an optional field of a SEQUENCE
        DWORD temporaryID;  // INTEGER, 0..4294967295;
    };
    
    struct SignalStatusMessageTemporaryID {
        INT isValidFlag;   // necessary if this struct is used as an optional field of a SEQUENCE
        CHAR string[5];
        INT  stringLength;
        struct SignalStatusMessage_Blob_TemporaryID _Blob_TemporaryID;  // SEQUENCE;
    };
    
    struct SignalStatusMessage_VehicleIdent_vehicleClass {
        INT isValidFlag;   // necessary if this struct is used as an optional field of a SEQUENCE
        INT choice;
        INT vGroup;  // ENUMERATED, all_vehicles(9217), bicycles(9218), motorcycles(9219), cars(9220), light_vehicles(9221), cars_and_light_vehicles(9222), cars_with_trailers(9223), cars_with_recreational_trailers(9224), vehicles_with_trailers(9225), heavy_vehicles(9226), trucks(9227), buses(9228), articulated_buses(9229), school_buses(9230), vehicles_with_semi_trailers(9231), vehicles_with_double_trailers(9232), high_profile_vehicles(9233), wide_vehicles(9234), long_vehicles(9235), hazardous_loads(9236), exceptional_loads(9237), abnormal_loads(9238), convoys(9239), maintenance_vehicles(9240), delivery_vehicles(9241), vehicles_with_even_numbered_license_plates(9242), vehicles_with_odd_numbered_license_plates(9243), vehicles_with_parking_permits(9244), vehicles_with_catalytic_converters(9245), vehicles_without_catalytic_converters(9246), gas_powered_vehicles(9247), diesel_powered_vehicles(9248), lPG_vehicles(9249), military_convoys(9250), military_vehicles(9251);
        INT rGroup;  // ENUMERATED, emergency_vehicle_units(9729), federal_law_enforcement_units(9730), state_police_units(9731), county_police_units(9732), local_police_units(9733), ambulance_units(9734), rescue_units(9735), fire_units(9736), hAZMAT_units(9737), light_tow_unit(9738), heavy_tow_unit(9739), freeway_service_patrols(9740), transportation_response_units(9741), private_contractor_response_units(9742);
        INT rEquip;  // ENUMERATED, ground_fire_suppression(9985), heavy_ground_equipment(9986), aircraft(9988), marine_equipment(9989), support_equipment(9990), medical_rescue_unit(9991), other(9993), ground_fire_suppression_other(9994), engine(9995), truck_or_aerial(9996), quint(9997), tanker_pumper_combination(9998), brush_truck(10000), aircraft_rescue_firefighting(10001), heavy_ground_equipment_other(10004), dozer_or_plow(10005), tractor(10006), tanker_or_tender(10008), aircraft_other(10024), aircraft_fixed_wing_tanker(10025), helitanker(10026), helicopter(10027), marine_equipment_other(10034), fire_boat_with_pump(10035), boat_no_pump(10036), support_apparatus_other(10044), breathing_apparatus_support(10045), light_and_air_unit(10046), medical_rescue_unit_other(10054), rescue_unit(10055), urban_search_rescue_unit(10056), high_angle_rescue(10057), crash_fire_rescue(10058), bLS_unit(10059), aLS_unit(10060), mobile_command_post(10075), chief_officer_car(10076), hAZMAT_unit(10077), type_i_hand_crew(10078), type_ii_hand_crew(10079), privately_owned_vehicle(10083), other_apparatus_resource(10084), ambulance(10085), bomb_squad_van(10086), combine_harvester(10087), construction_vehicle(10088), farm_tractor(10089), grass_cutting_machines(10090), hAZMAT_containment_tow(10091), heavy_tow(10092), light_tow(10094), flatbed_tow(10114), hedge_cutting_machines(10093), mobile_crane(10095), refuse_collection_vehicle(10096), resurfacing_vehicle(10097), road_sweeper(10098), roadside_litter_collection_crews(10099), salvage_vehicle(10100), sand_truck(10101), snowplow(10102), steam_roller(10103), swat_team_van(10104), track_laying_vehicle(10105), unknown_vehicle(10106), white_lining_vehicle(10107), dump_truck(10108), supervisor_vehicle(10109), snow_blower(10110), rotary_snow_blower(10111), road_grader(10112), steam_truck(10113);
    };
    
    struct SignalStatusMessageVehicleIdent {
        INT isValidFlag;   // necessary if this struct is used as an optional field of a SEQUENCE
        struct SignalStatusMessageDescriptiveName name;  // IA5STRING, OPTIONAL;
        struct SignalStatusMessageVINstring vin;  // OCTETSTRING, OPTIONAL;
        struct SignalStatusMessage_VehicleIdent_ownerCode ownerCode;  // IA5STRING, OPTIONAL;
        struct SignalStatusMessageTemporaryID id;  // OCTETSTRING, OPTIONAL;
        struct OPT_ENUM_ASN vehicleType;  // ENUMERATED, OPTIONAL, none(0), unknown(1), special(2), moto(3), car(4), carOther(5), bus(6), axleCnt2(7), axleCnt3(8), axleCnt4(9), axleCnt4Trailer(10), axleCnt5Trailer(11), axleCnt6Trailer(12), axleCnt5MultiTrailer(13), axleCnt6MultiTrailer(14), axleCnt7MultiTrailer(15);
        struct SignalStatusMessage_VehicleIdent_vehicleClass vehicleClass;  // CHOICE, OPTIONAL;
    };
    
    struct SignalStatusMessage_SignalStatusMessage_prempt {
        INT isValidFlag;   // necessary if this struct is used as an optional field of a SEQUENCE
        INT length;
        struct SignalStatusMessageSignalState arrayValue[7];  // OCTETSTRING;
    };
    
    struct SignalStatusMessageTransitStatus {
        INT isValidFlag;   // necessary if this struct is used as an optional field of a SEQUENCE
        CHAR string[7];
        INT  stringLength;
    };
    
    struct SignalStatusMessage {
        INT isValidFlag;   // necessary if this struct is used as an optional field of a SEQUENCE
        INT msgID;  // ENUMERATED, reserved(0), alaCarteMessage(1), basicSafetyMessage(2), basicSafetyMessageVerbose(3), commonSafetyRequest(4), emergencyVehicleAlert(5), intersectionCollisionAlert(6), mapData(7), nmeaCorrections(8), probeDataManagement(9), probeVehicleData(10), roadSideAlert(11), rtcmCorrections(12), signalPhaseAndTimingMessage(13), signalRequestMessage(14), signalStatusMessage(15), travelerInformation(16);
        BYTE msgCnt;  // INTEGER, 0..127;
        WORD id;  // INTEGER, 0..65535;
        struct SignalStatusMessageIntersectionStatusObject status;  // BITSTRING;
        struct SignalStatusMessage_SignalStatusMessage_priority priority;  // SEQUENCEOF, OPTIONAL;
        struct SignalStatusMessageVehicleIdent priorityCause;  // SEQUENCE, OPTIONAL;
        struct SignalStatusMessage_SignalStatusMessage_prempt prempt;  // SEQUENCEOF, OPTIONAL;
        struct SignalStatusMessageVehicleIdent preemptCause;  // SEQUENCE, OPTIONAL;
        struct SignalStatusMessageTransitStatus transitStatus;  // BITSTRING, OPTIONAL;
    };
    
}

/*
// init function to create a simple packet handle
*/ 
LONG API_InitSignalStatusMessagePacket()
{
  return C2xInitPacket("SignalStatusMessage"); 
}

/*
// init function to create a simple packet handle and
// initialize the struct with valid data
*/ 
LONG API_InitSignalStatusMessagePacket(struct SignalStatusMessage msgStruct)
{
  long pktHandle;

  pktHandle = API_InitSignalStatusMessagePacket();

  if (pktHandle != 0)
  {
    // create valid message and application data
    if (C2xCompletePacket(pktHandle) == 0) 
    {
      API_GetSignalStatusMessageParams(pktHandle, msgStruct);
    }
  }
  return pktHandle;
}

/*
// init function to create a packet with security layer and
// initialize the struct with valid data
*/ 
LONG API_InitSignalStatusMessagePacket(struct SignalStatusMessage msgStruct, char packetTypeDesignator[], char certificateName[])
{
  long pktHandle, certHdl;

  // initialize the packet
  pktHandle = C2xInitPacket("SignalStatusMessage", packetTypeDesignator);

  if (pktHandle != 0)
  {
    certHdl = C2xSecCertificateGetHandle(certificateName);  // get the certificate handle for the cert with name "certificateName"
    if (certHdl != 0) 
    {
      C2xSecPacketSetSignerHandle(pktHandle, certHdl); // set the certHdl to the packet
    }

    // create valid message and application data
    if (C2xCompletePacket(pktHandle) == 0) 
    {
      // copy application data to the application structure
      API_GetSignalStatusMessageParams(pktHandle, msgStruct);
    }
  }
  return pktHandle;
}
    

int GetSignalStatusMessage_Blob_SignalStateParams(LONG packetHandle, struct SignalStatusMessage_Blob_SignalState value, char oldPath[])
{
  char newPath[300];
  int result;

  result = 0;

  snprintf(newPath, elcount(newPath), "%s.%s", oldPath, "isActive");
  value.isActive = C2xGetTokenInt64(packetHandle, "SignalStatusMessage", newPath);
  result = CheckLastError("SignalStatusMessage", gkFuncRefGet, result);

  snprintf(newPath, elcount(newPath), "%s.%s", oldPath, "Preempt_or_Priority_Value");
  value.Preempt_or_Priority_Value = C2xGetTokenInt(packetHandle, "SignalStatusMessage", newPath);
  result = CheckLastError("SignalStatusMessage", gkFuncRefGet, result);

  snprintf(newPath, elcount(newPath), "%s.%s", oldPath, "Preempt_or_Priority_State");
  value.Preempt_or_Priority_State = C2xGetTokenInt(packetHandle, "SignalStatusMessage", newPath);
  result = CheckLastError("SignalStatusMessage", gkFuncRefGet, result);

  return result;
}

int SetSignalStatusMessage_Blob_SignalStateParams(LONG packetHandle, struct SignalStatusMessage_Blob_SignalState value, char oldPath[])
{
  char newPath[300];
  int result;

  result = 0;

  snprintf(newPath, elcount(newPath), "%s.%s", oldPath, "isActive");
  C2xSetTokenInt64(packetHandle, "SignalStatusMessage", newPath, value.isActive);
  result = CheckLastError("SignalStatusMessage", gkFuncRefGet, result);

  snprintf(newPath, elcount(newPath), "%s.%s", oldPath, "Preempt_or_Priority_Value");
  C2xSetTokenInt(packetHandle, "SignalStatusMessage", newPath, value.Preempt_or_Priority_Value);
  result = CheckLastError("SignalStatusMessage", gkFuncRefGet, result);

  snprintf(newPath, elcount(newPath), "%s.%s", oldPath, "Preempt_or_Priority_State");
  C2xSetTokenInt(packetHandle, "SignalStatusMessage", newPath, value.Preempt_or_Priority_State);
  result = CheckLastError("SignalStatusMessage", gkFuncRefGet, result);

  return result;
}

int GetSignalStatusMessageSignalStateParams(LONG packetHandle, struct SignalStatusMessageSignalState value, char oldPath[])
{
  char newPath[300];
  int result;

  result = 0;

  snprintf(newPath, elcount(newPath), "%s.%s", oldPath, "_Blob_SignalState");
  GetSignalStatusMessage_Blob_SignalStateParams(packetHandle, value._Blob_SignalState, newPath);
  result = CheckLastError("SignalStatusMessage", gkFuncRefGet, result);

  return result;
}

int SetSignalStatusMessageSignalStateParams(LONG packetHandle, struct SignalStatusMessageSignalState value, char oldPath[])
{
  char newPath[300];
  int result;

  result = 0;

  snprintf(newPath, elcount(newPath), "%s.%s", oldPath, "_Blob_SignalState");
  SetSignalStatusMessage_Blob_SignalStateParams(packetHandle, value._Blob_SignalState, newPath);
  result = CheckLastError("SignalStatusMessage", gkFuncRefGet, result);

  return result;
}

int GetSignalStatusMessage_SignalStatusMessage_priorityParams(LONG packetHandle, struct SignalStatusMessage_SignalStatusMessage_priority value, char oldPath[])
{
  char newPath[300]; 
  int i;
  int result;

  result = 0;

  value.length = C2xGetTokenInt(packetHandle, "SignalStatusMessage", oldPath);
  if((result = CheckLastError("SignalStatusMessage", gkFuncRefGet, result))==0)
  {
    for(i=0; i<value.length; i++)
    {
      snprintf(newPath, elcount(newPath), "%s[%d]", oldPath, i);
      GetSignalStatusMessageSignalStateParams(packetHandle, value.arrayValue[i], newPath);
      result = CheckLastError("SignalStatusMessage", gkFuncRefGet, result);
    }
  }
  return result;
}

int SetSignalStatusMessage_SignalStatusMessage_priorityParams(LONG packetHandle, struct SignalStatusMessage_SignalStatusMessage_priority value, char oldPath[])
{
  char newPath[300]; 
  int i;
  int result;

  result = 0;

  C2xRemoveToken(packetHandle, "SignalStatusMessage", oldPath);
  for(i=0; i<value.length; i++)
  {
    snprintf(newPath, elcount(newPath), "%s[%d]", oldPath, i);
    SetSignalStatusMessageSignalStateParams(packetHandle, value.arrayValue[i], newPath);
    result = CheckLastError("SignalStatusMessage", gkFuncRefGet, result);
  }
  return result;
}

int GetSignalStatusMessage_Blob_TemporaryIDParams(LONG packetHandle, struct SignalStatusMessage_Blob_TemporaryID value, char oldPath[])
{
  char newPath[300];
  int result;

  result = 0;

  snprintf(newPath, elcount(newPath), "%s.%s", oldPath, "temporaryID");
  value.temporaryID = C2xGetTokenInt64(packetHandle, "SignalStatusMessage", newPath);
  result = CheckLastError("SignalStatusMessage", gkFuncRefGet, result);

  return result;
}

int SetSignalStatusMessage_Blob_TemporaryIDParams(LONG packetHandle, struct SignalStatusMessage_Blob_TemporaryID value, char oldPath[])
{
  char newPath[300];
  int result;

  result = 0;

  snprintf(newPath, elcount(newPath), "%s.%s", oldPath, "temporaryID");
  C2xSetTokenInt64(packetHandle, "SignalStatusMessage", newPath, value.temporaryID);
  result = CheckLastError("SignalStatusMessage", gkFuncRefGet, result);

  return result;
}

int GetSignalStatusMessageTemporaryIDParams(LONG packetHandle, struct SignalStatusMessageTemporaryID value, char oldPath[])
{
  char newPath[300];
  int result;

  result = 0;

  snprintf(newPath, elcount(newPath), "%s.%s", oldPath, "_Blob_TemporaryID");
  GetSignalStatusMessage_Blob_TemporaryIDParams(packetHandle, value._Blob_TemporaryID, newPath);
  result = CheckLastError("SignalStatusMessage", gkFuncRefGet, result);

  return result;
}

int SetSignalStatusMessageTemporaryIDParams(LONG packetHandle, struct SignalStatusMessageTemporaryID value, char oldPath[])
{
  char newPath[300];
  int result;

  result = 0;

  snprintf(newPath, elcount(newPath), "%s.%s", oldPath, "_Blob_TemporaryID");
  SetSignalStatusMessage_Blob_TemporaryIDParams(packetHandle, value._Blob_TemporaryID, newPath);
  result = CheckLastError("SignalStatusMessage", gkFuncRefGet, result);

  return result;
}

int GetSignalStatusMessage_VehicleIdent_vehicleClassParams(LONG packetHandle, struct SignalStatusMessage_VehicleIdent_vehicleClass value, char oldPath[])
{
  char newPath[300];
  int result;

  result = 0;

  value.choice = C2xGetTokenInt(packetHandle, "SignalStatusMessage", oldPath);

  switch(value.choice)
  {
    case 0:
    {
      snprintf(newPath, elcount(newPath), "%s.%s", oldPath, "vGroup");
      value.vGroup = C2xGetTokenInt(packetHandle, "SignalStatusMessage", newPath);
      result = CheckLastError("SignalStatusMessage", gkFuncRefGet, result);
    }
    break;
    case 1:
    {
      snprintf(newPath, elcount(newPath), "%s.%s", oldPath, "rGroup");
      value.rGroup = C2xGetTokenInt(packetHandle, "SignalStatusMessage", newPath);
      result = CheckLastError("SignalStatusMessage", gkFuncRefGet, result);
    }
    break;
    case 2:
    {
      snprintf(newPath, elcount(newPath), "%s.%s", oldPath, "rEquip");
      value.rEquip = C2xGetTokenInt(packetHandle, "SignalStatusMessage", newPath);
      result = CheckLastError("SignalStatusMessage", gkFuncRefGet, result);
    }
    break;
  }
  return result;
}

int SetSignalStatusMessage_VehicleIdent_vehicleClassParams(LONG packetHandle, struct SignalStatusMessage_VehicleIdent_vehicleClass value, char oldPath[])
{
  char newPath[300];
  int result;

  result = 0;

  switch(value.choice)
  {
    case 0:
    {
      snprintf(newPath, elcount(newPath), "%s.%s", oldPath, "vGroup");
      C2xSetTokenInt(packetHandle, "SignalStatusMessage", newPath, value.vGroup);
      result = CheckLastError("SignalStatusMessage", gkFuncRefGet, result);
    }
    break;
    case 1:
    {
      snprintf(newPath, elcount(newPath), "%s.%s", oldPath, "rGroup");
      C2xSetTokenInt(packetHandle, "SignalStatusMessage", newPath, value.rGroup);
      result = CheckLastError("SignalStatusMessage", gkFuncRefGet, result);
    }
    break;
    case 2:
    {
      snprintf(newPath, elcount(newPath), "%s.%s", oldPath, "rEquip");
      C2xSetTokenInt(packetHandle, "SignalStatusMessage", newPath, value.rEquip);
      result = CheckLastError("SignalStatusMessage", gkFuncRefGet, result);
    }
    break;
  }
  return result;
}

int GetSignalStatusMessageVehicleIdentParams(LONG packetHandle, struct SignalStatusMessageVehicleIdent value, char oldPath[])
{
  char newPath[300];
  int result;

  result = 0;

  snprintf(newPath, elcount(newPath), "%s.%s", oldPath, "name");
  value.name.isValidFlag = C2xIsTokenAvailable(packetHandle, "SignalStatusMessage", newPath);
  if(value.name.isValidFlag==1)
  {
    value.name.stringLength = C2xGetTokenData(packetHandle, "SignalStatusMessage", newPath, elcount(value.name.string), value.name.string);
    result = CheckLastError("SignalStatusMessage", gkFuncRefGet, result);
  }
  snprintf(newPath, elcount(newPath), "%s.%s", oldPath, "vin");
  value.vin.isValidFlag = C2xIsTokenAvailable(packetHandle, "SignalStatusMessage", newPath);
  if(value.vin.isValidFlag==1)
  {
    value.vin.isValidFlag = 1;
    value.vin.stringLength = C2xGetTokenData(packetHandle, "SignalStatusMessage", newPath, elcount(value.vin.string), value.vin.string);
  }
  snprintf(newPath, elcount(newPath), "%s.%s", oldPath, "ownerCode");
  value.ownerCode.isValidFlag = C2xIsTokenAvailable(packetHandle, "SignalStatusMessage", newPath);
  if(value.ownerCode.isValidFlag==1)
  {
    value.ownerCode.stringLength = C2xGetTokenData(packetHandle, "SignalStatusMessage", newPath, elcount(value.ownerCode.string), value.ownerCode.string);
    result = CheckLastError("SignalStatusMessage", gkFuncRefGet, result);
  }
  snprintf(newPath, elcount(newPath), "%s.%s", oldPath, "id");
  value.id.isValidFlag = C2xIsTokenAvailable(packetHandle, "SignalStatusMessage", newPath);
  if(value.id.isValidFlag==1)
  {
    value.id.isValidFlag = 1;
    value.id.stringLength = C2xGetTokenData(packetHandle, "SignalStatusMessage", newPath, elcount(value.id.string), value.id.string);
  }
  snprintf(newPath, elcount(newPath), "%s.%s", oldPath, "vehicleType");
  value.vehicleType.isValidFlag = C2xIsTokenAvailable(packetHandle, "SignalStatusMessage", newPath);
  if(value.vehicleType.isValidFlag==1)
  {
    value.vehicleType.value = C2xGetTokenInt(packetHandle, "SignalStatusMessage", newPath);
    result = CheckLastError("SignalStatusMessage", gkFuncRefGet, result);
  }
  snprintf(newPath, elcount(newPath), "%s.%s", oldPath, "vehicleClass");
  value.vehicleClass.isValidFlag = C2xIsTokenAvailable(packetHandle, "SignalStatusMessage", newPath);
  if(value.vehicleClass.isValidFlag==1)
  {
    GetSignalStatusMessage_VehicleIdent_vehicleClassParams(packetHandle, value.vehicleClass, newPath);
    result = CheckLastError("SignalStatusMessage", gkFuncRefGet, result);
  }
  return result;
}

int SetSignalStatusMessageVehicleIdentParams(LONG packetHandle, struct SignalStatusMessageVehicleIdent value, char oldPath[])
{
  char newPath[300];
  int result;

  result = 0;

  snprintf(newPath, elcount(newPath), "%s.%s", oldPath, "name");
  if(value.name.isValidFlag==1)
  {
    C2xSetTokenData(packetHandle, "SignalStatusMessage", newPath, value.name.stringLength, value.name.string);
    result = CheckLastError("SignalStatusMessage", gkFuncRefGet, result);
  }
  else
  {
    if( C2xIsTokenAvailable(packetHandle, "SignalStatusMessage", newPath) )
    {
      C2xRemoveToken(packetHandle, "SignalStatusMessage", newPath);
    }
  }

  snprintf(newPath, elcount(newPath), "%s.%s", oldPath, "vin");
  if(value.vin.isValidFlag==1)
  {
    C2xSetTokenData(packetHandle, "SignalStatusMessage", newPath, value.vin.stringLength, value.vin.string);
  }
  else
  {
    if( C2xIsTokenAvailable(packetHandle, "SignalStatusMessage", newPath) )
    {
      C2xRemoveToken(packetHandle, "SignalStatusMessage", newPath);
    }
  }

  snprintf(newPath, elcount(newPath), "%s.%s", oldPath, "ownerCode");
  if(value.ownerCode.isValidFlag==1)
  {
    C2xSetTokenData(packetHandle, "SignalStatusMessage", newPath, value.ownerCode.stringLength, value.ownerCode.string);
    result = CheckLastError("SignalStatusMessage", gkFuncRefGet, result);
  }
  else
  {
    if( C2xIsTokenAvailable(packetHandle, "SignalStatusMessage", newPath) )
    {
      C2xRemoveToken(packetHandle, "SignalStatusMessage", newPath);
    }
  }

  snprintf(newPath, elcount(newPath), "%s.%s", oldPath, "id");
  if(value.id.isValidFlag==1)
  {
    C2xSetTokenData(packetHandle, "SignalStatusMessage", newPath, value.id.stringLength, value.id.string);
  }
  else
  {
    if( C2xIsTokenAvailable(packetHandle, "SignalStatusMessage", newPath) )
    {
      C2xRemoveToken(packetHandle, "SignalStatusMessage", newPath);
    }
  }

  snprintf(newPath, elcount(newPath), "%s.%s", oldPath, "vehicleType");
  if(value.vehicleType.isValidFlag==1)
  {
    C2xSetTokenInt(packetHandle, "SignalStatusMessage", newPath, value.vehicleType.value);
    result = CheckLastError("SignalStatusMessage", gkFuncRefGet, result);
  }
  else
  {
    if( C2xIsTokenAvailable(packetHandle, "SignalStatusMessage", newPath) )
    {
      C2xRemoveToken(packetHandle, "SignalStatusMessage", newPath);
    }
  }

  snprintf(newPath, elcount(newPath), "%s.%s", oldPath, "vehicleClass");
  if(value.vehicleClass.isValidFlag==1)
  {
    SetSignalStatusMessage_VehicleIdent_vehicleClassParams(packetHandle, value.vehicleClass, newPath);
    result = CheckLastError("SignalStatusMessage", gkFuncRefGet, result);
  }
  else
  {
    if( C2xIsTokenAvailable(packetHandle, "SignalStatusMessage", newPath) )
    {
      C2xRemoveToken(packetHandle, "SignalStatusMessage", newPath);
    }
  }

  return result;
}

int GetSignalStatusMessage_SignalStatusMessage_premptParams(LONG packetHandle, struct SignalStatusMessage_SignalStatusMessage_prempt value, char oldPath[])
{
  char newPath[300]; 
  int i;
  int result;

  result = 0;

  value.length = C2xGetTokenInt(packetHandle, "SignalStatusMessage", oldPath);
  if((result = CheckLastError("SignalStatusMessage", gkFuncRefGet, result))==0)
  {
    for(i=0; i<value.length; i++)
    {
      snprintf(newPath, elcount(newPath), "%s[%d]", oldPath, i);
      GetSignalStatusMessageSignalStateParams(packetHandle, value.arrayValue[i], newPath);
      result = CheckLastError("SignalStatusMessage", gkFuncRefGet, result);
    }
  }
  return result;
}

int SetSignalStatusMessage_SignalStatusMessage_premptParams(LONG packetHandle, struct SignalStatusMessage_SignalStatusMessage_prempt value, char oldPath[])
{
  char newPath[300]; 
  int i;
  int result;

  result = 0;

  C2xRemoveToken(packetHandle, "SignalStatusMessage", oldPath);
  for(i=0; i<value.length; i++)
  {
    snprintf(newPath, elcount(newPath), "%s[%d]", oldPath, i);
    SetSignalStatusMessageSignalStateParams(packetHandle, value.arrayValue[i], newPath);
    result = CheckLastError("SignalStatusMessage", gkFuncRefGet, result);
  }
  return result;
}

int API_GetSignalStatusMessageParams(LONG packetHandle, struct SignalStatusMessage value)
{
  int result; 
  int j;
  result = 0;

  value.msgID = C2xGetTokenInt(packetHandle, "SignalStatusMessage", "msgID");
  result = CheckLastError("SignalStatusMessage", gkFuncRefGet, result);

  value.msgCnt = C2xGetTokenInt(packetHandle, "SignalStatusMessage", "msgCnt");
  result = CheckLastError("SignalStatusMessage", gkFuncRefGet, result);

  value.id = C2xGetTokenInt(packetHandle, "SignalStatusMessage", "id");
  result = CheckLastError("SignalStatusMessage", gkFuncRefGet, result);

  value.status.stringLength = C2xGetTokenLengthBit(packetHandle, "SignalStatusMessage", "status");
  if ((result = CheckLastError("SignalStatusMessage", gkFuncRefGet, result))==0)
  {
    for(j=0; j<value.status.stringLength; j++)
    {
      if(C2xGetTokenBitOfBitString(packetHandle, "SignalStatusMessage", "status", j) == 0)
      {
        value.status.string[j] = '0';
      }
      else
      {
        value.status.string[j] = '1';
      }
      result = CheckLastError("SignalStatusMessage", gkFuncRefGet, result);
    }
  }

  result = CheckLastError("SignalStatusMessage", gkFuncRefGet, result);

  value.priority.isValidFlag = C2xIsTokenAvailable(packetHandle, "SignalStatusMessage", "priority");
  if(value.priority.isValidFlag == 1)
  {
    value.priority.isValidFlag = 1;
    GetSignalStatusMessage_SignalStatusMessage_priorityParams(packetHandle, value.priority, "priority");
    result = CheckLastError("SignalStatusMessage", gkFuncRefGet, result);

  }
  value.priorityCause.isValidFlag = C2xIsTokenAvailable(packetHandle, "SignalStatusMessage", "priorityCause");
  if(value.priorityCause.isValidFlag == 1)
  {
    value.priorityCause.isValidFlag = 1;
    GetSignalStatusMessageVehicleIdentParams(packetHandle, value.priorityCause, "priorityCause");
    result = CheckLastError("SignalStatusMessage", gkFuncRefGet, result);

  }
  value.prempt.isValidFlag = C2xIsTokenAvailable(packetHandle, "SignalStatusMessage", "prempt");
  if(value.prempt.isValidFlag == 1)
  {
    value.prempt.isValidFlag = 1;
    GetSignalStatusMessage_SignalStatusMessage_premptParams(packetHandle, value.prempt, "prempt");
    result = CheckLastError("SignalStatusMessage", gkFuncRefGet, result);

  }
  value.preemptCause.isValidFlag = C2xIsTokenAvailable(packetHandle, "SignalStatusMessage", "preemptCause");
  if(value.preemptCause.isValidFlag == 1)
  {
    value.preemptCause.isValidFlag = 1;
    GetSignalStatusMessageVehicleIdentParams(packetHandle, value.preemptCause, "preemptCause");
    result = CheckLastError("SignalStatusMessage", gkFuncRefGet, result);

  }
  value.transitStatus.isValidFlag = C2xIsTokenAvailable(packetHandle, "SignalStatusMessage", "transitStatus");
  if(value.transitStatus.isValidFlag == 1)
  {
    value.transitStatus.stringLength = C2xGetTokenLengthBit(packetHandle, "SignalStatusMessage", "transitStatus");
    if ((result = CheckLastError("SignalStatusMessage", gkFuncRefGet, result))==0)
    {
      for(j=0; j<value.transitStatus.stringLength; j++)
      {
        if(C2xGetTokenBitOfBitString(packetHandle, "SignalStatusMessage", "transitStatus", j) == 0)
        {
          value.transitStatus.string[j] = '0';
        }
        else
        {
          value.transitStatus.string[j] = '1';
        }
        result = CheckLastError("SignalStatusMessage", gkFuncRefGet, result);
      }
    }

    result = CheckLastError("SignalStatusMessage", gkFuncRefGet, result);

  }
  return result;
}

int API_SetSignalStatusMessageParams(LONG packetHandle, struct SignalStatusMessage value)
{
  int result; 
  int j;
  result = 0;

  value.msgID = 15;

  C2xSetTokenInt(packetHandle, "SignalStatusMessage", "msgID", value.msgID);
  result = CheckLastError("SignalStatusMessage", gkFuncRefGet, result);

  C2xSetTokenInt(packetHandle, "SignalStatusMessage", "msgCnt", value.msgCnt);
  result = CheckLastError("SignalStatusMessage", gkFuncRefGet, result);

  C2xSetTokenInt(packetHandle, "SignalStatusMessage", "id", value.id);
  result = CheckLastError("SignalStatusMessage", gkFuncRefGet, result);

    for(j=0; j<value.status.stringLength; j++)
    {
      if(value.status.string[j] == '0')
      {
        C2xSetTokenBitOfBitString(packetHandle, "SignalStatusMessage", "status", j, 0);
      }
      else
      {
        C2xSetTokenBitOfBitString(packetHandle, "SignalStatusMessage", "status", j, 1);
      }
      result = CheckLastError("SignalStatusMessage", gkFuncRefGet, result);
    }
  result = CheckLastError("SignalStatusMessage", gkFuncRefGet, result);

  if (value.priority.isValidFlag==1)
  {
    SetSignalStatusMessage_SignalStatusMessage_priorityParams(packetHandle, value.priority, "priority");
    result = CheckLastError("SignalStatusMessage", gkFuncRefGet, result);

  }
  else
  {
    if( C2xIsTokenAvailable(packetHandle, "SignalStatusMessage", "priority") )
    {
      C2xRemoveToken(packetHandle, "SignalStatusMessage", "priority");
    }
  }

  if (value.priorityCause.isValidFlag==1)
  {
    SetSignalStatusMessageVehicleIdentParams(packetHandle, value.priorityCause, "priorityCause");
    result = CheckLastError("SignalStatusMessage", gkFuncRefGet, result);

  }
  else
  {
    if( C2xIsTokenAvailable(packetHandle, "SignalStatusMessage", "priorityCause") )
    {
      C2xRemoveToken(packetHandle, "SignalStatusMessage", "priorityCause");
    }
  }

  if (value.prempt.isValidFlag==1)
  {
    SetSignalStatusMessage_SignalStatusMessage_premptParams(packetHandle, value.prempt, "prempt");
    result = CheckLastError("SignalStatusMessage", gkFuncRefGet, result);

  }
  else
  {
    if( C2xIsTokenAvailable(packetHandle, "SignalStatusMessage", "prempt") )
    {
      C2xRemoveToken(packetHandle, "SignalStatusMessage", "prempt");
    }
  }

  if (value.preemptCause.isValidFlag==1)
  {
    SetSignalStatusMessageVehicleIdentParams(packetHandle, value.preemptCause, "preemptCause");
    result = CheckLastError("SignalStatusMessage", gkFuncRefGet, result);

  }
  else
  {
    if( C2xIsTokenAvailable(packetHandle, "SignalStatusMessage", "preemptCause") )
    {
      C2xRemoveToken(packetHandle, "SignalStatusMessage", "preemptCause");
    }
  }

  if (value.transitStatus.isValidFlag==1)
  {
      for(j=0; j<value.transitStatus.stringLength; j++)
      {
        if(value.transitStatus.string[j] == '0')
        {
          C2xSetTokenBitOfBitString(packetHandle, "SignalStatusMessage", "transitStatus", j, 0);
        }
        else
        {
          C2xSetTokenBitOfBitString(packetHandle, "SignalStatusMessage", "transitStatus", j, 1);
        }
        result = CheckLastError("SignalStatusMessage", gkFuncRefGet, result);
      }
    result = CheckLastError("SignalStatusMessage", gkFuncRefGet, result);

  }
  else
  {
    if( C2xIsTokenAvailable(packetHandle, "SignalStatusMessage", "transitStatus") )
    {
      C2xRemoveToken(packetHandle, "SignalStatusMessage", "transitStatus");
    }
  }

  return result;
}

