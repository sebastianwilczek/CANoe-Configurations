/*@!Encoding:1252*/
/*
//  (c) Vector Informatik GmbH. All rights reserved.
//
//  This file contains definitions of structs and methods that may be used
//  to set and get the values of an ASN.1 defined packet's payload.
//
//  //This example demonstrates how to set a packet's payload:
//  LONG packetHandle;
//  struct CommonSafetyRequest payload;
//  //you need to set the values of the variable "payload" yourself
//  packetHandle = API_InitCommonSafetyRequestPacket();
//  if (packetHandle!=0) {
//    if (API_SetCommonSafetyRequestParams(packetHandle, payload)==0) {
//      if (C2xCompletePacket(packetHandle)==0) {
//        C2xOutputPacket(packetHandle);
//      }
//    }
//  }
//                                                                             */
includes
{

}
variables
{
    struct CommonSafetyRequest_Blob_TemporaryID {
        INT isValidFlag;   // necessary if this struct is used as an optional field of a SEQUENCE
        DWORD temporaryID;  // INTEGER, 0..4294967295;
    };
    
    struct CommonSafetyRequestTemporaryID {
        INT isValidFlag;   // necessary if this struct is used as an optional field of a SEQUENCE
        CHAR string[5];
        INT  stringLength;
        struct CommonSafetyRequest_Blob_TemporaryID _Blob_TemporaryID;  // SEQUENCE;
    };
    
    struct CommonSafetyRequest_CommonSafetyRequest_requests {
        INT isValidFlag;   // necessary if this struct is used as an optional field of a SEQUENCE
        INT length;
        INT arrayValue[32];  // ENUMERATED, reserved(0), itemA(1), itemB(2), itemC(3), itemD(4), itemE(5), itemF(6), itemG(7), itemH(8), itemI(9), itemJ(10), itemK(11), itemL(12), itemM(13), itemN(14), itemO(15), itemP(16), itemQ(17);
    };
    
    struct CommonSafetyRequest {
        INT isValidFlag;   // necessary if this struct is used as an optional field of a SEQUENCE
        INT msgID;  // ENUMERATED, reserved(0), alaCarteMessage(1), basicSafetyMessage(2), basicSafetyMessageVerbose(3), commonSafetyRequest(4), emergencyVehicleAlert(5), intersectionCollisionAlert(6), mapData(7), nmeaCorrections(8), probeDataManagement(9), probeVehicleData(10), roadSideAlert(11), rtcmCorrections(12), signalPhaseAndTimingMessage(13), signalRequestMessage(14), signalStatusMessage(15), travelerInformation(16);
        struct OPT_BYTE_ASN msgCnt;  // INTEGER, OPTIONAL, 0..127;
        struct CommonSafetyRequestTemporaryID id;  // OCTETSTRING, OPTIONAL;
        struct CommonSafetyRequest_CommonSafetyRequest_requests requests;  // SEQUENCEOF;
    };
    
}

/*
// init function to create a simple packet handle
*/ 
LONG API_InitCommonSafetyRequestPacket()
{
  return C2xInitPacket("CommonSafetyRequest"); 
}

/*
// init function to create a simple packet handle and
// initialize the struct with valid data
*/ 
LONG API_InitCommonSafetyRequestPacket(struct CommonSafetyRequest msgStruct)
{
  long pktHandle;

  pktHandle = API_InitCommonSafetyRequestPacket();

  if (pktHandle != 0)
  {
    // create valid message and application data
    if (C2xCompletePacket(pktHandle) == 0) 
    {
      API_GetCommonSafetyRequestParams(pktHandle, msgStruct);
    }
  }
  return pktHandle;
}

/*
// init function to create a packet with security layer and
// initialize the struct with valid data
*/ 
LONG API_InitCommonSafetyRequestPacket(struct CommonSafetyRequest msgStruct, char packetTypeDesignator[], char certificateName[])
{
  long pktHandle, certHdl;

  // initialize the packet
  pktHandle = C2xInitPacket("CommonSafetyRequest", packetTypeDesignator);

  if (pktHandle != 0)
  {
    certHdl = C2xSecCertificateGetHandle(certificateName);  // get the certificate handle for the cert with name "certificateName"
    if (certHdl != 0) 
    {
      C2xSecPacketSetSignerHandle(pktHandle, certHdl); // set the certHdl to the packet
    }

    // create valid message and application data
    if (C2xCompletePacket(pktHandle) == 0) 
    {
      // copy application data to the application structure
      API_GetCommonSafetyRequestParams(pktHandle, msgStruct);
    }
  }
  return pktHandle;
}
    

int GetCommonSafetyRequest_Blob_TemporaryIDParams(LONG packetHandle, struct CommonSafetyRequest_Blob_TemporaryID value, char oldPath[])
{
  char newPath[300];
  int result;

  result = 0;

  snprintf(newPath, elcount(newPath), "%s.%s", oldPath, "temporaryID");
  value.temporaryID = C2xGetTokenInt64(packetHandle, "CommonSafetyRequest", newPath);
  result = CheckLastError("CommonSafetyRequest", gkFuncRefGet, result);

  return result;
}

int SetCommonSafetyRequest_Blob_TemporaryIDParams(LONG packetHandle, struct CommonSafetyRequest_Blob_TemporaryID value, char oldPath[])
{
  char newPath[300];
  int result;

  result = 0;

  snprintf(newPath, elcount(newPath), "%s.%s", oldPath, "temporaryID");
  C2xSetTokenInt64(packetHandle, "CommonSafetyRequest", newPath, value.temporaryID);
  result = CheckLastError("CommonSafetyRequest", gkFuncRefGet, result);

  return result;
}

int GetCommonSafetyRequestTemporaryIDParams(LONG packetHandle, struct CommonSafetyRequestTemporaryID value, char oldPath[])
{
  char newPath[300];
  int result;

  result = 0;

  snprintf(newPath, elcount(newPath), "%s.%s", oldPath, "_Blob_TemporaryID");
  GetCommonSafetyRequest_Blob_TemporaryIDParams(packetHandle, value._Blob_TemporaryID, newPath);
  result = CheckLastError("CommonSafetyRequest", gkFuncRefGet, result);

  return result;
}

int SetCommonSafetyRequestTemporaryIDParams(LONG packetHandle, struct CommonSafetyRequestTemporaryID value, char oldPath[])
{
  char newPath[300];
  int result;

  result = 0;

  snprintf(newPath, elcount(newPath), "%s.%s", oldPath, "_Blob_TemporaryID");
  SetCommonSafetyRequest_Blob_TemporaryIDParams(packetHandle, value._Blob_TemporaryID, newPath);
  result = CheckLastError("CommonSafetyRequest", gkFuncRefGet, result);

  return result;
}

int GetCommonSafetyRequest_CommonSafetyRequest_requestsParams(LONG packetHandle, struct CommonSafetyRequest_CommonSafetyRequest_requests value, char oldPath[])
{
  char newPath[300]; 
  int i;
  int result;

  result = 0;

  value.length = C2xGetTokenInt(packetHandle, "CommonSafetyRequest", oldPath);
  if((result = CheckLastError("CommonSafetyRequest", gkFuncRefGet, result))==0)
  {
    for(i=0; i<value.length; i++)
    {
      snprintf(newPath, elcount(newPath), "%s[%d]", oldPath, i);
      value.arrayValue[i] = C2xGetTokenInt64(packetHandle, "CommonSafetyRequest", newPath);
      result = CheckLastError("CommonSafetyRequest", gkFuncRefGet, result);
    }
  }
  return result;
}

int SetCommonSafetyRequest_CommonSafetyRequest_requestsParams(LONG packetHandle, struct CommonSafetyRequest_CommonSafetyRequest_requests value, char oldPath[])
{
  char newPath[300]; 
  int i;
  int result;

  result = 0;

  C2xRemoveToken(packetHandle, "CommonSafetyRequest", oldPath);
  for(i=0; i<value.length; i++)
  {
    snprintf(newPath, elcount(newPath), "%s[%d]", oldPath, i);
    C2xSetTokenInt64(packetHandle, "CommonSafetyRequest", newPath, value.arrayValue[i]);
    result = CheckLastError("CommonSafetyRequest", gkFuncRefGet, result);
  }
  return result;
}

int API_GetCommonSafetyRequestParams(LONG packetHandle, struct CommonSafetyRequest value)
{
  int result;
  result = 0;

  value.msgID = C2xGetTokenInt(packetHandle, "CommonSafetyRequest", "msgID");
  result = CheckLastError("CommonSafetyRequest", gkFuncRefGet, result);

  value.msgCnt.isValidFlag = C2xIsTokenAvailable(packetHandle, "CommonSafetyRequest", "msgCnt");
  if(value.msgCnt.isValidFlag == 1)
  {
    value.msgCnt.value = C2xGetTokenInt(packetHandle, "CommonSafetyRequest", "msgCnt");
    result = CheckLastError("CommonSafetyRequest", gkFuncRefGet, result);

  }
  value.id.isValidFlag = C2xIsTokenAvailable(packetHandle, "CommonSafetyRequest", "id");
  if(value.id.isValidFlag == 1)
  {
    value.id.isValidFlag = 1;
    GetCommonSafetyRequestTemporaryIDParams(packetHandle, value.id, "id");
    result = CheckLastError("CommonSafetyRequest", gkFuncRefGet, result);

  }
  value.requests.isValidFlag = 1;
  GetCommonSafetyRequest_CommonSafetyRequest_requestsParams(packetHandle, value.requests, "requests");
  result = CheckLastError("CommonSafetyRequest", gkFuncRefGet, result);

  return result;
}

int API_SetCommonSafetyRequestParams(LONG packetHandle, struct CommonSafetyRequest value)
{
  int result;
  result = 0;

  value.msgID = 4;

  C2xSetTokenInt(packetHandle, "CommonSafetyRequest", "msgID", value.msgID);
  result = CheckLastError("CommonSafetyRequest", gkFuncRefGet, result);

  if (value.msgCnt.isValidFlag==1)
  {
    C2xSetTokenInt(packetHandle, "CommonSafetyRequest", "msgCnt", value.msgCnt.value);
    result = CheckLastError("CommonSafetyRequest", gkFuncRefGet, result);

  }
  else
  {
    if( C2xIsTokenAvailable(packetHandle, "CommonSafetyRequest", "msgCnt") )
    {
      C2xRemoveToken(packetHandle, "CommonSafetyRequest", "msgCnt");
    }
  }

  if (value.id.isValidFlag==1)
  {
    SetCommonSafetyRequestTemporaryIDParams(packetHandle, value.id, "id");
    result = CheckLastError("CommonSafetyRequest", gkFuncRefGet, result);

  }
  else
  {
    if( C2xIsTokenAvailable(packetHandle, "CommonSafetyRequest", "id") )
    {
      C2xRemoveToken(packetHandle, "CommonSafetyRequest", "id");
    }
  }

  SetCommonSafetyRequest_CommonSafetyRequest_requestsParams(packetHandle, value.requests, "requests");
  result = CheckLastError("CommonSafetyRequest", gkFuncRefGet, result);

  return result;
}

