/*@!Encoding:1252*/
includes
{
  #include "..\DataSources_Templates\ASNV_Template_BaseDatatypes.cin"
  
  #include "..\DataSources_Templates\ASNV_Template_BasicSafetyMessage.cin"           // DSRC Message ID 2
//  #include "..\DataSources_Templates\ASNV_Template_BasicSafetyMessageVerbose.cin"    // DSRC Message ID 3
//  #include "..\DataSources_Templates\ASNV_Template_CommonSafetyRequest.cin"          // DSRC Message ID 4
//  #include "..\DataSources_Templates\ASNV_Template_EmergencyVehicleAlert.cin"        // DSRC Message ID 5
//  #include "..\DataSources_Templates\ASNV_Template_IntersectionCollision.cin"        // DSRC Message ID 6
//  #include "..\DataSources_Templates\ASNV_Template_NMEA_Corrections.cin"             // DSRC Message ID 8
//  #include "..\DataSources_Templates\ASNV_Template_ProbeDataManagement.cin"          // DSRC Message ID 9
//  #include "..\DataSources_Templates\ASNV_Template_ProbeVehicleData.cin"             // DSRC Message ID 10
//  #include "..\DataSources_Templates\ASNV_Template_RoadSideAlert.cin"                // DSRC Message ID 11
//  #include "..\DataSources_Templates\ASNV_Template_RTCM_Corrections.cin"             // DSRC Message ID 12
//  #include "..\DataSources_Templates\ASNV_Template_SignalRequestMsg.cin"             // DSRC Message ID 14
//  #include "..\DataSources_Templates\ASNV_Template_SignalStatusMessage.cin"          // DSRC Message ID 15
//  #include "..\DataSources_Templates\ASNV_Template_TravelerInformation.cin"          // DSRC Message ID 16
//  #include "..\DataSources_Templates\ASNV_Template_UPERframeMAP.cin"                 // DSRC Message ID 18
//  #include "..\DataSources_Templates\ASNV_Template_UPERframeSPAT.cin"                // DSRC Message ID 19
}

// On start, callback functions for the most common application message BasicSafetyMessage are registered.
// It is possible to do the same with the other application messages if needed.
on start
{
  enum CallbackType { OnRx, PreTx };
  
  C2xRegisterCallback(OnRx,  "OnRxBSM",    "BasicSafetyMessage");
  C2xRegisterCallback(PreTx, "OnPreTxBSM", "BasicSafetyMessage");
}

// Callback function on receiving BSM messages
void OnRxBSM(long channel, long dir, long radioChannel, long signalStrength, long signalQuality, long packet)
{

}

// Callback function before sending BSM messages from IL
void OnPreTxBSM(LONG packet)
{

}