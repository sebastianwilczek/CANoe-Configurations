/*@!Encoding:1252*/
includes
{
  #include "..\DataSources_Templates\ASNV_Template_BaseDatatypes.cin"
  #include "..\DataSources_Templates\ASNV_Template_BasicSafetyMessage.cin"
  #include "..\DataSources_Templates\ASNV_Template_MapData.cin"
  #include "..\DataSources_Templates\ASNV_Template_RoadSideInformation.cin"
  #include "..\DataSources_Templates\ASNV_Template_RoadsideSafetyMessage.cin"
  #include "..\DataSources_Templates\ASNV_Template_RoadTrafficSigns.cin"
  #include "..\DataSources_Templates\ASNV_Template_SPAT.cin"
}

// Before measurement start, Channel 1 (ATH1) is set to C-V2X Mode
on preStart
{
  C2xEnableCV2xMode(1); 
}

// On start, callback functions for the most common application messages CAM and DENM are registered.
// It is possible to do the same with the other application messages if needed.
on start
{
  enum CallbackType { OnRx, PreTx };
  
  C2xRegisterCallback(OnRx,  "OnRxBasicSafetyMessage",    "BasicSafetyMessage");
  C2xRegisterCallback(PreTx, "OnPreTxBasicSafetyMessage", "BasicSafetyMessage");
  
  C2xRegisterCallback(OnRx,  "OnRxMapData",    "MapData");
  C2xRegisterCallback(PreTx, "OnPreTxMapData", "MapData");
  
  C2xRegisterCallback(OnRx,  "OnRxRoadSideInformation",    "RoadSideInformation");
  C2xRegisterCallback(PreTx, "OnPreTxRoadSideInformation", "RoadSideInformation");
  
  C2xRegisterCallback(OnRx,  "OnRxRoadsideSafetyMessage",    "RoadsideSafetyMessage");
  C2xRegisterCallback(PreTx, "OnPreTxRoadsideSafetyMessage", "RoadsideSafetyMessage");
  
  C2xRegisterCallback(OnRx,  "OnRxRoadTrafficSigns",    "RoadTrafficSigns");
  C2xRegisterCallback(PreTx, "OnPreTxRoadTrafficSigns", "RoadTrafficSigns");
  
  C2xRegisterCallback(OnRx,  "OnRxSPAT",    "SPAT");
  C2xRegisterCallback(PreTx, "OnPreTxSPAT", "SPAT");
}

// Callback function on receiving BasicSafetyMessage messages
void OnRxBasicSafetyMessage(long channel, long dir, long radioChannel, long signalStrength, long signalQuality, long packet)
{

}

// Callback function before sending BasicSafetyMessage messages from IL
void OnPreTxBasicSafetyMessage(LONG packet)
{

}

// Callback function on receiving MapData messages
void OnRxMapData(long channel, long dir, long radioChannel, long signalStrength, long signalQuality, long packet)
{

}

// Callback function before sending MapData messages from IL
void OnPreTxMapData(LONG packet)
{

}

// Callback function on receiving RoadSideInformation messages
void OnRxRoadSideInformation(long channel, long dir, long radioChannel, long signalStrength, long signalQuality, long packet)
{

}

// Callback function before sending RoadSideInformation messages from IL
void OnPreTxRoadSideInformation(LONG packet)
{

}

// Callback function on receiving RoadsideSafetyMessage messages
void OnRxRoadsideSafetyMessage(long channel, long dir, long radioChannel, long signalStrength, long signalQuality, long packet)
{

}

// Callback function before sending RoadsideSafetyMessage messages from IL
void OnPreTxRoadsideSafetyMessage(LONG packet)
{

}

// Callback function on receiving RoadTrafficSigns messages
void OnRxRoadTrafficSigns(long channel, long dir, long radioChannel, long signalStrength, long signalQuality, long packet)
{

}

// Callback function before sending RoadTrafficSigns messages from IL
void OnPreTxRoadTrafficSigns(LONG packet)
{

}

// Callback function on receiving SPAT messages
void OnRxSPAT(long channel, long dir, long radioChannel, long signalStrength, long signalQuality, long packet)
{

}

// Callback function before sending SPAT messages from IL
void OnPreTxSPAT(LONG packet)
{

}