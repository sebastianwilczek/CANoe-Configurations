/*@!Encoding:1252*/
/*
//  (c) Vector Informatik GmbH. All rights reserved.
//
//  This file contains definitions of structs and methods that may be used
//  to set and get the values of an ASN.1 defined packet's payload.
//
//  //This example demonstrates how to set a packet's payload:
//  LONG packetHandle;
//  struct RoadTrafficSigns payload;
//  //you need to set the values of the variable "payload" yourself
//  packetHandle = API_InitRoadTrafficSignsPacket();
//  if (packetHandle!=0) {
//    if (API_SetRoadTrafficSignsParams(packetHandle, payload)==0) {
//      if (C2xCompletePacket(packetHandle)==0) {
//        C2xOutputPacket(packetHandle);
//      }
//    }
//  }
//                                                                             */
includes
{
  //#include "ASNV_Template_BaseDatatypes.cin"  // If warning "Duplicate #include, ignoring this include" appears, please remove the ASNV_Template_BaseDatatypes.cin include from your other *.cin files in the project.
}
variables
{
    struct RoadTrafficSignsRoadTrafficSigns_id {
        INT isValidFlag;   // necessary if this struct is used as an optional field of a SEQUENCE
        CHAR string[9];
        INT  stringLength;
    };
    
    struct RoadTrafficSignsPosition3D {
        INT isValidFlag;   // necessary if this struct is used as an optional field of a SEQUENCE
        LONG lat;  // INTEGER, -900000000..900000001;
        LONG lon;  // INTEGER, -1799999999..1800000001;
        struct OPT_LONG_ASN elevation;  // INTEGER, OPTIONAL, -4096..61439;
    };
    
    struct RoadTrafficSignsPosition_LL_24B {
        INT isValidFlag;   // necessary if this struct is used as an optional field of a SEQUENCE
        INT lon;  // INTEGER, -2048..2047;
        INT lat;  // INTEGER, -2048..2047;
    };
    
    struct RoadTrafficSignsPosition_LL_28B {
        INT isValidFlag;   // necessary if this struct is used as an optional field of a SEQUENCE
        INT lon;  // INTEGER, -8192..8191;
        INT lat;  // INTEGER, -8192..8191;
    };
    
    struct RoadTrafficSignsPosition_LL_32B {
        INT isValidFlag;   // necessary if this struct is used as an optional field of a SEQUENCE
        INT lon;  // INTEGER, -32768..32767;
        INT lat;  // INTEGER, -32768..32767;
    };
    
    struct RoadTrafficSignsPosition_LL_36B {
        INT isValidFlag;   // necessary if this struct is used as an optional field of a SEQUENCE
        LONG lon;  // INTEGER, -131072..131071;
        LONG lat;  // INTEGER, -131072..131071;
    };
    
    struct RoadTrafficSignsPosition_LL_44B {
        INT isValidFlag;   // necessary if this struct is used as an optional field of a SEQUENCE
        LONG lon;  // INTEGER, -2097152..2097151;
        LONG lat;  // INTEGER, -2097152..2097151;
    };
    
    struct RoadTrafficSignsPosition_LL_48B {
        INT isValidFlag;   // necessary if this struct is used as an optional field of a SEQUENCE
        LONG lon;  // INTEGER, -8388608..8388607;
        LONG lat;  // INTEGER, -8388608..8388607;
    };
    
    struct RoadTrafficSignsPosition_LLmD_64b {
        INT isValidFlag;   // necessary if this struct is used as an optional field of a SEQUENCE
        LONG lon;  // INTEGER, -1799999999..1800000001;
        LONG lat;  // INTEGER, -900000000..900000001;
    };
    
    struct RoadTrafficSignsPositionOffsetLL {
        INT isValidFlag;   // necessary if this struct is used as an optional field of a SEQUENCE
        INT choice;
        struct RoadTrafficSignsPosition_LL_24B position_LL1;  // SEQUENCE;
        struct RoadTrafficSignsPosition_LL_28B position_LL2;  // SEQUENCE;
        struct RoadTrafficSignsPosition_LL_32B position_LL3;  // SEQUENCE;
        struct RoadTrafficSignsPosition_LL_36B position_LL4;  // SEQUENCE;
        struct RoadTrafficSignsPosition_LL_44B position_LL5;  // SEQUENCE;
        struct RoadTrafficSignsPosition_LL_48B position_LL6;  // SEQUENCE;
        struct RoadTrafficSignsPosition_LLmD_64b position_LatLon;  // SEQUENCE;
    };
    
    struct RoadTrafficSignsVerticalOffset {
        INT isValidFlag;   // necessary if this struct is used as an optional field of a SEQUENCE
        INT choice;
        INT offset1;  // INTEGER, -64..63;
        INT offset2;  // INTEGER, -128..127;
        INT offset3;  // INTEGER, -256..255;
        INT offset4;  // INTEGER, -512..511;
        INT offset5;  // INTEGER, -1024..1023;
        INT offset6;  // INTEGER, -2048..2047;
        LONG elevation;  // INTEGER, -4096..61439;
    };
    
    struct RoadTrafficSignsPositionOffsetLLV {
        INT isValidFlag;   // necessary if this struct is used as an optional field of a SEQUENCE
        struct RoadTrafficSignsPositionOffsetLL offsetLL;  // CHOICE;
        struct RoadTrafficSignsVerticalOffset offsetV;  // CHOICE, OPTIONAL;
    };
    
    struct RoadTrafficSignsRTSData_description {
        INT isValidFlag;   // necessary if this struct is used as an optional field of a SEQUENCE
        CHAR string[257];
        INT  stringLength;
    };
    
    struct RoadTrafficSignsPriority {
        INT isValidFlag;   // necessary if this struct is used as an optional field of a SEQUENCE
        CHAR string[2];
        INT  stringLength;
    };
    
    struct RoadTrafficSignsPathPointList {
        INT isValidFlag;   // necessary if this struct is used as an optional field of a SEQUENCE
        INT length;
        struct RoadTrafficSignsPositionOffsetLLV arrayValue[32];  // SEQUENCE;
    };
    
    struct RoadTrafficSignsNodeReferenceID {
        INT isValidFlag;   // necessary if this struct is used as an optional field of a SEQUENCE
        struct OPT_WORD_ASN region;  // INTEGER, OPTIONAL, 0..65535;
        WORD id;  // INTEGER, 0..65535;
    };
    
    struct RoadTrafficSignsReferenceLanes {
        INT isValidFlag;   // necessary if this struct is used as an optional field of a SEQUENCE
        CHAR string[17];
        INT  stringLength;
    };
    
    struct RoadTrafficSignsReferenceLink {
        INT isValidFlag;   // necessary if this struct is used as an optional field of a SEQUENCE
        struct RoadTrafficSignsNodeReferenceID upstreamNodeId;  // SEQUENCE;
        struct RoadTrafficSignsNodeReferenceID downstreamNodeId;  // SEQUENCE;
        struct RoadTrafficSignsReferenceLanes referenceLanes;  // BITSTRING, OPTIONAL;
    };
    
    struct RoadTrafficSignsReferenceLinkList {
        INT isValidFlag;   // necessary if this struct is used as an optional field of a SEQUENCE
        INT length;
        struct RoadTrafficSignsReferenceLink arrayValue[16];  // SEQUENCE;
    };
    
    struct RoadTrafficSignsRTSData {
        INT isValidFlag;   // necessary if this struct is used as an optional field of a SEQUENCE
        BYTE rtsId;  // INTEGER, 0..255;
        WORD signType;  // INTEGER, 0..65535;
        struct RoadTrafficSignsPositionOffsetLLV signPos;  // SEQUENCE, OPTIONAL;
        struct RoadTrafficSignsRTSData_description description;  // IA5STRING, OPTIONAL;
        struct RoadTrafficSignsPriority priority;  // OCTETSTRING, OPTIONAL;
        struct RoadTrafficSignsPathPointList activePath;  // SEQUENCEOF;
        WORD radius;  // INTEGER, 0..1024;
        struct RoadTrafficSignsReferenceLinkList referenceLinks;  // SEQUENCEOF, OPTIONAL;
    };
    
    struct RoadTrafficSignsRTSList {
        INT isValidFlag;   // necessary if this struct is used as an optional field of a SEQUENCE
        INT length;
        struct RoadTrafficSignsRTSData arrayValue[16];  // SEQUENCE;
    };
    
    struct RoadTrafficSignsRTSFrame {
        INT isValidFlag;   // necessary if this struct is used as an optional field of a SEQUENCE
        BYTE msgCnt;  // INTEGER, 0..127;
        struct OPT_DWORD_ASN timeStamp;  // INTEGER, OPTIONAL, 0..527040;
        struct RoadTrafficSignsRoadTrafficSigns_id id;  // OCTETSTRING;
        struct RoadTrafficSignsPosition3D refPos;  // SEQUENCE;
        struct RoadTrafficSignsRTSList rtss;  // SEQUENCEOF;
    };
    
    struct RoadTrafficSigns {
        INT isValidFlag;   // necessary if this struct is used as an optional field of a SEQUENCE
        BYTE frameType;  // INTEGER, 0..15, rsiFrame(2);
        struct RoadTrafficSignsRTSFrame rtsFrame;  // SEQUENCE;
    };
    
}

/*
// init function to create a simple packet handle
*/ 
LONG API_InitRoadTrafficSignsPacket()
{
  return C2xInitPacket("RoadTrafficSigns"); 
}

/*
// init function to create a simple packet handle and
// initialize the struct with valid data
*/ 
LONG API_InitRoadTrafficSignsPacket(struct RoadTrafficSigns msgStruct)
{
  long pktHandle;

  pktHandle = API_InitRoadTrafficSignsPacket();

  if (pktHandle != 0)
  {
    // create valid message and application data
    if (C2xCompletePacket(pktHandle) == 0) 
    {
      API_GetRoadTrafficSignsParams(pktHandle, msgStruct);
    }
  }
  return pktHandle;
}

/*
// init function to create a packet with security layer and
// initialize the struct with valid data
*/ 
LONG API_InitRoadTrafficSignsPacket(struct RoadTrafficSigns msgStruct, char packetTypeDesignator[], char certificateName[])
{
  long pktHandle, certHdl;

  // initialize the packet
  pktHandle = C2xInitPacket("RoadTrafficSigns", packetTypeDesignator);

  if (pktHandle != 0)
  {
    certHdl = C2xSecCertificateGetHandle(certificateName);  // get the certificate handle for the cert with name "certificateName"
    if (certHdl != 0) 
    {
      C2xSecPacketSetSignerHandle(pktHandle, certHdl); // set the certHdl to the packet
    }

    // create valid message and application data
    if (C2xCompletePacket(pktHandle) == 0) 
    {
      // copy application data to the application structure
      API_GetRoadTrafficSignsParams(pktHandle, msgStruct);
    }
  }
  return pktHandle;
}
    

int GetRoadTrafficSignsPosition3DParams(LONG packetHandle, struct RoadTrafficSignsPosition3D value, char oldPath[])
{
  char newPath[300];
  int result;

  result = 0;

  snprintf(newPath, elcount(newPath), "%s.%s", oldPath, "lat");
  value.lat = C2xGetTokenInt(packetHandle, "RoadTrafficSigns", newPath);
  result = CheckLastError("RoadTrafficSigns", gkFuncRefGet, result);

  snprintf(newPath, elcount(newPath), "%s.%s", oldPath, "lon");
  value.lon = C2xGetTokenInt(packetHandle, "RoadTrafficSigns", newPath);
  result = CheckLastError("RoadTrafficSigns", gkFuncRefGet, result);

  snprintf(newPath, elcount(newPath), "%s.%s", oldPath, "elevation");
  value.elevation.isValidFlag = C2xIsTokenAvailable(packetHandle, "RoadTrafficSigns", newPath);
  if(value.elevation.isValidFlag==1)
  {
    value.elevation.value = C2xGetTokenInt(packetHandle, "RoadTrafficSigns", newPath);
    result = CheckLastError("RoadTrafficSigns", gkFuncRefGet, result);
  }
  return result;
}

int SetRoadTrafficSignsPosition3DParams(LONG packetHandle, struct RoadTrafficSignsPosition3D value, char oldPath[])
{
  char newPath[300];
  int result;

  result = 0;

  snprintf(newPath, elcount(newPath), "%s.%s", oldPath, "lat");
  C2xSetTokenInt(packetHandle, "RoadTrafficSigns", newPath, value.lat);
  result = CheckLastError("RoadTrafficSigns", gkFuncRefGet, result);

  snprintf(newPath, elcount(newPath), "%s.%s", oldPath, "lon");
  C2xSetTokenInt(packetHandle, "RoadTrafficSigns", newPath, value.lon);
  result = CheckLastError("RoadTrafficSigns", gkFuncRefGet, result);

  snprintf(newPath, elcount(newPath), "%s.%s", oldPath, "elevation");
  if(value.elevation.isValidFlag==1)
  {
    C2xSetTokenInt(packetHandle, "RoadTrafficSigns", newPath, value.elevation.value);
    result = CheckLastError("RoadTrafficSigns", gkFuncRefGet, result);
  }
  else
  {
    if( C2xIsTokenAvailable(packetHandle, "RoadTrafficSigns", newPath) )
    {
      C2xRemoveToken(packetHandle, "RoadTrafficSigns", newPath);
    }
  }

  return result;
}

int GetRoadTrafficSignsPosition_LL_24BParams(LONG packetHandle, struct RoadTrafficSignsPosition_LL_24B value, char oldPath[])
{
  char newPath[300];
  int result;

  result = 0;

  snprintf(newPath, elcount(newPath), "%s.%s", oldPath, "lon");
  value.lon = C2xGetTokenInt(packetHandle, "RoadTrafficSigns", newPath);
  result = CheckLastError("RoadTrafficSigns", gkFuncRefGet, result);

  snprintf(newPath, elcount(newPath), "%s.%s", oldPath, "lat");
  value.lat = C2xGetTokenInt(packetHandle, "RoadTrafficSigns", newPath);
  result = CheckLastError("RoadTrafficSigns", gkFuncRefGet, result);

  return result;
}

int SetRoadTrafficSignsPosition_LL_24BParams(LONG packetHandle, struct RoadTrafficSignsPosition_LL_24B value, char oldPath[])
{
  char newPath[300];
  int result;

  result = 0;

  snprintf(newPath, elcount(newPath), "%s.%s", oldPath, "lon");
  C2xSetTokenInt(packetHandle, "RoadTrafficSigns", newPath, value.lon);
  result = CheckLastError("RoadTrafficSigns", gkFuncRefGet, result);

  snprintf(newPath, elcount(newPath), "%s.%s", oldPath, "lat");
  C2xSetTokenInt(packetHandle, "RoadTrafficSigns", newPath, value.lat);
  result = CheckLastError("RoadTrafficSigns", gkFuncRefGet, result);

  return result;
}

int GetRoadTrafficSignsPosition_LL_28BParams(LONG packetHandle, struct RoadTrafficSignsPosition_LL_28B value, char oldPath[])
{
  char newPath[300];
  int result;

  result = 0;

  snprintf(newPath, elcount(newPath), "%s.%s", oldPath, "lon");
  value.lon = C2xGetTokenInt(packetHandle, "RoadTrafficSigns", newPath);
  result = CheckLastError("RoadTrafficSigns", gkFuncRefGet, result);

  snprintf(newPath, elcount(newPath), "%s.%s", oldPath, "lat");
  value.lat = C2xGetTokenInt(packetHandle, "RoadTrafficSigns", newPath);
  result = CheckLastError("RoadTrafficSigns", gkFuncRefGet, result);

  return result;
}

int SetRoadTrafficSignsPosition_LL_28BParams(LONG packetHandle, struct RoadTrafficSignsPosition_LL_28B value, char oldPath[])
{
  char newPath[300];
  int result;

  result = 0;

  snprintf(newPath, elcount(newPath), "%s.%s", oldPath, "lon");
  C2xSetTokenInt(packetHandle, "RoadTrafficSigns", newPath, value.lon);
  result = CheckLastError("RoadTrafficSigns", gkFuncRefGet, result);

  snprintf(newPath, elcount(newPath), "%s.%s", oldPath, "lat");
  C2xSetTokenInt(packetHandle, "RoadTrafficSigns", newPath, value.lat);
  result = CheckLastError("RoadTrafficSigns", gkFuncRefGet, result);

  return result;
}

int GetRoadTrafficSignsPosition_LL_32BParams(LONG packetHandle, struct RoadTrafficSignsPosition_LL_32B value, char oldPath[])
{
  char newPath[300];
  int result;

  result = 0;

  snprintf(newPath, elcount(newPath), "%s.%s", oldPath, "lon");
  value.lon = C2xGetTokenInt(packetHandle, "RoadTrafficSigns", newPath);
  result = CheckLastError("RoadTrafficSigns", gkFuncRefGet, result);

  snprintf(newPath, elcount(newPath), "%s.%s", oldPath, "lat");
  value.lat = C2xGetTokenInt(packetHandle, "RoadTrafficSigns", newPath);
  result = CheckLastError("RoadTrafficSigns", gkFuncRefGet, result);

  return result;
}

int SetRoadTrafficSignsPosition_LL_32BParams(LONG packetHandle, struct RoadTrafficSignsPosition_LL_32B value, char oldPath[])
{
  char newPath[300];
  int result;

  result = 0;

  snprintf(newPath, elcount(newPath), "%s.%s", oldPath, "lon");
  C2xSetTokenInt(packetHandle, "RoadTrafficSigns", newPath, value.lon);
  result = CheckLastError("RoadTrafficSigns", gkFuncRefGet, result);

  snprintf(newPath, elcount(newPath), "%s.%s", oldPath, "lat");
  C2xSetTokenInt(packetHandle, "RoadTrafficSigns", newPath, value.lat);
  result = CheckLastError("RoadTrafficSigns", gkFuncRefGet, result);

  return result;
}

int GetRoadTrafficSignsPosition_LL_36BParams(LONG packetHandle, struct RoadTrafficSignsPosition_LL_36B value, char oldPath[])
{
  char newPath[300];
  int result;

  result = 0;

  snprintf(newPath, elcount(newPath), "%s.%s", oldPath, "lon");
  value.lon = C2xGetTokenInt(packetHandle, "RoadTrafficSigns", newPath);
  result = CheckLastError("RoadTrafficSigns", gkFuncRefGet, result);

  snprintf(newPath, elcount(newPath), "%s.%s", oldPath, "lat");
  value.lat = C2xGetTokenInt(packetHandle, "RoadTrafficSigns", newPath);
  result = CheckLastError("RoadTrafficSigns", gkFuncRefGet, result);

  return result;
}

int SetRoadTrafficSignsPosition_LL_36BParams(LONG packetHandle, struct RoadTrafficSignsPosition_LL_36B value, char oldPath[])
{
  char newPath[300];
  int result;

  result = 0;

  snprintf(newPath, elcount(newPath), "%s.%s", oldPath, "lon");
  C2xSetTokenInt(packetHandle, "RoadTrafficSigns", newPath, value.lon);
  result = CheckLastError("RoadTrafficSigns", gkFuncRefGet, result);

  snprintf(newPath, elcount(newPath), "%s.%s", oldPath, "lat");
  C2xSetTokenInt(packetHandle, "RoadTrafficSigns", newPath, value.lat);
  result = CheckLastError("RoadTrafficSigns", gkFuncRefGet, result);

  return result;
}

int GetRoadTrafficSignsPosition_LL_44BParams(LONG packetHandle, struct RoadTrafficSignsPosition_LL_44B value, char oldPath[])
{
  char newPath[300];
  int result;

  result = 0;

  snprintf(newPath, elcount(newPath), "%s.%s", oldPath, "lon");
  value.lon = C2xGetTokenInt(packetHandle, "RoadTrafficSigns", newPath);
  result = CheckLastError("RoadTrafficSigns", gkFuncRefGet, result);

  snprintf(newPath, elcount(newPath), "%s.%s", oldPath, "lat");
  value.lat = C2xGetTokenInt(packetHandle, "RoadTrafficSigns", newPath);
  result = CheckLastError("RoadTrafficSigns", gkFuncRefGet, result);

  return result;
}

int SetRoadTrafficSignsPosition_LL_44BParams(LONG packetHandle, struct RoadTrafficSignsPosition_LL_44B value, char oldPath[])
{
  char newPath[300];
  int result;

  result = 0;

  snprintf(newPath, elcount(newPath), "%s.%s", oldPath, "lon");
  C2xSetTokenInt(packetHandle, "RoadTrafficSigns", newPath, value.lon);
  result = CheckLastError("RoadTrafficSigns", gkFuncRefGet, result);

  snprintf(newPath, elcount(newPath), "%s.%s", oldPath, "lat");
  C2xSetTokenInt(packetHandle, "RoadTrafficSigns", newPath, value.lat);
  result = CheckLastError("RoadTrafficSigns", gkFuncRefGet, result);

  return result;
}

int GetRoadTrafficSignsPosition_LL_48BParams(LONG packetHandle, struct RoadTrafficSignsPosition_LL_48B value, char oldPath[])
{
  char newPath[300];
  int result;

  result = 0;

  snprintf(newPath, elcount(newPath), "%s.%s", oldPath, "lon");
  value.lon = C2xGetTokenInt(packetHandle, "RoadTrafficSigns", newPath);
  result = CheckLastError("RoadTrafficSigns", gkFuncRefGet, result);

  snprintf(newPath, elcount(newPath), "%s.%s", oldPath, "lat");
  value.lat = C2xGetTokenInt(packetHandle, "RoadTrafficSigns", newPath);
  result = CheckLastError("RoadTrafficSigns", gkFuncRefGet, result);

  return result;
}

int SetRoadTrafficSignsPosition_LL_48BParams(LONG packetHandle, struct RoadTrafficSignsPosition_LL_48B value, char oldPath[])
{
  char newPath[300];
  int result;

  result = 0;

  snprintf(newPath, elcount(newPath), "%s.%s", oldPath, "lon");
  C2xSetTokenInt(packetHandle, "RoadTrafficSigns", newPath, value.lon);
  result = CheckLastError("RoadTrafficSigns", gkFuncRefGet, result);

  snprintf(newPath, elcount(newPath), "%s.%s", oldPath, "lat");
  C2xSetTokenInt(packetHandle, "RoadTrafficSigns", newPath, value.lat);
  result = CheckLastError("RoadTrafficSigns", gkFuncRefGet, result);

  return result;
}

int GetRoadTrafficSignsPosition_LLmD_64bParams(LONG packetHandle, struct RoadTrafficSignsPosition_LLmD_64b value, char oldPath[])
{
  char newPath[300];
  int result;

  result = 0;

  snprintf(newPath, elcount(newPath), "%s.%s", oldPath, "lon");
  value.lon = C2xGetTokenInt(packetHandle, "RoadTrafficSigns", newPath);
  result = CheckLastError("RoadTrafficSigns", gkFuncRefGet, result);

  snprintf(newPath, elcount(newPath), "%s.%s", oldPath, "lat");
  value.lat = C2xGetTokenInt(packetHandle, "RoadTrafficSigns", newPath);
  result = CheckLastError("RoadTrafficSigns", gkFuncRefGet, result);

  return result;
}

int SetRoadTrafficSignsPosition_LLmD_64bParams(LONG packetHandle, struct RoadTrafficSignsPosition_LLmD_64b value, char oldPath[])
{
  char newPath[300];
  int result;

  result = 0;

  snprintf(newPath, elcount(newPath), "%s.%s", oldPath, "lon");
  C2xSetTokenInt(packetHandle, "RoadTrafficSigns", newPath, value.lon);
  result = CheckLastError("RoadTrafficSigns", gkFuncRefGet, result);

  snprintf(newPath, elcount(newPath), "%s.%s", oldPath, "lat");
  C2xSetTokenInt(packetHandle, "RoadTrafficSigns", newPath, value.lat);
  result = CheckLastError("RoadTrafficSigns", gkFuncRefGet, result);

  return result;
}

int GetRoadTrafficSignsPositionOffsetLLParams(LONG packetHandle, struct RoadTrafficSignsPositionOffsetLL value, char oldPath[])
{
  char newPath[300];
  int result;

  result = 0;

  value.choice = C2xGetTokenInt(packetHandle, "RoadTrafficSigns", oldPath);

  switch(value.choice)
  {
    case 0:
    {
      snprintf(newPath, elcount(newPath), "%s.%s", oldPath, "position_LL1");
      GetRoadTrafficSignsPosition_LL_24BParams(packetHandle, value.position_LL1, newPath);
      result = CheckLastError("RoadTrafficSigns", gkFuncRefGet, result);
    }
    break;
    case 1:
    {
      snprintf(newPath, elcount(newPath), "%s.%s", oldPath, "position_LL2");
      GetRoadTrafficSignsPosition_LL_28BParams(packetHandle, value.position_LL2, newPath);
      result = CheckLastError("RoadTrafficSigns", gkFuncRefGet, result);
    }
    break;
    case 2:
    {
      snprintf(newPath, elcount(newPath), "%s.%s", oldPath, "position_LL3");
      GetRoadTrafficSignsPosition_LL_32BParams(packetHandle, value.position_LL3, newPath);
      result = CheckLastError("RoadTrafficSigns", gkFuncRefGet, result);
    }
    break;
    case 3:
    {
      snprintf(newPath, elcount(newPath), "%s.%s", oldPath, "position_LL4");
      GetRoadTrafficSignsPosition_LL_36BParams(packetHandle, value.position_LL4, newPath);
      result = CheckLastError("RoadTrafficSigns", gkFuncRefGet, result);
    }
    break;
    case 4:
    {
      snprintf(newPath, elcount(newPath), "%s.%s", oldPath, "position_LL5");
      GetRoadTrafficSignsPosition_LL_44BParams(packetHandle, value.position_LL5, newPath);
      result = CheckLastError("RoadTrafficSigns", gkFuncRefGet, result);
    }
    break;
    case 5:
    {
      snprintf(newPath, elcount(newPath), "%s.%s", oldPath, "position_LL6");
      GetRoadTrafficSignsPosition_LL_48BParams(packetHandle, value.position_LL6, newPath);
      result = CheckLastError("RoadTrafficSigns", gkFuncRefGet, result);
    }
    break;
    case 6:
    {
      snprintf(newPath, elcount(newPath), "%s.%s", oldPath, "position_LatLon");
      GetRoadTrafficSignsPosition_LLmD_64bParams(packetHandle, value.position_LatLon, newPath);
      result = CheckLastError("RoadTrafficSigns", gkFuncRefGet, result);
    }
    break;
  }
  return result;
}

int SetRoadTrafficSignsPositionOffsetLLParams(LONG packetHandle, struct RoadTrafficSignsPositionOffsetLL value, char oldPath[])
{
  char newPath[300];
  int result;

  result = 0;

  switch(value.choice)
  {
    case 0:
    {
      snprintf(newPath, elcount(newPath), "%s.%s", oldPath, "position_LL1");
      SetRoadTrafficSignsPosition_LL_24BParams(packetHandle, value.position_LL1, newPath);
      result = CheckLastError("RoadTrafficSigns", gkFuncRefGet, result);
    }
    break;
    case 1:
    {
      snprintf(newPath, elcount(newPath), "%s.%s", oldPath, "position_LL2");
      SetRoadTrafficSignsPosition_LL_28BParams(packetHandle, value.position_LL2, newPath);
      result = CheckLastError("RoadTrafficSigns", gkFuncRefGet, result);
    }
    break;
    case 2:
    {
      snprintf(newPath, elcount(newPath), "%s.%s", oldPath, "position_LL3");
      SetRoadTrafficSignsPosition_LL_32BParams(packetHandle, value.position_LL3, newPath);
      result = CheckLastError("RoadTrafficSigns", gkFuncRefGet, result);
    }
    break;
    case 3:
    {
      snprintf(newPath, elcount(newPath), "%s.%s", oldPath, "position_LL4");
      SetRoadTrafficSignsPosition_LL_36BParams(packetHandle, value.position_LL4, newPath);
      result = CheckLastError("RoadTrafficSigns", gkFuncRefGet, result);
    }
    break;
    case 4:
    {
      snprintf(newPath, elcount(newPath), "%s.%s", oldPath, "position_LL5");
      SetRoadTrafficSignsPosition_LL_44BParams(packetHandle, value.position_LL5, newPath);
      result = CheckLastError("RoadTrafficSigns", gkFuncRefGet, result);
    }
    break;
    case 5:
    {
      snprintf(newPath, elcount(newPath), "%s.%s", oldPath, "position_LL6");
      SetRoadTrafficSignsPosition_LL_48BParams(packetHandle, value.position_LL6, newPath);
      result = CheckLastError("RoadTrafficSigns", gkFuncRefGet, result);
    }
    break;
    case 6:
    {
      snprintf(newPath, elcount(newPath), "%s.%s", oldPath, "position_LatLon");
      SetRoadTrafficSignsPosition_LLmD_64bParams(packetHandle, value.position_LatLon, newPath);
      result = CheckLastError("RoadTrafficSigns", gkFuncRefGet, result);
    }
    break;
  }
  return result;
}

int GetRoadTrafficSignsVerticalOffsetParams(LONG packetHandle, struct RoadTrafficSignsVerticalOffset value, char oldPath[])
{
  char newPath[300];
  int result;

  result = 0;

  value.choice = C2xGetTokenInt(packetHandle, "RoadTrafficSigns", oldPath);

  switch(value.choice)
  {
    case 0:
    {
      snprintf(newPath, elcount(newPath), "%s.%s", oldPath, "offset1");
      value.offset1 = C2xGetTokenInt(packetHandle, "RoadTrafficSigns", newPath);
      result = CheckLastError("RoadTrafficSigns", gkFuncRefGet, result);
    }
    break;
    case 1:
    {
      snprintf(newPath, elcount(newPath), "%s.%s", oldPath, "offset2");
      value.offset2 = C2xGetTokenInt(packetHandle, "RoadTrafficSigns", newPath);
      result = CheckLastError("RoadTrafficSigns", gkFuncRefGet, result);
    }
    break;
    case 2:
    {
      snprintf(newPath, elcount(newPath), "%s.%s", oldPath, "offset3");
      value.offset3 = C2xGetTokenInt(packetHandle, "RoadTrafficSigns", newPath);
      result = CheckLastError("RoadTrafficSigns", gkFuncRefGet, result);
    }
    break;
    case 3:
    {
      snprintf(newPath, elcount(newPath), "%s.%s", oldPath, "offset4");
      value.offset4 = C2xGetTokenInt(packetHandle, "RoadTrafficSigns", newPath);
      result = CheckLastError("RoadTrafficSigns", gkFuncRefGet, result);
    }
    break;
    case 4:
    {
      snprintf(newPath, elcount(newPath), "%s.%s", oldPath, "offset5");
      value.offset5 = C2xGetTokenInt(packetHandle, "RoadTrafficSigns", newPath);
      result = CheckLastError("RoadTrafficSigns", gkFuncRefGet, result);
    }
    break;
    case 5:
    {
      snprintf(newPath, elcount(newPath), "%s.%s", oldPath, "offset6");
      value.offset6 = C2xGetTokenInt(packetHandle, "RoadTrafficSigns", newPath);
      result = CheckLastError("RoadTrafficSigns", gkFuncRefGet, result);
    }
    break;
    case 6:
    {
      snprintf(newPath, elcount(newPath), "%s.%s", oldPath, "elevation");
      value.elevation = C2xGetTokenInt(packetHandle, "RoadTrafficSigns", newPath);
      result = CheckLastError("RoadTrafficSigns", gkFuncRefGet, result);
    }
    break;
  }
  return result;
}

int SetRoadTrafficSignsVerticalOffsetParams(LONG packetHandle, struct RoadTrafficSignsVerticalOffset value, char oldPath[])
{
  char newPath[300];
  int result;

  result = 0;

  switch(value.choice)
  {
    case 0:
    {
      snprintf(newPath, elcount(newPath), "%s.%s", oldPath, "offset1");
      C2xSetTokenInt(packetHandle, "RoadTrafficSigns", newPath, value.offset1);
      result = CheckLastError("RoadTrafficSigns", gkFuncRefGet, result);
    }
    break;
    case 1:
    {
      snprintf(newPath, elcount(newPath), "%s.%s", oldPath, "offset2");
      C2xSetTokenInt(packetHandle, "RoadTrafficSigns", newPath, value.offset2);
      result = CheckLastError("RoadTrafficSigns", gkFuncRefGet, result);
    }
    break;
    case 2:
    {
      snprintf(newPath, elcount(newPath), "%s.%s", oldPath, "offset3");
      C2xSetTokenInt(packetHandle, "RoadTrafficSigns", newPath, value.offset3);
      result = CheckLastError("RoadTrafficSigns", gkFuncRefGet, result);
    }
    break;
    case 3:
    {
      snprintf(newPath, elcount(newPath), "%s.%s", oldPath, "offset4");
      C2xSetTokenInt(packetHandle, "RoadTrafficSigns", newPath, value.offset4);
      result = CheckLastError("RoadTrafficSigns", gkFuncRefGet, result);
    }
    break;
    case 4:
    {
      snprintf(newPath, elcount(newPath), "%s.%s", oldPath, "offset5");
      C2xSetTokenInt(packetHandle, "RoadTrafficSigns", newPath, value.offset5);
      result = CheckLastError("RoadTrafficSigns", gkFuncRefGet, result);
    }
    break;
    case 5:
    {
      snprintf(newPath, elcount(newPath), "%s.%s", oldPath, "offset6");
      C2xSetTokenInt(packetHandle, "RoadTrafficSigns", newPath, value.offset6);
      result = CheckLastError("RoadTrafficSigns", gkFuncRefGet, result);
    }
    break;
    case 6:
    {
      snprintf(newPath, elcount(newPath), "%s.%s", oldPath, "elevation");
      C2xSetTokenInt(packetHandle, "RoadTrafficSigns", newPath, value.elevation);
      result = CheckLastError("RoadTrafficSigns", gkFuncRefGet, result);
    }
    break;
  }
  return result;
}

int GetRoadTrafficSignsPositionOffsetLLVParams(LONG packetHandle, struct RoadTrafficSignsPositionOffsetLLV value, char oldPath[])
{
  char newPath[300];
  int result;

  result = 0;

  snprintf(newPath, elcount(newPath), "%s.%s", oldPath, "offsetLL");
  GetRoadTrafficSignsPositionOffsetLLParams(packetHandle, value.offsetLL, newPath);
  result = CheckLastError("RoadTrafficSigns", gkFuncRefGet, result);

  snprintf(newPath, elcount(newPath), "%s.%s", oldPath, "offsetV");
  value.offsetV.isValidFlag = C2xIsTokenAvailable(packetHandle, "RoadTrafficSigns", newPath);
  if(value.offsetV.isValidFlag==1)
  {
    GetRoadTrafficSignsVerticalOffsetParams(packetHandle, value.offsetV, newPath);
    result = CheckLastError("RoadTrafficSigns", gkFuncRefGet, result);
  }
  return result;
}

int SetRoadTrafficSignsPositionOffsetLLVParams(LONG packetHandle, struct RoadTrafficSignsPositionOffsetLLV value, char oldPath[])
{
  char newPath[300];
  int result;

  result = 0;

  snprintf(newPath, elcount(newPath), "%s.%s", oldPath, "offsetLL");
  SetRoadTrafficSignsPositionOffsetLLParams(packetHandle, value.offsetLL, newPath);
  result = CheckLastError("RoadTrafficSigns", gkFuncRefGet, result);

  snprintf(newPath, elcount(newPath), "%s.%s", oldPath, "offsetV");
  if(value.offsetV.isValidFlag==1)
  {
    SetRoadTrafficSignsVerticalOffsetParams(packetHandle, value.offsetV, newPath);
    result = CheckLastError("RoadTrafficSigns", gkFuncRefGet, result);
  }
  else
  {
    if( C2xIsTokenAvailable(packetHandle, "RoadTrafficSigns", newPath) )
    {
      C2xRemoveToken(packetHandle, "RoadTrafficSigns", newPath);
    }
  }

  return result;
}

int GetRoadTrafficSignsPathPointListParams(LONG packetHandle, struct RoadTrafficSignsPathPointList value, char oldPath[])
{
  char newPath[300]; 
  int i;
  int result;

  result = 0;

  value.length = C2xGetTokenInt(packetHandle, "RoadTrafficSigns", oldPath);
  if((result = CheckLastError("RoadTrafficSigns", gkFuncRefGet, result))==0)
  {
    for(i=0; i<value.length; i++)
    {
      snprintf(newPath, elcount(newPath), "%s[%d]", oldPath, i);
      GetRoadTrafficSignsPositionOffsetLLVParams(packetHandle, value.arrayValue[i], newPath);
      result = CheckLastError("RoadTrafficSigns", gkFuncRefGet, result);
    }
  }
  return result;
}

int SetRoadTrafficSignsPathPointListParams(LONG packetHandle, struct RoadTrafficSignsPathPointList value, char oldPath[])
{
  char newPath[300]; 
  int i;
  int result;

  result = 0;

  C2xRemoveToken(packetHandle, "RoadTrafficSigns", oldPath);
  for(i=0; i<value.length; i++)
  {
    snprintf(newPath, elcount(newPath), "%s[%d]", oldPath, i);
    SetRoadTrafficSignsPositionOffsetLLVParams(packetHandle, value.arrayValue[i], newPath);
    result = CheckLastError("RoadTrafficSigns", gkFuncRefGet, result);
  }
  return result;
}

int GetRoadTrafficSignsNodeReferenceIDParams(LONG packetHandle, struct RoadTrafficSignsNodeReferenceID value, char oldPath[])
{
  char newPath[300];
  int result;

  result = 0;

  snprintf(newPath, elcount(newPath), "%s.%s", oldPath, "region");
  value.region.isValidFlag = C2xIsTokenAvailable(packetHandle, "RoadTrafficSigns", newPath);
  if(value.region.isValidFlag==1)
  {
    value.region.value = C2xGetTokenInt(packetHandle, "RoadTrafficSigns", newPath);
    result = CheckLastError("RoadTrafficSigns", gkFuncRefGet, result);
  }
  snprintf(newPath, elcount(newPath), "%s.%s", oldPath, "id");
  value.id = C2xGetTokenInt(packetHandle, "RoadTrafficSigns", newPath);
  result = CheckLastError("RoadTrafficSigns", gkFuncRefGet, result);

  return result;
}

int SetRoadTrafficSignsNodeReferenceIDParams(LONG packetHandle, struct RoadTrafficSignsNodeReferenceID value, char oldPath[])
{
  char newPath[300];
  int result;

  result = 0;

  snprintf(newPath, elcount(newPath), "%s.%s", oldPath, "region");
  if(value.region.isValidFlag==1)
  {
    C2xSetTokenInt(packetHandle, "RoadTrafficSigns", newPath, value.region.value);
    result = CheckLastError("RoadTrafficSigns", gkFuncRefGet, result);
  }
  else
  {
    if( C2xIsTokenAvailable(packetHandle, "RoadTrafficSigns", newPath) )
    {
      C2xRemoveToken(packetHandle, "RoadTrafficSigns", newPath);
    }
  }

  snprintf(newPath, elcount(newPath), "%s.%s", oldPath, "id");
  C2xSetTokenInt(packetHandle, "RoadTrafficSigns", newPath, value.id);
  result = CheckLastError("RoadTrafficSigns", gkFuncRefGet, result);

  return result;
}

int GetRoadTrafficSignsReferenceLinkParams(LONG packetHandle, struct RoadTrafficSignsReferenceLink value, char oldPath[])
{
  char newPath[300]; 
  int j; 
  int k;
  int result;

  result = 0;

  snprintf(newPath, elcount(newPath), "%s.%s", oldPath, "upstreamNodeId");
  GetRoadTrafficSignsNodeReferenceIDParams(packetHandle, value.upstreamNodeId, newPath);
  result = CheckLastError("RoadTrafficSigns", gkFuncRefGet, result);

  snprintf(newPath, elcount(newPath), "%s.%s", oldPath, "downstreamNodeId");
  GetRoadTrafficSignsNodeReferenceIDParams(packetHandle, value.downstreamNodeId, newPath);
  result = CheckLastError("RoadTrafficSigns", gkFuncRefGet, result);

  snprintf(newPath, elcount(newPath), "%s.%s", oldPath, "referenceLanes");
  value.referenceLanes.isValidFlag = C2xIsTokenAvailable(packetHandle, "RoadTrafficSigns", newPath);
  if(value.referenceLanes.isValidFlag==1)
  {
    value.referenceLanes.isValidFlag = 1;
    value.referenceLanes.stringLength = C2xGetTokenLengthBit(packetHandle, "RoadTrafficSigns", newPath);
    if ((result = CheckLastError("RoadTrafficSigns", gkFuncRefGet, result))==0)
    {
      if(value.referenceLanes.stringLength > 0)
      {
        for(j=0; j<value.referenceLanes.stringLength; j++)
        {
          if(C2xGetTokenBitOfBitString(packetHandle, "RoadTrafficSigns", newPath, j) == 0)
          {
            value.referenceLanes.string[j] = '0';
          }
          else if(C2xGetTokenBitOfBitString(packetHandle, "RoadTrafficSigns", newPath, j) == 1)
          {
            value.referenceLanes.string[j] = '1';
          }

          if(value.referenceLanes.stringLength == 1)
          {
            value.referenceLanes.string[1] = '0';
          }
          result = CheckLastError("RoadTrafficSigns", gkFuncRefGet, result);
        }
      }
      else
      {
        for(k = value.referenceLanes.stringLength+1; k > -1; k--)
        {
          if(value.referenceLanes.string[k] == '1')
          {
            value.referenceLanes.string[k] = '0';
          }
        }
      }
    }

  }
  return result;
}

int SetRoadTrafficSignsReferenceLinkParams(LONG packetHandle, struct RoadTrafficSignsReferenceLink value, char oldPath[])
{
  char newPath[300]; 
  int j;
  int result;

  result = 0;

  snprintf(newPath, elcount(newPath), "%s.%s", oldPath, "upstreamNodeId");
  SetRoadTrafficSignsNodeReferenceIDParams(packetHandle, value.upstreamNodeId, newPath);
  result = CheckLastError("RoadTrafficSigns", gkFuncRefGet, result);

  snprintf(newPath, elcount(newPath), "%s.%s", oldPath, "downstreamNodeId");
  SetRoadTrafficSignsNodeReferenceIDParams(packetHandle, value.downstreamNodeId, newPath);
  result = CheckLastError("RoadTrafficSigns", gkFuncRefGet, result);

  snprintf(newPath, elcount(newPath), "%s.%s", oldPath, "referenceLanes");
  if(value.referenceLanes.isValidFlag==1)
  {
      for(j=0; j<value.referenceLanes.stringLength; j++)
      {
        if(value.referenceLanes.string[j] == '0')
        {
          C2xSetTokenBitOfBitString(packetHandle, "RoadTrafficSigns", newPath, j, 0);
        }
        else
        {
          C2xSetTokenBitOfBitString(packetHandle, "RoadTrafficSigns", newPath, j, 1);
        }
        result = CheckLastError("RoadTrafficSigns", gkFuncRefGet, result);
      }
  }
  else
  {
    if( C2xIsTokenAvailable(packetHandle, "RoadTrafficSigns", newPath) )
    {
      C2xRemoveToken(packetHandle, "RoadTrafficSigns", newPath);
    }
  }

  return result;
}

int GetRoadTrafficSignsReferenceLinkListParams(LONG packetHandle, struct RoadTrafficSignsReferenceLinkList value, char oldPath[])
{
  char newPath[300]; 
  int i;
  int result;

  result = 0;

  value.length = C2xGetTokenInt(packetHandle, "RoadTrafficSigns", oldPath);
  if((result = CheckLastError("RoadTrafficSigns", gkFuncRefGet, result))==0)
  {
    for(i=0; i<value.length; i++)
    {
      snprintf(newPath, elcount(newPath), "%s[%d]", oldPath, i);
      GetRoadTrafficSignsReferenceLinkParams(packetHandle, value.arrayValue[i], newPath);
      result = CheckLastError("RoadTrafficSigns", gkFuncRefGet, result);
    }
  }
  return result;
}

int SetRoadTrafficSignsReferenceLinkListParams(LONG packetHandle, struct RoadTrafficSignsReferenceLinkList value, char oldPath[])
{
  char newPath[300]; 
  int i;
  int result;

  result = 0;

  C2xRemoveToken(packetHandle, "RoadTrafficSigns", oldPath);
  for(i=0; i<value.length; i++)
  {
    snprintf(newPath, elcount(newPath), "%s[%d]", oldPath, i);
    SetRoadTrafficSignsReferenceLinkParams(packetHandle, value.arrayValue[i], newPath);
    result = CheckLastError("RoadTrafficSigns", gkFuncRefGet, result);
  }
  return result;
}

int GetRoadTrafficSignsRTSDataParams(LONG packetHandle, struct RoadTrafficSignsRTSData value, char oldPath[])
{
  char newPath[300];
  int result;

  result = 0;

  snprintf(newPath, elcount(newPath), "%s.%s", oldPath, "rtsId");
  value.rtsId = C2xGetTokenInt(packetHandle, "RoadTrafficSigns", newPath);
  result = CheckLastError("RoadTrafficSigns", gkFuncRefGet, result);

  snprintf(newPath, elcount(newPath), "%s.%s", oldPath, "signType");
  value.signType = C2xGetTokenInt(packetHandle, "RoadTrafficSigns", newPath);
  result = CheckLastError("RoadTrafficSigns", gkFuncRefGet, result);

  snprintf(newPath, elcount(newPath), "%s.%s", oldPath, "signPos");
  value.signPos.isValidFlag = C2xIsTokenAvailable(packetHandle, "RoadTrafficSigns", newPath);
  if(value.signPos.isValidFlag==1)
  {
    GetRoadTrafficSignsPositionOffsetLLVParams(packetHandle, value.signPos, newPath);
    result = CheckLastError("RoadTrafficSigns", gkFuncRefGet, result);
  }
  snprintf(newPath, elcount(newPath), "%s.%s", oldPath, "description");
  value.description.isValidFlag = C2xIsTokenAvailable(packetHandle, "RoadTrafficSigns", newPath);
  if(value.description.isValidFlag==1)
  {
    value.description.stringLength = C2xGetTokenData(packetHandle, "RoadTrafficSigns", newPath, elcount(value.description.string), value.description.string);
    result = CheckLastError("RoadTrafficSigns", gkFuncRefGet, result);
  }
  snprintf(newPath, elcount(newPath), "%s.%s", oldPath, "priority");
  value.priority.isValidFlag = C2xIsTokenAvailable(packetHandle, "RoadTrafficSigns", newPath);
  if(value.priority.isValidFlag==1)
  {
    value.priority.isValidFlag = 1;
    value.priority.stringLength = C2xGetTokenData(packetHandle, "RoadTrafficSigns", newPath, elcount(value.priority.string), value.priority.string);
  }
  snprintf(newPath, elcount(newPath), "%s.%s", oldPath, "activePath");
  GetRoadTrafficSignsPathPointListParams(packetHandle, value.activePath, newPath);
  result = CheckLastError("RoadTrafficSigns", gkFuncRefGet, result);

  snprintf(newPath, elcount(newPath), "%s.%s", oldPath, "radius");
  value.radius = C2xGetTokenInt(packetHandle, "RoadTrafficSigns", newPath);
  result = CheckLastError("RoadTrafficSigns", gkFuncRefGet, result);

  snprintf(newPath, elcount(newPath), "%s.%s", oldPath, "referenceLinks");
  value.referenceLinks.isValidFlag = C2xIsTokenAvailable(packetHandle, "RoadTrafficSigns", newPath);
  if(value.referenceLinks.isValidFlag==1)
  {
    GetRoadTrafficSignsReferenceLinkListParams(packetHandle, value.referenceLinks, newPath);
    result = CheckLastError("RoadTrafficSigns", gkFuncRefGet, result);
  }
  return result;
}

int SetRoadTrafficSignsRTSDataParams(LONG packetHandle, struct RoadTrafficSignsRTSData value, char oldPath[])
{
  char newPath[300];
  int result;

  result = 0;

  snprintf(newPath, elcount(newPath), "%s.%s", oldPath, "rtsId");
  C2xSetTokenInt(packetHandle, "RoadTrafficSigns", newPath, value.rtsId);
  result = CheckLastError("RoadTrafficSigns", gkFuncRefGet, result);

  snprintf(newPath, elcount(newPath), "%s.%s", oldPath, "signType");
  C2xSetTokenInt(packetHandle, "RoadTrafficSigns", newPath, value.signType);
  result = CheckLastError("RoadTrafficSigns", gkFuncRefGet, result);

  snprintf(newPath, elcount(newPath), "%s.%s", oldPath, "signPos");
  if(value.signPos.isValidFlag==1)
  {
    SetRoadTrafficSignsPositionOffsetLLVParams(packetHandle, value.signPos, newPath);
    result = CheckLastError("RoadTrafficSigns", gkFuncRefGet, result);
  }
  else
  {
    if( C2xIsTokenAvailable(packetHandle, "RoadTrafficSigns", newPath) )
    {
      C2xRemoveToken(packetHandle, "RoadTrafficSigns", newPath);
    }
  }

  snprintf(newPath, elcount(newPath), "%s.%s", oldPath, "description");
  if(value.description.isValidFlag==1)
  {
    C2xSetTokenData(packetHandle, "RoadTrafficSigns", newPath, value.description.stringLength, value.description.string);
    result = CheckLastError("RoadTrafficSigns", gkFuncRefGet, result);
  }
  else
  {
    if( C2xIsTokenAvailable(packetHandle, "RoadTrafficSigns", newPath) )
    {
      C2xRemoveToken(packetHandle, "RoadTrafficSigns", newPath);
    }
  }

  snprintf(newPath, elcount(newPath), "%s.%s", oldPath, "priority");
  if(value.priority.isValidFlag==1)
  {
    C2xSetTokenData(packetHandle, "RoadTrafficSigns", newPath, value.priority.stringLength, value.priority.string);
  }
  else
  {
    if( C2xIsTokenAvailable(packetHandle, "RoadTrafficSigns", newPath) )
    {
      C2xRemoveToken(packetHandle, "RoadTrafficSigns", newPath);
    }
  }

  snprintf(newPath, elcount(newPath), "%s.%s", oldPath, "activePath");
  SetRoadTrafficSignsPathPointListParams(packetHandle, value.activePath, newPath);
  result = CheckLastError("RoadTrafficSigns", gkFuncRefGet, result);

  snprintf(newPath, elcount(newPath), "%s.%s", oldPath, "radius");
  C2xSetTokenInt(packetHandle, "RoadTrafficSigns", newPath, value.radius);
  result = CheckLastError("RoadTrafficSigns", gkFuncRefGet, result);

  snprintf(newPath, elcount(newPath), "%s.%s", oldPath, "referenceLinks");
  if(value.referenceLinks.isValidFlag==1)
  {
    SetRoadTrafficSignsReferenceLinkListParams(packetHandle, value.referenceLinks, newPath);
    result = CheckLastError("RoadTrafficSigns", gkFuncRefGet, result);
  }
  else
  {
    if( C2xIsTokenAvailable(packetHandle, "RoadTrafficSigns", newPath) )
    {
      C2xRemoveToken(packetHandle, "RoadTrafficSigns", newPath);
    }
  }

  return result;
}

int GetRoadTrafficSignsRTSListParams(LONG packetHandle, struct RoadTrafficSignsRTSList value, char oldPath[])
{
  char newPath[300]; 
  int i;
  int result;

  result = 0;

  value.length = C2xGetTokenInt(packetHandle, "RoadTrafficSigns", oldPath);
  if((result = CheckLastError("RoadTrafficSigns", gkFuncRefGet, result))==0)
  {
    for(i=0; i<value.length; i++)
    {
      snprintf(newPath, elcount(newPath), "%s[%d]", oldPath, i);
      GetRoadTrafficSignsRTSDataParams(packetHandle, value.arrayValue[i], newPath);
      result = CheckLastError("RoadTrafficSigns", gkFuncRefGet, result);
    }
  }
  return result;
}

int SetRoadTrafficSignsRTSListParams(LONG packetHandle, struct RoadTrafficSignsRTSList value, char oldPath[])
{
  char newPath[300]; 
  int i;
  int result;

  result = 0;

  C2xRemoveToken(packetHandle, "RoadTrafficSigns", oldPath);
  for(i=0; i<value.length; i++)
  {
    snprintf(newPath, elcount(newPath), "%s[%d]", oldPath, i);
    SetRoadTrafficSignsRTSDataParams(packetHandle, value.arrayValue[i], newPath);
    result = CheckLastError("RoadTrafficSigns", gkFuncRefGet, result);
  }
  return result;
}

int GetRoadTrafficSignsRTSFrameParams(LONG packetHandle, struct RoadTrafficSignsRTSFrame value, char oldPath[])
{
  char newPath[300];
  int result;

  result = 0;

  snprintf(newPath, elcount(newPath), "%s.%s", oldPath, "msgCnt");
  value.msgCnt = C2xGetTokenInt(packetHandle, "RoadTrafficSigns", newPath);
  result = CheckLastError("RoadTrafficSigns", gkFuncRefGet, result);

  snprintf(newPath, elcount(newPath), "%s.%s", oldPath, "timeStamp");
  value.timeStamp.isValidFlag = C2xIsTokenAvailable(packetHandle, "RoadTrafficSigns", newPath);
  if(value.timeStamp.isValidFlag==1)
  {
    value.timeStamp.value = C2xGetTokenInt(packetHandle, "RoadTrafficSigns", newPath);
    result = CheckLastError("RoadTrafficSigns", gkFuncRefGet, result);
  }
  snprintf(newPath, elcount(newPath), "%s.%s", oldPath, "id");
  value.id.stringLength = C2xGetTokenData(packetHandle, "RoadTrafficSigns", newPath, elcount(value.id.string), value.id.string);
  snprintf(newPath, elcount(newPath), "%s.%s", oldPath, "refPos");
  GetRoadTrafficSignsPosition3DParams(packetHandle, value.refPos, newPath);
  result = CheckLastError("RoadTrafficSigns", gkFuncRefGet, result);

  snprintf(newPath, elcount(newPath), "%s.%s", oldPath, "rtss");
  GetRoadTrafficSignsRTSListParams(packetHandle, value.rtss, newPath);
  result = CheckLastError("RoadTrafficSigns", gkFuncRefGet, result);

  return result;
}

int SetRoadTrafficSignsRTSFrameParams(LONG packetHandle, struct RoadTrafficSignsRTSFrame value, char oldPath[])
{
  char newPath[300];
  int result;

  result = 0;

  snprintf(newPath, elcount(newPath), "%s.%s", oldPath, "msgCnt");
  C2xSetTokenInt(packetHandle, "RoadTrafficSigns", newPath, value.msgCnt);
  result = CheckLastError("RoadTrafficSigns", gkFuncRefGet, result);

  snprintf(newPath, elcount(newPath), "%s.%s", oldPath, "timeStamp");
  if(value.timeStamp.isValidFlag==1)
  {
    C2xSetTokenInt(packetHandle, "RoadTrafficSigns", newPath, value.timeStamp.value);
    result = CheckLastError("RoadTrafficSigns", gkFuncRefGet, result);
  }
  else
  {
    if( C2xIsTokenAvailable(packetHandle, "RoadTrafficSigns", newPath) )
    {
      C2xRemoveToken(packetHandle, "RoadTrafficSigns", newPath);
    }
  }

  if(value.id.stringLength == 0)
  {
    value.id.stringLength = 8;
    memcpy(value.id.string, "00000000", value.id.stringLength);
  }

  snprintf(newPath, elcount(newPath), "%s.%s", oldPath, "id");
  C2xSetTokenData(packetHandle, "RoadTrafficSigns", newPath, value.id.stringLength, value.id.string);

  snprintf(newPath, elcount(newPath), "%s.%s", oldPath, "refPos");
  SetRoadTrafficSignsPosition3DParams(packetHandle, value.refPos, newPath);
  result = CheckLastError("RoadTrafficSigns", gkFuncRefGet, result);

  snprintf(newPath, elcount(newPath), "%s.%s", oldPath, "rtss");
  SetRoadTrafficSignsRTSListParams(packetHandle, value.rtss, newPath);
  result = CheckLastError("RoadTrafficSigns", gkFuncRefGet, result);

  return result;
}

int API_GetRoadTrafficSignsParams(LONG packetHandle, struct RoadTrafficSigns value)
{
  int result;
  result = 0;

  value.frameType = C2xGetTokenInt(packetHandle, "RoadTrafficSigns", "frameType");
  result = CheckLastError("RoadTrafficSigns", gkFuncRefGet, result);

  value.rtsFrame.isValidFlag = 1;
  GetRoadTrafficSignsRTSFrameParams(packetHandle, value.rtsFrame, "rtsFrame");
  result = CheckLastError("RoadTrafficSigns", gkFuncRefGet, result);

  return result;
}

int API_SetRoadTrafficSignsParams(LONG packetHandle, struct RoadTrafficSigns value)
{
  int result;
  result = 0;

  C2xSetTokenInt(packetHandle, "RoadTrafficSigns", "frameType", value.frameType);
  result = CheckLastError("RoadTrafficSigns", gkFuncRefGet, result);

  SetRoadTrafficSignsRTSFrameParams(packetHandle, value.rtsFrame, "rtsFrame");
  result = CheckLastError("RoadTrafficSigns", gkFuncRefGet, result);

  return result;
}

