/*@!Encoding:1252*/
/*
//  (c) Vector Informatik GmbH. All rights reserved.
//
//  This file contains definitions of structs and methods that may be used
//  to set and get the values of an ASN.1 defined packet's payload.
//
//  //This example demonstrates how to set a packet's payload:
//  LONG packetHandle;
//  struct SPAT payload;
//  //you need to set the values of the variable "payload" yourself
//  packetHandle = API_InitSPATPacket();
//  if (packetHandle!=0) {
//    if (API_SetSPATParams(packetHandle, payload)==0) {
//      if (C2xCompletePacket(packetHandle)==0) {
//        C2xOutputPacket(packetHandle);
//      }
//    }
//  }
//                                                                             */
includes
{
  //#include "ASNV_Template_BaseDatatypes.cin"  // If warning "Duplicate #include, ignoring this include" appears, please remove the ASNV_Template_BaseDatatypes.cin include from your other *.cin files in the project.
}
variables
{
    struct SPATDescriptiveName {
        INT isValidFlag;   // necessary if this struct is used as an optional field of a SEQUENCE
        CHAR string[64];
        INT  stringLength;
    };
    
    struct SPATNodeReferenceID {
        INT isValidFlag;   // necessary if this struct is used as an optional field of a SEQUENCE
        struct OPT_WORD_ASN region;  // INTEGER, OPTIONAL, 0..65535;
        WORD id;  // INTEGER, 0..65535;
    };
    
    struct SPATIntersectionStatusObject {
        INT isValidFlag;   // necessary if this struct is used as an optional field of a SEQUENCE
        CHAR string[17];
        INT  stringLength;
    };
    
    struct SPATTimeChangeDetails {
        INT isValidFlag;   // necessary if this struct is used as an optional field of a SEQUENCE
        WORD startTime;  // INTEGER, 0..36001;
        struct OPT_WORD_ASN minEndTime;  // INTEGER, OPTIONAL, 0..36001;
        struct OPT_WORD_ASN maxEndTime;  // INTEGER, OPTIONAL, 0..36001;
        WORD likelyEndTime;  // INTEGER, 0..36001;
        struct OPT_BYTE_ASN timeConfidence;  // INTEGER, OPTIONAL, 0..200;
        struct OPT_WORD_ASN nextStartTime;  // INTEGER, OPTIONAL, 0..36001;
        struct OPT_WORD_ASN nextDuration;  // INTEGER, OPTIONAL, 0..36001;
    };
    
    struct SPATPhaseState {
        INT isValidFlag;   // necessary if this struct is used as an optional field of a SEQUENCE
        INT light;  // ENUMERATED, unavailable(0), dark(1), stop_Then_Proceed(2), stop_And_Remain(3), pre_Movement(4), permissive_Movement_Allowed(5), protected_Movement_Allowed(6), intersection_clearance(7), caution_Conflicting_Traffic(8);
        struct SPATTimeChangeDetails timing;  // SEQUENCE, OPTIONAL;
    };
    
    struct SPATPhaseStateList {
        INT isValidFlag;   // necessary if this struct is used as an optional field of a SEQUENCE
        INT length;
        struct SPATPhaseState arrayValue[16];  // SEQUENCE;
    };
    
    struct SPATPhase {
        INT isValidFlag;   // necessary if this struct is used as an optional field of a SEQUENCE
        BYTE id;  // INTEGER, 0..255;
        struct SPATPhaseStateList phaseStates;  // SEQUENCEOF;
    };
    
    struct SPATPhaseList {
        INT isValidFlag;   // necessary if this struct is used as an optional field of a SEQUENCE
        INT length;
        struct SPATPhase arrayValue[16];  // SEQUENCE;
    };
    
    struct SPATIntersectionState {
        INT isValidFlag;   // necessary if this struct is used as an optional field of a SEQUENCE
        struct SPATNodeReferenceID intersectionId;  // SEQUENCE;
        struct SPATIntersectionStatusObject status;  // BITSTRING;
        struct OPT_DWORD_ASN moy;  // INTEGER, OPTIONAL, 0..527040;
        struct OPT_WORD_ASN timeStamp;  // INTEGER, OPTIONAL, 0..65535;
        struct SPATPhaseList phases;  // SEQUENCEOF;
    };
    
    struct SPATIntersectionStateList {
        INT isValidFlag;   // necessary if this struct is used as an optional field of a SEQUENCE
        INT length;
        struct SPATIntersectionState arrayValue[32];  // SEQUENCE;
    };
    
    struct SPATSigPhaseTimeFrame {
        INT isValidFlag;   // necessary if this struct is used as an optional field of a SEQUENCE
        BYTE msgCnt;  // INTEGER, 0..127;
        struct OPT_DWORD_ASN timeStamp;  // INTEGER, OPTIONAL, 0..527040;
        struct SPATDescriptiveName name;  // IA5STRING, OPTIONAL;
        struct SPATIntersectionStateList intersections;  // SEQUENCEOF;
    };
    
    struct SPAT {
        INT isValidFlag;   // necessary if this struct is used as an optional field of a SEQUENCE
        BYTE frameType;  // INTEGER, 0..15, spatFrame(3);
        struct SPATSigPhaseTimeFrame spatFrame;  // SEQUENCE;
    };
    
}

/*
// init function to create a simple packet handle
*/ 
LONG API_InitSPATPacket()
{
  return C2xInitPacket("SPAT"); 
}

/*
// init function to create a simple packet handle and
// initialize the struct with valid data
*/ 
LONG API_InitSPATPacket(struct SPAT msgStruct)
{
  long pktHandle;

  pktHandle = API_InitSPATPacket();

  if (pktHandle != 0)
  {
    // create valid message and application data
    if (C2xCompletePacket(pktHandle) == 0) 
    {
      API_GetSPATParams(pktHandle, msgStruct);
    }
  }
  return pktHandle;
}

/*
// init function to create a packet with security layer and
// initialize the struct with valid data
*/ 
LONG API_InitSPATPacket(struct SPAT msgStruct, char packetTypeDesignator[], char certificateName[])
{
  long pktHandle, certHdl;

  // initialize the packet
  pktHandle = C2xInitPacket("SPAT", packetTypeDesignator);

  if (pktHandle != 0)
  {
    certHdl = C2xSecCertificateGetHandle(certificateName);  // get the certificate handle for the cert with name "certificateName"
    if (certHdl != 0) 
    {
      C2xSecPacketSetSignerHandle(pktHandle, certHdl); // set the certHdl to the packet
    }

    // create valid message and application data
    if (C2xCompletePacket(pktHandle) == 0) 
    {
      // copy application data to the application structure
      API_GetSPATParams(pktHandle, msgStruct);
    }
  }
  return pktHandle;
}
    

int GetSPATNodeReferenceIDParams(LONG packetHandle, struct SPATNodeReferenceID value, char oldPath[])
{
  char newPath[300];
  int result;

  result = 0;

  snprintf(newPath, elcount(newPath), "%s.%s", oldPath, "region");
  value.region.isValidFlag = C2xIsTokenAvailable(packetHandle, "SPAT", newPath);
  if(value.region.isValidFlag==1)
  {
    value.region.value = C2xGetTokenInt(packetHandle, "SPAT", newPath);
    result = CheckLastError("SPAT", gkFuncRefGet, result);
  }
  snprintf(newPath, elcount(newPath), "%s.%s", oldPath, "id");
  value.id = C2xGetTokenInt(packetHandle, "SPAT", newPath);
  result = CheckLastError("SPAT", gkFuncRefGet, result);

  return result;
}

int SetSPATNodeReferenceIDParams(LONG packetHandle, struct SPATNodeReferenceID value, char oldPath[])
{
  char newPath[300];
  int result;

  result = 0;

  snprintf(newPath, elcount(newPath), "%s.%s", oldPath, "region");
  if(value.region.isValidFlag==1)
  {
    C2xSetTokenInt(packetHandle, "SPAT", newPath, value.region.value);
    result = CheckLastError("SPAT", gkFuncRefGet, result);
  }
  else
  {
    if( C2xIsTokenAvailable(packetHandle, "SPAT", newPath) )
    {
      C2xRemoveToken(packetHandle, "SPAT", newPath);
    }
  }

  snprintf(newPath, elcount(newPath), "%s.%s", oldPath, "id");
  C2xSetTokenInt(packetHandle, "SPAT", newPath, value.id);
  result = CheckLastError("SPAT", gkFuncRefGet, result);

  return result;
}

int GetSPATTimeChangeDetailsParams(LONG packetHandle, struct SPATTimeChangeDetails value, char oldPath[])
{
  char newPath[300];
  int result;

  result = 0;

  snprintf(newPath, elcount(newPath), "%s.%s", oldPath, "startTime");
  value.startTime = C2xGetTokenInt(packetHandle, "SPAT", newPath);
  result = CheckLastError("SPAT", gkFuncRefGet, result);

  snprintf(newPath, elcount(newPath), "%s.%s", oldPath, "minEndTime");
  value.minEndTime.isValidFlag = C2xIsTokenAvailable(packetHandle, "SPAT", newPath);
  if(value.minEndTime.isValidFlag==1)
  {
    value.minEndTime.value = C2xGetTokenInt(packetHandle, "SPAT", newPath);
    result = CheckLastError("SPAT", gkFuncRefGet, result);
  }
  snprintf(newPath, elcount(newPath), "%s.%s", oldPath, "maxEndTime");
  value.maxEndTime.isValidFlag = C2xIsTokenAvailable(packetHandle, "SPAT", newPath);
  if(value.maxEndTime.isValidFlag==1)
  {
    value.maxEndTime.value = C2xGetTokenInt(packetHandle, "SPAT", newPath);
    result = CheckLastError("SPAT", gkFuncRefGet, result);
  }
  snprintf(newPath, elcount(newPath), "%s.%s", oldPath, "likelyEndTime");
  value.likelyEndTime = C2xGetTokenInt(packetHandle, "SPAT", newPath);
  result = CheckLastError("SPAT", gkFuncRefGet, result);

  snprintf(newPath, elcount(newPath), "%s.%s", oldPath, "timeConfidence");
  value.timeConfidence.isValidFlag = C2xIsTokenAvailable(packetHandle, "SPAT", newPath);
  if(value.timeConfidence.isValidFlag==1)
  {
    value.timeConfidence.value = C2xGetTokenInt(packetHandle, "SPAT", newPath);
    result = CheckLastError("SPAT", gkFuncRefGet, result);
  }
  snprintf(newPath, elcount(newPath), "%s.%s", oldPath, "nextStartTime");
  value.nextStartTime.isValidFlag = C2xIsTokenAvailable(packetHandle, "SPAT", newPath);
  if(value.nextStartTime.isValidFlag==1)
  {
    value.nextStartTime.value = C2xGetTokenInt(packetHandle, "SPAT", newPath);
    result = CheckLastError("SPAT", gkFuncRefGet, result);
  }
  snprintf(newPath, elcount(newPath), "%s.%s", oldPath, "nextDuration");
  value.nextDuration.isValidFlag = C2xIsTokenAvailable(packetHandle, "SPAT", newPath);
  if(value.nextDuration.isValidFlag==1)
  {
    value.nextDuration.value = C2xGetTokenInt(packetHandle, "SPAT", newPath);
    result = CheckLastError("SPAT", gkFuncRefGet, result);
  }
  return result;
}

int SetSPATTimeChangeDetailsParams(LONG packetHandle, struct SPATTimeChangeDetails value, char oldPath[])
{
  char newPath[300];
  int result;

  result = 0;

  snprintf(newPath, elcount(newPath), "%s.%s", oldPath, "startTime");
  C2xSetTokenInt(packetHandle, "SPAT", newPath, value.startTime);
  result = CheckLastError("SPAT", gkFuncRefGet, result);

  snprintf(newPath, elcount(newPath), "%s.%s", oldPath, "minEndTime");
  if(value.minEndTime.isValidFlag==1)
  {
    C2xSetTokenInt(packetHandle, "SPAT", newPath, value.minEndTime.value);
    result = CheckLastError("SPAT", gkFuncRefGet, result);
  }
  else
  {
    if( C2xIsTokenAvailable(packetHandle, "SPAT", newPath) )
    {
      C2xRemoveToken(packetHandle, "SPAT", newPath);
    }
  }

  snprintf(newPath, elcount(newPath), "%s.%s", oldPath, "maxEndTime");
  if(value.maxEndTime.isValidFlag==1)
  {
    C2xSetTokenInt(packetHandle, "SPAT", newPath, value.maxEndTime.value);
    result = CheckLastError("SPAT", gkFuncRefGet, result);
  }
  else
  {
    if( C2xIsTokenAvailable(packetHandle, "SPAT", newPath) )
    {
      C2xRemoveToken(packetHandle, "SPAT", newPath);
    }
  }

  snprintf(newPath, elcount(newPath), "%s.%s", oldPath, "likelyEndTime");
  C2xSetTokenInt(packetHandle, "SPAT", newPath, value.likelyEndTime);
  result = CheckLastError("SPAT", gkFuncRefGet, result);

  snprintf(newPath, elcount(newPath), "%s.%s", oldPath, "timeConfidence");
  if(value.timeConfidence.isValidFlag==1)
  {
    C2xSetTokenInt(packetHandle, "SPAT", newPath, value.timeConfidence.value);
    result = CheckLastError("SPAT", gkFuncRefGet, result);
  }
  else
  {
    if( C2xIsTokenAvailable(packetHandle, "SPAT", newPath) )
    {
      C2xRemoveToken(packetHandle, "SPAT", newPath);
    }
  }

  snprintf(newPath, elcount(newPath), "%s.%s", oldPath, "nextStartTime");
  if(value.nextStartTime.isValidFlag==1)
  {
    C2xSetTokenInt(packetHandle, "SPAT", newPath, value.nextStartTime.value);
    result = CheckLastError("SPAT", gkFuncRefGet, result);
  }
  else
  {
    if( C2xIsTokenAvailable(packetHandle, "SPAT", newPath) )
    {
      C2xRemoveToken(packetHandle, "SPAT", newPath);
    }
  }

  snprintf(newPath, elcount(newPath), "%s.%s", oldPath, "nextDuration");
  if(value.nextDuration.isValidFlag==1)
  {
    C2xSetTokenInt(packetHandle, "SPAT", newPath, value.nextDuration.value);
    result = CheckLastError("SPAT", gkFuncRefGet, result);
  }
  else
  {
    if( C2xIsTokenAvailable(packetHandle, "SPAT", newPath) )
    {
      C2xRemoveToken(packetHandle, "SPAT", newPath);
    }
  }

  return result;
}

int GetSPATPhaseStateParams(LONG packetHandle, struct SPATPhaseState value, char oldPath[])
{
  char newPath[300];
  int result;

  result = 0;

  snprintf(newPath, elcount(newPath), "%s.%s", oldPath, "light");
  value.light = C2xGetTokenInt(packetHandle, "SPAT", newPath);
  result = CheckLastError("SPAT", gkFuncRefGet, result);

  snprintf(newPath, elcount(newPath), "%s.%s", oldPath, "timing");
  value.timing.isValidFlag = C2xIsTokenAvailable(packetHandle, "SPAT", newPath);
  if(value.timing.isValidFlag==1)
  {
    GetSPATTimeChangeDetailsParams(packetHandle, value.timing, newPath);
    result = CheckLastError("SPAT", gkFuncRefGet, result);
  }
  return result;
}

int SetSPATPhaseStateParams(LONG packetHandle, struct SPATPhaseState value, char oldPath[])
{
  char newPath[300];
  int result;

  result = 0;

  snprintf(newPath, elcount(newPath), "%s.%s", oldPath, "light");
  C2xSetTokenInt(packetHandle, "SPAT", newPath, value.light);
  result = CheckLastError("SPAT", gkFuncRefGet, result);

  snprintf(newPath, elcount(newPath), "%s.%s", oldPath, "timing");
  if(value.timing.isValidFlag==1)
  {
    SetSPATTimeChangeDetailsParams(packetHandle, value.timing, newPath);
    result = CheckLastError("SPAT", gkFuncRefGet, result);
  }
  else
  {
    if( C2xIsTokenAvailable(packetHandle, "SPAT", newPath) )
    {
      C2xRemoveToken(packetHandle, "SPAT", newPath);
    }
  }

  return result;
}

int GetSPATPhaseStateListParams(LONG packetHandle, struct SPATPhaseStateList value, char oldPath[])
{
  char newPath[300]; 
  int i;
  int result;

  result = 0;

  value.length = C2xGetTokenInt(packetHandle, "SPAT", oldPath);
  if((result = CheckLastError("SPAT", gkFuncRefGet, result))==0)
  {
    for(i=0; i<value.length; i++)
    {
      snprintf(newPath, elcount(newPath), "%s[%d]", oldPath, i);
      GetSPATPhaseStateParams(packetHandle, value.arrayValue[i], newPath);
      result = CheckLastError("SPAT", gkFuncRefGet, result);
    }
  }
  return result;
}

int SetSPATPhaseStateListParams(LONG packetHandle, struct SPATPhaseStateList value, char oldPath[])
{
  char newPath[300]; 
  int i;
  int result;

  result = 0;

  C2xRemoveToken(packetHandle, "SPAT", oldPath);
  for(i=0; i<value.length; i++)
  {
    snprintf(newPath, elcount(newPath), "%s[%d]", oldPath, i);
    SetSPATPhaseStateParams(packetHandle, value.arrayValue[i], newPath);
    result = CheckLastError("SPAT", gkFuncRefGet, result);
  }
  return result;
}

int GetSPATPhaseParams(LONG packetHandle, struct SPATPhase value, char oldPath[])
{
  char newPath[300];
  int result;

  result = 0;

  snprintf(newPath, elcount(newPath), "%s.%s", oldPath, "id");
  value.id = C2xGetTokenInt(packetHandle, "SPAT", newPath);
  result = CheckLastError("SPAT", gkFuncRefGet, result);

  snprintf(newPath, elcount(newPath), "%s.%s", oldPath, "phaseStates");
  GetSPATPhaseStateListParams(packetHandle, value.phaseStates, newPath);
  result = CheckLastError("SPAT", gkFuncRefGet, result);

  return result;
}

int SetSPATPhaseParams(LONG packetHandle, struct SPATPhase value, char oldPath[])
{
  char newPath[300];
  int result;

  result = 0;

  snprintf(newPath, elcount(newPath), "%s.%s", oldPath, "id");
  C2xSetTokenInt(packetHandle, "SPAT", newPath, value.id);
  result = CheckLastError("SPAT", gkFuncRefGet, result);

  snprintf(newPath, elcount(newPath), "%s.%s", oldPath, "phaseStates");
  SetSPATPhaseStateListParams(packetHandle, value.phaseStates, newPath);
  result = CheckLastError("SPAT", gkFuncRefGet, result);

  return result;
}

int GetSPATPhaseListParams(LONG packetHandle, struct SPATPhaseList value, char oldPath[])
{
  char newPath[300]; 
  int i;
  int result;

  result = 0;

  value.length = C2xGetTokenInt(packetHandle, "SPAT", oldPath);
  if((result = CheckLastError("SPAT", gkFuncRefGet, result))==0)
  {
    for(i=0; i<value.length; i++)
    {
      snprintf(newPath, elcount(newPath), "%s[%d]", oldPath, i);
      GetSPATPhaseParams(packetHandle, value.arrayValue[i], newPath);
      result = CheckLastError("SPAT", gkFuncRefGet, result);
    }
  }
  return result;
}

int SetSPATPhaseListParams(LONG packetHandle, struct SPATPhaseList value, char oldPath[])
{
  char newPath[300]; 
  int i;
  int result;

  result = 0;

  C2xRemoveToken(packetHandle, "SPAT", oldPath);
  for(i=0; i<value.length; i++)
  {
    snprintf(newPath, elcount(newPath), "%s[%d]", oldPath, i);
    SetSPATPhaseParams(packetHandle, value.arrayValue[i], newPath);
    result = CheckLastError("SPAT", gkFuncRefGet, result);
  }
  return result;
}

int GetSPATIntersectionStateParams(LONG packetHandle, struct SPATIntersectionState value, char oldPath[])
{
  char newPath[300]; 
  int j; 
  int k;
  int result;

  result = 0;

  snprintf(newPath, elcount(newPath), "%s.%s", oldPath, "intersectionId");
  GetSPATNodeReferenceIDParams(packetHandle, value.intersectionId, newPath);
  result = CheckLastError("SPAT", gkFuncRefGet, result);

  snprintf(newPath, elcount(newPath), "%s.%s", oldPath, "status");
  value.status.isValidFlag = 1;
  value.status.stringLength = C2xGetTokenLengthBit(packetHandle, "SPAT", newPath);
  if ((result = CheckLastError("SPAT", gkFuncRefGet, result))==0)
  {
    if(value.status.stringLength > 0)
    {
      for(j=0; j<value.status.stringLength; j++)
      {
        if(C2xGetTokenBitOfBitString(packetHandle, "SPAT", newPath, j) == 0)
        {
          value.status.string[j] = '0';
        }
        else if(C2xGetTokenBitOfBitString(packetHandle, "SPAT", newPath, j) == 1)
        {
          value.status.string[j] = '1';
        }

        if(value.status.stringLength == 1)
        {
          value.status.string[1] = '0';
        }
        result = CheckLastError("SPAT", gkFuncRefGet, result);
      }
    }
    else
    {
      for(k = value.status.stringLength+1; k > -1; k--)
      {
        if(value.status.string[k] == '1')
        {
          value.status.string[k] = '0';
        }
      }
    }
  }

  snprintf(newPath, elcount(newPath), "%s.%s", oldPath, "moy");
  value.moy.isValidFlag = C2xIsTokenAvailable(packetHandle, "SPAT", newPath);
  if(value.moy.isValidFlag==1)
  {
    value.moy.value = C2xGetTokenInt(packetHandle, "SPAT", newPath);
    result = CheckLastError("SPAT", gkFuncRefGet, result);
  }
  snprintf(newPath, elcount(newPath), "%s.%s", oldPath, "timeStamp");
  value.timeStamp.isValidFlag = C2xIsTokenAvailable(packetHandle, "SPAT", newPath);
  if(value.timeStamp.isValidFlag==1)
  {
    value.timeStamp.value = C2xGetTokenInt(packetHandle, "SPAT", newPath);
    result = CheckLastError("SPAT", gkFuncRefGet, result);
  }
  snprintf(newPath, elcount(newPath), "%s.%s", oldPath, "phases");
  GetSPATPhaseListParams(packetHandle, value.phases, newPath);
  result = CheckLastError("SPAT", gkFuncRefGet, result);

  return result;
}

int SetSPATIntersectionStateParams(LONG packetHandle, struct SPATIntersectionState value, char oldPath[])
{
  char newPath[300]; 
  int j;
  int result;

  result = 0;

  snprintf(newPath, elcount(newPath), "%s.%s", oldPath, "intersectionId");
  SetSPATNodeReferenceIDParams(packetHandle, value.intersectionId, newPath);
  result = CheckLastError("SPAT", gkFuncRefGet, result);

  snprintf(newPath, elcount(newPath), "%s.%s", oldPath, "status");
    for(j=0; j<value.status.stringLength; j++)
    {
      if(value.status.string[j] == '0')
      {
        C2xSetTokenBitOfBitString(packetHandle, "SPAT", newPath, j, 0);
      }
      else
      {
        C2xSetTokenBitOfBitString(packetHandle, "SPAT", newPath, j, 1);
      }
      result = CheckLastError("SPAT", gkFuncRefGet, result);
    }

  snprintf(newPath, elcount(newPath), "%s.%s", oldPath, "moy");
  if(value.moy.isValidFlag==1)
  {
    C2xSetTokenInt(packetHandle, "SPAT", newPath, value.moy.value);
    result = CheckLastError("SPAT", gkFuncRefGet, result);
  }
  else
  {
    if( C2xIsTokenAvailable(packetHandle, "SPAT", newPath) )
    {
      C2xRemoveToken(packetHandle, "SPAT", newPath);
    }
  }

  snprintf(newPath, elcount(newPath), "%s.%s", oldPath, "timeStamp");
  if(value.timeStamp.isValidFlag==1)
  {
    C2xSetTokenInt(packetHandle, "SPAT", newPath, value.timeStamp.value);
    result = CheckLastError("SPAT", gkFuncRefGet, result);
  }
  else
  {
    if( C2xIsTokenAvailable(packetHandle, "SPAT", newPath) )
    {
      C2xRemoveToken(packetHandle, "SPAT", newPath);
    }
  }

  snprintf(newPath, elcount(newPath), "%s.%s", oldPath, "phases");
  SetSPATPhaseListParams(packetHandle, value.phases, newPath);
  result = CheckLastError("SPAT", gkFuncRefGet, result);

  return result;
}

int GetSPATIntersectionStateListParams(LONG packetHandle, struct SPATIntersectionStateList value, char oldPath[])
{
  char newPath[300]; 
  int i;
  int result;

  result = 0;

  value.length = C2xGetTokenInt(packetHandle, "SPAT", oldPath);
  if((result = CheckLastError("SPAT", gkFuncRefGet, result))==0)
  {
    for(i=0; i<value.length; i++)
    {
      snprintf(newPath, elcount(newPath), "%s[%d]", oldPath, i);
      GetSPATIntersectionStateParams(packetHandle, value.arrayValue[i], newPath);
      result = CheckLastError("SPAT", gkFuncRefGet, result);
    }
  }
  return result;
}

int SetSPATIntersectionStateListParams(LONG packetHandle, struct SPATIntersectionStateList value, char oldPath[])
{
  char newPath[300]; 
  int i;
  int result;

  result = 0;

  C2xRemoveToken(packetHandle, "SPAT", oldPath);
  for(i=0; i<value.length; i++)
  {
    snprintf(newPath, elcount(newPath), "%s[%d]", oldPath, i);
    SetSPATIntersectionStateParams(packetHandle, value.arrayValue[i], newPath);
    result = CheckLastError("SPAT", gkFuncRefGet, result);
  }
  return result;
}

int GetSPATSigPhaseTimeFrameParams(LONG packetHandle, struct SPATSigPhaseTimeFrame value, char oldPath[])
{
  char newPath[300];
  int result;

  result = 0;

  snprintf(newPath, elcount(newPath), "%s.%s", oldPath, "msgCnt");
  value.msgCnt = C2xGetTokenInt(packetHandle, "SPAT", newPath);
  result = CheckLastError("SPAT", gkFuncRefGet, result);

  snprintf(newPath, elcount(newPath), "%s.%s", oldPath, "timeStamp");
  value.timeStamp.isValidFlag = C2xIsTokenAvailable(packetHandle, "SPAT", newPath);
  if(value.timeStamp.isValidFlag==1)
  {
    value.timeStamp.value = C2xGetTokenInt(packetHandle, "SPAT", newPath);
    result = CheckLastError("SPAT", gkFuncRefGet, result);
  }
  snprintf(newPath, elcount(newPath), "%s.%s", oldPath, "name");
  value.name.isValidFlag = C2xIsTokenAvailable(packetHandle, "SPAT", newPath);
  if(value.name.isValidFlag==1)
  {
    value.name.stringLength = C2xGetTokenData(packetHandle, "SPAT", newPath, elcount(value.name.string), value.name.string);
    result = CheckLastError("SPAT", gkFuncRefGet, result);
  }
  snprintf(newPath, elcount(newPath), "%s.%s", oldPath, "intersections");
  GetSPATIntersectionStateListParams(packetHandle, value.intersections, newPath);
  result = CheckLastError("SPAT", gkFuncRefGet, result);

  return result;
}

int SetSPATSigPhaseTimeFrameParams(LONG packetHandle, struct SPATSigPhaseTimeFrame value, char oldPath[])
{
  char newPath[300];
  int result;

  result = 0;

  snprintf(newPath, elcount(newPath), "%s.%s", oldPath, "msgCnt");
  C2xSetTokenInt(packetHandle, "SPAT", newPath, value.msgCnt);
  result = CheckLastError("SPAT", gkFuncRefGet, result);

  snprintf(newPath, elcount(newPath), "%s.%s", oldPath, "timeStamp");
  if(value.timeStamp.isValidFlag==1)
  {
    C2xSetTokenInt(packetHandle, "SPAT", newPath, value.timeStamp.value);
    result = CheckLastError("SPAT", gkFuncRefGet, result);
  }
  else
  {
    if( C2xIsTokenAvailable(packetHandle, "SPAT", newPath) )
    {
      C2xRemoveToken(packetHandle, "SPAT", newPath);
    }
  }

  snprintf(newPath, elcount(newPath), "%s.%s", oldPath, "name");
  if(value.name.isValidFlag==1)
  {
    C2xSetTokenData(packetHandle, "SPAT", newPath, value.name.stringLength, value.name.string);
    result = CheckLastError("SPAT", gkFuncRefGet, result);
  }
  else
  {
    if( C2xIsTokenAvailable(packetHandle, "SPAT", newPath) )
    {
      C2xRemoveToken(packetHandle, "SPAT", newPath);
    }
  }

  snprintf(newPath, elcount(newPath), "%s.%s", oldPath, "intersections");
  SetSPATIntersectionStateListParams(packetHandle, value.intersections, newPath);
  result = CheckLastError("SPAT", gkFuncRefGet, result);

  return result;
}

int API_GetSPATParams(LONG packetHandle, struct SPAT value)
{
  int result;
  result = 0;

  value.frameType = C2xGetTokenInt(packetHandle, "SPAT", "frameType");
  result = CheckLastError("SPAT", gkFuncRefGet, result);

  value.spatFrame.isValidFlag = 1;
  GetSPATSigPhaseTimeFrameParams(packetHandle, value.spatFrame, "spatFrame");
  result = CheckLastError("SPAT", gkFuncRefGet, result);

  return result;
}

int API_SetSPATParams(LONG packetHandle, struct SPAT value)
{
  int result;
  result = 0;

  C2xSetTokenInt(packetHandle, "SPAT", "frameType", value.frameType);
  result = CheckLastError("SPAT", gkFuncRefGet, result);

  SetSPATSigPhaseTimeFrameParams(packetHandle, value.spatFrame, "spatFrame");
  result = CheckLastError("SPAT", gkFuncRefGet, result);

  return result;
}

