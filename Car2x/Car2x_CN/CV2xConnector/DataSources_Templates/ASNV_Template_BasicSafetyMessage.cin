/*@!Encoding:1252*/
/*
//  (c) Vector Informatik GmbH. All rights reserved.
//
//  This file contains definitions of structs and methods that may be used
//  to set and get the values of an ASN.1 defined packet's payload.
//
//  //This example demonstrates how to set a packet's payload:
//  LONG packetHandle;
//  struct BasicSafetyMessage payload;
//  //you need to set the values of the variable "payload" yourself
//  packetHandle = API_InitBasicSafetyMessagePacket();
//  if (packetHandle!=0) {
//    if (API_SetBasicSafetyMessageParams(packetHandle, payload)==0) {
//      if (C2xCompletePacket(packetHandle)==0) {
//        C2xOutputPacket(packetHandle);
//      }
//    }
//  }
//                                                                             */
includes
{
  //#include "ASNV_Template_BaseDatatypes.cin"  // If warning "Duplicate #include, ignoring this include" appears, please remove the ASNV_Template_BaseDatatypes.cin include from your other *.cin files in the project.
}
variables
{
    struct BasicSafetyMessageBasicSafetyMessage_id {
        INT isValidFlag;   // necessary if this struct is used as an optional field of a SEQUENCE
        CHAR string[9];
        INT  stringLength;
    };
    
    struct BasicSafetyMessageBasicSafetyMessage_plateNo {
        INT isValidFlag;   // necessary if this struct is used as an optional field of a SEQUENCE
        CHAR string[17];
        INT  stringLength;
    };
    
    struct BasicSafetyMessagePosition3D {
        INT isValidFlag;   // necessary if this struct is used as an optional field of a SEQUENCE
        LONG lat;  // INTEGER, -900000000..900000001;
        LONG lon;  // INTEGER, -1799999999..1800000001;
        struct OPT_LONG_ASN elevation;  // INTEGER, OPTIONAL, -4096..61439;
    };
    
    struct BasicSafetyMessagePositionConfidenceSet {
        INT isValidFlag;   // necessary if this struct is used as an optional field of a SEQUENCE
        INT pos;  // ENUMERATED, unavailable(0), a500m(1), a200m(2), a100m(3), a50m(4), a20m(5), a10m(6), a5m(7), a2m(8), a1m(9), a50cm(10), a20cm(11), a10cm(12), a5cm(13), a2cm(14), a1cm(15);
        struct OPT_ENUM_ASN elevation;  // ENUMERATED, OPTIONAL, unavailable(0), elev_500_00(1), elev_200_00(2), elev_100_00(3), elev_050_00(4), elev_020_00(5), elev_010_00(6), elev_005_00(7), elev_002_00(8), elev_001_00(9), elev_000_50(10), elev_000_20(11), elev_000_10(12), elev_000_05(13), elev_000_02(14), elev_000_01(15);
    };
    
    struct BasicSafetyMessageMotionConfidenceSet {
        INT isValidFlag;   // necessary if this struct is used as an optional field of a SEQUENCE
        struct OPT_ENUM_ASN speedCfd;  // ENUMERATED, OPTIONAL, unavailable(0), prec100ms(1), prec10ms(2), prec5ms(3), prec1ms(4), prec0_1ms(5), prec0_05ms(6), prec0_01ms(7);
        struct OPT_ENUM_ASN headingCfd;  // ENUMERATED, OPTIONAL, unavailable(0), prec10deg(1), prec05deg(2), prec01deg(3), prec0_1deg(4), prec0_05deg(5), prec0_01deg(6), prec0_0125deg(7);
        struct OPT_ENUM_ASN steerCfd;  // ENUMERATED, OPTIONAL, unavailable(0), prec2deg(1), prec1deg(2), prec0_02deg(3);
    };
    
    struct BasicSafetyMessageAccelerationSet4Way {
        INT isValidFlag;   // necessary if this struct is used as an optional field of a SEQUENCE
        INT lon;  // INTEGER, -2000..2001;
        INT lat;  // INTEGER, -2000..2001;
        INT vert;  // INTEGER, -127..127;
        INT yaw;  // INTEGER, -32767..32767;
    };
    
    struct BasicSafetyMessageBrakeAppliedStatus {
        INT isValidFlag;   // necessary if this struct is used as an optional field of a SEQUENCE
        CHAR string[6];
        INT  stringLength;
    };
    
    struct BasicSafetyMessageBrakeSystemStatus {
        INT isValidFlag;   // necessary if this struct is used as an optional field of a SEQUENCE
        struct OPT_ENUM_ASN brakePadel;  // ENUMERATED, OPTIONAL, unavailable(0), off(1), on(2);
        struct BasicSafetyMessageBrakeAppliedStatus wheelBrakes;  // BITSTRING, OPTIONAL;
        struct OPT_ENUM_ASN traction;  // ENUMERATED, OPTIONAL, unavailable(0), off(1), on(2), engaged(3);
        struct OPT_ENUM_ASN antiLockBrake;  // ENUMERATED, OPTIONAL, unavailable(0), off(1), on(2), engaged(3);
        struct OPT_ENUM_ASN scs;  // ENUMERATED, OPTIONAL, unavailable(0), off(1), on(2), engaged(3);
        struct OPT_ENUM_ASN brakeBoost;  // ENUMERATED, OPTIONAL, unavailable(0), off(1), on(2);
        struct OPT_ENUM_ASN auxBrakes;  // ENUMERATED, OPTIONAL, unavailable(0), off(1), on(2), reserved(3);
    };
    
    struct BasicSafetyMessageVehicleSize {
        INT isValidFlag;   // necessary if this struct is used as an optional field of a SEQUENCE
        WORD width;  // INTEGER, 0..1023;
        WORD length;  // INTEGER, 0..4095;
        struct OPT_BYTE_ASN height;  // INTEGER, OPTIONAL, 0..127;
    };
    
    struct BasicSafetyMessageVehicleClassification {
        INT isValidFlag;   // necessary if this struct is used as an optional field of a SEQUENCE
        BYTE classification;  // INTEGER, 0..255, unknownVehicleClass(0), specialVehicleClass(1), passenger_Vehicle_TypeUnknown(10), passenger_Vehicle_TypeOther(11), lightTruck_Vehicle_TypeUnknown(20), lightTruck_Vehicle_TypeOther(21), truck_Vehicle_TypeUnknown(25), truck_Vehicle_TypeOther(26), truck_axleCnt2(27), truck_axleCnt3(28), truck_axleCnt4(29), truck_axleCnt4Trailer(30), truck_axleCnt5Trailer(31), truck_axleCnt6Trailer(32), truck_axleCnt5MultiTrailer(33), truck_axleCnt6MultiTrailer(34), truck_axleCnt7MultiTrailer(35), motorcycle_TypeUnknown(40), motorcycle_TypeOther(41), motorcycle_Cruiser_Standard(42), motorcycle_SportUnclad(43), motorcycle_SportTouring(44), motorcycle_SuperSport(45), motorcycle_Touring(46), motorcycle_Trike(47), motorcycle_wPassengers(48), transit_TypeUnknown(50), transit_TypeOther(51), transit_BRT(52), transit_ExpressBus(53), transit_LocalBus(54), transit_SchoolBus(55), transit_FixedGuideway(56), transit_Paratransit(57), transit_Paratransit_Ambulance(58), emergency_TypeUnknown(60), emergency_TypeOther(61), emergency_Fire_Light_Vehicle(62), emergency_Fire_Heavy_Vehicle(63), emergency_Fire_Paramedic_Vehicle(64), emergency_Fire_Ambulance_Vehicle(65), emergency_Police_Light_Vehicle(66), emergency_Police_Heavy_Vehicle(67), emergency_Other_Responder(68), emergency_Other_Ambulance(69), otherTraveler_TypeUnknown(80), otherTraveler_TypeOther(81), otherTraveler_Pedestrian(82), otherTraveler_Visually_Disabled(83), otherTraveler_Physically_Disabled(84), otherTraveler_Bicycle(85), otherTraveler_Vulnerable_Roadworker(86), infrastructure_TypeUnknown(90), infrastructure_Fixed(91), infrastructure_Movable(92), equipped_CargoTrailer(93);
    };
    
    struct BasicSafetyMessageVehicleEventFlags {
        INT isValidFlag;   // necessary if this struct is used as an optional field of a SEQUENCE
        CHAR string[14];
        INT  stringLength;
    };
    
    struct BasicSafetyMessageDDateTime {
        INT isValidFlag;   // necessary if this struct is used as an optional field of a SEQUENCE
        struct OPT_WORD_ASN year;  // INTEGER, OPTIONAL, 0..4095;
        struct OPT_BYTE_ASN month;  // INTEGER, OPTIONAL, 0..12;
        struct OPT_BYTE_ASN day;  // INTEGER, OPTIONAL, 0..31;
        struct OPT_BYTE_ASN hour;  // INTEGER, OPTIONAL, 0..31;
        struct OPT_BYTE_ASN minute;  // INTEGER, OPTIONAL, 0..60;
        struct OPT_WORD_ASN second;  // INTEGER, OPTIONAL, 0..65535;
        struct OPT_INT_ASN offset;  // INTEGER, OPTIONAL, -840..840;
    };
    
    struct BasicSafetyMessageFullPositionVector {
        INT isValidFlag;   // necessary if this struct is used as an optional field of a SEQUENCE
        struct BasicSafetyMessageDDateTime utcTime;  // SEQUENCE, OPTIONAL;
        struct BasicSafetyMessagePosition3D pos;  // SEQUENCE;
        struct OPT_WORD_ASN heading;  // INTEGER, OPTIONAL, 0..28800;
        struct OPT_ENUM_ASN transmission;  // ENUMERATED, OPTIONAL, neutral(0), park(1), forwardGears(2), reverseGears(3), reserved1(4), reserved2(5), reserved3(6), unavailable(7);
        struct OPT_WORD_ASN speed;  // INTEGER, OPTIONAL, 0..8191;
        struct BasicSafetyMessagePositionConfidenceSet posAccuracy;  // SEQUENCE, OPTIONAL;
        struct OPT_ENUM_ASN timeConfidence;  // ENUMERATED, OPTIONAL, unavailable(0), time_100_000(1), time_050_000(2), time_020_000(3), time_010_000(4), time_002_000(5), time_001_000(6), time_000_500(7), time_000_200(8), time_000_100(9), time_000_050(10), time_000_020(11), time_000_010(12), time_000_005(13), time_000_002(14), time_000_001(15), time_000_000_5(16), time_000_000_2(17), time_000_000_1(18), time_000_000_05(19), time_000_000_02(20), time_000_000_01(21), time_000_000_005(22), time_000_000_002(23), time_000_000_001(24), time_000_000_000_5(25), time_000_000_000_2(26), time_000_000_000_1(27), time_000_000_000_05(28), time_000_000_000_02(29), time_000_000_000_01(30), time_000_000_000_005(31), time_000_000_000_002(32), time_000_000_000_001(33), time_000_000_000_000_5(34), time_000_000_000_000_2(35), time_000_000_000_000_1(36), time_000_000_000_000_05(37), time_000_000_000_000_02(38), time_000_000_000_000_01(39);
        struct BasicSafetyMessagePositionConfidenceSet posConfidence;  // SEQUENCE, OPTIONAL;
        struct BasicSafetyMessageMotionConfidenceSet motionCfd;  // SEQUENCE, OPTIONAL;
    };
    
    struct BasicSafetyMessageGNSSstatus {
        INT isValidFlag;   // necessary if this struct is used as an optional field of a SEQUENCE
        CHAR string[9];
        INT  stringLength;
    };
    
    struct BasicSafetyMessagePosition_LL_24B {
        INT isValidFlag;   // necessary if this struct is used as an optional field of a SEQUENCE
        INT lon;  // INTEGER, -2048..2047;
        INT lat;  // INTEGER, -2048..2047;
    };
    
    struct BasicSafetyMessagePosition_LL_28B {
        INT isValidFlag;   // necessary if this struct is used as an optional field of a SEQUENCE
        INT lon;  // INTEGER, -8192..8191;
        INT lat;  // INTEGER, -8192..8191;
    };
    
    struct BasicSafetyMessagePosition_LL_32B {
        INT isValidFlag;   // necessary if this struct is used as an optional field of a SEQUENCE
        INT lon;  // INTEGER, -32768..32767;
        INT lat;  // INTEGER, -32768..32767;
    };
    
    struct BasicSafetyMessagePosition_LL_36B {
        INT isValidFlag;   // necessary if this struct is used as an optional field of a SEQUENCE
        LONG lon;  // INTEGER, -131072..131071;
        LONG lat;  // INTEGER, -131072..131071;
    };
    
    struct BasicSafetyMessagePosition_LL_44B {
        INT isValidFlag;   // necessary if this struct is used as an optional field of a SEQUENCE
        LONG lon;  // INTEGER, -2097152..2097151;
        LONG lat;  // INTEGER, -2097152..2097151;
    };
    
    struct BasicSafetyMessagePosition_LL_48B {
        INT isValidFlag;   // necessary if this struct is used as an optional field of a SEQUENCE
        LONG lon;  // INTEGER, -8388608..8388607;
        LONG lat;  // INTEGER, -8388608..8388607;
    };
    
    struct BasicSafetyMessagePosition_LLmD_64b {
        INT isValidFlag;   // necessary if this struct is used as an optional field of a SEQUENCE
        LONG lon;  // INTEGER, -1799999999..1800000001;
        LONG lat;  // INTEGER, -900000000..900000001;
    };
    
    struct BasicSafetyMessagePositionOffsetLL {
        INT isValidFlag;   // necessary if this struct is used as an optional field of a SEQUENCE
        INT choice;
        struct BasicSafetyMessagePosition_LL_24B position_LL1;  // SEQUENCE;
        struct BasicSafetyMessagePosition_LL_28B position_LL2;  // SEQUENCE;
        struct BasicSafetyMessagePosition_LL_32B position_LL3;  // SEQUENCE;
        struct BasicSafetyMessagePosition_LL_36B position_LL4;  // SEQUENCE;
        struct BasicSafetyMessagePosition_LL_44B position_LL5;  // SEQUENCE;
        struct BasicSafetyMessagePosition_LL_48B position_LL6;  // SEQUENCE;
        struct BasicSafetyMessagePosition_LLmD_64b position_LatLon;  // SEQUENCE;
    };
    
    struct BasicSafetyMessageVerticalOffset {
        INT isValidFlag;   // necessary if this struct is used as an optional field of a SEQUENCE
        INT choice;
        INT offset1;  // INTEGER, -64..63;
        INT offset2;  // INTEGER, -128..127;
        INT offset3;  // INTEGER, -256..255;
        INT offset4;  // INTEGER, -512..511;
        INT offset5;  // INTEGER, -1024..1023;
        INT offset6;  // INTEGER, -2048..2047;
        LONG elevation;  // INTEGER, -4096..61439;
    };
    
    struct BasicSafetyMessagePositionOffsetLLV {
        INT isValidFlag;   // necessary if this struct is used as an optional field of a SEQUENCE
        struct BasicSafetyMessagePositionOffsetLL offsetLL;  // CHOICE;
        struct BasicSafetyMessageVerticalOffset offsetV;  // CHOICE, OPTIONAL;
    };
    
    struct BasicSafetyMessagePathHistoryPoint {
        INT isValidFlag;   // necessary if this struct is used as an optional field of a SEQUENCE
        struct BasicSafetyMessagePositionOffsetLLV llvOffset;  // SEQUENCE;
        WORD timeOffset;  // INTEGER, 1..65535;
        struct OPT_WORD_ASN speed;  // INTEGER, OPTIONAL, 0..8191;
        struct BasicSafetyMessagePositionConfidenceSet posAccuracy;  // SEQUENCE, OPTIONAL;
        struct OPT_BYTE_ASN heading;  // INTEGER, OPTIONAL, 0..240;
    };
    
    struct BasicSafetyMessagePathHistoryPointList {
        INT isValidFlag;   // necessary if this struct is used as an optional field of a SEQUENCE
        INT length;
        struct BasicSafetyMessagePathHistoryPoint arrayValue[23];  // SEQUENCE;
    };
    
    struct BasicSafetyMessagePathHistory {
        INT isValidFlag;   // necessary if this struct is used as an optional field of a SEQUENCE
        struct BasicSafetyMessageFullPositionVector initialPosition;  // SEQUENCE, OPTIONAL;
        struct BasicSafetyMessageGNSSstatus currGNSSstatus;  // BITSTRING, OPTIONAL;
        struct BasicSafetyMessagePathHistoryPointList crumbData;  // SEQUENCEOF;
    };
    
    struct BasicSafetyMessagePathPrediction {
        INT isValidFlag;   // necessary if this struct is used as an optional field of a SEQUENCE
        INT radiusOfCurve;  // INTEGER, -32767..32767;
        BYTE confidence;  // INTEGER, 0..200;
    };
    
    struct BasicSafetyMessageExteriorLights {
        INT isValidFlag;   // necessary if this struct is used as an optional field of a SEQUENCE
        CHAR string[10];
        INT  stringLength;
    };
    
    struct BasicSafetyMessageVehicleSafetyExtensions {
        INT isValidFlag;   // necessary if this struct is used as an optional field of a SEQUENCE
        struct BasicSafetyMessageVehicleEventFlags events;  // BITSTRING, OPTIONAL;
        struct BasicSafetyMessagePathHistory pathHistory;  // SEQUENCE, OPTIONAL;
        struct BasicSafetyMessagePathPrediction pathPrediction;  // SEQUENCE, OPTIONAL;
        struct BasicSafetyMessageExteriorLights lights;  // BITSTRING, OPTIONAL;
    };
    
    struct BasicSafetyMessageBasicSafetyMessageFrame {
        INT isValidFlag;   // necessary if this struct is used as an optional field of a SEQUENCE
        BYTE msgCnt;  // INTEGER, 0..127;
        struct BasicSafetyMessageBasicSafetyMessage_id id;  // OCTETSTRING;
        struct BasicSafetyMessageBasicSafetyMessage_plateNo plateNo;  // OCTETSTRING, OPTIONAL;
        WORD secMark;  // INTEGER, 0..65535;
        struct BasicSafetyMessagePosition3D pos;  // SEQUENCE;
        struct BasicSafetyMessagePositionConfidenceSet accuracy;  // SEQUENCE;
        INT transmission;  // ENUMERATED, neutral(0), park(1), forwardGears(2), reverseGears(3), reserved1(4), reserved2(5), reserved3(6), unavailable(7);
        WORD speed;  // INTEGER, 0..8191;
        WORD heading;  // INTEGER, 0..28800;
        struct OPT_INT_ASN angle;  // INTEGER, OPTIONAL, -126..127;
        struct BasicSafetyMessageMotionConfidenceSet motionCfd;  // SEQUENCE, OPTIONAL;
        struct BasicSafetyMessageAccelerationSet4Way accelSet;  // SEQUENCE;
        struct BasicSafetyMessageBrakeSystemStatus brakes;  // SEQUENCE;
        struct BasicSafetyMessageVehicleSize size;  // SEQUENCE;
        struct BasicSafetyMessageVehicleClassification vehicleClass;  // SEQUENCE;
        struct BasicSafetyMessageVehicleSafetyExtensions safetyExt;  // SEQUENCE, OPTIONAL;
    };
    
    struct BasicSafetyMessage {
        INT isValidFlag;   // necessary if this struct is used as an optional field of a SEQUENCE
        BYTE frameType;  // INTEGER, 0..15, bsmFrame(0);
        struct BasicSafetyMessageBasicSafetyMessageFrame bsmFrame;  // SEQUENCE;
    };
    
}

/*
// init function to create a simple packet handle
*/ 
LONG API_InitBasicSafetyMessagePacket()
{
  return C2xInitPacket("BasicSafetyMessage"); 
}

/*
// init function to create a simple packet handle and
// initialize the struct with valid data
*/ 
LONG API_InitBasicSafetyMessagePacket(struct BasicSafetyMessage msgStruct)
{
  long pktHandle;

  pktHandle = API_InitBasicSafetyMessagePacket();

  if (pktHandle != 0)
  {
    // create valid message and application data
    if (C2xCompletePacket(pktHandle) == 0) 
    {
      API_GetBasicSafetyMessageParams(pktHandle, msgStruct);
    }
  }
  return pktHandle;
}

/*
// init function to create a packet with security layer and
// initialize the struct with valid data
*/ 
LONG API_InitBasicSafetyMessagePacket(struct BasicSafetyMessage msgStruct, char packetTypeDesignator[], char certificateName[])
{
  long pktHandle, certHdl;

  // initialize the packet
  pktHandle = C2xInitPacket("BasicSafetyMessage", packetTypeDesignator);

  if (pktHandle != 0)
  {
    certHdl = C2xSecCertificateGetHandle(certificateName);  // get the certificate handle for the cert with name "certificateName"
    if (certHdl != 0) 
    {
      C2xSecPacketSetSignerHandle(pktHandle, certHdl); // set the certHdl to the packet
    }

    // create valid message and application data
    if (C2xCompletePacket(pktHandle) == 0) 
    {
      // copy application data to the application structure
      API_GetBasicSafetyMessageParams(pktHandle, msgStruct);
    }
  }
  return pktHandle;
}
    

int GetBasicSafetyMessagePosition3DParams(LONG packetHandle, struct BasicSafetyMessagePosition3D value, char oldPath[])
{
  char newPath[300];
  int result;

  result = 0;

  snprintf(newPath, elcount(newPath), "%s.%s", oldPath, "lat");
  value.lat = C2xGetTokenInt(packetHandle, "BasicSafetyMessage", newPath);
  result = CheckLastError("BasicSafetyMessage", gkFuncRefGet, result);

  snprintf(newPath, elcount(newPath), "%s.%s", oldPath, "lon");
  value.lon = C2xGetTokenInt(packetHandle, "BasicSafetyMessage", newPath);
  result = CheckLastError("BasicSafetyMessage", gkFuncRefGet, result);

  snprintf(newPath, elcount(newPath), "%s.%s", oldPath, "elevation");
  value.elevation.isValidFlag = C2xIsTokenAvailable(packetHandle, "BasicSafetyMessage", newPath);
  if(value.elevation.isValidFlag==1)
  {
    value.elevation.value = C2xGetTokenInt(packetHandle, "BasicSafetyMessage", newPath);
    result = CheckLastError("BasicSafetyMessage", gkFuncRefGet, result);
  }
  return result;
}

int SetBasicSafetyMessagePosition3DParams(LONG packetHandle, struct BasicSafetyMessagePosition3D value, char oldPath[])
{
  char newPath[300];
  int result;

  result = 0;

  snprintf(newPath, elcount(newPath), "%s.%s", oldPath, "lat");
  C2xSetTokenInt(packetHandle, "BasicSafetyMessage", newPath, value.lat);
  result = CheckLastError("BasicSafetyMessage", gkFuncRefGet, result);

  snprintf(newPath, elcount(newPath), "%s.%s", oldPath, "lon");
  C2xSetTokenInt(packetHandle, "BasicSafetyMessage", newPath, value.lon);
  result = CheckLastError("BasicSafetyMessage", gkFuncRefGet, result);

  snprintf(newPath, elcount(newPath), "%s.%s", oldPath, "elevation");
  if(value.elevation.isValidFlag==1)
  {
    C2xSetTokenInt(packetHandle, "BasicSafetyMessage", newPath, value.elevation.value);
    result = CheckLastError("BasicSafetyMessage", gkFuncRefGet, result);
  }
  else
  {
    if( C2xIsTokenAvailable(packetHandle, "BasicSafetyMessage", newPath) )
    {
      C2xRemoveToken(packetHandle, "BasicSafetyMessage", newPath);
    }
  }

  return result;
}

int GetBasicSafetyMessagePositionConfidenceSetParams(LONG packetHandle, struct BasicSafetyMessagePositionConfidenceSet value, char oldPath[])
{
  char newPath[300];
  int result;

  result = 0;

  snprintf(newPath, elcount(newPath), "%s.%s", oldPath, "pos");
  value.pos = C2xGetTokenInt(packetHandle, "BasicSafetyMessage", newPath);
  result = CheckLastError("BasicSafetyMessage", gkFuncRefGet, result);

  snprintf(newPath, elcount(newPath), "%s.%s", oldPath, "elevation");
  value.elevation.isValidFlag = C2xIsTokenAvailable(packetHandle, "BasicSafetyMessage", newPath);
  if(value.elevation.isValidFlag==1)
  {
    value.elevation.value = C2xGetTokenInt(packetHandle, "BasicSafetyMessage", newPath);
    result = CheckLastError("BasicSafetyMessage", gkFuncRefGet, result);
  }
  return result;
}

int SetBasicSafetyMessagePositionConfidenceSetParams(LONG packetHandle, struct BasicSafetyMessagePositionConfidenceSet value, char oldPath[])
{
  char newPath[300];
  int result;

  result = 0;

  snprintf(newPath, elcount(newPath), "%s.%s", oldPath, "pos");
  C2xSetTokenInt(packetHandle, "BasicSafetyMessage", newPath, value.pos);
  result = CheckLastError("BasicSafetyMessage", gkFuncRefGet, result);

  snprintf(newPath, elcount(newPath), "%s.%s", oldPath, "elevation");
  if(value.elevation.isValidFlag==1)
  {
    C2xSetTokenInt(packetHandle, "BasicSafetyMessage", newPath, value.elevation.value);
    result = CheckLastError("BasicSafetyMessage", gkFuncRefGet, result);
  }
  else
  {
    if( C2xIsTokenAvailable(packetHandle, "BasicSafetyMessage", newPath) )
    {
      C2xRemoveToken(packetHandle, "BasicSafetyMessage", newPath);
    }
  }

  return result;
}

int GetBasicSafetyMessageMotionConfidenceSetParams(LONG packetHandle, struct BasicSafetyMessageMotionConfidenceSet value, char oldPath[])
{
  char newPath[300];
  int result;

  result = 0;

  snprintf(newPath, elcount(newPath), "%s.%s", oldPath, "speedCfd");
  value.speedCfd.isValidFlag = C2xIsTokenAvailable(packetHandle, "BasicSafetyMessage", newPath);
  if(value.speedCfd.isValidFlag==1)
  {
    value.speedCfd.value = C2xGetTokenInt(packetHandle, "BasicSafetyMessage", newPath);
    result = CheckLastError("BasicSafetyMessage", gkFuncRefGet, result);
  }
  snprintf(newPath, elcount(newPath), "%s.%s", oldPath, "headingCfd");
  value.headingCfd.isValidFlag = C2xIsTokenAvailable(packetHandle, "BasicSafetyMessage", newPath);
  if(value.headingCfd.isValidFlag==1)
  {
    value.headingCfd.value = C2xGetTokenInt(packetHandle, "BasicSafetyMessage", newPath);
    result = CheckLastError("BasicSafetyMessage", gkFuncRefGet, result);
  }
  snprintf(newPath, elcount(newPath), "%s.%s", oldPath, "steerCfd");
  value.steerCfd.isValidFlag = C2xIsTokenAvailable(packetHandle, "BasicSafetyMessage", newPath);
  if(value.steerCfd.isValidFlag==1)
  {
    value.steerCfd.value = C2xGetTokenInt(packetHandle, "BasicSafetyMessage", newPath);
    result = CheckLastError("BasicSafetyMessage", gkFuncRefGet, result);
  }
  return result;
}

int SetBasicSafetyMessageMotionConfidenceSetParams(LONG packetHandle, struct BasicSafetyMessageMotionConfidenceSet value, char oldPath[])
{
  char newPath[300];
  int result;

  result = 0;

  snprintf(newPath, elcount(newPath), "%s.%s", oldPath, "speedCfd");
  if(value.speedCfd.isValidFlag==1)
  {
    C2xSetTokenInt(packetHandle, "BasicSafetyMessage", newPath, value.speedCfd.value);
    result = CheckLastError("BasicSafetyMessage", gkFuncRefGet, result);
  }
  else
  {
    if( C2xIsTokenAvailable(packetHandle, "BasicSafetyMessage", newPath) )
    {
      C2xRemoveToken(packetHandle, "BasicSafetyMessage", newPath);
    }
  }

  snprintf(newPath, elcount(newPath), "%s.%s", oldPath, "headingCfd");
  if(value.headingCfd.isValidFlag==1)
  {
    C2xSetTokenInt(packetHandle, "BasicSafetyMessage", newPath, value.headingCfd.value);
    result = CheckLastError("BasicSafetyMessage", gkFuncRefGet, result);
  }
  else
  {
    if( C2xIsTokenAvailable(packetHandle, "BasicSafetyMessage", newPath) )
    {
      C2xRemoveToken(packetHandle, "BasicSafetyMessage", newPath);
    }
  }

  snprintf(newPath, elcount(newPath), "%s.%s", oldPath, "steerCfd");
  if(value.steerCfd.isValidFlag==1)
  {
    C2xSetTokenInt(packetHandle, "BasicSafetyMessage", newPath, value.steerCfd.value);
    result = CheckLastError("BasicSafetyMessage", gkFuncRefGet, result);
  }
  else
  {
    if( C2xIsTokenAvailable(packetHandle, "BasicSafetyMessage", newPath) )
    {
      C2xRemoveToken(packetHandle, "BasicSafetyMessage", newPath);
    }
  }

  return result;
}

int GetBasicSafetyMessageAccelerationSet4WayParams(LONG packetHandle, struct BasicSafetyMessageAccelerationSet4Way value, char oldPath[])
{
  char newPath[300];
  int result;

  result = 0;

  snprintf(newPath, elcount(newPath), "%s.%s", oldPath, "lon");
  value.lon = C2xGetTokenInt(packetHandle, "BasicSafetyMessage", newPath);
  result = CheckLastError("BasicSafetyMessage", gkFuncRefGet, result);

  snprintf(newPath, elcount(newPath), "%s.%s", oldPath, "lat");
  value.lat = C2xGetTokenInt(packetHandle, "BasicSafetyMessage", newPath);
  result = CheckLastError("BasicSafetyMessage", gkFuncRefGet, result);

  snprintf(newPath, elcount(newPath), "%s.%s", oldPath, "vert");
  value.vert = C2xGetTokenInt(packetHandle, "BasicSafetyMessage", newPath);
  result = CheckLastError("BasicSafetyMessage", gkFuncRefGet, result);

  snprintf(newPath, elcount(newPath), "%s.%s", oldPath, "yaw");
  value.yaw = C2xGetTokenInt(packetHandle, "BasicSafetyMessage", newPath);
  result = CheckLastError("BasicSafetyMessage", gkFuncRefGet, result);

  return result;
}

int SetBasicSafetyMessageAccelerationSet4WayParams(LONG packetHandle, struct BasicSafetyMessageAccelerationSet4Way value, char oldPath[])
{
  char newPath[300];
  int result;

  result = 0;

  snprintf(newPath, elcount(newPath), "%s.%s", oldPath, "lon");
  C2xSetTokenInt(packetHandle, "BasicSafetyMessage", newPath, value.lon);
  result = CheckLastError("BasicSafetyMessage", gkFuncRefGet, result);

  snprintf(newPath, elcount(newPath), "%s.%s", oldPath, "lat");
  C2xSetTokenInt(packetHandle, "BasicSafetyMessage", newPath, value.lat);
  result = CheckLastError("BasicSafetyMessage", gkFuncRefGet, result);

  snprintf(newPath, elcount(newPath), "%s.%s", oldPath, "vert");
  C2xSetTokenInt(packetHandle, "BasicSafetyMessage", newPath, value.vert);
  result = CheckLastError("BasicSafetyMessage", gkFuncRefGet, result);

  snprintf(newPath, elcount(newPath), "%s.%s", oldPath, "yaw");
  C2xSetTokenInt(packetHandle, "BasicSafetyMessage", newPath, value.yaw);
  result = CheckLastError("BasicSafetyMessage", gkFuncRefGet, result);

  return result;
}

int GetBasicSafetyMessageBrakeSystemStatusParams(LONG packetHandle, struct BasicSafetyMessageBrakeSystemStatus value, char oldPath[])
{
  char newPath[300]; 
  int j; 
  int k;
  int result;

  result = 0;

  snprintf(newPath, elcount(newPath), "%s.%s", oldPath, "brakePadel");
  value.brakePadel.isValidFlag = C2xIsTokenAvailable(packetHandle, "BasicSafetyMessage", newPath);
  if(value.brakePadel.isValidFlag==1)
  {
    value.brakePadel.value = C2xGetTokenInt(packetHandle, "BasicSafetyMessage", newPath);
    result = CheckLastError("BasicSafetyMessage", gkFuncRefGet, result);
  }
  snprintf(newPath, elcount(newPath), "%s.%s", oldPath, "wheelBrakes");
  value.wheelBrakes.isValidFlag = C2xIsTokenAvailable(packetHandle, "BasicSafetyMessage", newPath);
  if(value.wheelBrakes.isValidFlag==1)
  {
    value.wheelBrakes.isValidFlag = 1;
    value.wheelBrakes.stringLength = C2xGetTokenLengthBit(packetHandle, "BasicSafetyMessage", newPath);
    if ((result = CheckLastError("BasicSafetyMessage", gkFuncRefGet, result))==0)
    {
      if(value.wheelBrakes.stringLength > 0)
      {
        for(j=0; j<value.wheelBrakes.stringLength; j++)
        {
          if(C2xGetTokenBitOfBitString(packetHandle, "BasicSafetyMessage", newPath, j) == 0)
          {
            value.wheelBrakes.string[j] = '0';
          }
          else if(C2xGetTokenBitOfBitString(packetHandle, "BasicSafetyMessage", newPath, j) == 1)
          {
            value.wheelBrakes.string[j] = '1';
          }

          if(value.wheelBrakes.stringLength == 1)
          {
            value.wheelBrakes.string[1] = '0';
          }
          result = CheckLastError("BasicSafetyMessage", gkFuncRefGet, result);
        }
      }
      else
      {
        for(k = value.wheelBrakes.stringLength+1; k > -1; k--)
        {
          if(value.wheelBrakes.string[k] == '1')
          {
            value.wheelBrakes.string[k] = '0';
          }
        }
      }
    }

  }
  snprintf(newPath, elcount(newPath), "%s.%s", oldPath, "traction");
  value.traction.isValidFlag = C2xIsTokenAvailable(packetHandle, "BasicSafetyMessage", newPath);
  if(value.traction.isValidFlag==1)
  {
    value.traction.value = C2xGetTokenInt(packetHandle, "BasicSafetyMessage", newPath);
    result = CheckLastError("BasicSafetyMessage", gkFuncRefGet, result);
  }
  snprintf(newPath, elcount(newPath), "%s.%s", oldPath, "antiLockBrake");
  value.antiLockBrake.isValidFlag = C2xIsTokenAvailable(packetHandle, "BasicSafetyMessage", newPath);
  if(value.antiLockBrake.isValidFlag==1)
  {
    value.antiLockBrake.value = C2xGetTokenInt(packetHandle, "BasicSafetyMessage", newPath);
    result = CheckLastError("BasicSafetyMessage", gkFuncRefGet, result);
  }
  snprintf(newPath, elcount(newPath), "%s.%s", oldPath, "scs");
  value.scs.isValidFlag = C2xIsTokenAvailable(packetHandle, "BasicSafetyMessage", newPath);
  if(value.scs.isValidFlag==1)
  {
    value.scs.value = C2xGetTokenInt(packetHandle, "BasicSafetyMessage", newPath);
    result = CheckLastError("BasicSafetyMessage", gkFuncRefGet, result);
  }
  snprintf(newPath, elcount(newPath), "%s.%s", oldPath, "brakeBoost");
  value.brakeBoost.isValidFlag = C2xIsTokenAvailable(packetHandle, "BasicSafetyMessage", newPath);
  if(value.brakeBoost.isValidFlag==1)
  {
    value.brakeBoost.value = C2xGetTokenInt(packetHandle, "BasicSafetyMessage", newPath);
    result = CheckLastError("BasicSafetyMessage", gkFuncRefGet, result);
  }
  snprintf(newPath, elcount(newPath), "%s.%s", oldPath, "auxBrakes");
  value.auxBrakes.isValidFlag = C2xIsTokenAvailable(packetHandle, "BasicSafetyMessage", newPath);
  if(value.auxBrakes.isValidFlag==1)
  {
    value.auxBrakes.value = C2xGetTokenInt(packetHandle, "BasicSafetyMessage", newPath);
    result = CheckLastError("BasicSafetyMessage", gkFuncRefGet, result);
  }
  return result;
}

int SetBasicSafetyMessageBrakeSystemStatusParams(LONG packetHandle, struct BasicSafetyMessageBrakeSystemStatus value, char oldPath[])
{
  char newPath[300]; 
  int j;
  int result;

  result = 0;

  snprintf(newPath, elcount(newPath), "%s.%s", oldPath, "brakePadel");
  if(value.brakePadel.isValidFlag==1)
  {
    C2xSetTokenInt(packetHandle, "BasicSafetyMessage", newPath, value.brakePadel.value);
    result = CheckLastError("BasicSafetyMessage", gkFuncRefGet, result);
  }
  else
  {
    if( C2xIsTokenAvailable(packetHandle, "BasicSafetyMessage", newPath) )
    {
      C2xRemoveToken(packetHandle, "BasicSafetyMessage", newPath);
    }
  }

  snprintf(newPath, elcount(newPath), "%s.%s", oldPath, "wheelBrakes");
  if(value.wheelBrakes.isValidFlag==1)
  {
      for(j=0; j<value.wheelBrakes.stringLength; j++)
      {
        if(value.wheelBrakes.string[j] == '0')
        {
          C2xSetTokenBitOfBitString(packetHandle, "BasicSafetyMessage", newPath, j, 0);
        }
        else
        {
          C2xSetTokenBitOfBitString(packetHandle, "BasicSafetyMessage", newPath, j, 1);
        }
        result = CheckLastError("BasicSafetyMessage", gkFuncRefGet, result);
      }
  }
  else
  {
    if( C2xIsTokenAvailable(packetHandle, "BasicSafetyMessage", newPath) )
    {
      C2xRemoveToken(packetHandle, "BasicSafetyMessage", newPath);
    }
  }

  snprintf(newPath, elcount(newPath), "%s.%s", oldPath, "traction");
  if(value.traction.isValidFlag==1)
  {
    C2xSetTokenInt(packetHandle, "BasicSafetyMessage", newPath, value.traction.value);
    result = CheckLastError("BasicSafetyMessage", gkFuncRefGet, result);
  }
  else
  {
    if( C2xIsTokenAvailable(packetHandle, "BasicSafetyMessage", newPath) )
    {
      C2xRemoveToken(packetHandle, "BasicSafetyMessage", newPath);
    }
  }

  snprintf(newPath, elcount(newPath), "%s.%s", oldPath, "antiLockBrake");
  if(value.antiLockBrake.isValidFlag==1)
  {
    C2xSetTokenInt(packetHandle, "BasicSafetyMessage", newPath, value.antiLockBrake.value);
    result = CheckLastError("BasicSafetyMessage", gkFuncRefGet, result);
  }
  else
  {
    if( C2xIsTokenAvailable(packetHandle, "BasicSafetyMessage", newPath) )
    {
      C2xRemoveToken(packetHandle, "BasicSafetyMessage", newPath);
    }
  }

  snprintf(newPath, elcount(newPath), "%s.%s", oldPath, "scs");
  if(value.scs.isValidFlag==1)
  {
    C2xSetTokenInt(packetHandle, "BasicSafetyMessage", newPath, value.scs.value);
    result = CheckLastError("BasicSafetyMessage", gkFuncRefGet, result);
  }
  else
  {
    if( C2xIsTokenAvailable(packetHandle, "BasicSafetyMessage", newPath) )
    {
      C2xRemoveToken(packetHandle, "BasicSafetyMessage", newPath);
    }
  }

  snprintf(newPath, elcount(newPath), "%s.%s", oldPath, "brakeBoost");
  if(value.brakeBoost.isValidFlag==1)
  {
    C2xSetTokenInt(packetHandle, "BasicSafetyMessage", newPath, value.brakeBoost.value);
    result = CheckLastError("BasicSafetyMessage", gkFuncRefGet, result);
  }
  else
  {
    if( C2xIsTokenAvailable(packetHandle, "BasicSafetyMessage", newPath) )
    {
      C2xRemoveToken(packetHandle, "BasicSafetyMessage", newPath);
    }
  }

  snprintf(newPath, elcount(newPath), "%s.%s", oldPath, "auxBrakes");
  if(value.auxBrakes.isValidFlag==1)
  {
    C2xSetTokenInt(packetHandle, "BasicSafetyMessage", newPath, value.auxBrakes.value);
    result = CheckLastError("BasicSafetyMessage", gkFuncRefGet, result);
  }
  else
  {
    if( C2xIsTokenAvailable(packetHandle, "BasicSafetyMessage", newPath) )
    {
      C2xRemoveToken(packetHandle, "BasicSafetyMessage", newPath);
    }
  }

  return result;
}

int GetBasicSafetyMessageVehicleSizeParams(LONG packetHandle, struct BasicSafetyMessageVehicleSize value, char oldPath[])
{
  char newPath[300];
  int result;

  result = 0;

  snprintf(newPath, elcount(newPath), "%s.%s", oldPath, "width");
  value.width = C2xGetTokenInt(packetHandle, "BasicSafetyMessage", newPath);
  result = CheckLastError("BasicSafetyMessage", gkFuncRefGet, result);

  snprintf(newPath, elcount(newPath), "%s.%s", oldPath, "length");
  value.length = C2xGetTokenInt(packetHandle, "BasicSafetyMessage", newPath);
  result = CheckLastError("BasicSafetyMessage", gkFuncRefGet, result);

  snprintf(newPath, elcount(newPath), "%s.%s", oldPath, "height");
  value.height.isValidFlag = C2xIsTokenAvailable(packetHandle, "BasicSafetyMessage", newPath);
  if(value.height.isValidFlag==1)
  {
    value.height.value = C2xGetTokenInt(packetHandle, "BasicSafetyMessage", newPath);
    result = CheckLastError("BasicSafetyMessage", gkFuncRefGet, result);
  }
  return result;
}

int SetBasicSafetyMessageVehicleSizeParams(LONG packetHandle, struct BasicSafetyMessageVehicleSize value, char oldPath[])
{
  char newPath[300];
  int result;

  result = 0;

  snprintf(newPath, elcount(newPath), "%s.%s", oldPath, "width");
  C2xSetTokenInt(packetHandle, "BasicSafetyMessage", newPath, value.width);
  result = CheckLastError("BasicSafetyMessage", gkFuncRefGet, result);

  snprintf(newPath, elcount(newPath), "%s.%s", oldPath, "length");
  C2xSetTokenInt(packetHandle, "BasicSafetyMessage", newPath, value.length);
  result = CheckLastError("BasicSafetyMessage", gkFuncRefGet, result);

  snprintf(newPath, elcount(newPath), "%s.%s", oldPath, "height");
  if(value.height.isValidFlag==1)
  {
    C2xSetTokenInt(packetHandle, "BasicSafetyMessage", newPath, value.height.value);
    result = CheckLastError("BasicSafetyMessage", gkFuncRefGet, result);
  }
  else
  {
    if( C2xIsTokenAvailable(packetHandle, "BasicSafetyMessage", newPath) )
    {
      C2xRemoveToken(packetHandle, "BasicSafetyMessage", newPath);
    }
  }

  return result;
}

int GetBasicSafetyMessageVehicleClassificationParams(LONG packetHandle, struct BasicSafetyMessageVehicleClassification value, char oldPath[])
{
  char newPath[300];
  int result;

  result = 0;

  snprintf(newPath, elcount(newPath), "%s.%s", oldPath, "classification");
  value.classification = C2xGetTokenInt(packetHandle, "BasicSafetyMessage", newPath);
  result = CheckLastError("BasicSafetyMessage", gkFuncRefGet, result);

  return result;
}

int SetBasicSafetyMessageVehicleClassificationParams(LONG packetHandle, struct BasicSafetyMessageVehicleClassification value, char oldPath[])
{
  char newPath[300];
  int result;

  result = 0;

  snprintf(newPath, elcount(newPath), "%s.%s", oldPath, "classification");
  C2xSetTokenInt(packetHandle, "BasicSafetyMessage", newPath, value.classification);
  result = CheckLastError("BasicSafetyMessage", gkFuncRefGet, result);

  return result;
}

int GetBasicSafetyMessageDDateTimeParams(LONG packetHandle, struct BasicSafetyMessageDDateTime value, char oldPath[])
{
  char newPath[300];
  int result;

  result = 0;

  snprintf(newPath, elcount(newPath), "%s.%s", oldPath, "year");
  value.year.isValidFlag = C2xIsTokenAvailable(packetHandle, "BasicSafetyMessage", newPath);
  if(value.year.isValidFlag==1)
  {
    value.year.value = C2xGetTokenInt(packetHandle, "BasicSafetyMessage", newPath);
    result = CheckLastError("BasicSafetyMessage", gkFuncRefGet, result);
  }
  snprintf(newPath, elcount(newPath), "%s.%s", oldPath, "month");
  value.month.isValidFlag = C2xIsTokenAvailable(packetHandle, "BasicSafetyMessage", newPath);
  if(value.month.isValidFlag==1)
  {
    value.month.value = C2xGetTokenInt(packetHandle, "BasicSafetyMessage", newPath);
    result = CheckLastError("BasicSafetyMessage", gkFuncRefGet, result);
  }
  snprintf(newPath, elcount(newPath), "%s.%s", oldPath, "day");
  value.day.isValidFlag = C2xIsTokenAvailable(packetHandle, "BasicSafetyMessage", newPath);
  if(value.day.isValidFlag==1)
  {
    value.day.value = C2xGetTokenInt(packetHandle, "BasicSafetyMessage", newPath);
    result = CheckLastError("BasicSafetyMessage", gkFuncRefGet, result);
  }
  snprintf(newPath, elcount(newPath), "%s.%s", oldPath, "hour");
  value.hour.isValidFlag = C2xIsTokenAvailable(packetHandle, "BasicSafetyMessage", newPath);
  if(value.hour.isValidFlag==1)
  {
    value.hour.value = C2xGetTokenInt(packetHandle, "BasicSafetyMessage", newPath);
    result = CheckLastError("BasicSafetyMessage", gkFuncRefGet, result);
  }
  snprintf(newPath, elcount(newPath), "%s.%s", oldPath, "minute");
  value.minute.isValidFlag = C2xIsTokenAvailable(packetHandle, "BasicSafetyMessage", newPath);
  if(value.minute.isValidFlag==1)
  {
    value.minute.value = C2xGetTokenInt(packetHandle, "BasicSafetyMessage", newPath);
    result = CheckLastError("BasicSafetyMessage", gkFuncRefGet, result);
  }
  snprintf(newPath, elcount(newPath), "%s.%s", oldPath, "second");
  value.second.isValidFlag = C2xIsTokenAvailable(packetHandle, "BasicSafetyMessage", newPath);
  if(value.second.isValidFlag==1)
  {
    value.second.value = C2xGetTokenInt(packetHandle, "BasicSafetyMessage", newPath);
    result = CheckLastError("BasicSafetyMessage", gkFuncRefGet, result);
  }
  snprintf(newPath, elcount(newPath), "%s.%s", oldPath, "offset");
  value.offset.isValidFlag = C2xIsTokenAvailable(packetHandle, "BasicSafetyMessage", newPath);
  if(value.offset.isValidFlag==1)
  {
    value.offset.value = C2xGetTokenInt(packetHandle, "BasicSafetyMessage", newPath);
    result = CheckLastError("BasicSafetyMessage", gkFuncRefGet, result);
  }
  return result;
}

int SetBasicSafetyMessageDDateTimeParams(LONG packetHandle, struct BasicSafetyMessageDDateTime value, char oldPath[])
{
  char newPath[300];
  int result;

  result = 0;

  snprintf(newPath, elcount(newPath), "%s.%s", oldPath, "year");
  if(value.year.isValidFlag==1)
  {
    C2xSetTokenInt(packetHandle, "BasicSafetyMessage", newPath, value.year.value);
    result = CheckLastError("BasicSafetyMessage", gkFuncRefGet, result);
  }
  else
  {
    if( C2xIsTokenAvailable(packetHandle, "BasicSafetyMessage", newPath) )
    {
      C2xRemoveToken(packetHandle, "BasicSafetyMessage", newPath);
    }
  }

  snprintf(newPath, elcount(newPath), "%s.%s", oldPath, "month");
  if(value.month.isValidFlag==1)
  {
    C2xSetTokenInt(packetHandle, "BasicSafetyMessage", newPath, value.month.value);
    result = CheckLastError("BasicSafetyMessage", gkFuncRefGet, result);
  }
  else
  {
    if( C2xIsTokenAvailable(packetHandle, "BasicSafetyMessage", newPath) )
    {
      C2xRemoveToken(packetHandle, "BasicSafetyMessage", newPath);
    }
  }

  snprintf(newPath, elcount(newPath), "%s.%s", oldPath, "day");
  if(value.day.isValidFlag==1)
  {
    C2xSetTokenInt(packetHandle, "BasicSafetyMessage", newPath, value.day.value);
    result = CheckLastError("BasicSafetyMessage", gkFuncRefGet, result);
  }
  else
  {
    if( C2xIsTokenAvailable(packetHandle, "BasicSafetyMessage", newPath) )
    {
      C2xRemoveToken(packetHandle, "BasicSafetyMessage", newPath);
    }
  }

  snprintf(newPath, elcount(newPath), "%s.%s", oldPath, "hour");
  if(value.hour.isValidFlag==1)
  {
    C2xSetTokenInt(packetHandle, "BasicSafetyMessage", newPath, value.hour.value);
    result = CheckLastError("BasicSafetyMessage", gkFuncRefGet, result);
  }
  else
  {
    if( C2xIsTokenAvailable(packetHandle, "BasicSafetyMessage", newPath) )
    {
      C2xRemoveToken(packetHandle, "BasicSafetyMessage", newPath);
    }
  }

  snprintf(newPath, elcount(newPath), "%s.%s", oldPath, "minute");
  if(value.minute.isValidFlag==1)
  {
    C2xSetTokenInt(packetHandle, "BasicSafetyMessage", newPath, value.minute.value);
    result = CheckLastError("BasicSafetyMessage", gkFuncRefGet, result);
  }
  else
  {
    if( C2xIsTokenAvailable(packetHandle, "BasicSafetyMessage", newPath) )
    {
      C2xRemoveToken(packetHandle, "BasicSafetyMessage", newPath);
    }
  }

  snprintf(newPath, elcount(newPath), "%s.%s", oldPath, "second");
  if(value.second.isValidFlag==1)
  {
    C2xSetTokenInt(packetHandle, "BasicSafetyMessage", newPath, value.second.value);
    result = CheckLastError("BasicSafetyMessage", gkFuncRefGet, result);
  }
  else
  {
    if( C2xIsTokenAvailable(packetHandle, "BasicSafetyMessage", newPath) )
    {
      C2xRemoveToken(packetHandle, "BasicSafetyMessage", newPath);
    }
  }

  snprintf(newPath, elcount(newPath), "%s.%s", oldPath, "offset");
  if(value.offset.isValidFlag==1)
  {
    C2xSetTokenInt(packetHandle, "BasicSafetyMessage", newPath, value.offset.value);
    result = CheckLastError("BasicSafetyMessage", gkFuncRefGet, result);
  }
  else
  {
    if( C2xIsTokenAvailable(packetHandle, "BasicSafetyMessage", newPath) )
    {
      C2xRemoveToken(packetHandle, "BasicSafetyMessage", newPath);
    }
  }

  return result;
}

int GetBasicSafetyMessageFullPositionVectorParams(LONG packetHandle, struct BasicSafetyMessageFullPositionVector value, char oldPath[])
{
  char newPath[300];
  int result;

  result = 0;

  snprintf(newPath, elcount(newPath), "%s.%s", oldPath, "utcTime");
  value.utcTime.isValidFlag = C2xIsTokenAvailable(packetHandle, "BasicSafetyMessage", newPath);
  if(value.utcTime.isValidFlag==1)
  {
    GetBasicSafetyMessageDDateTimeParams(packetHandle, value.utcTime, newPath);
    result = CheckLastError("BasicSafetyMessage", gkFuncRefGet, result);
  }
  snprintf(newPath, elcount(newPath), "%s.%s", oldPath, "pos");
  GetBasicSafetyMessagePosition3DParams(packetHandle, value.pos, newPath);
  result = CheckLastError("BasicSafetyMessage", gkFuncRefGet, result);

  snprintf(newPath, elcount(newPath), "%s.%s", oldPath, "heading");
  value.heading.isValidFlag = C2xIsTokenAvailable(packetHandle, "BasicSafetyMessage", newPath);
  if(value.heading.isValidFlag==1)
  {
    value.heading.value = C2xGetTokenInt(packetHandle, "BasicSafetyMessage", newPath);
    result = CheckLastError("BasicSafetyMessage", gkFuncRefGet, result);
  }
  snprintf(newPath, elcount(newPath), "%s.%s", oldPath, "transmission");
  value.transmission.isValidFlag = C2xIsTokenAvailable(packetHandle, "BasicSafetyMessage", newPath);
  if(value.transmission.isValidFlag==1)
  {
    value.transmission.value = C2xGetTokenInt(packetHandle, "BasicSafetyMessage", newPath);
    result = CheckLastError("BasicSafetyMessage", gkFuncRefGet, result);
  }
  snprintf(newPath, elcount(newPath), "%s.%s", oldPath, "speed");
  value.speed.isValidFlag = C2xIsTokenAvailable(packetHandle, "BasicSafetyMessage", newPath);
  if(value.speed.isValidFlag==1)
  {
    value.speed.value = C2xGetTokenInt(packetHandle, "BasicSafetyMessage", newPath);
    result = CheckLastError("BasicSafetyMessage", gkFuncRefGet, result);
  }
  snprintf(newPath, elcount(newPath), "%s.%s", oldPath, "posAccuracy");
  value.posAccuracy.isValidFlag = C2xIsTokenAvailable(packetHandle, "BasicSafetyMessage", newPath);
  if(value.posAccuracy.isValidFlag==1)
  {
    GetBasicSafetyMessagePositionConfidenceSetParams(packetHandle, value.posAccuracy, newPath);
    result = CheckLastError("BasicSafetyMessage", gkFuncRefGet, result);
  }
  snprintf(newPath, elcount(newPath), "%s.%s", oldPath, "timeConfidence");
  value.timeConfidence.isValidFlag = C2xIsTokenAvailable(packetHandle, "BasicSafetyMessage", newPath);
  if(value.timeConfidence.isValidFlag==1)
  {
    value.timeConfidence.value = C2xGetTokenInt(packetHandle, "BasicSafetyMessage", newPath);
    result = CheckLastError("BasicSafetyMessage", gkFuncRefGet, result);
  }
  snprintf(newPath, elcount(newPath), "%s.%s", oldPath, "posConfidence");
  value.posConfidence.isValidFlag = C2xIsTokenAvailable(packetHandle, "BasicSafetyMessage", newPath);
  if(value.posConfidence.isValidFlag==1)
  {
    GetBasicSafetyMessagePositionConfidenceSetParams(packetHandle, value.posConfidence, newPath);
    result = CheckLastError("BasicSafetyMessage", gkFuncRefGet, result);
  }
  snprintf(newPath, elcount(newPath), "%s.%s", oldPath, "motionCfd");
  value.motionCfd.isValidFlag = C2xIsTokenAvailable(packetHandle, "BasicSafetyMessage", newPath);
  if(value.motionCfd.isValidFlag==1)
  {
    GetBasicSafetyMessageMotionConfidenceSetParams(packetHandle, value.motionCfd, newPath);
    result = CheckLastError("BasicSafetyMessage", gkFuncRefGet, result);
  }
  return result;
}

int SetBasicSafetyMessageFullPositionVectorParams(LONG packetHandle, struct BasicSafetyMessageFullPositionVector value, char oldPath[])
{
  char newPath[300];
  int result;

  result = 0;

  snprintf(newPath, elcount(newPath), "%s.%s", oldPath, "utcTime");
  if(value.utcTime.isValidFlag==1)
  {
    SetBasicSafetyMessageDDateTimeParams(packetHandle, value.utcTime, newPath);
    result = CheckLastError("BasicSafetyMessage", gkFuncRefGet, result);
  }
  else
  {
    if( C2xIsTokenAvailable(packetHandle, "BasicSafetyMessage", newPath) )
    {
      C2xRemoveToken(packetHandle, "BasicSafetyMessage", newPath);
    }
  }

  snprintf(newPath, elcount(newPath), "%s.%s", oldPath, "pos");
  SetBasicSafetyMessagePosition3DParams(packetHandle, value.pos, newPath);
  result = CheckLastError("BasicSafetyMessage", gkFuncRefGet, result);

  snprintf(newPath, elcount(newPath), "%s.%s", oldPath, "heading");
  if(value.heading.isValidFlag==1)
  {
    C2xSetTokenInt(packetHandle, "BasicSafetyMessage", newPath, value.heading.value);
    result = CheckLastError("BasicSafetyMessage", gkFuncRefGet, result);
  }
  else
  {
    if( C2xIsTokenAvailable(packetHandle, "BasicSafetyMessage", newPath) )
    {
      C2xRemoveToken(packetHandle, "BasicSafetyMessage", newPath);
    }
  }

  snprintf(newPath, elcount(newPath), "%s.%s", oldPath, "transmission");
  if(value.transmission.isValidFlag==1)
  {
    C2xSetTokenInt(packetHandle, "BasicSafetyMessage", newPath, value.transmission.value);
    result = CheckLastError("BasicSafetyMessage", gkFuncRefGet, result);
  }
  else
  {
    if( C2xIsTokenAvailable(packetHandle, "BasicSafetyMessage", newPath) )
    {
      C2xRemoveToken(packetHandle, "BasicSafetyMessage", newPath);
    }
  }

  snprintf(newPath, elcount(newPath), "%s.%s", oldPath, "speed");
  if(value.speed.isValidFlag==1)
  {
    C2xSetTokenInt(packetHandle, "BasicSafetyMessage", newPath, value.speed.value);
    result = CheckLastError("BasicSafetyMessage", gkFuncRefGet, result);
  }
  else
  {
    if( C2xIsTokenAvailable(packetHandle, "BasicSafetyMessage", newPath) )
    {
      C2xRemoveToken(packetHandle, "BasicSafetyMessage", newPath);
    }
  }

  snprintf(newPath, elcount(newPath), "%s.%s", oldPath, "posAccuracy");
  if(value.posAccuracy.isValidFlag==1)
  {
    SetBasicSafetyMessagePositionConfidenceSetParams(packetHandle, value.posAccuracy, newPath);
    result = CheckLastError("BasicSafetyMessage", gkFuncRefGet, result);
  }
  else
  {
    if( C2xIsTokenAvailable(packetHandle, "BasicSafetyMessage", newPath) )
    {
      C2xRemoveToken(packetHandle, "BasicSafetyMessage", newPath);
    }
  }

  snprintf(newPath, elcount(newPath), "%s.%s", oldPath, "timeConfidence");
  if(value.timeConfidence.isValidFlag==1)
  {
    C2xSetTokenInt(packetHandle, "BasicSafetyMessage", newPath, value.timeConfidence.value);
    result = CheckLastError("BasicSafetyMessage", gkFuncRefGet, result);
  }
  else
  {
    if( C2xIsTokenAvailable(packetHandle, "BasicSafetyMessage", newPath) )
    {
      C2xRemoveToken(packetHandle, "BasicSafetyMessage", newPath);
    }
  }

  snprintf(newPath, elcount(newPath), "%s.%s", oldPath, "posConfidence");
  if(value.posConfidence.isValidFlag==1)
  {
    SetBasicSafetyMessagePositionConfidenceSetParams(packetHandle, value.posConfidence, newPath);
    result = CheckLastError("BasicSafetyMessage", gkFuncRefGet, result);
  }
  else
  {
    if( C2xIsTokenAvailable(packetHandle, "BasicSafetyMessage", newPath) )
    {
      C2xRemoveToken(packetHandle, "BasicSafetyMessage", newPath);
    }
  }

  snprintf(newPath, elcount(newPath), "%s.%s", oldPath, "motionCfd");
  if(value.motionCfd.isValidFlag==1)
  {
    SetBasicSafetyMessageMotionConfidenceSetParams(packetHandle, value.motionCfd, newPath);
    result = CheckLastError("BasicSafetyMessage", gkFuncRefGet, result);
  }
  else
  {
    if( C2xIsTokenAvailable(packetHandle, "BasicSafetyMessage", newPath) )
    {
      C2xRemoveToken(packetHandle, "BasicSafetyMessage", newPath);
    }
  }

  return result;
}

int GetBasicSafetyMessagePosition_LL_24BParams(LONG packetHandle, struct BasicSafetyMessagePosition_LL_24B value, char oldPath[])
{
  char newPath[300];
  int result;

  result = 0;

  snprintf(newPath, elcount(newPath), "%s.%s", oldPath, "lon");
  value.lon = C2xGetTokenInt(packetHandle, "BasicSafetyMessage", newPath);
  result = CheckLastError("BasicSafetyMessage", gkFuncRefGet, result);

  snprintf(newPath, elcount(newPath), "%s.%s", oldPath, "lat");
  value.lat = C2xGetTokenInt(packetHandle, "BasicSafetyMessage", newPath);
  result = CheckLastError("BasicSafetyMessage", gkFuncRefGet, result);

  return result;
}

int SetBasicSafetyMessagePosition_LL_24BParams(LONG packetHandle, struct BasicSafetyMessagePosition_LL_24B value, char oldPath[])
{
  char newPath[300];
  int result;

  result = 0;

  snprintf(newPath, elcount(newPath), "%s.%s", oldPath, "lon");
  C2xSetTokenInt(packetHandle, "BasicSafetyMessage", newPath, value.lon);
  result = CheckLastError("BasicSafetyMessage", gkFuncRefGet, result);

  snprintf(newPath, elcount(newPath), "%s.%s", oldPath, "lat");
  C2xSetTokenInt(packetHandle, "BasicSafetyMessage", newPath, value.lat);
  result = CheckLastError("BasicSafetyMessage", gkFuncRefGet, result);

  return result;
}

int GetBasicSafetyMessagePosition_LL_28BParams(LONG packetHandle, struct BasicSafetyMessagePosition_LL_28B value, char oldPath[])
{
  char newPath[300];
  int result;

  result = 0;

  snprintf(newPath, elcount(newPath), "%s.%s", oldPath, "lon");
  value.lon = C2xGetTokenInt(packetHandle, "BasicSafetyMessage", newPath);
  result = CheckLastError("BasicSafetyMessage", gkFuncRefGet, result);

  snprintf(newPath, elcount(newPath), "%s.%s", oldPath, "lat");
  value.lat = C2xGetTokenInt(packetHandle, "BasicSafetyMessage", newPath);
  result = CheckLastError("BasicSafetyMessage", gkFuncRefGet, result);

  return result;
}

int SetBasicSafetyMessagePosition_LL_28BParams(LONG packetHandle, struct BasicSafetyMessagePosition_LL_28B value, char oldPath[])
{
  char newPath[300];
  int result;

  result = 0;

  snprintf(newPath, elcount(newPath), "%s.%s", oldPath, "lon");
  C2xSetTokenInt(packetHandle, "BasicSafetyMessage", newPath, value.lon);
  result = CheckLastError("BasicSafetyMessage", gkFuncRefGet, result);

  snprintf(newPath, elcount(newPath), "%s.%s", oldPath, "lat");
  C2xSetTokenInt(packetHandle, "BasicSafetyMessage", newPath, value.lat);
  result = CheckLastError("BasicSafetyMessage", gkFuncRefGet, result);

  return result;
}

int GetBasicSafetyMessagePosition_LL_32BParams(LONG packetHandle, struct BasicSafetyMessagePosition_LL_32B value, char oldPath[])
{
  char newPath[300];
  int result;

  result = 0;

  snprintf(newPath, elcount(newPath), "%s.%s", oldPath, "lon");
  value.lon = C2xGetTokenInt(packetHandle, "BasicSafetyMessage", newPath);
  result = CheckLastError("BasicSafetyMessage", gkFuncRefGet, result);

  snprintf(newPath, elcount(newPath), "%s.%s", oldPath, "lat");
  value.lat = C2xGetTokenInt(packetHandle, "BasicSafetyMessage", newPath);
  result = CheckLastError("BasicSafetyMessage", gkFuncRefGet, result);

  return result;
}

int SetBasicSafetyMessagePosition_LL_32BParams(LONG packetHandle, struct BasicSafetyMessagePosition_LL_32B value, char oldPath[])
{
  char newPath[300];
  int result;

  result = 0;

  snprintf(newPath, elcount(newPath), "%s.%s", oldPath, "lon");
  C2xSetTokenInt(packetHandle, "BasicSafetyMessage", newPath, value.lon);
  result = CheckLastError("BasicSafetyMessage", gkFuncRefGet, result);

  snprintf(newPath, elcount(newPath), "%s.%s", oldPath, "lat");
  C2xSetTokenInt(packetHandle, "BasicSafetyMessage", newPath, value.lat);
  result = CheckLastError("BasicSafetyMessage", gkFuncRefGet, result);

  return result;
}

int GetBasicSafetyMessagePosition_LL_36BParams(LONG packetHandle, struct BasicSafetyMessagePosition_LL_36B value, char oldPath[])
{
  char newPath[300];
  int result;

  result = 0;

  snprintf(newPath, elcount(newPath), "%s.%s", oldPath, "lon");
  value.lon = C2xGetTokenInt(packetHandle, "BasicSafetyMessage", newPath);
  result = CheckLastError("BasicSafetyMessage", gkFuncRefGet, result);

  snprintf(newPath, elcount(newPath), "%s.%s", oldPath, "lat");
  value.lat = C2xGetTokenInt(packetHandle, "BasicSafetyMessage", newPath);
  result = CheckLastError("BasicSafetyMessage", gkFuncRefGet, result);

  return result;
}

int SetBasicSafetyMessagePosition_LL_36BParams(LONG packetHandle, struct BasicSafetyMessagePosition_LL_36B value, char oldPath[])
{
  char newPath[300];
  int result;

  result = 0;

  snprintf(newPath, elcount(newPath), "%s.%s", oldPath, "lon");
  C2xSetTokenInt(packetHandle, "BasicSafetyMessage", newPath, value.lon);
  result = CheckLastError("BasicSafetyMessage", gkFuncRefGet, result);

  snprintf(newPath, elcount(newPath), "%s.%s", oldPath, "lat");
  C2xSetTokenInt(packetHandle, "BasicSafetyMessage", newPath, value.lat);
  result = CheckLastError("BasicSafetyMessage", gkFuncRefGet, result);

  return result;
}

int GetBasicSafetyMessagePosition_LL_44BParams(LONG packetHandle, struct BasicSafetyMessagePosition_LL_44B value, char oldPath[])
{
  char newPath[300];
  int result;

  result = 0;

  snprintf(newPath, elcount(newPath), "%s.%s", oldPath, "lon");
  value.lon = C2xGetTokenInt(packetHandle, "BasicSafetyMessage", newPath);
  result = CheckLastError("BasicSafetyMessage", gkFuncRefGet, result);

  snprintf(newPath, elcount(newPath), "%s.%s", oldPath, "lat");
  value.lat = C2xGetTokenInt(packetHandle, "BasicSafetyMessage", newPath);
  result = CheckLastError("BasicSafetyMessage", gkFuncRefGet, result);

  return result;
}

int SetBasicSafetyMessagePosition_LL_44BParams(LONG packetHandle, struct BasicSafetyMessagePosition_LL_44B value, char oldPath[])
{
  char newPath[300];
  int result;

  result = 0;

  snprintf(newPath, elcount(newPath), "%s.%s", oldPath, "lon");
  C2xSetTokenInt(packetHandle, "BasicSafetyMessage", newPath, value.lon);
  result = CheckLastError("BasicSafetyMessage", gkFuncRefGet, result);

  snprintf(newPath, elcount(newPath), "%s.%s", oldPath, "lat");
  C2xSetTokenInt(packetHandle, "BasicSafetyMessage", newPath, value.lat);
  result = CheckLastError("BasicSafetyMessage", gkFuncRefGet, result);

  return result;
}

int GetBasicSafetyMessagePosition_LL_48BParams(LONG packetHandle, struct BasicSafetyMessagePosition_LL_48B value, char oldPath[])
{
  char newPath[300];
  int result;

  result = 0;

  snprintf(newPath, elcount(newPath), "%s.%s", oldPath, "lon");
  value.lon = C2xGetTokenInt(packetHandle, "BasicSafetyMessage", newPath);
  result = CheckLastError("BasicSafetyMessage", gkFuncRefGet, result);

  snprintf(newPath, elcount(newPath), "%s.%s", oldPath, "lat");
  value.lat = C2xGetTokenInt(packetHandle, "BasicSafetyMessage", newPath);
  result = CheckLastError("BasicSafetyMessage", gkFuncRefGet, result);

  return result;
}

int SetBasicSafetyMessagePosition_LL_48BParams(LONG packetHandle, struct BasicSafetyMessagePosition_LL_48B value, char oldPath[])
{
  char newPath[300];
  int result;

  result = 0;

  snprintf(newPath, elcount(newPath), "%s.%s", oldPath, "lon");
  C2xSetTokenInt(packetHandle, "BasicSafetyMessage", newPath, value.lon);
  result = CheckLastError("BasicSafetyMessage", gkFuncRefGet, result);

  snprintf(newPath, elcount(newPath), "%s.%s", oldPath, "lat");
  C2xSetTokenInt(packetHandle, "BasicSafetyMessage", newPath, value.lat);
  result = CheckLastError("BasicSafetyMessage", gkFuncRefGet, result);

  return result;
}

int GetBasicSafetyMessagePosition_LLmD_64bParams(LONG packetHandle, struct BasicSafetyMessagePosition_LLmD_64b value, char oldPath[])
{
  char newPath[300];
  int result;

  result = 0;

  snprintf(newPath, elcount(newPath), "%s.%s", oldPath, "lon");
  value.lon = C2xGetTokenInt(packetHandle, "BasicSafetyMessage", newPath);
  result = CheckLastError("BasicSafetyMessage", gkFuncRefGet, result);

  snprintf(newPath, elcount(newPath), "%s.%s", oldPath, "lat");
  value.lat = C2xGetTokenInt(packetHandle, "BasicSafetyMessage", newPath);
  result = CheckLastError("BasicSafetyMessage", gkFuncRefGet, result);

  return result;
}

int SetBasicSafetyMessagePosition_LLmD_64bParams(LONG packetHandle, struct BasicSafetyMessagePosition_LLmD_64b value, char oldPath[])
{
  char newPath[300];
  int result;

  result = 0;

  snprintf(newPath, elcount(newPath), "%s.%s", oldPath, "lon");
  C2xSetTokenInt(packetHandle, "BasicSafetyMessage", newPath, value.lon);
  result = CheckLastError("BasicSafetyMessage", gkFuncRefGet, result);

  snprintf(newPath, elcount(newPath), "%s.%s", oldPath, "lat");
  C2xSetTokenInt(packetHandle, "BasicSafetyMessage", newPath, value.lat);
  result = CheckLastError("BasicSafetyMessage", gkFuncRefGet, result);

  return result;
}

int GetBasicSafetyMessagePositionOffsetLLParams(LONG packetHandle, struct BasicSafetyMessagePositionOffsetLL value, char oldPath[])
{
  char newPath[300];
  int result;

  result = 0;

  value.choice = C2xGetTokenInt(packetHandle, "BasicSafetyMessage", oldPath);

  switch(value.choice)
  {
    case 0:
    {
      snprintf(newPath, elcount(newPath), "%s.%s", oldPath, "position_LL1");
      GetBasicSafetyMessagePosition_LL_24BParams(packetHandle, value.position_LL1, newPath);
      result = CheckLastError("BasicSafetyMessage", gkFuncRefGet, result);
    }
    break;
    case 1:
    {
      snprintf(newPath, elcount(newPath), "%s.%s", oldPath, "position_LL2");
      GetBasicSafetyMessagePosition_LL_28BParams(packetHandle, value.position_LL2, newPath);
      result = CheckLastError("BasicSafetyMessage", gkFuncRefGet, result);
    }
    break;
    case 2:
    {
      snprintf(newPath, elcount(newPath), "%s.%s", oldPath, "position_LL3");
      GetBasicSafetyMessagePosition_LL_32BParams(packetHandle, value.position_LL3, newPath);
      result = CheckLastError("BasicSafetyMessage", gkFuncRefGet, result);
    }
    break;
    case 3:
    {
      snprintf(newPath, elcount(newPath), "%s.%s", oldPath, "position_LL4");
      GetBasicSafetyMessagePosition_LL_36BParams(packetHandle, value.position_LL4, newPath);
      result = CheckLastError("BasicSafetyMessage", gkFuncRefGet, result);
    }
    break;
    case 4:
    {
      snprintf(newPath, elcount(newPath), "%s.%s", oldPath, "position_LL5");
      GetBasicSafetyMessagePosition_LL_44BParams(packetHandle, value.position_LL5, newPath);
      result = CheckLastError("BasicSafetyMessage", gkFuncRefGet, result);
    }
    break;
    case 5:
    {
      snprintf(newPath, elcount(newPath), "%s.%s", oldPath, "position_LL6");
      GetBasicSafetyMessagePosition_LL_48BParams(packetHandle, value.position_LL6, newPath);
      result = CheckLastError("BasicSafetyMessage", gkFuncRefGet, result);
    }
    break;
    case 6:
    {
      snprintf(newPath, elcount(newPath), "%s.%s", oldPath, "position_LatLon");
      GetBasicSafetyMessagePosition_LLmD_64bParams(packetHandle, value.position_LatLon, newPath);
      result = CheckLastError("BasicSafetyMessage", gkFuncRefGet, result);
    }
    break;
  }
  return result;
}

int SetBasicSafetyMessagePositionOffsetLLParams(LONG packetHandle, struct BasicSafetyMessagePositionOffsetLL value, char oldPath[])
{
  char newPath[300];
  int result;

  result = 0;

  switch(value.choice)
  {
    case 0:
    {
      snprintf(newPath, elcount(newPath), "%s.%s", oldPath, "position_LL1");
      SetBasicSafetyMessagePosition_LL_24BParams(packetHandle, value.position_LL1, newPath);
      result = CheckLastError("BasicSafetyMessage", gkFuncRefGet, result);
    }
    break;
    case 1:
    {
      snprintf(newPath, elcount(newPath), "%s.%s", oldPath, "position_LL2");
      SetBasicSafetyMessagePosition_LL_28BParams(packetHandle, value.position_LL2, newPath);
      result = CheckLastError("BasicSafetyMessage", gkFuncRefGet, result);
    }
    break;
    case 2:
    {
      snprintf(newPath, elcount(newPath), "%s.%s", oldPath, "position_LL3");
      SetBasicSafetyMessagePosition_LL_32BParams(packetHandle, value.position_LL3, newPath);
      result = CheckLastError("BasicSafetyMessage", gkFuncRefGet, result);
    }
    break;
    case 3:
    {
      snprintf(newPath, elcount(newPath), "%s.%s", oldPath, "position_LL4");
      SetBasicSafetyMessagePosition_LL_36BParams(packetHandle, value.position_LL4, newPath);
      result = CheckLastError("BasicSafetyMessage", gkFuncRefGet, result);
    }
    break;
    case 4:
    {
      snprintf(newPath, elcount(newPath), "%s.%s", oldPath, "position_LL5");
      SetBasicSafetyMessagePosition_LL_44BParams(packetHandle, value.position_LL5, newPath);
      result = CheckLastError("BasicSafetyMessage", gkFuncRefGet, result);
    }
    break;
    case 5:
    {
      snprintf(newPath, elcount(newPath), "%s.%s", oldPath, "position_LL6");
      SetBasicSafetyMessagePosition_LL_48BParams(packetHandle, value.position_LL6, newPath);
      result = CheckLastError("BasicSafetyMessage", gkFuncRefGet, result);
    }
    break;
    case 6:
    {
      snprintf(newPath, elcount(newPath), "%s.%s", oldPath, "position_LatLon");
      SetBasicSafetyMessagePosition_LLmD_64bParams(packetHandle, value.position_LatLon, newPath);
      result = CheckLastError("BasicSafetyMessage", gkFuncRefGet, result);
    }
    break;
  }
  return result;
}

int GetBasicSafetyMessageVerticalOffsetParams(LONG packetHandle, struct BasicSafetyMessageVerticalOffset value, char oldPath[])
{
  char newPath[300];
  int result;

  result = 0;

  value.choice = C2xGetTokenInt(packetHandle, "BasicSafetyMessage", oldPath);

  switch(value.choice)
  {
    case 0:
    {
      snprintf(newPath, elcount(newPath), "%s.%s", oldPath, "offset1");
      value.offset1 = C2xGetTokenInt(packetHandle, "BasicSafetyMessage", newPath);
      result = CheckLastError("BasicSafetyMessage", gkFuncRefGet, result);
    }
    break;
    case 1:
    {
      snprintf(newPath, elcount(newPath), "%s.%s", oldPath, "offset2");
      value.offset2 = C2xGetTokenInt(packetHandle, "BasicSafetyMessage", newPath);
      result = CheckLastError("BasicSafetyMessage", gkFuncRefGet, result);
    }
    break;
    case 2:
    {
      snprintf(newPath, elcount(newPath), "%s.%s", oldPath, "offset3");
      value.offset3 = C2xGetTokenInt(packetHandle, "BasicSafetyMessage", newPath);
      result = CheckLastError("BasicSafetyMessage", gkFuncRefGet, result);
    }
    break;
    case 3:
    {
      snprintf(newPath, elcount(newPath), "%s.%s", oldPath, "offset4");
      value.offset4 = C2xGetTokenInt(packetHandle, "BasicSafetyMessage", newPath);
      result = CheckLastError("BasicSafetyMessage", gkFuncRefGet, result);
    }
    break;
    case 4:
    {
      snprintf(newPath, elcount(newPath), "%s.%s", oldPath, "offset5");
      value.offset5 = C2xGetTokenInt(packetHandle, "BasicSafetyMessage", newPath);
      result = CheckLastError("BasicSafetyMessage", gkFuncRefGet, result);
    }
    break;
    case 5:
    {
      snprintf(newPath, elcount(newPath), "%s.%s", oldPath, "offset6");
      value.offset6 = C2xGetTokenInt(packetHandle, "BasicSafetyMessage", newPath);
      result = CheckLastError("BasicSafetyMessage", gkFuncRefGet, result);
    }
    break;
    case 6:
    {
      snprintf(newPath, elcount(newPath), "%s.%s", oldPath, "elevation");
      value.elevation = C2xGetTokenInt(packetHandle, "BasicSafetyMessage", newPath);
      result = CheckLastError("BasicSafetyMessage", gkFuncRefGet, result);
    }
    break;
  }
  return result;
}

int SetBasicSafetyMessageVerticalOffsetParams(LONG packetHandle, struct BasicSafetyMessageVerticalOffset value, char oldPath[])
{
  char newPath[300];
  int result;

  result = 0;

  switch(value.choice)
  {
    case 0:
    {
      snprintf(newPath, elcount(newPath), "%s.%s", oldPath, "offset1");
      C2xSetTokenInt(packetHandle, "BasicSafetyMessage", newPath, value.offset1);
      result = CheckLastError("BasicSafetyMessage", gkFuncRefGet, result);
    }
    break;
    case 1:
    {
      snprintf(newPath, elcount(newPath), "%s.%s", oldPath, "offset2");
      C2xSetTokenInt(packetHandle, "BasicSafetyMessage", newPath, value.offset2);
      result = CheckLastError("BasicSafetyMessage", gkFuncRefGet, result);
    }
    break;
    case 2:
    {
      snprintf(newPath, elcount(newPath), "%s.%s", oldPath, "offset3");
      C2xSetTokenInt(packetHandle, "BasicSafetyMessage", newPath, value.offset3);
      result = CheckLastError("BasicSafetyMessage", gkFuncRefGet, result);
    }
    break;
    case 3:
    {
      snprintf(newPath, elcount(newPath), "%s.%s", oldPath, "offset4");
      C2xSetTokenInt(packetHandle, "BasicSafetyMessage", newPath, value.offset4);
      result = CheckLastError("BasicSafetyMessage", gkFuncRefGet, result);
    }
    break;
    case 4:
    {
      snprintf(newPath, elcount(newPath), "%s.%s", oldPath, "offset5");
      C2xSetTokenInt(packetHandle, "BasicSafetyMessage", newPath, value.offset5);
      result = CheckLastError("BasicSafetyMessage", gkFuncRefGet, result);
    }
    break;
    case 5:
    {
      snprintf(newPath, elcount(newPath), "%s.%s", oldPath, "offset6");
      C2xSetTokenInt(packetHandle, "BasicSafetyMessage", newPath, value.offset6);
      result = CheckLastError("BasicSafetyMessage", gkFuncRefGet, result);
    }
    break;
    case 6:
    {
      snprintf(newPath, elcount(newPath), "%s.%s", oldPath, "elevation");
      C2xSetTokenInt(packetHandle, "BasicSafetyMessage", newPath, value.elevation);
      result = CheckLastError("BasicSafetyMessage", gkFuncRefGet, result);
    }
    break;
  }
  return result;
}

int GetBasicSafetyMessagePositionOffsetLLVParams(LONG packetHandle, struct BasicSafetyMessagePositionOffsetLLV value, char oldPath[])
{
  char newPath[300];
  int result;

  result = 0;

  snprintf(newPath, elcount(newPath), "%s.%s", oldPath, "offsetLL");
  GetBasicSafetyMessagePositionOffsetLLParams(packetHandle, value.offsetLL, newPath);
  result = CheckLastError("BasicSafetyMessage", gkFuncRefGet, result);

  snprintf(newPath, elcount(newPath), "%s.%s", oldPath, "offsetV");
  value.offsetV.isValidFlag = C2xIsTokenAvailable(packetHandle, "BasicSafetyMessage", newPath);
  if(value.offsetV.isValidFlag==1)
  {
    GetBasicSafetyMessageVerticalOffsetParams(packetHandle, value.offsetV, newPath);
    result = CheckLastError("BasicSafetyMessage", gkFuncRefGet, result);
  }
  return result;
}

int SetBasicSafetyMessagePositionOffsetLLVParams(LONG packetHandle, struct BasicSafetyMessagePositionOffsetLLV value, char oldPath[])
{
  char newPath[300];
  int result;

  result = 0;

  snprintf(newPath, elcount(newPath), "%s.%s", oldPath, "offsetLL");
  SetBasicSafetyMessagePositionOffsetLLParams(packetHandle, value.offsetLL, newPath);
  result = CheckLastError("BasicSafetyMessage", gkFuncRefGet, result);

  snprintf(newPath, elcount(newPath), "%s.%s", oldPath, "offsetV");
  if(value.offsetV.isValidFlag==1)
  {
    SetBasicSafetyMessageVerticalOffsetParams(packetHandle, value.offsetV, newPath);
    result = CheckLastError("BasicSafetyMessage", gkFuncRefGet, result);
  }
  else
  {
    if( C2xIsTokenAvailable(packetHandle, "BasicSafetyMessage", newPath) )
    {
      C2xRemoveToken(packetHandle, "BasicSafetyMessage", newPath);
    }
  }

  return result;
}

int GetBasicSafetyMessagePathHistoryPointParams(LONG packetHandle, struct BasicSafetyMessagePathHistoryPoint value, char oldPath[])
{
  char newPath[300];
  int result;

  result = 0;

  snprintf(newPath, elcount(newPath), "%s.%s", oldPath, "llvOffset");
  GetBasicSafetyMessagePositionOffsetLLVParams(packetHandle, value.llvOffset, newPath);
  result = CheckLastError("BasicSafetyMessage", gkFuncRefGet, result);

  snprintf(newPath, elcount(newPath), "%s.%s", oldPath, "timeOffset");
  value.timeOffset = C2xGetTokenInt(packetHandle, "BasicSafetyMessage", newPath);
  result = CheckLastError("BasicSafetyMessage", gkFuncRefGet, result);

  snprintf(newPath, elcount(newPath), "%s.%s", oldPath, "speed");
  value.speed.isValidFlag = C2xIsTokenAvailable(packetHandle, "BasicSafetyMessage", newPath);
  if(value.speed.isValidFlag==1)
  {
    value.speed.value = C2xGetTokenInt(packetHandle, "BasicSafetyMessage", newPath);
    result = CheckLastError("BasicSafetyMessage", gkFuncRefGet, result);
  }
  snprintf(newPath, elcount(newPath), "%s.%s", oldPath, "posAccuracy");
  value.posAccuracy.isValidFlag = C2xIsTokenAvailable(packetHandle, "BasicSafetyMessage", newPath);
  if(value.posAccuracy.isValidFlag==1)
  {
    GetBasicSafetyMessagePositionConfidenceSetParams(packetHandle, value.posAccuracy, newPath);
    result = CheckLastError("BasicSafetyMessage", gkFuncRefGet, result);
  }
  snprintf(newPath, elcount(newPath), "%s.%s", oldPath, "heading");
  value.heading.isValidFlag = C2xIsTokenAvailable(packetHandle, "BasicSafetyMessage", newPath);
  if(value.heading.isValidFlag==1)
  {
    value.heading.value = C2xGetTokenInt(packetHandle, "BasicSafetyMessage", newPath);
    result = CheckLastError("BasicSafetyMessage", gkFuncRefGet, result);
  }
  return result;
}

int SetBasicSafetyMessagePathHistoryPointParams(LONG packetHandle, struct BasicSafetyMessagePathHistoryPoint value, char oldPath[])
{
  char newPath[300];
  int result;

  result = 0;

  snprintf(newPath, elcount(newPath), "%s.%s", oldPath, "llvOffset");
  SetBasicSafetyMessagePositionOffsetLLVParams(packetHandle, value.llvOffset, newPath);
  result = CheckLastError("BasicSafetyMessage", gkFuncRefGet, result);

  snprintf(newPath, elcount(newPath), "%s.%s", oldPath, "timeOffset");
  C2xSetTokenInt(packetHandle, "BasicSafetyMessage", newPath, value.timeOffset);
  result = CheckLastError("BasicSafetyMessage", gkFuncRefGet, result);

  snprintf(newPath, elcount(newPath), "%s.%s", oldPath, "speed");
  if(value.speed.isValidFlag==1)
  {
    C2xSetTokenInt(packetHandle, "BasicSafetyMessage", newPath, value.speed.value);
    result = CheckLastError("BasicSafetyMessage", gkFuncRefGet, result);
  }
  else
  {
    if( C2xIsTokenAvailable(packetHandle, "BasicSafetyMessage", newPath) )
    {
      C2xRemoveToken(packetHandle, "BasicSafetyMessage", newPath);
    }
  }

  snprintf(newPath, elcount(newPath), "%s.%s", oldPath, "posAccuracy");
  if(value.posAccuracy.isValidFlag==1)
  {
    SetBasicSafetyMessagePositionConfidenceSetParams(packetHandle, value.posAccuracy, newPath);
    result = CheckLastError("BasicSafetyMessage", gkFuncRefGet, result);
  }
  else
  {
    if( C2xIsTokenAvailable(packetHandle, "BasicSafetyMessage", newPath) )
    {
      C2xRemoveToken(packetHandle, "BasicSafetyMessage", newPath);
    }
  }

  snprintf(newPath, elcount(newPath), "%s.%s", oldPath, "heading");
  if(value.heading.isValidFlag==1)
  {
    C2xSetTokenInt(packetHandle, "BasicSafetyMessage", newPath, value.heading.value);
    result = CheckLastError("BasicSafetyMessage", gkFuncRefGet, result);
  }
  else
  {
    if( C2xIsTokenAvailable(packetHandle, "BasicSafetyMessage", newPath) )
    {
      C2xRemoveToken(packetHandle, "BasicSafetyMessage", newPath);
    }
  }

  return result;
}

int GetBasicSafetyMessagePathHistoryPointListParams(LONG packetHandle, struct BasicSafetyMessagePathHistoryPointList value, char oldPath[])
{
  char newPath[300]; 
  int i;
  int result;

  result = 0;

  value.length = C2xGetTokenInt(packetHandle, "BasicSafetyMessage", oldPath);
  if((result = CheckLastError("BasicSafetyMessage", gkFuncRefGet, result))==0)
  {
    for(i=0; i<value.length; i++)
    {
      snprintf(newPath, elcount(newPath), "%s[%d]", oldPath, i);
      GetBasicSafetyMessagePathHistoryPointParams(packetHandle, value.arrayValue[i], newPath);
      result = CheckLastError("BasicSafetyMessage", gkFuncRefGet, result);
    }
  }
  return result;
}

int SetBasicSafetyMessagePathHistoryPointListParams(LONG packetHandle, struct BasicSafetyMessagePathHistoryPointList value, char oldPath[])
{
  char newPath[300]; 
  int i;
  int result;

  result = 0;

  C2xRemoveToken(packetHandle, "BasicSafetyMessage", oldPath);
  for(i=0; i<value.length; i++)
  {
    snprintf(newPath, elcount(newPath), "%s[%d]", oldPath, i);
    SetBasicSafetyMessagePathHistoryPointParams(packetHandle, value.arrayValue[i], newPath);
    result = CheckLastError("BasicSafetyMessage", gkFuncRefGet, result);
  }
  return result;
}

int GetBasicSafetyMessagePathHistoryParams(LONG packetHandle, struct BasicSafetyMessagePathHistory value, char oldPath[])
{
  char newPath[300]; 
  int j; 
  int k;
  int result;

  result = 0;

  snprintf(newPath, elcount(newPath), "%s.%s", oldPath, "initialPosition");
  value.initialPosition.isValidFlag = C2xIsTokenAvailable(packetHandle, "BasicSafetyMessage", newPath);
  if(value.initialPosition.isValidFlag==1)
  {
    GetBasicSafetyMessageFullPositionVectorParams(packetHandle, value.initialPosition, newPath);
    result = CheckLastError("BasicSafetyMessage", gkFuncRefGet, result);
  }
  snprintf(newPath, elcount(newPath), "%s.%s", oldPath, "currGNSSstatus");
  value.currGNSSstatus.isValidFlag = C2xIsTokenAvailable(packetHandle, "BasicSafetyMessage", newPath);
  if(value.currGNSSstatus.isValidFlag==1)
  {
    value.currGNSSstatus.isValidFlag = 1;
    value.currGNSSstatus.stringLength = C2xGetTokenLengthBit(packetHandle, "BasicSafetyMessage", newPath);
    if ((result = CheckLastError("BasicSafetyMessage", gkFuncRefGet, result))==0)
    {
      if(value.currGNSSstatus.stringLength > 0)
      {
        for(j=0; j<value.currGNSSstatus.stringLength; j++)
        {
          if(C2xGetTokenBitOfBitString(packetHandle, "BasicSafetyMessage", newPath, j) == 0)
          {
            value.currGNSSstatus.string[j] = '0';
          }
          else if(C2xGetTokenBitOfBitString(packetHandle, "BasicSafetyMessage", newPath, j) == 1)
          {
            value.currGNSSstatus.string[j] = '1';
          }

          if(value.currGNSSstatus.stringLength == 1)
          {
            value.currGNSSstatus.string[1] = '0';
          }
          result = CheckLastError("BasicSafetyMessage", gkFuncRefGet, result);
        }
      }
      else
      {
        for(k = value.currGNSSstatus.stringLength+1; k > -1; k--)
        {
          if(value.currGNSSstatus.string[k] == '1')
          {
            value.currGNSSstatus.string[k] = '0';
          }
        }
      }
    }

  }
  snprintf(newPath, elcount(newPath), "%s.%s", oldPath, "crumbData");
  GetBasicSafetyMessagePathHistoryPointListParams(packetHandle, value.crumbData, newPath);
  result = CheckLastError("BasicSafetyMessage", gkFuncRefGet, result);

  return result;
}

int SetBasicSafetyMessagePathHistoryParams(LONG packetHandle, struct BasicSafetyMessagePathHistory value, char oldPath[])
{
  char newPath[300]; 
  int j;
  int result;

  result = 0;

  snprintf(newPath, elcount(newPath), "%s.%s", oldPath, "initialPosition");
  if(value.initialPosition.isValidFlag==1)
  {
    SetBasicSafetyMessageFullPositionVectorParams(packetHandle, value.initialPosition, newPath);
    result = CheckLastError("BasicSafetyMessage", gkFuncRefGet, result);
  }
  else
  {
    if( C2xIsTokenAvailable(packetHandle, "BasicSafetyMessage", newPath) )
    {
      C2xRemoveToken(packetHandle, "BasicSafetyMessage", newPath);
    }
  }

  snprintf(newPath, elcount(newPath), "%s.%s", oldPath, "currGNSSstatus");
  if(value.currGNSSstatus.isValidFlag==1)
  {
      for(j=0; j<value.currGNSSstatus.stringLength; j++)
      {
        if(value.currGNSSstatus.string[j] == '0')
        {
          C2xSetTokenBitOfBitString(packetHandle, "BasicSafetyMessage", newPath, j, 0);
        }
        else
        {
          C2xSetTokenBitOfBitString(packetHandle, "BasicSafetyMessage", newPath, j, 1);
        }
        result = CheckLastError("BasicSafetyMessage", gkFuncRefGet, result);
      }
  }
  else
  {
    if( C2xIsTokenAvailable(packetHandle, "BasicSafetyMessage", newPath) )
    {
      C2xRemoveToken(packetHandle, "BasicSafetyMessage", newPath);
    }
  }

  snprintf(newPath, elcount(newPath), "%s.%s", oldPath, "crumbData");
  SetBasicSafetyMessagePathHistoryPointListParams(packetHandle, value.crumbData, newPath);
  result = CheckLastError("BasicSafetyMessage", gkFuncRefGet, result);

  return result;
}

int GetBasicSafetyMessagePathPredictionParams(LONG packetHandle, struct BasicSafetyMessagePathPrediction value, char oldPath[])
{
  char newPath[300];
  int result;

  result = 0;

  snprintf(newPath, elcount(newPath), "%s.%s", oldPath, "radiusOfCurve");
  value.radiusOfCurve = C2xGetTokenInt(packetHandle, "BasicSafetyMessage", newPath);
  result = CheckLastError("BasicSafetyMessage", gkFuncRefGet, result);

  snprintf(newPath, elcount(newPath), "%s.%s", oldPath, "confidence");
  value.confidence = C2xGetTokenInt(packetHandle, "BasicSafetyMessage", newPath);
  result = CheckLastError("BasicSafetyMessage", gkFuncRefGet, result);

  return result;
}

int SetBasicSafetyMessagePathPredictionParams(LONG packetHandle, struct BasicSafetyMessagePathPrediction value, char oldPath[])
{
  char newPath[300];
  int result;

  result = 0;

  snprintf(newPath, elcount(newPath), "%s.%s", oldPath, "radiusOfCurve");
  C2xSetTokenInt(packetHandle, "BasicSafetyMessage", newPath, value.radiusOfCurve);
  result = CheckLastError("BasicSafetyMessage", gkFuncRefGet, result);

  snprintf(newPath, elcount(newPath), "%s.%s", oldPath, "confidence");
  C2xSetTokenInt(packetHandle, "BasicSafetyMessage", newPath, value.confidence);
  result = CheckLastError("BasicSafetyMessage", gkFuncRefGet, result);

  return result;
}

int GetBasicSafetyMessageVehicleSafetyExtensionsParams(LONG packetHandle, struct BasicSafetyMessageVehicleSafetyExtensions value, char oldPath[])
{
  char newPath[300]; 
  int j; 
  int k;
  int result;

  result = 0;

  snprintf(newPath, elcount(newPath), "%s.%s", oldPath, "events");
  value.events.isValidFlag = C2xIsTokenAvailable(packetHandle, "BasicSafetyMessage", newPath);
  if(value.events.isValidFlag==1)
  {
    value.events.isValidFlag = 1;
    value.events.stringLength = C2xGetTokenLengthBit(packetHandle, "BasicSafetyMessage", newPath);
    if ((result = CheckLastError("BasicSafetyMessage", gkFuncRefGet, result))==0)
    {
      if(value.events.stringLength > 0)
      {
        for(j=0; j<value.events.stringLength; j++)
        {
          if(C2xGetTokenBitOfBitString(packetHandle, "BasicSafetyMessage", newPath, j) == 0)
          {
            value.events.string[j] = '0';
          }
          else if(C2xGetTokenBitOfBitString(packetHandle, "BasicSafetyMessage", newPath, j) == 1)
          {
            value.events.string[j] = '1';
          }

          if(value.events.stringLength == 1)
          {
            value.events.string[1] = '0';
          }
          result = CheckLastError("BasicSafetyMessage", gkFuncRefGet, result);
        }
      }
      else
      {
        for(k = value.events.stringLength+1; k > -1; k--)
        {
          if(value.events.string[k] == '1')
          {
            value.events.string[k] = '0';
          }
        }
      }
    }

  }
  snprintf(newPath, elcount(newPath), "%s.%s", oldPath, "pathHistory");
  value.pathHistory.isValidFlag = C2xIsTokenAvailable(packetHandle, "BasicSafetyMessage", newPath);
  if(value.pathHistory.isValidFlag==1)
  {
    GetBasicSafetyMessagePathHistoryParams(packetHandle, value.pathHistory, newPath);
    result = CheckLastError("BasicSafetyMessage", gkFuncRefGet, result);
  }
  snprintf(newPath, elcount(newPath), "%s.%s", oldPath, "pathPrediction");
  value.pathPrediction.isValidFlag = C2xIsTokenAvailable(packetHandle, "BasicSafetyMessage", newPath);
  if(value.pathPrediction.isValidFlag==1)
  {
    GetBasicSafetyMessagePathPredictionParams(packetHandle, value.pathPrediction, newPath);
    result = CheckLastError("BasicSafetyMessage", gkFuncRefGet, result);
  }
  snprintf(newPath, elcount(newPath), "%s.%s", oldPath, "lights");
  value.lights.isValidFlag = C2xIsTokenAvailable(packetHandle, "BasicSafetyMessage", newPath);
  if(value.lights.isValidFlag==1)
  {
    value.lights.isValidFlag = 1;
    value.lights.stringLength = C2xGetTokenLengthBit(packetHandle, "BasicSafetyMessage", newPath);
    if ((result = CheckLastError("BasicSafetyMessage", gkFuncRefGet, result))==0)
    {
      if(value.lights.stringLength > 0)
      {
        for(j=0; j<value.lights.stringLength; j++)
        {
          if(C2xGetTokenBitOfBitString(packetHandle, "BasicSafetyMessage", newPath, j) == 0)
          {
            value.lights.string[j] = '0';
          }
          else if(C2xGetTokenBitOfBitString(packetHandle, "BasicSafetyMessage", newPath, j) == 1)
          {
            value.lights.string[j] = '1';
          }

          if(value.lights.stringLength == 1)
          {
            value.lights.string[1] = '0';
          }
          result = CheckLastError("BasicSafetyMessage", gkFuncRefGet, result);
        }
      }
      else
      {
        for(k = value.lights.stringLength+1; k > -1; k--)
        {
          if(value.lights.string[k] == '1')
          {
            value.lights.string[k] = '0';
          }
        }
      }
    }

  }
  return result;
}

int SetBasicSafetyMessageVehicleSafetyExtensionsParams(LONG packetHandle, struct BasicSafetyMessageVehicleSafetyExtensions value, char oldPath[])
{
  char newPath[300]; 
  int j;
  int result;

  result = 0;

  snprintf(newPath, elcount(newPath), "%s.%s", oldPath, "events");
  if(value.events.isValidFlag==1)
  {
      for(j=0; j<value.events.stringLength; j++)
      {
        if(value.events.string[j] == '0')
        {
          C2xSetTokenBitOfBitString(packetHandle, "BasicSafetyMessage", newPath, j, 0);
        }
        else
        {
          C2xSetTokenBitOfBitString(packetHandle, "BasicSafetyMessage", newPath, j, 1);
        }
        result = CheckLastError("BasicSafetyMessage", gkFuncRefGet, result);
      }
  }
  else
  {
    if( C2xIsTokenAvailable(packetHandle, "BasicSafetyMessage", newPath) )
    {
      C2xRemoveToken(packetHandle, "BasicSafetyMessage", newPath);
    }
  }

  snprintf(newPath, elcount(newPath), "%s.%s", oldPath, "pathHistory");
  if(value.pathHistory.isValidFlag==1)
  {
    SetBasicSafetyMessagePathHistoryParams(packetHandle, value.pathHistory, newPath);
    result = CheckLastError("BasicSafetyMessage", gkFuncRefGet, result);
  }
  else
  {
    if( C2xIsTokenAvailable(packetHandle, "BasicSafetyMessage", newPath) )
    {
      C2xRemoveToken(packetHandle, "BasicSafetyMessage", newPath);
    }
  }

  snprintf(newPath, elcount(newPath), "%s.%s", oldPath, "pathPrediction");
  if(value.pathPrediction.isValidFlag==1)
  {
    SetBasicSafetyMessagePathPredictionParams(packetHandle, value.pathPrediction, newPath);
    result = CheckLastError("BasicSafetyMessage", gkFuncRefGet, result);
  }
  else
  {
    if( C2xIsTokenAvailable(packetHandle, "BasicSafetyMessage", newPath) )
    {
      C2xRemoveToken(packetHandle, "BasicSafetyMessage", newPath);
    }
  }

  snprintf(newPath, elcount(newPath), "%s.%s", oldPath, "lights");
  if(value.lights.isValidFlag==1)
  {
      for(j=0; j<value.lights.stringLength; j++)
      {
        if(value.lights.string[j] == '0')
        {
          C2xSetTokenBitOfBitString(packetHandle, "BasicSafetyMessage", newPath, j, 0);
        }
        else
        {
          C2xSetTokenBitOfBitString(packetHandle, "BasicSafetyMessage", newPath, j, 1);
        }
        result = CheckLastError("BasicSafetyMessage", gkFuncRefGet, result);
      }
  }
  else
  {
    if( C2xIsTokenAvailable(packetHandle, "BasicSafetyMessage", newPath) )
    {
      C2xRemoveToken(packetHandle, "BasicSafetyMessage", newPath);
    }
  }

  return result;
}

int GetBasicSafetyMessageBasicSafetyMessageFrameParams(LONG packetHandle, struct BasicSafetyMessageBasicSafetyMessageFrame value, char oldPath[])
{
  char newPath[300];
  int result;

  result = 0;

  snprintf(newPath, elcount(newPath), "%s.%s", oldPath, "msgCnt");
  value.msgCnt = C2xGetTokenInt(packetHandle, "BasicSafetyMessage", newPath);
  result = CheckLastError("BasicSafetyMessage", gkFuncRefGet, result);

  snprintf(newPath, elcount(newPath), "%s.%s", oldPath, "id");
  value.id.stringLength = C2xGetTokenData(packetHandle, "BasicSafetyMessage", newPath, elcount(value.id.string), value.id.string);
  snprintf(newPath, elcount(newPath), "%s.%s", oldPath, "plateNo");
  value.plateNo.isValidFlag = C2xIsTokenAvailable(packetHandle, "BasicSafetyMessage", newPath);
  if(value.plateNo.isValidFlag==1)
  {
    value.plateNo.isValidFlag = 1;
    value.plateNo.stringLength = C2xGetTokenData(packetHandle, "BasicSafetyMessage", newPath, elcount(value.plateNo.string), value.plateNo.string);
  }
  snprintf(newPath, elcount(newPath), "%s.%s", oldPath, "secMark");
  value.secMark = C2xGetTokenInt(packetHandle, "BasicSafetyMessage", newPath);
  result = CheckLastError("BasicSafetyMessage", gkFuncRefGet, result);

  snprintf(newPath, elcount(newPath), "%s.%s", oldPath, "pos");
  GetBasicSafetyMessagePosition3DParams(packetHandle, value.pos, newPath);
  result = CheckLastError("BasicSafetyMessage", gkFuncRefGet, result);

  snprintf(newPath, elcount(newPath), "%s.%s", oldPath, "accuracy");
  GetBasicSafetyMessagePositionConfidenceSetParams(packetHandle, value.accuracy, newPath);
  result = CheckLastError("BasicSafetyMessage", gkFuncRefGet, result);

  snprintf(newPath, elcount(newPath), "%s.%s", oldPath, "transmission");
  value.transmission = C2xGetTokenInt(packetHandle, "BasicSafetyMessage", newPath);
  result = CheckLastError("BasicSafetyMessage", gkFuncRefGet, result);

  snprintf(newPath, elcount(newPath), "%s.%s", oldPath, "speed");
  value.speed = C2xGetTokenInt(packetHandle, "BasicSafetyMessage", newPath);
  result = CheckLastError("BasicSafetyMessage", gkFuncRefGet, result);

  snprintf(newPath, elcount(newPath), "%s.%s", oldPath, "heading");
  value.heading = C2xGetTokenInt(packetHandle, "BasicSafetyMessage", newPath);
  result = CheckLastError("BasicSafetyMessage", gkFuncRefGet, result);

  snprintf(newPath, elcount(newPath), "%s.%s", oldPath, "angle");
  value.angle.isValidFlag = C2xIsTokenAvailable(packetHandle, "BasicSafetyMessage", newPath);
  if(value.angle.isValidFlag==1)
  {
    value.angle.value = C2xGetTokenInt(packetHandle, "BasicSafetyMessage", newPath);
    result = CheckLastError("BasicSafetyMessage", gkFuncRefGet, result);
  }
  snprintf(newPath, elcount(newPath), "%s.%s", oldPath, "motionCfd");
  value.motionCfd.isValidFlag = C2xIsTokenAvailable(packetHandle, "BasicSafetyMessage", newPath);
  if(value.motionCfd.isValidFlag==1)
  {
    GetBasicSafetyMessageMotionConfidenceSetParams(packetHandle, value.motionCfd, newPath);
    result = CheckLastError("BasicSafetyMessage", gkFuncRefGet, result);
  }
  snprintf(newPath, elcount(newPath), "%s.%s", oldPath, "accelSet");
  GetBasicSafetyMessageAccelerationSet4WayParams(packetHandle, value.accelSet, newPath);
  result = CheckLastError("BasicSafetyMessage", gkFuncRefGet, result);

  snprintf(newPath, elcount(newPath), "%s.%s", oldPath, "brakes");
  GetBasicSafetyMessageBrakeSystemStatusParams(packetHandle, value.brakes, newPath);
  result = CheckLastError("BasicSafetyMessage", gkFuncRefGet, result);

  snprintf(newPath, elcount(newPath), "%s.%s", oldPath, "size");
  GetBasicSafetyMessageVehicleSizeParams(packetHandle, value.size, newPath);
  result = CheckLastError("BasicSafetyMessage", gkFuncRefGet, result);

  snprintf(newPath, elcount(newPath), "%s.%s", oldPath, "vehicleClass");
  GetBasicSafetyMessageVehicleClassificationParams(packetHandle, value.vehicleClass, newPath);
  result = CheckLastError("BasicSafetyMessage", gkFuncRefGet, result);

  snprintf(newPath, elcount(newPath), "%s.%s", oldPath, "safetyExt");
  value.safetyExt.isValidFlag = C2xIsTokenAvailable(packetHandle, "BasicSafetyMessage", newPath);
  if(value.safetyExt.isValidFlag==1)
  {
    GetBasicSafetyMessageVehicleSafetyExtensionsParams(packetHandle, value.safetyExt, newPath);
    result = CheckLastError("BasicSafetyMessage", gkFuncRefGet, result);
  }
  return result;
}

int SetBasicSafetyMessageBasicSafetyMessageFrameParams(LONG packetHandle, struct BasicSafetyMessageBasicSafetyMessageFrame value, char oldPath[])
{
  char newPath[300];
  int result;

  result = 0;

  snprintf(newPath, elcount(newPath), "%s.%s", oldPath, "msgCnt");
  C2xSetTokenInt(packetHandle, "BasicSafetyMessage", newPath, value.msgCnt);
  result = CheckLastError("BasicSafetyMessage", gkFuncRefGet, result);

  if(value.id.stringLength == 0)
  {
    value.id.stringLength = 8;
    memcpy(value.id.string, "00000000", value.id.stringLength);
  }

  snprintf(newPath, elcount(newPath), "%s.%s", oldPath, "id");
  C2xSetTokenData(packetHandle, "BasicSafetyMessage", newPath, value.id.stringLength, value.id.string);

  snprintf(newPath, elcount(newPath), "%s.%s", oldPath, "plateNo");
  if(value.plateNo.isValidFlag==1)
  {
    C2xSetTokenData(packetHandle, "BasicSafetyMessage", newPath, value.plateNo.stringLength, value.plateNo.string);
  }
  else
  {
    if( C2xIsTokenAvailable(packetHandle, "BasicSafetyMessage", newPath) )
    {
      C2xRemoveToken(packetHandle, "BasicSafetyMessage", newPath);
    }
  }

  snprintf(newPath, elcount(newPath), "%s.%s", oldPath, "secMark");
  C2xSetTokenInt(packetHandle, "BasicSafetyMessage", newPath, value.secMark);
  result = CheckLastError("BasicSafetyMessage", gkFuncRefGet, result);

  snprintf(newPath, elcount(newPath), "%s.%s", oldPath, "pos");
  SetBasicSafetyMessagePosition3DParams(packetHandle, value.pos, newPath);
  result = CheckLastError("BasicSafetyMessage", gkFuncRefGet, result);

  snprintf(newPath, elcount(newPath), "%s.%s", oldPath, "accuracy");
  SetBasicSafetyMessagePositionConfidenceSetParams(packetHandle, value.accuracy, newPath);
  result = CheckLastError("BasicSafetyMessage", gkFuncRefGet, result);

  snprintf(newPath, elcount(newPath), "%s.%s", oldPath, "transmission");
  C2xSetTokenInt(packetHandle, "BasicSafetyMessage", newPath, value.transmission);
  result = CheckLastError("BasicSafetyMessage", gkFuncRefGet, result);

  snprintf(newPath, elcount(newPath), "%s.%s", oldPath, "speed");
  C2xSetTokenInt(packetHandle, "BasicSafetyMessage", newPath, value.speed);
  result = CheckLastError("BasicSafetyMessage", gkFuncRefGet, result);

  snprintf(newPath, elcount(newPath), "%s.%s", oldPath, "heading");
  C2xSetTokenInt(packetHandle, "BasicSafetyMessage", newPath, value.heading);
  result = CheckLastError("BasicSafetyMessage", gkFuncRefGet, result);

  snprintf(newPath, elcount(newPath), "%s.%s", oldPath, "angle");
  if(value.angle.isValidFlag==1)
  {
    C2xSetTokenInt(packetHandle, "BasicSafetyMessage", newPath, value.angle.value);
    result = CheckLastError("BasicSafetyMessage", gkFuncRefGet, result);
  }
  else
  {
    if( C2xIsTokenAvailable(packetHandle, "BasicSafetyMessage", newPath) )
    {
      C2xRemoveToken(packetHandle, "BasicSafetyMessage", newPath);
    }
  }

  snprintf(newPath, elcount(newPath), "%s.%s", oldPath, "motionCfd");
  if(value.motionCfd.isValidFlag==1)
  {
    SetBasicSafetyMessageMotionConfidenceSetParams(packetHandle, value.motionCfd, newPath);
    result = CheckLastError("BasicSafetyMessage", gkFuncRefGet, result);
  }
  else
  {
    if( C2xIsTokenAvailable(packetHandle, "BasicSafetyMessage", newPath) )
    {
      C2xRemoveToken(packetHandle, "BasicSafetyMessage", newPath);
    }
  }

  snprintf(newPath, elcount(newPath), "%s.%s", oldPath, "accelSet");
  SetBasicSafetyMessageAccelerationSet4WayParams(packetHandle, value.accelSet, newPath);
  result = CheckLastError("BasicSafetyMessage", gkFuncRefGet, result);

  snprintf(newPath, elcount(newPath), "%s.%s", oldPath, "brakes");
  SetBasicSafetyMessageBrakeSystemStatusParams(packetHandle, value.brakes, newPath);
  result = CheckLastError("BasicSafetyMessage", gkFuncRefGet, result);

  snprintf(newPath, elcount(newPath), "%s.%s", oldPath, "size");
  SetBasicSafetyMessageVehicleSizeParams(packetHandle, value.size, newPath);
  result = CheckLastError("BasicSafetyMessage", gkFuncRefGet, result);

  snprintf(newPath, elcount(newPath), "%s.%s", oldPath, "vehicleClass");
  SetBasicSafetyMessageVehicleClassificationParams(packetHandle, value.vehicleClass, newPath);
  result = CheckLastError("BasicSafetyMessage", gkFuncRefGet, result);

  snprintf(newPath, elcount(newPath), "%s.%s", oldPath, "safetyExt");
  if(value.safetyExt.isValidFlag==1)
  {
    SetBasicSafetyMessageVehicleSafetyExtensionsParams(packetHandle, value.safetyExt, newPath);
    result = CheckLastError("BasicSafetyMessage", gkFuncRefGet, result);
  }
  else
  {
    if( C2xIsTokenAvailable(packetHandle, "BasicSafetyMessage", newPath) )
    {
      C2xRemoveToken(packetHandle, "BasicSafetyMessage", newPath);
    }
  }

  return result;
}

int API_GetBasicSafetyMessageParams(LONG packetHandle, struct BasicSafetyMessage value)
{
  int result;
  result = 0;

  value.frameType = C2xGetTokenInt(packetHandle, "BasicSafetyMessage", "frameType");
  result = CheckLastError("BasicSafetyMessage", gkFuncRefGet, result);

  value.bsmFrame.isValidFlag = 1;
  GetBasicSafetyMessageBasicSafetyMessageFrameParams(packetHandle, value.bsmFrame, "bsmFrame");
  result = CheckLastError("BasicSafetyMessage", gkFuncRefGet, result);

  return result;
}

int API_SetBasicSafetyMessageParams(LONG packetHandle, struct BasicSafetyMessage value)
{
  int result;
  result = 0;

  C2xSetTokenInt(packetHandle, "BasicSafetyMessage", "frameType", value.frameType);
  result = CheckLastError("BasicSafetyMessage", gkFuncRefGet, result);

  SetBasicSafetyMessageBasicSafetyMessageFrameParams(packetHandle, value.bsmFrame, "bsmFrame");
  result = CheckLastError("BasicSafetyMessage", gkFuncRefGet, result);

  return result;
}

