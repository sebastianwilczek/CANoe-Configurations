/*@!Encoding:1252*/
/*
//  (c) Vector Informatik GmbH. All rights reserved.
//
//  This file contains definitions of structs and methods that may be used
//  to set and get the values of an ASN.1 defined packet's payload.
//
//  //This example demonstrates how to set a packet's payload:
//  LONG packetHandle;
//  struct RoadSideInformation payload;
//  //you need to set the values of the variable "payload" yourself
//  packetHandle = API_InitRoadSideInformationPacket();
//  if (packetHandle!=0) {
//    if (API_SetRoadSideInformationParams(packetHandle, payload)==0) {
//      if (C2xCompletePacket(packetHandle)==0) {
//        C2xOutputPacket(packetHandle);
//      }
//    }
//  }
//                                                                             */
includes
{
  //#include "ASNV_Template_BaseDatatypes.cin"  // If warning "Duplicate #include, ignoring this include" appears, please remove the ASNV_Template_BaseDatatypes.cin include from your other *.cin files in the project.
}
variables
{
    struct RoadSideInformationRoadSideInformation_id {
        INT isValidFlag;   // necessary if this struct is used as an optional field of a SEQUENCE
        CHAR string[9];
        INT  stringLength;
    };
    
    struct RoadSideInformationRoadSideInformation_description {
        INT isValidFlag;   // necessary if this struct is used as an optional field of a SEQUENCE
        CHAR string[257];
        INT  stringLength;
    };
    
    struct RoadSideInformationPriority {
        INT isValidFlag;   // necessary if this struct is used as an optional field of a SEQUENCE
        CHAR string[2];
        INT  stringLength;
    };
    
    struct RoadSideInformationPosition3D {
        INT isValidFlag;   // necessary if this struct is used as an optional field of a SEQUENCE
        LONG lat;  // INTEGER, -900000000..900000001;
        LONG lon;  // INTEGER, -1799999999..1800000001;
        struct OPT_LONG_ASN elevation;  // INTEGER, OPTIONAL, -4096..61439;
    };
    
    struct RoadSideInformationPosition_LL_24B {
        INT isValidFlag;   // necessary if this struct is used as an optional field of a SEQUENCE
        INT lon;  // INTEGER, -2048..2047;
        INT lat;  // INTEGER, -2048..2047;
    };
    
    struct RoadSideInformationPosition_LL_28B {
        INT isValidFlag;   // necessary if this struct is used as an optional field of a SEQUENCE
        INT lon;  // INTEGER, -8192..8191;
        INT lat;  // INTEGER, -8192..8191;
    };
    
    struct RoadSideInformationPosition_LL_32B {
        INT isValidFlag;   // necessary if this struct is used as an optional field of a SEQUENCE
        INT lon;  // INTEGER, -32768..32767;
        INT lat;  // INTEGER, -32768..32767;
    };
    
    struct RoadSideInformationPosition_LL_36B {
        INT isValidFlag;   // necessary if this struct is used as an optional field of a SEQUENCE
        LONG lon;  // INTEGER, -131072..131071;
        LONG lat;  // INTEGER, -131072..131071;
    };
    
    struct RoadSideInformationPosition_LL_44B {
        INT isValidFlag;   // necessary if this struct is used as an optional field of a SEQUENCE
        LONG lon;  // INTEGER, -2097152..2097151;
        LONG lat;  // INTEGER, -2097152..2097151;
    };
    
    struct RoadSideInformationPosition_LL_48B {
        INT isValidFlag;   // necessary if this struct is used as an optional field of a SEQUENCE
        LONG lon;  // INTEGER, -8388608..8388607;
        LONG lat;  // INTEGER, -8388608..8388607;
    };
    
    struct RoadSideInformationPosition_LLmD_64b {
        INT isValidFlag;   // necessary if this struct is used as an optional field of a SEQUENCE
        LONG lon;  // INTEGER, -1799999999..1800000001;
        LONG lat;  // INTEGER, -900000000..900000001;
    };
    
    struct RoadSideInformationPositionOffsetLL {
        INT isValidFlag;   // necessary if this struct is used as an optional field of a SEQUENCE
        INT choice;
        struct RoadSideInformationPosition_LL_24B position_LL1;  // SEQUENCE;
        struct RoadSideInformationPosition_LL_28B position_LL2;  // SEQUENCE;
        struct RoadSideInformationPosition_LL_32B position_LL3;  // SEQUENCE;
        struct RoadSideInformationPosition_LL_36B position_LL4;  // SEQUENCE;
        struct RoadSideInformationPosition_LL_44B position_LL5;  // SEQUENCE;
        struct RoadSideInformationPosition_LL_48B position_LL6;  // SEQUENCE;
        struct RoadSideInformationPosition_LLmD_64b position_LatLon;  // SEQUENCE;
    };
    
    struct RoadSideInformationVerticalOffset {
        INT isValidFlag;   // necessary if this struct is used as an optional field of a SEQUENCE
        INT choice;
        INT offset1;  // INTEGER, -64..63;
        INT offset2;  // INTEGER, -128..127;
        INT offset3;  // INTEGER, -256..255;
        INT offset4;  // INTEGER, -512..511;
        INT offset5;  // INTEGER, -1024..1023;
        INT offset6;  // INTEGER, -2048..2047;
        LONG elevation;  // INTEGER, -4096..61439;
    };
    
    struct RoadSideInformationPositionOffsetLLV {
        INT isValidFlag;   // necessary if this struct is used as an optional field of a SEQUENCE
        struct RoadSideInformationPositionOffsetLL offsetLL;  // CHOICE;
        struct RoadSideInformationVerticalOffset offsetV;  // CHOICE, OPTIONAL;
    };
    
    struct RoadSideInformationPathPointList {
        INT isValidFlag;   // necessary if this struct is used as an optional field of a SEQUENCE
        INT length;
        struct RoadSideInformationPositionOffsetLLV arrayValue[32];  // SEQUENCE;
    };
    
    struct RoadSideInformationRSIFrame {
        INT isValidFlag;   // necessary if this struct is used as an optional field of a SEQUENCE
        BYTE msgCnt;  // INTEGER, 0..127;
        struct OPT_DWORD_ASN timeStamp;  // INTEGER, OPTIONAL, 0..527040;
        struct RoadSideInformationRoadSideInformation_id id;  // OCTETSTRING;
        BYTE rsiId;  // INTEGER, 0..255;
        WORD alertType;  // INTEGER, 0..65535;
        struct RoadSideInformationRoadSideInformation_description description;  // IA5STRING, OPTIONAL;
        struct RoadSideInformationPriority priority;  // OCTETSTRING, OPTIONAL;
        struct RoadSideInformationPosition3D refPos;  // SEQUENCE;
        struct RoadSideInformationPathPointList alertPath;  // SEQUENCEOF;
        WORD alertRadius;  // INTEGER, 0..1024;
    };
    
    struct RoadSideInformation {
        INT isValidFlag;   // necessary if this struct is used as an optional field of a SEQUENCE
        BYTE frameType;  // INTEGER, 0..15, rsiFrame(5);
        struct RoadSideInformationRSIFrame rsiFrame;  // SEQUENCE;
    };
    
}

/*
// init function to create a simple packet handle
*/ 
LONG API_InitRoadSideInformationPacket()
{
  return C2xInitPacket("RoadSideInformation"); 
}

/*
// init function to create a simple packet handle and
// initialize the struct with valid data
*/ 
LONG API_InitRoadSideInformationPacket(struct RoadSideInformation msgStruct)
{
  long pktHandle;

  pktHandle = API_InitRoadSideInformationPacket();

  if (pktHandle != 0)
  {
    // create valid message and application data
    if (C2xCompletePacket(pktHandle) == 0) 
    {
      API_GetRoadSideInformationParams(pktHandle, msgStruct);
    }
  }
  return pktHandle;
}

/*
// init function to create a packet with security layer and
// initialize the struct with valid data
*/ 
LONG API_InitRoadSideInformationPacket(struct RoadSideInformation msgStruct, char packetTypeDesignator[], char certificateName[])
{
  long pktHandle, certHdl;

  // initialize the packet
  pktHandle = C2xInitPacket("RoadSideInformation", packetTypeDesignator);

  if (pktHandle != 0)
  {
    certHdl = C2xSecCertificateGetHandle(certificateName);  // get the certificate handle for the cert with name "certificateName"
    if (certHdl != 0) 
    {
      C2xSecPacketSetSignerHandle(pktHandle, certHdl); // set the certHdl to the packet
    }

    // create valid message and application data
    if (C2xCompletePacket(pktHandle) == 0) 
    {
      // copy application data to the application structure
      API_GetRoadSideInformationParams(pktHandle, msgStruct);
    }
  }
  return pktHandle;
}
    

int GetRoadSideInformationPosition3DParams(LONG packetHandle, struct RoadSideInformationPosition3D value, char oldPath[])
{
  char newPath[300];
  int result;

  result = 0;

  snprintf(newPath, elcount(newPath), "%s.%s", oldPath, "lat");
  value.lat = C2xGetTokenInt(packetHandle, "RoadSideInformation", newPath);
  result = CheckLastError("RoadSideInformation", gkFuncRefGet, result);

  snprintf(newPath, elcount(newPath), "%s.%s", oldPath, "lon");
  value.lon = C2xGetTokenInt(packetHandle, "RoadSideInformation", newPath);
  result = CheckLastError("RoadSideInformation", gkFuncRefGet, result);

  snprintf(newPath, elcount(newPath), "%s.%s", oldPath, "elevation");
  value.elevation.isValidFlag = C2xIsTokenAvailable(packetHandle, "RoadSideInformation", newPath);
  if(value.elevation.isValidFlag==1)
  {
    value.elevation.value = C2xGetTokenInt(packetHandle, "RoadSideInformation", newPath);
    result = CheckLastError("RoadSideInformation", gkFuncRefGet, result);
  }
  return result;
}

int SetRoadSideInformationPosition3DParams(LONG packetHandle, struct RoadSideInformationPosition3D value, char oldPath[])
{
  char newPath[300];
  int result;

  result = 0;

  snprintf(newPath, elcount(newPath), "%s.%s", oldPath, "lat");
  C2xSetTokenInt(packetHandle, "RoadSideInformation", newPath, value.lat);
  result = CheckLastError("RoadSideInformation", gkFuncRefGet, result);

  snprintf(newPath, elcount(newPath), "%s.%s", oldPath, "lon");
  C2xSetTokenInt(packetHandle, "RoadSideInformation", newPath, value.lon);
  result = CheckLastError("RoadSideInformation", gkFuncRefGet, result);

  snprintf(newPath, elcount(newPath), "%s.%s", oldPath, "elevation");
  if(value.elevation.isValidFlag==1)
  {
    C2xSetTokenInt(packetHandle, "RoadSideInformation", newPath, value.elevation.value);
    result = CheckLastError("RoadSideInformation", gkFuncRefGet, result);
  }
  else
  {
    if( C2xIsTokenAvailable(packetHandle, "RoadSideInformation", newPath) )
    {
      C2xRemoveToken(packetHandle, "RoadSideInformation", newPath);
    }
  }

  return result;
}

int GetRoadSideInformationPosition_LL_24BParams(LONG packetHandle, struct RoadSideInformationPosition_LL_24B value, char oldPath[])
{
  char newPath[300];
  int result;

  result = 0;

  snprintf(newPath, elcount(newPath), "%s.%s", oldPath, "lon");
  value.lon = C2xGetTokenInt(packetHandle, "RoadSideInformation", newPath);
  result = CheckLastError("RoadSideInformation", gkFuncRefGet, result);

  snprintf(newPath, elcount(newPath), "%s.%s", oldPath, "lat");
  value.lat = C2xGetTokenInt(packetHandle, "RoadSideInformation", newPath);
  result = CheckLastError("RoadSideInformation", gkFuncRefGet, result);

  return result;
}

int SetRoadSideInformationPosition_LL_24BParams(LONG packetHandle, struct RoadSideInformationPosition_LL_24B value, char oldPath[])
{
  char newPath[300];
  int result;

  result = 0;

  snprintf(newPath, elcount(newPath), "%s.%s", oldPath, "lon");
  C2xSetTokenInt(packetHandle, "RoadSideInformation", newPath, value.lon);
  result = CheckLastError("RoadSideInformation", gkFuncRefGet, result);

  snprintf(newPath, elcount(newPath), "%s.%s", oldPath, "lat");
  C2xSetTokenInt(packetHandle, "RoadSideInformation", newPath, value.lat);
  result = CheckLastError("RoadSideInformation", gkFuncRefGet, result);

  return result;
}

int GetRoadSideInformationPosition_LL_28BParams(LONG packetHandle, struct RoadSideInformationPosition_LL_28B value, char oldPath[])
{
  char newPath[300];
  int result;

  result = 0;

  snprintf(newPath, elcount(newPath), "%s.%s", oldPath, "lon");
  value.lon = C2xGetTokenInt(packetHandle, "RoadSideInformation", newPath);
  result = CheckLastError("RoadSideInformation", gkFuncRefGet, result);

  snprintf(newPath, elcount(newPath), "%s.%s", oldPath, "lat");
  value.lat = C2xGetTokenInt(packetHandle, "RoadSideInformation", newPath);
  result = CheckLastError("RoadSideInformation", gkFuncRefGet, result);

  return result;
}

int SetRoadSideInformationPosition_LL_28BParams(LONG packetHandle, struct RoadSideInformationPosition_LL_28B value, char oldPath[])
{
  char newPath[300];
  int result;

  result = 0;

  snprintf(newPath, elcount(newPath), "%s.%s", oldPath, "lon");
  C2xSetTokenInt(packetHandle, "RoadSideInformation", newPath, value.lon);
  result = CheckLastError("RoadSideInformation", gkFuncRefGet, result);

  snprintf(newPath, elcount(newPath), "%s.%s", oldPath, "lat");
  C2xSetTokenInt(packetHandle, "RoadSideInformation", newPath, value.lat);
  result = CheckLastError("RoadSideInformation", gkFuncRefGet, result);

  return result;
}

int GetRoadSideInformationPosition_LL_32BParams(LONG packetHandle, struct RoadSideInformationPosition_LL_32B value, char oldPath[])
{
  char newPath[300];
  int result;

  result = 0;

  snprintf(newPath, elcount(newPath), "%s.%s", oldPath, "lon");
  value.lon = C2xGetTokenInt(packetHandle, "RoadSideInformation", newPath);
  result = CheckLastError("RoadSideInformation", gkFuncRefGet, result);

  snprintf(newPath, elcount(newPath), "%s.%s", oldPath, "lat");
  value.lat = C2xGetTokenInt(packetHandle, "RoadSideInformation", newPath);
  result = CheckLastError("RoadSideInformation", gkFuncRefGet, result);

  return result;
}

int SetRoadSideInformationPosition_LL_32BParams(LONG packetHandle, struct RoadSideInformationPosition_LL_32B value, char oldPath[])
{
  char newPath[300];
  int result;

  result = 0;

  snprintf(newPath, elcount(newPath), "%s.%s", oldPath, "lon");
  C2xSetTokenInt(packetHandle, "RoadSideInformation", newPath, value.lon);
  result = CheckLastError("RoadSideInformation", gkFuncRefGet, result);

  snprintf(newPath, elcount(newPath), "%s.%s", oldPath, "lat");
  C2xSetTokenInt(packetHandle, "RoadSideInformation", newPath, value.lat);
  result = CheckLastError("RoadSideInformation", gkFuncRefGet, result);

  return result;
}

int GetRoadSideInformationPosition_LL_36BParams(LONG packetHandle, struct RoadSideInformationPosition_LL_36B value, char oldPath[])
{
  char newPath[300];
  int result;

  result = 0;

  snprintf(newPath, elcount(newPath), "%s.%s", oldPath, "lon");
  value.lon = C2xGetTokenInt(packetHandle, "RoadSideInformation", newPath);
  result = CheckLastError("RoadSideInformation", gkFuncRefGet, result);

  snprintf(newPath, elcount(newPath), "%s.%s", oldPath, "lat");
  value.lat = C2xGetTokenInt(packetHandle, "RoadSideInformation", newPath);
  result = CheckLastError("RoadSideInformation", gkFuncRefGet, result);

  return result;
}

int SetRoadSideInformationPosition_LL_36BParams(LONG packetHandle, struct RoadSideInformationPosition_LL_36B value, char oldPath[])
{
  char newPath[300];
  int result;

  result = 0;

  snprintf(newPath, elcount(newPath), "%s.%s", oldPath, "lon");
  C2xSetTokenInt(packetHandle, "RoadSideInformation", newPath, value.lon);
  result = CheckLastError("RoadSideInformation", gkFuncRefGet, result);

  snprintf(newPath, elcount(newPath), "%s.%s", oldPath, "lat");
  C2xSetTokenInt(packetHandle, "RoadSideInformation", newPath, value.lat);
  result = CheckLastError("RoadSideInformation", gkFuncRefGet, result);

  return result;
}

int GetRoadSideInformationPosition_LL_44BParams(LONG packetHandle, struct RoadSideInformationPosition_LL_44B value, char oldPath[])
{
  char newPath[300];
  int result;

  result = 0;

  snprintf(newPath, elcount(newPath), "%s.%s", oldPath, "lon");
  value.lon = C2xGetTokenInt(packetHandle, "RoadSideInformation", newPath);
  result = CheckLastError("RoadSideInformation", gkFuncRefGet, result);

  snprintf(newPath, elcount(newPath), "%s.%s", oldPath, "lat");
  value.lat = C2xGetTokenInt(packetHandle, "RoadSideInformation", newPath);
  result = CheckLastError("RoadSideInformation", gkFuncRefGet, result);

  return result;
}

int SetRoadSideInformationPosition_LL_44BParams(LONG packetHandle, struct RoadSideInformationPosition_LL_44B value, char oldPath[])
{
  char newPath[300];
  int result;

  result = 0;

  snprintf(newPath, elcount(newPath), "%s.%s", oldPath, "lon");
  C2xSetTokenInt(packetHandle, "RoadSideInformation", newPath, value.lon);
  result = CheckLastError("RoadSideInformation", gkFuncRefGet, result);

  snprintf(newPath, elcount(newPath), "%s.%s", oldPath, "lat");
  C2xSetTokenInt(packetHandle, "RoadSideInformation", newPath, value.lat);
  result = CheckLastError("RoadSideInformation", gkFuncRefGet, result);

  return result;
}

int GetRoadSideInformationPosition_LL_48BParams(LONG packetHandle, struct RoadSideInformationPosition_LL_48B value, char oldPath[])
{
  char newPath[300];
  int result;

  result = 0;

  snprintf(newPath, elcount(newPath), "%s.%s", oldPath, "lon");
  value.lon = C2xGetTokenInt(packetHandle, "RoadSideInformation", newPath);
  result = CheckLastError("RoadSideInformation", gkFuncRefGet, result);

  snprintf(newPath, elcount(newPath), "%s.%s", oldPath, "lat");
  value.lat = C2xGetTokenInt(packetHandle, "RoadSideInformation", newPath);
  result = CheckLastError("RoadSideInformation", gkFuncRefGet, result);

  return result;
}

int SetRoadSideInformationPosition_LL_48BParams(LONG packetHandle, struct RoadSideInformationPosition_LL_48B value, char oldPath[])
{
  char newPath[300];
  int result;

  result = 0;

  snprintf(newPath, elcount(newPath), "%s.%s", oldPath, "lon");
  C2xSetTokenInt(packetHandle, "RoadSideInformation", newPath, value.lon);
  result = CheckLastError("RoadSideInformation", gkFuncRefGet, result);

  snprintf(newPath, elcount(newPath), "%s.%s", oldPath, "lat");
  C2xSetTokenInt(packetHandle, "RoadSideInformation", newPath, value.lat);
  result = CheckLastError("RoadSideInformation", gkFuncRefGet, result);

  return result;
}

int GetRoadSideInformationPosition_LLmD_64bParams(LONG packetHandle, struct RoadSideInformationPosition_LLmD_64b value, char oldPath[])
{
  char newPath[300];
  int result;

  result = 0;

  snprintf(newPath, elcount(newPath), "%s.%s", oldPath, "lon");
  value.lon = C2xGetTokenInt(packetHandle, "RoadSideInformation", newPath);
  result = CheckLastError("RoadSideInformation", gkFuncRefGet, result);

  snprintf(newPath, elcount(newPath), "%s.%s", oldPath, "lat");
  value.lat = C2xGetTokenInt(packetHandle, "RoadSideInformation", newPath);
  result = CheckLastError("RoadSideInformation", gkFuncRefGet, result);

  return result;
}

int SetRoadSideInformationPosition_LLmD_64bParams(LONG packetHandle, struct RoadSideInformationPosition_LLmD_64b value, char oldPath[])
{
  char newPath[300];
  int result;

  result = 0;

  snprintf(newPath, elcount(newPath), "%s.%s", oldPath, "lon");
  C2xSetTokenInt(packetHandle, "RoadSideInformation", newPath, value.lon);
  result = CheckLastError("RoadSideInformation", gkFuncRefGet, result);

  snprintf(newPath, elcount(newPath), "%s.%s", oldPath, "lat");
  C2xSetTokenInt(packetHandle, "RoadSideInformation", newPath, value.lat);
  result = CheckLastError("RoadSideInformation", gkFuncRefGet, result);

  return result;
}

int GetRoadSideInformationPositionOffsetLLParams(LONG packetHandle, struct RoadSideInformationPositionOffsetLL value, char oldPath[])
{
  char newPath[300];
  int result;

  result = 0;

  value.choice = C2xGetTokenInt(packetHandle, "RoadSideInformation", oldPath);

  switch(value.choice)
  {
    case 0:
    {
      snprintf(newPath, elcount(newPath), "%s.%s", oldPath, "position_LL1");
      GetRoadSideInformationPosition_LL_24BParams(packetHandle, value.position_LL1, newPath);
      result = CheckLastError("RoadSideInformation", gkFuncRefGet, result);
    }
    break;
    case 1:
    {
      snprintf(newPath, elcount(newPath), "%s.%s", oldPath, "position_LL2");
      GetRoadSideInformationPosition_LL_28BParams(packetHandle, value.position_LL2, newPath);
      result = CheckLastError("RoadSideInformation", gkFuncRefGet, result);
    }
    break;
    case 2:
    {
      snprintf(newPath, elcount(newPath), "%s.%s", oldPath, "position_LL3");
      GetRoadSideInformationPosition_LL_32BParams(packetHandle, value.position_LL3, newPath);
      result = CheckLastError("RoadSideInformation", gkFuncRefGet, result);
    }
    break;
    case 3:
    {
      snprintf(newPath, elcount(newPath), "%s.%s", oldPath, "position_LL4");
      GetRoadSideInformationPosition_LL_36BParams(packetHandle, value.position_LL4, newPath);
      result = CheckLastError("RoadSideInformation", gkFuncRefGet, result);
    }
    break;
    case 4:
    {
      snprintf(newPath, elcount(newPath), "%s.%s", oldPath, "position_LL5");
      GetRoadSideInformationPosition_LL_44BParams(packetHandle, value.position_LL5, newPath);
      result = CheckLastError("RoadSideInformation", gkFuncRefGet, result);
    }
    break;
    case 5:
    {
      snprintf(newPath, elcount(newPath), "%s.%s", oldPath, "position_LL6");
      GetRoadSideInformationPosition_LL_48BParams(packetHandle, value.position_LL6, newPath);
      result = CheckLastError("RoadSideInformation", gkFuncRefGet, result);
    }
    break;
    case 6:
    {
      snprintf(newPath, elcount(newPath), "%s.%s", oldPath, "position_LatLon");
      GetRoadSideInformationPosition_LLmD_64bParams(packetHandle, value.position_LatLon, newPath);
      result = CheckLastError("RoadSideInformation", gkFuncRefGet, result);
    }
    break;
  }
  return result;
}

int SetRoadSideInformationPositionOffsetLLParams(LONG packetHandle, struct RoadSideInformationPositionOffsetLL value, char oldPath[])
{
  char newPath[300];
  int result;

  result = 0;

  switch(value.choice)
  {
    case 0:
    {
      snprintf(newPath, elcount(newPath), "%s.%s", oldPath, "position_LL1");
      SetRoadSideInformationPosition_LL_24BParams(packetHandle, value.position_LL1, newPath);
      result = CheckLastError("RoadSideInformation", gkFuncRefGet, result);
    }
    break;
    case 1:
    {
      snprintf(newPath, elcount(newPath), "%s.%s", oldPath, "position_LL2");
      SetRoadSideInformationPosition_LL_28BParams(packetHandle, value.position_LL2, newPath);
      result = CheckLastError("RoadSideInformation", gkFuncRefGet, result);
    }
    break;
    case 2:
    {
      snprintf(newPath, elcount(newPath), "%s.%s", oldPath, "position_LL3");
      SetRoadSideInformationPosition_LL_32BParams(packetHandle, value.position_LL3, newPath);
      result = CheckLastError("RoadSideInformation", gkFuncRefGet, result);
    }
    break;
    case 3:
    {
      snprintf(newPath, elcount(newPath), "%s.%s", oldPath, "position_LL4");
      SetRoadSideInformationPosition_LL_36BParams(packetHandle, value.position_LL4, newPath);
      result = CheckLastError("RoadSideInformation", gkFuncRefGet, result);
    }
    break;
    case 4:
    {
      snprintf(newPath, elcount(newPath), "%s.%s", oldPath, "position_LL5");
      SetRoadSideInformationPosition_LL_44BParams(packetHandle, value.position_LL5, newPath);
      result = CheckLastError("RoadSideInformation", gkFuncRefGet, result);
    }
    break;
    case 5:
    {
      snprintf(newPath, elcount(newPath), "%s.%s", oldPath, "position_LL6");
      SetRoadSideInformationPosition_LL_48BParams(packetHandle, value.position_LL6, newPath);
      result = CheckLastError("RoadSideInformation", gkFuncRefGet, result);
    }
    break;
    case 6:
    {
      snprintf(newPath, elcount(newPath), "%s.%s", oldPath, "position_LatLon");
      SetRoadSideInformationPosition_LLmD_64bParams(packetHandle, value.position_LatLon, newPath);
      result = CheckLastError("RoadSideInformation", gkFuncRefGet, result);
    }
    break;
  }
  return result;
}

int GetRoadSideInformationVerticalOffsetParams(LONG packetHandle, struct RoadSideInformationVerticalOffset value, char oldPath[])
{
  char newPath[300];
  int result;

  result = 0;

  value.choice = C2xGetTokenInt(packetHandle, "RoadSideInformation", oldPath);

  switch(value.choice)
  {
    case 0:
    {
      snprintf(newPath, elcount(newPath), "%s.%s", oldPath, "offset1");
      value.offset1 = C2xGetTokenInt(packetHandle, "RoadSideInformation", newPath);
      result = CheckLastError("RoadSideInformation", gkFuncRefGet, result);
    }
    break;
    case 1:
    {
      snprintf(newPath, elcount(newPath), "%s.%s", oldPath, "offset2");
      value.offset2 = C2xGetTokenInt(packetHandle, "RoadSideInformation", newPath);
      result = CheckLastError("RoadSideInformation", gkFuncRefGet, result);
    }
    break;
    case 2:
    {
      snprintf(newPath, elcount(newPath), "%s.%s", oldPath, "offset3");
      value.offset3 = C2xGetTokenInt(packetHandle, "RoadSideInformation", newPath);
      result = CheckLastError("RoadSideInformation", gkFuncRefGet, result);
    }
    break;
    case 3:
    {
      snprintf(newPath, elcount(newPath), "%s.%s", oldPath, "offset4");
      value.offset4 = C2xGetTokenInt(packetHandle, "RoadSideInformation", newPath);
      result = CheckLastError("RoadSideInformation", gkFuncRefGet, result);
    }
    break;
    case 4:
    {
      snprintf(newPath, elcount(newPath), "%s.%s", oldPath, "offset5");
      value.offset5 = C2xGetTokenInt(packetHandle, "RoadSideInformation", newPath);
      result = CheckLastError("RoadSideInformation", gkFuncRefGet, result);
    }
    break;
    case 5:
    {
      snprintf(newPath, elcount(newPath), "%s.%s", oldPath, "offset6");
      value.offset6 = C2xGetTokenInt(packetHandle, "RoadSideInformation", newPath);
      result = CheckLastError("RoadSideInformation", gkFuncRefGet, result);
    }
    break;
    case 6:
    {
      snprintf(newPath, elcount(newPath), "%s.%s", oldPath, "elevation");
      value.elevation = C2xGetTokenInt(packetHandle, "RoadSideInformation", newPath);
      result = CheckLastError("RoadSideInformation", gkFuncRefGet, result);
    }
    break;
  }
  return result;
}

int SetRoadSideInformationVerticalOffsetParams(LONG packetHandle, struct RoadSideInformationVerticalOffset value, char oldPath[])
{
  char newPath[300];
  int result;

  result = 0;

  switch(value.choice)
  {
    case 0:
    {
      snprintf(newPath, elcount(newPath), "%s.%s", oldPath, "offset1");
      C2xSetTokenInt(packetHandle, "RoadSideInformation", newPath, value.offset1);
      result = CheckLastError("RoadSideInformation", gkFuncRefGet, result);
    }
    break;
    case 1:
    {
      snprintf(newPath, elcount(newPath), "%s.%s", oldPath, "offset2");
      C2xSetTokenInt(packetHandle, "RoadSideInformation", newPath, value.offset2);
      result = CheckLastError("RoadSideInformation", gkFuncRefGet, result);
    }
    break;
    case 2:
    {
      snprintf(newPath, elcount(newPath), "%s.%s", oldPath, "offset3");
      C2xSetTokenInt(packetHandle, "RoadSideInformation", newPath, value.offset3);
      result = CheckLastError("RoadSideInformation", gkFuncRefGet, result);
    }
    break;
    case 3:
    {
      snprintf(newPath, elcount(newPath), "%s.%s", oldPath, "offset4");
      C2xSetTokenInt(packetHandle, "RoadSideInformation", newPath, value.offset4);
      result = CheckLastError("RoadSideInformation", gkFuncRefGet, result);
    }
    break;
    case 4:
    {
      snprintf(newPath, elcount(newPath), "%s.%s", oldPath, "offset5");
      C2xSetTokenInt(packetHandle, "RoadSideInformation", newPath, value.offset5);
      result = CheckLastError("RoadSideInformation", gkFuncRefGet, result);
    }
    break;
    case 5:
    {
      snprintf(newPath, elcount(newPath), "%s.%s", oldPath, "offset6");
      C2xSetTokenInt(packetHandle, "RoadSideInformation", newPath, value.offset6);
      result = CheckLastError("RoadSideInformation", gkFuncRefGet, result);
    }
    break;
    case 6:
    {
      snprintf(newPath, elcount(newPath), "%s.%s", oldPath, "elevation");
      C2xSetTokenInt(packetHandle, "RoadSideInformation", newPath, value.elevation);
      result = CheckLastError("RoadSideInformation", gkFuncRefGet, result);
    }
    break;
  }
  return result;
}

int GetRoadSideInformationPositionOffsetLLVParams(LONG packetHandle, struct RoadSideInformationPositionOffsetLLV value, char oldPath[])
{
  char newPath[300];
  int result;

  result = 0;

  snprintf(newPath, elcount(newPath), "%s.%s", oldPath, "offsetLL");
  GetRoadSideInformationPositionOffsetLLParams(packetHandle, value.offsetLL, newPath);
  result = CheckLastError("RoadSideInformation", gkFuncRefGet, result);

  snprintf(newPath, elcount(newPath), "%s.%s", oldPath, "offsetV");
  value.offsetV.isValidFlag = C2xIsTokenAvailable(packetHandle, "RoadSideInformation", newPath);
  if(value.offsetV.isValidFlag==1)
  {
    GetRoadSideInformationVerticalOffsetParams(packetHandle, value.offsetV, newPath);
    result = CheckLastError("RoadSideInformation", gkFuncRefGet, result);
  }
  return result;
}

int SetRoadSideInformationPositionOffsetLLVParams(LONG packetHandle, struct RoadSideInformationPositionOffsetLLV value, char oldPath[])
{
  char newPath[300];
  int result;

  result = 0;

  snprintf(newPath, elcount(newPath), "%s.%s", oldPath, "offsetLL");
  SetRoadSideInformationPositionOffsetLLParams(packetHandle, value.offsetLL, newPath);
  result = CheckLastError("RoadSideInformation", gkFuncRefGet, result);

  snprintf(newPath, elcount(newPath), "%s.%s", oldPath, "offsetV");
  if(value.offsetV.isValidFlag==1)
  {
    SetRoadSideInformationVerticalOffsetParams(packetHandle, value.offsetV, newPath);
    result = CheckLastError("RoadSideInformation", gkFuncRefGet, result);
  }
  else
  {
    if( C2xIsTokenAvailable(packetHandle, "RoadSideInformation", newPath) )
    {
      C2xRemoveToken(packetHandle, "RoadSideInformation", newPath);
    }
  }

  return result;
}

int GetRoadSideInformationPathPointListParams(LONG packetHandle, struct RoadSideInformationPathPointList value, char oldPath[])
{
  char newPath[300]; 
  int i;
  int result;

  result = 0;

  value.length = C2xGetTokenInt(packetHandle, "RoadSideInformation", oldPath);
  if((result = CheckLastError("RoadSideInformation", gkFuncRefGet, result))==0)
  {
    for(i=0; i<value.length; i++)
    {
      snprintf(newPath, elcount(newPath), "%s[%d]", oldPath, i);
      GetRoadSideInformationPositionOffsetLLVParams(packetHandle, value.arrayValue[i], newPath);
      result = CheckLastError("RoadSideInformation", gkFuncRefGet, result);
    }
  }
  return result;
}

int SetRoadSideInformationPathPointListParams(LONG packetHandle, struct RoadSideInformationPathPointList value, char oldPath[])
{
  char newPath[300]; 
  int i;
  int result;

  result = 0;

  C2xRemoveToken(packetHandle, "RoadSideInformation", oldPath);
  for(i=0; i<value.length; i++)
  {
    snprintf(newPath, elcount(newPath), "%s[%d]", oldPath, i);
    SetRoadSideInformationPositionOffsetLLVParams(packetHandle, value.arrayValue[i], newPath);
    result = CheckLastError("RoadSideInformation", gkFuncRefGet, result);
  }
  return result;
}

int GetRoadSideInformationRSIFrameParams(LONG packetHandle, struct RoadSideInformationRSIFrame value, char oldPath[])
{
  char newPath[300];
  int result;

  result = 0;

  snprintf(newPath, elcount(newPath), "%s.%s", oldPath, "msgCnt");
  value.msgCnt = C2xGetTokenInt(packetHandle, "RoadSideInformation", newPath);
  result = CheckLastError("RoadSideInformation", gkFuncRefGet, result);

  snprintf(newPath, elcount(newPath), "%s.%s", oldPath, "timeStamp");
  value.timeStamp.isValidFlag = C2xIsTokenAvailable(packetHandle, "RoadSideInformation", newPath);
  if(value.timeStamp.isValidFlag==1)
  {
    value.timeStamp.value = C2xGetTokenInt(packetHandle, "RoadSideInformation", newPath);
    result = CheckLastError("RoadSideInformation", gkFuncRefGet, result);
  }
  snprintf(newPath, elcount(newPath), "%s.%s", oldPath, "id");
  value.id.stringLength = C2xGetTokenData(packetHandle, "RoadSideInformation", newPath, elcount(value.id.string), value.id.string);
  snprintf(newPath, elcount(newPath), "%s.%s", oldPath, "rsiId");
  value.rsiId = C2xGetTokenInt(packetHandle, "RoadSideInformation", newPath);
  result = CheckLastError("RoadSideInformation", gkFuncRefGet, result);

  snprintf(newPath, elcount(newPath), "%s.%s", oldPath, "alertType");
  value.alertType = C2xGetTokenInt(packetHandle, "RoadSideInformation", newPath);
  result = CheckLastError("RoadSideInformation", gkFuncRefGet, result);

  snprintf(newPath, elcount(newPath), "%s.%s", oldPath, "description");
  value.description.isValidFlag = C2xIsTokenAvailable(packetHandle, "RoadSideInformation", newPath);
  if(value.description.isValidFlag==1)
  {
    value.description.stringLength = C2xGetTokenData(packetHandle, "RoadSideInformation", newPath, elcount(value.description.string), value.description.string);
    result = CheckLastError("RoadSideInformation", gkFuncRefGet, result);
  }
  snprintf(newPath, elcount(newPath), "%s.%s", oldPath, "priority");
  value.priority.isValidFlag = C2xIsTokenAvailable(packetHandle, "RoadSideInformation", newPath);
  if(value.priority.isValidFlag==1)
  {
    value.priority.isValidFlag = 1;
    value.priority.stringLength = C2xGetTokenData(packetHandle, "RoadSideInformation", newPath, elcount(value.priority.string), value.priority.string);
  }
  snprintf(newPath, elcount(newPath), "%s.%s", oldPath, "refPos");
  GetRoadSideInformationPosition3DParams(packetHandle, value.refPos, newPath);
  result = CheckLastError("RoadSideInformation", gkFuncRefGet, result);

  snprintf(newPath, elcount(newPath), "%s.%s", oldPath, "alertPath");
  GetRoadSideInformationPathPointListParams(packetHandle, value.alertPath, newPath);
  result = CheckLastError("RoadSideInformation", gkFuncRefGet, result);

  snprintf(newPath, elcount(newPath), "%s.%s", oldPath, "alertRadius");
  value.alertRadius = C2xGetTokenInt(packetHandle, "RoadSideInformation", newPath);
  result = CheckLastError("RoadSideInformation", gkFuncRefGet, result);

  return result;
}

int SetRoadSideInformationRSIFrameParams(LONG packetHandle, struct RoadSideInformationRSIFrame value, char oldPath[])
{
  char newPath[300];
  int result;

  result = 0;

  snprintf(newPath, elcount(newPath), "%s.%s", oldPath, "msgCnt");
  C2xSetTokenInt(packetHandle, "RoadSideInformation", newPath, value.msgCnt);
  result = CheckLastError("RoadSideInformation", gkFuncRefGet, result);

  snprintf(newPath, elcount(newPath), "%s.%s", oldPath, "timeStamp");
  if(value.timeStamp.isValidFlag==1)
  {
    C2xSetTokenInt(packetHandle, "RoadSideInformation", newPath, value.timeStamp.value);
    result = CheckLastError("RoadSideInformation", gkFuncRefGet, result);
  }
  else
  {
    if( C2xIsTokenAvailable(packetHandle, "RoadSideInformation", newPath) )
    {
      C2xRemoveToken(packetHandle, "RoadSideInformation", newPath);
    }
  }

  if(value.id.stringLength == 0)
  {
    value.id.stringLength = 8;
    memcpy(value.id.string, "00000000", value.id.stringLength);
  }

  snprintf(newPath, elcount(newPath), "%s.%s", oldPath, "id");
  C2xSetTokenData(packetHandle, "RoadSideInformation", newPath, value.id.stringLength, value.id.string);

  snprintf(newPath, elcount(newPath), "%s.%s", oldPath, "rsiId");
  C2xSetTokenInt(packetHandle, "RoadSideInformation", newPath, value.rsiId);
  result = CheckLastError("RoadSideInformation", gkFuncRefGet, result);

  snprintf(newPath, elcount(newPath), "%s.%s", oldPath, "alertType");
  C2xSetTokenInt(packetHandle, "RoadSideInformation", newPath, value.alertType);
  result = CheckLastError("RoadSideInformation", gkFuncRefGet, result);

  snprintf(newPath, elcount(newPath), "%s.%s", oldPath, "description");
  if(value.description.isValidFlag==1)
  {
    C2xSetTokenData(packetHandle, "RoadSideInformation", newPath, value.description.stringLength, value.description.string);
    result = CheckLastError("RoadSideInformation", gkFuncRefGet, result);
  }
  else
  {
    if( C2xIsTokenAvailable(packetHandle, "RoadSideInformation", newPath) )
    {
      C2xRemoveToken(packetHandle, "RoadSideInformation", newPath);
    }
  }

  snprintf(newPath, elcount(newPath), "%s.%s", oldPath, "priority");
  if(value.priority.isValidFlag==1)
  {
    C2xSetTokenData(packetHandle, "RoadSideInformation", newPath, value.priority.stringLength, value.priority.string);
  }
  else
  {
    if( C2xIsTokenAvailable(packetHandle, "RoadSideInformation", newPath) )
    {
      C2xRemoveToken(packetHandle, "RoadSideInformation", newPath);
    }
  }

  snprintf(newPath, elcount(newPath), "%s.%s", oldPath, "refPos");
  SetRoadSideInformationPosition3DParams(packetHandle, value.refPos, newPath);
  result = CheckLastError("RoadSideInformation", gkFuncRefGet, result);

  snprintf(newPath, elcount(newPath), "%s.%s", oldPath, "alertPath");
  SetRoadSideInformationPathPointListParams(packetHandle, value.alertPath, newPath);
  result = CheckLastError("RoadSideInformation", gkFuncRefGet, result);

  snprintf(newPath, elcount(newPath), "%s.%s", oldPath, "alertRadius");
  C2xSetTokenInt(packetHandle, "RoadSideInformation", newPath, value.alertRadius);
  result = CheckLastError("RoadSideInformation", gkFuncRefGet, result);

  return result;
}

int API_GetRoadSideInformationParams(LONG packetHandle, struct RoadSideInformation value)
{
  int result;
  result = 0;

  value.frameType = C2xGetTokenInt(packetHandle, "RoadSideInformation", "frameType");
  result = CheckLastError("RoadSideInformation", gkFuncRefGet, result);

  value.rsiFrame.isValidFlag = 1;
  GetRoadSideInformationRSIFrameParams(packetHandle, value.rsiFrame, "rsiFrame");
  result = CheckLastError("RoadSideInformation", gkFuncRefGet, result);

  return result;
}

int API_SetRoadSideInformationParams(LONG packetHandle, struct RoadSideInformation value)
{
  int result;
  result = 0;

  C2xSetTokenInt(packetHandle, "RoadSideInformation", "frameType", value.frameType);
  result = CheckLastError("RoadSideInformation", gkFuncRefGet, result);

  SetRoadSideInformationRSIFrameParams(packetHandle, value.rsiFrame, "rsiFrame");
  result = CheckLastError("RoadSideInformation", gkFuncRefGet, result);

  return result;
}

