/*@!Encoding:1252*/
/*
//  (c) Vector Informatik GmbH. All rights reserved.
//
//  This file contains definitions of structs and methods that may be used
//  to set and get the values of an ASN.1 defined packet's payload.
//
//  //This example demonstrates how to set a packet's payload:
//  LONG packetHandle;
//  struct RoadsideSafetyMessage payload;
//  //you need to set the values of the variable "payload" yourself
//  packetHandle = API_InitRoadsideSafetyMessagePacket();
//  if (packetHandle!=0) {
//    if (API_SetRoadsideSafetyMessageParams(packetHandle, payload)==0) {
//      if (C2xCompletePacket(packetHandle)==0) {
//        C2xOutputPacket(packetHandle);
//      }
//    }
//  }
//                                                                             */
includes
{
  //#include "ASNV_Template_BaseDatatypes.cin"  // If warning "Duplicate #include, ignoring this include" appears, please remove the ASNV_Template_BaseDatatypes.cin include from your other *.cin files in the project.
}
variables
{
    struct RoadsideSafetyMessageRoadsideSafetyMessage_id {
        INT isValidFlag;   // necessary if this struct is used as an optional field of a SEQUENCE
        CHAR string[9];
        INT  stringLength;
    };
    
    struct RoadsideSafetyMessagePosition3D {
        INT isValidFlag;   // necessary if this struct is used as an optional field of a SEQUENCE
        LONG lat;  // INTEGER, -900000000..900000001;
        LONG lon;  // INTEGER, -1799999999..1800000001;
        struct OPT_LONG_ASN elevation;  // INTEGER, OPTIONAL, -4096..61439;
    };
    
    struct RoadsideSafetyMessageParticipantData_id {
        INT isValidFlag;   // necessary if this struct is used as an optional field of a SEQUENCE
        CHAR string[9];
        INT  stringLength;
    };
    
    struct RoadsideSafetyMessageParticipantData_plateNo {
        INT isValidFlag;   // necessary if this struct is used as an optional field of a SEQUENCE
        CHAR string[17];
        INT  stringLength;
    };
    
    struct RoadsideSafetyMessagePosition_LL_24B {
        INT isValidFlag;   // necessary if this struct is used as an optional field of a SEQUENCE
        INT lon;  // INTEGER, -2048..2047;
        INT lat;  // INTEGER, -2048..2047;
    };
    
    struct RoadsideSafetyMessagePosition_LL_28B {
        INT isValidFlag;   // necessary if this struct is used as an optional field of a SEQUENCE
        INT lon;  // INTEGER, -8192..8191;
        INT lat;  // INTEGER, -8192..8191;
    };
    
    struct RoadsideSafetyMessagePosition_LL_32B {
        INT isValidFlag;   // necessary if this struct is used as an optional field of a SEQUENCE
        INT lon;  // INTEGER, -32768..32767;
        INT lat;  // INTEGER, -32768..32767;
    };
    
    struct RoadsideSafetyMessagePosition_LL_36B {
        INT isValidFlag;   // necessary if this struct is used as an optional field of a SEQUENCE
        LONG lon;  // INTEGER, -131072..131071;
        LONG lat;  // INTEGER, -131072..131071;
    };
    
    struct RoadsideSafetyMessagePosition_LL_44B {
        INT isValidFlag;   // necessary if this struct is used as an optional field of a SEQUENCE
        LONG lon;  // INTEGER, -2097152..2097151;
        LONG lat;  // INTEGER, -2097152..2097151;
    };
    
    struct RoadsideSafetyMessagePosition_LL_48B {
        INT isValidFlag;   // necessary if this struct is used as an optional field of a SEQUENCE
        LONG lon;  // INTEGER, -8388608..8388607;
        LONG lat;  // INTEGER, -8388608..8388607;
    };
    
    struct RoadsideSafetyMessagePosition_LLmD_64b {
        INT isValidFlag;   // necessary if this struct is used as an optional field of a SEQUENCE
        LONG lon;  // INTEGER, -1799999999..1800000001;
        LONG lat;  // INTEGER, -900000000..900000001;
    };
    
    struct RoadsideSafetyMessagePositionOffsetLL {
        INT isValidFlag;   // necessary if this struct is used as an optional field of a SEQUENCE
        INT choice;
        struct RoadsideSafetyMessagePosition_LL_24B position_LL1;  // SEQUENCE;
        struct RoadsideSafetyMessagePosition_LL_28B position_LL2;  // SEQUENCE;
        struct RoadsideSafetyMessagePosition_LL_32B position_LL3;  // SEQUENCE;
        struct RoadsideSafetyMessagePosition_LL_36B position_LL4;  // SEQUENCE;
        struct RoadsideSafetyMessagePosition_LL_44B position_LL5;  // SEQUENCE;
        struct RoadsideSafetyMessagePosition_LL_48B position_LL6;  // SEQUENCE;
        struct RoadsideSafetyMessagePosition_LLmD_64b position_LatLon;  // SEQUENCE;
    };
    
    struct RoadsideSafetyMessageVerticalOffset {
        INT isValidFlag;   // necessary if this struct is used as an optional field of a SEQUENCE
        INT choice;
        INT offset1;  // INTEGER, -64..63;
        INT offset2;  // INTEGER, -128..127;
        INT offset3;  // INTEGER, -256..255;
        INT offset4;  // INTEGER, -512..511;
        INT offset5;  // INTEGER, -1024..1023;
        INT offset6;  // INTEGER, -2048..2047;
        LONG elevation;  // INTEGER, -4096..61439;
    };
    
    struct RoadsideSafetyMessagePositionOffsetLLV {
        INT isValidFlag;   // necessary if this struct is used as an optional field of a SEQUENCE
        struct RoadsideSafetyMessagePositionOffsetLL offsetLL;  // CHOICE;
        struct RoadsideSafetyMessageVerticalOffset offsetV;  // CHOICE, OPTIONAL;
    };
    
    struct RoadsideSafetyMessagePositionConfidenceSet {
        INT isValidFlag;   // necessary if this struct is used as an optional field of a SEQUENCE
        INT pos;  // ENUMERATED, unavailable(0), a500m(1), a200m(2), a100m(3), a50m(4), a20m(5), a10m(6), a5m(7), a2m(8), a1m(9), a50cm(10), a20cm(11), a10cm(12), a5cm(13), a2cm(14), a1cm(15);
        struct OPT_ENUM_ASN elevation;  // ENUMERATED, OPTIONAL, unavailable(0), elev_500_00(1), elev_200_00(2), elev_100_00(3), elev_050_00(4), elev_020_00(5), elev_010_00(6), elev_005_00(7), elev_002_00(8), elev_001_00(9), elev_000_50(10), elev_000_20(11), elev_000_10(12), elev_000_05(13), elev_000_02(14), elev_000_01(15);
    };
    
    struct RoadsideSafetyMessageMotionConfidenceSet {
        INT isValidFlag;   // necessary if this struct is used as an optional field of a SEQUENCE
        struct OPT_ENUM_ASN speedCfd;  // ENUMERATED, OPTIONAL, unavailable(0), prec100ms(1), prec10ms(2), prec5ms(3), prec1ms(4), prec0_1ms(5), prec0_05ms(6), prec0_01ms(7);
        struct OPT_ENUM_ASN headingCfd;  // ENUMERATED, OPTIONAL, unavailable(0), prec10deg(1), prec05deg(2), prec01deg(3), prec0_1deg(4), prec0_05deg(5), prec0_01deg(6), prec0_0125deg(7);
        struct OPT_ENUM_ASN steerCfd;  // ENUMERATED, OPTIONAL, unavailable(0), prec2deg(1), prec1deg(2), prec0_02deg(3);
    };
    
    struct RoadsideSafetyMessageAccelerationSet4Way {
        INT isValidFlag;   // necessary if this struct is used as an optional field of a SEQUENCE
        INT lon;  // INTEGER, -2000..2001;
        INT lat;  // INTEGER, -2000..2001;
        INT vert;  // INTEGER, -127..127;
        INT yaw;  // INTEGER, -32767..32767;
    };
    
    struct RoadsideSafetyMessageVehicleSize {
        INT isValidFlag;   // necessary if this struct is used as an optional field of a SEQUENCE
        WORD width;  // INTEGER, 0..1023;
        WORD length;  // INTEGER, 0..4095;
        struct OPT_BYTE_ASN height;  // INTEGER, OPTIONAL, 0..127;
    };
    
    struct RoadsideSafetyMessageVehicleClassification {
        INT isValidFlag;   // necessary if this struct is used as an optional field of a SEQUENCE
        BYTE classification;  // INTEGER, 0..255, unknownVehicleClass(0), specialVehicleClass(1), passenger_Vehicle_TypeUnknown(10), passenger_Vehicle_TypeOther(11), lightTruck_Vehicle_TypeUnknown(20), lightTruck_Vehicle_TypeOther(21), truck_Vehicle_TypeUnknown(25), truck_Vehicle_TypeOther(26), truck_axleCnt2(27), truck_axleCnt3(28), truck_axleCnt4(29), truck_axleCnt4Trailer(30), truck_axleCnt5Trailer(31), truck_axleCnt6Trailer(32), truck_axleCnt5MultiTrailer(33), truck_axleCnt6MultiTrailer(34), truck_axleCnt7MultiTrailer(35), motorcycle_TypeUnknown(40), motorcycle_TypeOther(41), motorcycle_Cruiser_Standard(42), motorcycle_SportUnclad(43), motorcycle_SportTouring(44), motorcycle_SuperSport(45), motorcycle_Touring(46), motorcycle_Trike(47), motorcycle_wPassengers(48), transit_TypeUnknown(50), transit_TypeOther(51), transit_BRT(52), transit_ExpressBus(53), transit_LocalBus(54), transit_SchoolBus(55), transit_FixedGuideway(56), transit_Paratransit(57), transit_Paratransit_Ambulance(58), emergency_TypeUnknown(60), emergency_TypeOther(61), emergency_Fire_Light_Vehicle(62), emergency_Fire_Heavy_Vehicle(63), emergency_Fire_Paramedic_Vehicle(64), emergency_Fire_Ambulance_Vehicle(65), emergency_Police_Light_Vehicle(66), emergency_Police_Heavy_Vehicle(67), emergency_Other_Responder(68), emergency_Other_Ambulance(69), otherTraveler_TypeUnknown(80), otherTraveler_TypeOther(81), otherTraveler_Pedestrian(82), otherTraveler_Visually_Disabled(83), otherTraveler_Physically_Disabled(84), otherTraveler_Bicycle(85), otherTraveler_Vulnerable_Roadworker(86), infrastructure_TypeUnknown(90), infrastructure_Fixed(91), infrastructure_Movable(92), equipped_CargoTrailer(93);
    };
    
    struct RoadsideSafetyMessageParticipantData {
        INT isValidFlag;   // necessary if this struct is used as an optional field of a SEQUENCE
        INT ptcType;  // ENUMERATED, unknown(0), motor(1), non_motor(2), pedestrian(3), rsu(4);
        WORD ptcId;  // INTEGER, 0..65535;
        INT source;  // ENUMERATED, unknown(0), selfinfo(1), v2x(2), video(3), microwaveRadar(4), loop(5);
        struct RoadsideSafetyMessageParticipantData_id id;  // OCTETSTRING, OPTIONAL;
        struct RoadsideSafetyMessageParticipantData_plateNo plateNo;  // OCTETSTRING, OPTIONAL;
        WORD secMark;  // INTEGER, 0..65535;
        struct RoadsideSafetyMessagePositionOffsetLLV pos;  // SEQUENCE;
        struct RoadsideSafetyMessagePositionConfidenceSet accuracy;  // SEQUENCE;
        struct OPT_ENUM_ASN transmission;  // ENUMERATED, OPTIONAL, neutral(0), park(1), forwardGears(2), reverseGears(3), reserved1(4), reserved2(5), reserved3(6), unavailable(7);
        WORD speed;  // INTEGER, 0..8191;
        WORD heading;  // INTEGER, 0..28800;
        struct OPT_INT_ASN angle;  // INTEGER, OPTIONAL, -126..127;
        struct RoadsideSafetyMessageMotionConfidenceSet motionCfd;  // SEQUENCE, OPTIONAL;
        struct RoadsideSafetyMessageAccelerationSet4Way accelSet;  // SEQUENCE, OPTIONAL;
        struct RoadsideSafetyMessageVehicleSize size;  // SEQUENCE;
        struct RoadsideSafetyMessageVehicleClassification vehicleClass;  // SEQUENCE, OPTIONAL;
    };
    
    struct RoadsideSafetyMessageParticipantList {
        INT isValidFlag;   // necessary if this struct is used as an optional field of a SEQUENCE
        INT length;
        struct RoadsideSafetyMessageParticipantData arrayValue[16];  // SEQUENCE;
    };
    
    struct RoadsideSafetyMessageRSMFrame {
        INT isValidFlag;   // necessary if this struct is used as an optional field of a SEQUENCE
        BYTE msgCnt;  // INTEGER, 0..127;
        struct RoadsideSafetyMessageRoadsideSafetyMessage_id id;  // OCTETSTRING;
        struct RoadsideSafetyMessagePosition3D refPos;  // SEQUENCE;
        struct RoadsideSafetyMessageParticipantList participants;  // SEQUENCEOF;
    };
    
    struct RoadsideSafetyMessage {
        INT isValidFlag;   // necessary if this struct is used as an optional field of a SEQUENCE
        BYTE frameType;  // INTEGER, 0..15, rsmFrame(4);
        struct RoadsideSafetyMessageRSMFrame rsmFrame;  // SEQUENCE;
    };
    
}

/*
// init function to create a simple packet handle
*/ 
LONG API_InitRoadsideSafetyMessagePacket()
{
  return C2xInitPacket("RoadsideSafetyMessage"); 
}

/*
// init function to create a simple packet handle and
// initialize the struct with valid data
*/ 
LONG API_InitRoadsideSafetyMessagePacket(struct RoadsideSafetyMessage msgStruct)
{
  long pktHandle;

  pktHandle = API_InitRoadsideSafetyMessagePacket();

  if (pktHandle != 0)
  {
    // create valid message and application data
    if (C2xCompletePacket(pktHandle) == 0) 
    {
      API_GetRoadsideSafetyMessageParams(pktHandle, msgStruct);
    }
  }
  return pktHandle;
}

/*
// init function to create a packet with security layer and
// initialize the struct with valid data
*/ 
LONG API_InitRoadsideSafetyMessagePacket(struct RoadsideSafetyMessage msgStruct, char packetTypeDesignator[], char certificateName[])
{
  long pktHandle, certHdl;

  // initialize the packet
  pktHandle = C2xInitPacket("RoadsideSafetyMessage", packetTypeDesignator);

  if (pktHandle != 0)
  {
    certHdl = C2xSecCertificateGetHandle(certificateName);  // get the certificate handle for the cert with name "certificateName"
    if (certHdl != 0) 
    {
      C2xSecPacketSetSignerHandle(pktHandle, certHdl); // set the certHdl to the packet
    }

    // create valid message and application data
    if (C2xCompletePacket(pktHandle) == 0) 
    {
      // copy application data to the application structure
      API_GetRoadsideSafetyMessageParams(pktHandle, msgStruct);
    }
  }
  return pktHandle;
}
    

int GetRoadsideSafetyMessagePosition3DParams(LONG packetHandle, struct RoadsideSafetyMessagePosition3D value, char oldPath[])
{
  char newPath[300];
  int result;

  result = 0;

  snprintf(newPath, elcount(newPath), "%s.%s", oldPath, "lat");
  value.lat = C2xGetTokenInt(packetHandle, "RoadsideSafetyMessage", newPath);
  result = CheckLastError("RoadsideSafetyMessage", gkFuncRefGet, result);

  snprintf(newPath, elcount(newPath), "%s.%s", oldPath, "lon");
  value.lon = C2xGetTokenInt(packetHandle, "RoadsideSafetyMessage", newPath);
  result = CheckLastError("RoadsideSafetyMessage", gkFuncRefGet, result);

  snprintf(newPath, elcount(newPath), "%s.%s", oldPath, "elevation");
  value.elevation.isValidFlag = C2xIsTokenAvailable(packetHandle, "RoadsideSafetyMessage", newPath);
  if(value.elevation.isValidFlag==1)
  {
    value.elevation.value = C2xGetTokenInt(packetHandle, "RoadsideSafetyMessage", newPath);
    result = CheckLastError("RoadsideSafetyMessage", gkFuncRefGet, result);
  }
  return result;
}

int SetRoadsideSafetyMessagePosition3DParams(LONG packetHandle, struct RoadsideSafetyMessagePosition3D value, char oldPath[])
{
  char newPath[300];
  int result;

  result = 0;

  snprintf(newPath, elcount(newPath), "%s.%s", oldPath, "lat");
  C2xSetTokenInt(packetHandle, "RoadsideSafetyMessage", newPath, value.lat);
  result = CheckLastError("RoadsideSafetyMessage", gkFuncRefGet, result);

  snprintf(newPath, elcount(newPath), "%s.%s", oldPath, "lon");
  C2xSetTokenInt(packetHandle, "RoadsideSafetyMessage", newPath, value.lon);
  result = CheckLastError("RoadsideSafetyMessage", gkFuncRefGet, result);

  snprintf(newPath, elcount(newPath), "%s.%s", oldPath, "elevation");
  if(value.elevation.isValidFlag==1)
  {
    C2xSetTokenInt(packetHandle, "RoadsideSafetyMessage", newPath, value.elevation.value);
    result = CheckLastError("RoadsideSafetyMessage", gkFuncRefGet, result);
  }
  else
  {
    if( C2xIsTokenAvailable(packetHandle, "RoadsideSafetyMessage", newPath) )
    {
      C2xRemoveToken(packetHandle, "RoadsideSafetyMessage", newPath);
    }
  }

  return result;
}

int GetRoadsideSafetyMessagePosition_LL_24BParams(LONG packetHandle, struct RoadsideSafetyMessagePosition_LL_24B value, char oldPath[])
{
  char newPath[300];
  int result;

  result = 0;

  snprintf(newPath, elcount(newPath), "%s.%s", oldPath, "lon");
  value.lon = C2xGetTokenInt(packetHandle, "RoadsideSafetyMessage", newPath);
  result = CheckLastError("RoadsideSafetyMessage", gkFuncRefGet, result);

  snprintf(newPath, elcount(newPath), "%s.%s", oldPath, "lat");
  value.lat = C2xGetTokenInt(packetHandle, "RoadsideSafetyMessage", newPath);
  result = CheckLastError("RoadsideSafetyMessage", gkFuncRefGet, result);

  return result;
}

int SetRoadsideSafetyMessagePosition_LL_24BParams(LONG packetHandle, struct RoadsideSafetyMessagePosition_LL_24B value, char oldPath[])
{
  char newPath[300];
  int result;

  result = 0;

  snprintf(newPath, elcount(newPath), "%s.%s", oldPath, "lon");
  C2xSetTokenInt(packetHandle, "RoadsideSafetyMessage", newPath, value.lon);
  result = CheckLastError("RoadsideSafetyMessage", gkFuncRefGet, result);

  snprintf(newPath, elcount(newPath), "%s.%s", oldPath, "lat");
  C2xSetTokenInt(packetHandle, "RoadsideSafetyMessage", newPath, value.lat);
  result = CheckLastError("RoadsideSafetyMessage", gkFuncRefGet, result);

  return result;
}

int GetRoadsideSafetyMessagePosition_LL_28BParams(LONG packetHandle, struct RoadsideSafetyMessagePosition_LL_28B value, char oldPath[])
{
  char newPath[300];
  int result;

  result = 0;

  snprintf(newPath, elcount(newPath), "%s.%s", oldPath, "lon");
  value.lon = C2xGetTokenInt(packetHandle, "RoadsideSafetyMessage", newPath);
  result = CheckLastError("RoadsideSafetyMessage", gkFuncRefGet, result);

  snprintf(newPath, elcount(newPath), "%s.%s", oldPath, "lat");
  value.lat = C2xGetTokenInt(packetHandle, "RoadsideSafetyMessage", newPath);
  result = CheckLastError("RoadsideSafetyMessage", gkFuncRefGet, result);

  return result;
}

int SetRoadsideSafetyMessagePosition_LL_28BParams(LONG packetHandle, struct RoadsideSafetyMessagePosition_LL_28B value, char oldPath[])
{
  char newPath[300];
  int result;

  result = 0;

  snprintf(newPath, elcount(newPath), "%s.%s", oldPath, "lon");
  C2xSetTokenInt(packetHandle, "RoadsideSafetyMessage", newPath, value.lon);
  result = CheckLastError("RoadsideSafetyMessage", gkFuncRefGet, result);

  snprintf(newPath, elcount(newPath), "%s.%s", oldPath, "lat");
  C2xSetTokenInt(packetHandle, "RoadsideSafetyMessage", newPath, value.lat);
  result = CheckLastError("RoadsideSafetyMessage", gkFuncRefGet, result);

  return result;
}

int GetRoadsideSafetyMessagePosition_LL_32BParams(LONG packetHandle, struct RoadsideSafetyMessagePosition_LL_32B value, char oldPath[])
{
  char newPath[300];
  int result;

  result = 0;

  snprintf(newPath, elcount(newPath), "%s.%s", oldPath, "lon");
  value.lon = C2xGetTokenInt(packetHandle, "RoadsideSafetyMessage", newPath);
  result = CheckLastError("RoadsideSafetyMessage", gkFuncRefGet, result);

  snprintf(newPath, elcount(newPath), "%s.%s", oldPath, "lat");
  value.lat = C2xGetTokenInt(packetHandle, "RoadsideSafetyMessage", newPath);
  result = CheckLastError("RoadsideSafetyMessage", gkFuncRefGet, result);

  return result;
}

int SetRoadsideSafetyMessagePosition_LL_32BParams(LONG packetHandle, struct RoadsideSafetyMessagePosition_LL_32B value, char oldPath[])
{
  char newPath[300];
  int result;

  result = 0;

  snprintf(newPath, elcount(newPath), "%s.%s", oldPath, "lon");
  C2xSetTokenInt(packetHandle, "RoadsideSafetyMessage", newPath, value.lon);
  result = CheckLastError("RoadsideSafetyMessage", gkFuncRefGet, result);

  snprintf(newPath, elcount(newPath), "%s.%s", oldPath, "lat");
  C2xSetTokenInt(packetHandle, "RoadsideSafetyMessage", newPath, value.lat);
  result = CheckLastError("RoadsideSafetyMessage", gkFuncRefGet, result);

  return result;
}

int GetRoadsideSafetyMessagePosition_LL_36BParams(LONG packetHandle, struct RoadsideSafetyMessagePosition_LL_36B value, char oldPath[])
{
  char newPath[300];
  int result;

  result = 0;

  snprintf(newPath, elcount(newPath), "%s.%s", oldPath, "lon");
  value.lon = C2xGetTokenInt(packetHandle, "RoadsideSafetyMessage", newPath);
  result = CheckLastError("RoadsideSafetyMessage", gkFuncRefGet, result);

  snprintf(newPath, elcount(newPath), "%s.%s", oldPath, "lat");
  value.lat = C2xGetTokenInt(packetHandle, "RoadsideSafetyMessage", newPath);
  result = CheckLastError("RoadsideSafetyMessage", gkFuncRefGet, result);

  return result;
}

int SetRoadsideSafetyMessagePosition_LL_36BParams(LONG packetHandle, struct RoadsideSafetyMessagePosition_LL_36B value, char oldPath[])
{
  char newPath[300];
  int result;

  result = 0;

  snprintf(newPath, elcount(newPath), "%s.%s", oldPath, "lon");
  C2xSetTokenInt(packetHandle, "RoadsideSafetyMessage", newPath, value.lon);
  result = CheckLastError("RoadsideSafetyMessage", gkFuncRefGet, result);

  snprintf(newPath, elcount(newPath), "%s.%s", oldPath, "lat");
  C2xSetTokenInt(packetHandle, "RoadsideSafetyMessage", newPath, value.lat);
  result = CheckLastError("RoadsideSafetyMessage", gkFuncRefGet, result);

  return result;
}

int GetRoadsideSafetyMessagePosition_LL_44BParams(LONG packetHandle, struct RoadsideSafetyMessagePosition_LL_44B value, char oldPath[])
{
  char newPath[300];
  int result;

  result = 0;

  snprintf(newPath, elcount(newPath), "%s.%s", oldPath, "lon");
  value.lon = C2xGetTokenInt(packetHandle, "RoadsideSafetyMessage", newPath);
  result = CheckLastError("RoadsideSafetyMessage", gkFuncRefGet, result);

  snprintf(newPath, elcount(newPath), "%s.%s", oldPath, "lat");
  value.lat = C2xGetTokenInt(packetHandle, "RoadsideSafetyMessage", newPath);
  result = CheckLastError("RoadsideSafetyMessage", gkFuncRefGet, result);

  return result;
}

int SetRoadsideSafetyMessagePosition_LL_44BParams(LONG packetHandle, struct RoadsideSafetyMessagePosition_LL_44B value, char oldPath[])
{
  char newPath[300];
  int result;

  result = 0;

  snprintf(newPath, elcount(newPath), "%s.%s", oldPath, "lon");
  C2xSetTokenInt(packetHandle, "RoadsideSafetyMessage", newPath, value.lon);
  result = CheckLastError("RoadsideSafetyMessage", gkFuncRefGet, result);

  snprintf(newPath, elcount(newPath), "%s.%s", oldPath, "lat");
  C2xSetTokenInt(packetHandle, "RoadsideSafetyMessage", newPath, value.lat);
  result = CheckLastError("RoadsideSafetyMessage", gkFuncRefGet, result);

  return result;
}

int GetRoadsideSafetyMessagePosition_LL_48BParams(LONG packetHandle, struct RoadsideSafetyMessagePosition_LL_48B value, char oldPath[])
{
  char newPath[300];
  int result;

  result = 0;

  snprintf(newPath, elcount(newPath), "%s.%s", oldPath, "lon");
  value.lon = C2xGetTokenInt(packetHandle, "RoadsideSafetyMessage", newPath);
  result = CheckLastError("RoadsideSafetyMessage", gkFuncRefGet, result);

  snprintf(newPath, elcount(newPath), "%s.%s", oldPath, "lat");
  value.lat = C2xGetTokenInt(packetHandle, "RoadsideSafetyMessage", newPath);
  result = CheckLastError("RoadsideSafetyMessage", gkFuncRefGet, result);

  return result;
}

int SetRoadsideSafetyMessagePosition_LL_48BParams(LONG packetHandle, struct RoadsideSafetyMessagePosition_LL_48B value, char oldPath[])
{
  char newPath[300];
  int result;

  result = 0;

  snprintf(newPath, elcount(newPath), "%s.%s", oldPath, "lon");
  C2xSetTokenInt(packetHandle, "RoadsideSafetyMessage", newPath, value.lon);
  result = CheckLastError("RoadsideSafetyMessage", gkFuncRefGet, result);

  snprintf(newPath, elcount(newPath), "%s.%s", oldPath, "lat");
  C2xSetTokenInt(packetHandle, "RoadsideSafetyMessage", newPath, value.lat);
  result = CheckLastError("RoadsideSafetyMessage", gkFuncRefGet, result);

  return result;
}

int GetRoadsideSafetyMessagePosition_LLmD_64bParams(LONG packetHandle, struct RoadsideSafetyMessagePosition_LLmD_64b value, char oldPath[])
{
  char newPath[300];
  int result;

  result = 0;

  snprintf(newPath, elcount(newPath), "%s.%s", oldPath, "lon");
  value.lon = C2xGetTokenInt(packetHandle, "RoadsideSafetyMessage", newPath);
  result = CheckLastError("RoadsideSafetyMessage", gkFuncRefGet, result);

  snprintf(newPath, elcount(newPath), "%s.%s", oldPath, "lat");
  value.lat = C2xGetTokenInt(packetHandle, "RoadsideSafetyMessage", newPath);
  result = CheckLastError("RoadsideSafetyMessage", gkFuncRefGet, result);

  return result;
}

int SetRoadsideSafetyMessagePosition_LLmD_64bParams(LONG packetHandle, struct RoadsideSafetyMessagePosition_LLmD_64b value, char oldPath[])
{
  char newPath[300];
  int result;

  result = 0;

  snprintf(newPath, elcount(newPath), "%s.%s", oldPath, "lon");
  C2xSetTokenInt(packetHandle, "RoadsideSafetyMessage", newPath, value.lon);
  result = CheckLastError("RoadsideSafetyMessage", gkFuncRefGet, result);

  snprintf(newPath, elcount(newPath), "%s.%s", oldPath, "lat");
  C2xSetTokenInt(packetHandle, "RoadsideSafetyMessage", newPath, value.lat);
  result = CheckLastError("RoadsideSafetyMessage", gkFuncRefGet, result);

  return result;
}

int GetRoadsideSafetyMessagePositionOffsetLLParams(LONG packetHandle, struct RoadsideSafetyMessagePositionOffsetLL value, char oldPath[])
{
  char newPath[300];
  int result;

  result = 0;

  value.choice = C2xGetTokenInt(packetHandle, "RoadsideSafetyMessage", oldPath);

  switch(value.choice)
  {
    case 0:
    {
      snprintf(newPath, elcount(newPath), "%s.%s", oldPath, "position_LL1");
      GetRoadsideSafetyMessagePosition_LL_24BParams(packetHandle, value.position_LL1, newPath);
      result = CheckLastError("RoadsideSafetyMessage", gkFuncRefGet, result);
    }
    break;
    case 1:
    {
      snprintf(newPath, elcount(newPath), "%s.%s", oldPath, "position_LL2");
      GetRoadsideSafetyMessagePosition_LL_28BParams(packetHandle, value.position_LL2, newPath);
      result = CheckLastError("RoadsideSafetyMessage", gkFuncRefGet, result);
    }
    break;
    case 2:
    {
      snprintf(newPath, elcount(newPath), "%s.%s", oldPath, "position_LL3");
      GetRoadsideSafetyMessagePosition_LL_32BParams(packetHandle, value.position_LL3, newPath);
      result = CheckLastError("RoadsideSafetyMessage", gkFuncRefGet, result);
    }
    break;
    case 3:
    {
      snprintf(newPath, elcount(newPath), "%s.%s", oldPath, "position_LL4");
      GetRoadsideSafetyMessagePosition_LL_36BParams(packetHandle, value.position_LL4, newPath);
      result = CheckLastError("RoadsideSafetyMessage", gkFuncRefGet, result);
    }
    break;
    case 4:
    {
      snprintf(newPath, elcount(newPath), "%s.%s", oldPath, "position_LL5");
      GetRoadsideSafetyMessagePosition_LL_44BParams(packetHandle, value.position_LL5, newPath);
      result = CheckLastError("RoadsideSafetyMessage", gkFuncRefGet, result);
    }
    break;
    case 5:
    {
      snprintf(newPath, elcount(newPath), "%s.%s", oldPath, "position_LL6");
      GetRoadsideSafetyMessagePosition_LL_48BParams(packetHandle, value.position_LL6, newPath);
      result = CheckLastError("RoadsideSafetyMessage", gkFuncRefGet, result);
    }
    break;
    case 6:
    {
      snprintf(newPath, elcount(newPath), "%s.%s", oldPath, "position_LatLon");
      GetRoadsideSafetyMessagePosition_LLmD_64bParams(packetHandle, value.position_LatLon, newPath);
      result = CheckLastError("RoadsideSafetyMessage", gkFuncRefGet, result);
    }
    break;
  }
  return result;
}

int SetRoadsideSafetyMessagePositionOffsetLLParams(LONG packetHandle, struct RoadsideSafetyMessagePositionOffsetLL value, char oldPath[])
{
  char newPath[300];
  int result;

  result = 0;

  switch(value.choice)
  {
    case 0:
    {
      snprintf(newPath, elcount(newPath), "%s.%s", oldPath, "position_LL1");
      SetRoadsideSafetyMessagePosition_LL_24BParams(packetHandle, value.position_LL1, newPath);
      result = CheckLastError("RoadsideSafetyMessage", gkFuncRefGet, result);
    }
    break;
    case 1:
    {
      snprintf(newPath, elcount(newPath), "%s.%s", oldPath, "position_LL2");
      SetRoadsideSafetyMessagePosition_LL_28BParams(packetHandle, value.position_LL2, newPath);
      result = CheckLastError("RoadsideSafetyMessage", gkFuncRefGet, result);
    }
    break;
    case 2:
    {
      snprintf(newPath, elcount(newPath), "%s.%s", oldPath, "position_LL3");
      SetRoadsideSafetyMessagePosition_LL_32BParams(packetHandle, value.position_LL3, newPath);
      result = CheckLastError("RoadsideSafetyMessage", gkFuncRefGet, result);
    }
    break;
    case 3:
    {
      snprintf(newPath, elcount(newPath), "%s.%s", oldPath, "position_LL4");
      SetRoadsideSafetyMessagePosition_LL_36BParams(packetHandle, value.position_LL4, newPath);
      result = CheckLastError("RoadsideSafetyMessage", gkFuncRefGet, result);
    }
    break;
    case 4:
    {
      snprintf(newPath, elcount(newPath), "%s.%s", oldPath, "position_LL5");
      SetRoadsideSafetyMessagePosition_LL_44BParams(packetHandle, value.position_LL5, newPath);
      result = CheckLastError("RoadsideSafetyMessage", gkFuncRefGet, result);
    }
    break;
    case 5:
    {
      snprintf(newPath, elcount(newPath), "%s.%s", oldPath, "position_LL6");
      SetRoadsideSafetyMessagePosition_LL_48BParams(packetHandle, value.position_LL6, newPath);
      result = CheckLastError("RoadsideSafetyMessage", gkFuncRefGet, result);
    }
    break;
    case 6:
    {
      snprintf(newPath, elcount(newPath), "%s.%s", oldPath, "position_LatLon");
      SetRoadsideSafetyMessagePosition_LLmD_64bParams(packetHandle, value.position_LatLon, newPath);
      result = CheckLastError("RoadsideSafetyMessage", gkFuncRefGet, result);
    }
    break;
  }
  return result;
}

int GetRoadsideSafetyMessageVerticalOffsetParams(LONG packetHandle, struct RoadsideSafetyMessageVerticalOffset value, char oldPath[])
{
  char newPath[300];
  int result;

  result = 0;

  value.choice = C2xGetTokenInt(packetHandle, "RoadsideSafetyMessage", oldPath);

  switch(value.choice)
  {
    case 0:
    {
      snprintf(newPath, elcount(newPath), "%s.%s", oldPath, "offset1");
      value.offset1 = C2xGetTokenInt(packetHandle, "RoadsideSafetyMessage", newPath);
      result = CheckLastError("RoadsideSafetyMessage", gkFuncRefGet, result);
    }
    break;
    case 1:
    {
      snprintf(newPath, elcount(newPath), "%s.%s", oldPath, "offset2");
      value.offset2 = C2xGetTokenInt(packetHandle, "RoadsideSafetyMessage", newPath);
      result = CheckLastError("RoadsideSafetyMessage", gkFuncRefGet, result);
    }
    break;
    case 2:
    {
      snprintf(newPath, elcount(newPath), "%s.%s", oldPath, "offset3");
      value.offset3 = C2xGetTokenInt(packetHandle, "RoadsideSafetyMessage", newPath);
      result = CheckLastError("RoadsideSafetyMessage", gkFuncRefGet, result);
    }
    break;
    case 3:
    {
      snprintf(newPath, elcount(newPath), "%s.%s", oldPath, "offset4");
      value.offset4 = C2xGetTokenInt(packetHandle, "RoadsideSafetyMessage", newPath);
      result = CheckLastError("RoadsideSafetyMessage", gkFuncRefGet, result);
    }
    break;
    case 4:
    {
      snprintf(newPath, elcount(newPath), "%s.%s", oldPath, "offset5");
      value.offset5 = C2xGetTokenInt(packetHandle, "RoadsideSafetyMessage", newPath);
      result = CheckLastError("RoadsideSafetyMessage", gkFuncRefGet, result);
    }
    break;
    case 5:
    {
      snprintf(newPath, elcount(newPath), "%s.%s", oldPath, "offset6");
      value.offset6 = C2xGetTokenInt(packetHandle, "RoadsideSafetyMessage", newPath);
      result = CheckLastError("RoadsideSafetyMessage", gkFuncRefGet, result);
    }
    break;
    case 6:
    {
      snprintf(newPath, elcount(newPath), "%s.%s", oldPath, "elevation");
      value.elevation = C2xGetTokenInt(packetHandle, "RoadsideSafetyMessage", newPath);
      result = CheckLastError("RoadsideSafetyMessage", gkFuncRefGet, result);
    }
    break;
  }
  return result;
}

int SetRoadsideSafetyMessageVerticalOffsetParams(LONG packetHandle, struct RoadsideSafetyMessageVerticalOffset value, char oldPath[])
{
  char newPath[300];
  int result;

  result = 0;

  switch(value.choice)
  {
    case 0:
    {
      snprintf(newPath, elcount(newPath), "%s.%s", oldPath, "offset1");
      C2xSetTokenInt(packetHandle, "RoadsideSafetyMessage", newPath, value.offset1);
      result = CheckLastError("RoadsideSafetyMessage", gkFuncRefGet, result);
    }
    break;
    case 1:
    {
      snprintf(newPath, elcount(newPath), "%s.%s", oldPath, "offset2");
      C2xSetTokenInt(packetHandle, "RoadsideSafetyMessage", newPath, value.offset2);
      result = CheckLastError("RoadsideSafetyMessage", gkFuncRefGet, result);
    }
    break;
    case 2:
    {
      snprintf(newPath, elcount(newPath), "%s.%s", oldPath, "offset3");
      C2xSetTokenInt(packetHandle, "RoadsideSafetyMessage", newPath, value.offset3);
      result = CheckLastError("RoadsideSafetyMessage", gkFuncRefGet, result);
    }
    break;
    case 3:
    {
      snprintf(newPath, elcount(newPath), "%s.%s", oldPath, "offset4");
      C2xSetTokenInt(packetHandle, "RoadsideSafetyMessage", newPath, value.offset4);
      result = CheckLastError("RoadsideSafetyMessage", gkFuncRefGet, result);
    }
    break;
    case 4:
    {
      snprintf(newPath, elcount(newPath), "%s.%s", oldPath, "offset5");
      C2xSetTokenInt(packetHandle, "RoadsideSafetyMessage", newPath, value.offset5);
      result = CheckLastError("RoadsideSafetyMessage", gkFuncRefGet, result);
    }
    break;
    case 5:
    {
      snprintf(newPath, elcount(newPath), "%s.%s", oldPath, "offset6");
      C2xSetTokenInt(packetHandle, "RoadsideSafetyMessage", newPath, value.offset6);
      result = CheckLastError("RoadsideSafetyMessage", gkFuncRefGet, result);
    }
    break;
    case 6:
    {
      snprintf(newPath, elcount(newPath), "%s.%s", oldPath, "elevation");
      C2xSetTokenInt(packetHandle, "RoadsideSafetyMessage", newPath, value.elevation);
      result = CheckLastError("RoadsideSafetyMessage", gkFuncRefGet, result);
    }
    break;
  }
  return result;
}

int GetRoadsideSafetyMessagePositionOffsetLLVParams(LONG packetHandle, struct RoadsideSafetyMessagePositionOffsetLLV value, char oldPath[])
{
  char newPath[300];
  int result;

  result = 0;

  snprintf(newPath, elcount(newPath), "%s.%s", oldPath, "offsetLL");
  GetRoadsideSafetyMessagePositionOffsetLLParams(packetHandle, value.offsetLL, newPath);
  result = CheckLastError("RoadsideSafetyMessage", gkFuncRefGet, result);

  snprintf(newPath, elcount(newPath), "%s.%s", oldPath, "offsetV");
  value.offsetV.isValidFlag = C2xIsTokenAvailable(packetHandle, "RoadsideSafetyMessage", newPath);
  if(value.offsetV.isValidFlag==1)
  {
    GetRoadsideSafetyMessageVerticalOffsetParams(packetHandle, value.offsetV, newPath);
    result = CheckLastError("RoadsideSafetyMessage", gkFuncRefGet, result);
  }
  return result;
}

int SetRoadsideSafetyMessagePositionOffsetLLVParams(LONG packetHandle, struct RoadsideSafetyMessagePositionOffsetLLV value, char oldPath[])
{
  char newPath[300];
  int result;

  result = 0;

  snprintf(newPath, elcount(newPath), "%s.%s", oldPath, "offsetLL");
  SetRoadsideSafetyMessagePositionOffsetLLParams(packetHandle, value.offsetLL, newPath);
  result = CheckLastError("RoadsideSafetyMessage", gkFuncRefGet, result);

  snprintf(newPath, elcount(newPath), "%s.%s", oldPath, "offsetV");
  if(value.offsetV.isValidFlag==1)
  {
    SetRoadsideSafetyMessageVerticalOffsetParams(packetHandle, value.offsetV, newPath);
    result = CheckLastError("RoadsideSafetyMessage", gkFuncRefGet, result);
  }
  else
  {
    if( C2xIsTokenAvailable(packetHandle, "RoadsideSafetyMessage", newPath) )
    {
      C2xRemoveToken(packetHandle, "RoadsideSafetyMessage", newPath);
    }
  }

  return result;
}

int GetRoadsideSafetyMessagePositionConfidenceSetParams(LONG packetHandle, struct RoadsideSafetyMessagePositionConfidenceSet value, char oldPath[])
{
  char newPath[300];
  int result;

  result = 0;

  snprintf(newPath, elcount(newPath), "%s.%s", oldPath, "pos");
  value.pos = C2xGetTokenInt(packetHandle, "RoadsideSafetyMessage", newPath);
  result = CheckLastError("RoadsideSafetyMessage", gkFuncRefGet, result);

  snprintf(newPath, elcount(newPath), "%s.%s", oldPath, "elevation");
  value.elevation.isValidFlag = C2xIsTokenAvailable(packetHandle, "RoadsideSafetyMessage", newPath);
  if(value.elevation.isValidFlag==1)
  {
    value.elevation.value = C2xGetTokenInt(packetHandle, "RoadsideSafetyMessage", newPath);
    result = CheckLastError("RoadsideSafetyMessage", gkFuncRefGet, result);
  }
  return result;
}

int SetRoadsideSafetyMessagePositionConfidenceSetParams(LONG packetHandle, struct RoadsideSafetyMessagePositionConfidenceSet value, char oldPath[])
{
  char newPath[300];
  int result;

  result = 0;

  snprintf(newPath, elcount(newPath), "%s.%s", oldPath, "pos");
  C2xSetTokenInt(packetHandle, "RoadsideSafetyMessage", newPath, value.pos);
  result = CheckLastError("RoadsideSafetyMessage", gkFuncRefGet, result);

  snprintf(newPath, elcount(newPath), "%s.%s", oldPath, "elevation");
  if(value.elevation.isValidFlag==1)
  {
    C2xSetTokenInt(packetHandle, "RoadsideSafetyMessage", newPath, value.elevation.value);
    result = CheckLastError("RoadsideSafetyMessage", gkFuncRefGet, result);
  }
  else
  {
    if( C2xIsTokenAvailable(packetHandle, "RoadsideSafetyMessage", newPath) )
    {
      C2xRemoveToken(packetHandle, "RoadsideSafetyMessage", newPath);
    }
  }

  return result;
}

int GetRoadsideSafetyMessageMotionConfidenceSetParams(LONG packetHandle, struct RoadsideSafetyMessageMotionConfidenceSet value, char oldPath[])
{
  char newPath[300];
  int result;

  result = 0;

  snprintf(newPath, elcount(newPath), "%s.%s", oldPath, "speedCfd");
  value.speedCfd.isValidFlag = C2xIsTokenAvailable(packetHandle, "RoadsideSafetyMessage", newPath);
  if(value.speedCfd.isValidFlag==1)
  {
    value.speedCfd.value = C2xGetTokenInt(packetHandle, "RoadsideSafetyMessage", newPath);
    result = CheckLastError("RoadsideSafetyMessage", gkFuncRefGet, result);
  }
  snprintf(newPath, elcount(newPath), "%s.%s", oldPath, "headingCfd");
  value.headingCfd.isValidFlag = C2xIsTokenAvailable(packetHandle, "RoadsideSafetyMessage", newPath);
  if(value.headingCfd.isValidFlag==1)
  {
    value.headingCfd.value = C2xGetTokenInt(packetHandle, "RoadsideSafetyMessage", newPath);
    result = CheckLastError("RoadsideSafetyMessage", gkFuncRefGet, result);
  }
  snprintf(newPath, elcount(newPath), "%s.%s", oldPath, "steerCfd");
  value.steerCfd.isValidFlag = C2xIsTokenAvailable(packetHandle, "RoadsideSafetyMessage", newPath);
  if(value.steerCfd.isValidFlag==1)
  {
    value.steerCfd.value = C2xGetTokenInt(packetHandle, "RoadsideSafetyMessage", newPath);
    result = CheckLastError("RoadsideSafetyMessage", gkFuncRefGet, result);
  }
  return result;
}

int SetRoadsideSafetyMessageMotionConfidenceSetParams(LONG packetHandle, struct RoadsideSafetyMessageMotionConfidenceSet value, char oldPath[])
{
  char newPath[300];
  int result;

  result = 0;

  snprintf(newPath, elcount(newPath), "%s.%s", oldPath, "speedCfd");
  if(value.speedCfd.isValidFlag==1)
  {
    C2xSetTokenInt(packetHandle, "RoadsideSafetyMessage", newPath, value.speedCfd.value);
    result = CheckLastError("RoadsideSafetyMessage", gkFuncRefGet, result);
  }
  else
  {
    if( C2xIsTokenAvailable(packetHandle, "RoadsideSafetyMessage", newPath) )
    {
      C2xRemoveToken(packetHandle, "RoadsideSafetyMessage", newPath);
    }
  }

  snprintf(newPath, elcount(newPath), "%s.%s", oldPath, "headingCfd");
  if(value.headingCfd.isValidFlag==1)
  {
    C2xSetTokenInt(packetHandle, "RoadsideSafetyMessage", newPath, value.headingCfd.value);
    result = CheckLastError("RoadsideSafetyMessage", gkFuncRefGet, result);
  }
  else
  {
    if( C2xIsTokenAvailable(packetHandle, "RoadsideSafetyMessage", newPath) )
    {
      C2xRemoveToken(packetHandle, "RoadsideSafetyMessage", newPath);
    }
  }

  snprintf(newPath, elcount(newPath), "%s.%s", oldPath, "steerCfd");
  if(value.steerCfd.isValidFlag==1)
  {
    C2xSetTokenInt(packetHandle, "RoadsideSafetyMessage", newPath, value.steerCfd.value);
    result = CheckLastError("RoadsideSafetyMessage", gkFuncRefGet, result);
  }
  else
  {
    if( C2xIsTokenAvailable(packetHandle, "RoadsideSafetyMessage", newPath) )
    {
      C2xRemoveToken(packetHandle, "RoadsideSafetyMessage", newPath);
    }
  }

  return result;
}

int GetRoadsideSafetyMessageAccelerationSet4WayParams(LONG packetHandle, struct RoadsideSafetyMessageAccelerationSet4Way value, char oldPath[])
{
  char newPath[300];
  int result;

  result = 0;

  snprintf(newPath, elcount(newPath), "%s.%s", oldPath, "lon");
  value.lon = C2xGetTokenInt(packetHandle, "RoadsideSafetyMessage", newPath);
  result = CheckLastError("RoadsideSafetyMessage", gkFuncRefGet, result);

  snprintf(newPath, elcount(newPath), "%s.%s", oldPath, "lat");
  value.lat = C2xGetTokenInt(packetHandle, "RoadsideSafetyMessage", newPath);
  result = CheckLastError("RoadsideSafetyMessage", gkFuncRefGet, result);

  snprintf(newPath, elcount(newPath), "%s.%s", oldPath, "vert");
  value.vert = C2xGetTokenInt(packetHandle, "RoadsideSafetyMessage", newPath);
  result = CheckLastError("RoadsideSafetyMessage", gkFuncRefGet, result);

  snprintf(newPath, elcount(newPath), "%s.%s", oldPath, "yaw");
  value.yaw = C2xGetTokenInt(packetHandle, "RoadsideSafetyMessage", newPath);
  result = CheckLastError("RoadsideSafetyMessage", gkFuncRefGet, result);

  return result;
}

int SetRoadsideSafetyMessageAccelerationSet4WayParams(LONG packetHandle, struct RoadsideSafetyMessageAccelerationSet4Way value, char oldPath[])
{
  char newPath[300];
  int result;

  result = 0;

  snprintf(newPath, elcount(newPath), "%s.%s", oldPath, "lon");
  C2xSetTokenInt(packetHandle, "RoadsideSafetyMessage", newPath, value.lon);
  result = CheckLastError("RoadsideSafetyMessage", gkFuncRefGet, result);

  snprintf(newPath, elcount(newPath), "%s.%s", oldPath, "lat");
  C2xSetTokenInt(packetHandle, "RoadsideSafetyMessage", newPath, value.lat);
  result = CheckLastError("RoadsideSafetyMessage", gkFuncRefGet, result);

  snprintf(newPath, elcount(newPath), "%s.%s", oldPath, "vert");
  C2xSetTokenInt(packetHandle, "RoadsideSafetyMessage", newPath, value.vert);
  result = CheckLastError("RoadsideSafetyMessage", gkFuncRefGet, result);

  snprintf(newPath, elcount(newPath), "%s.%s", oldPath, "yaw");
  C2xSetTokenInt(packetHandle, "RoadsideSafetyMessage", newPath, value.yaw);
  result = CheckLastError("RoadsideSafetyMessage", gkFuncRefGet, result);

  return result;
}

int GetRoadsideSafetyMessageVehicleSizeParams(LONG packetHandle, struct RoadsideSafetyMessageVehicleSize value, char oldPath[])
{
  char newPath[300];
  int result;

  result = 0;

  snprintf(newPath, elcount(newPath), "%s.%s", oldPath, "width");
  value.width = C2xGetTokenInt(packetHandle, "RoadsideSafetyMessage", newPath);
  result = CheckLastError("RoadsideSafetyMessage", gkFuncRefGet, result);

  snprintf(newPath, elcount(newPath), "%s.%s", oldPath, "length");
  value.length = C2xGetTokenInt(packetHandle, "RoadsideSafetyMessage", newPath);
  result = CheckLastError("RoadsideSafetyMessage", gkFuncRefGet, result);

  snprintf(newPath, elcount(newPath), "%s.%s", oldPath, "height");
  value.height.isValidFlag = C2xIsTokenAvailable(packetHandle, "RoadsideSafetyMessage", newPath);
  if(value.height.isValidFlag==1)
  {
    value.height.value = C2xGetTokenInt(packetHandle, "RoadsideSafetyMessage", newPath);
    result = CheckLastError("RoadsideSafetyMessage", gkFuncRefGet, result);
  }
  return result;
}

int SetRoadsideSafetyMessageVehicleSizeParams(LONG packetHandle, struct RoadsideSafetyMessageVehicleSize value, char oldPath[])
{
  char newPath[300];
  int result;

  result = 0;

  snprintf(newPath, elcount(newPath), "%s.%s", oldPath, "width");
  C2xSetTokenInt(packetHandle, "RoadsideSafetyMessage", newPath, value.width);
  result = CheckLastError("RoadsideSafetyMessage", gkFuncRefGet, result);

  snprintf(newPath, elcount(newPath), "%s.%s", oldPath, "length");
  C2xSetTokenInt(packetHandle, "RoadsideSafetyMessage", newPath, value.length);
  result = CheckLastError("RoadsideSafetyMessage", gkFuncRefGet, result);

  snprintf(newPath, elcount(newPath), "%s.%s", oldPath, "height");
  if(value.height.isValidFlag==1)
  {
    C2xSetTokenInt(packetHandle, "RoadsideSafetyMessage", newPath, value.height.value);
    result = CheckLastError("RoadsideSafetyMessage", gkFuncRefGet, result);
  }
  else
  {
    if( C2xIsTokenAvailable(packetHandle, "RoadsideSafetyMessage", newPath) )
    {
      C2xRemoveToken(packetHandle, "RoadsideSafetyMessage", newPath);
    }
  }

  return result;
}

int GetRoadsideSafetyMessageVehicleClassificationParams(LONG packetHandle, struct RoadsideSafetyMessageVehicleClassification value, char oldPath[])
{
  char newPath[300];
  int result;

  result = 0;

  snprintf(newPath, elcount(newPath), "%s.%s", oldPath, "classification");
  value.classification = C2xGetTokenInt(packetHandle, "RoadsideSafetyMessage", newPath);
  result = CheckLastError("RoadsideSafetyMessage", gkFuncRefGet, result);

  return result;
}

int SetRoadsideSafetyMessageVehicleClassificationParams(LONG packetHandle, struct RoadsideSafetyMessageVehicleClassification value, char oldPath[])
{
  char newPath[300];
  int result;

  result = 0;

  snprintf(newPath, elcount(newPath), "%s.%s", oldPath, "classification");
  C2xSetTokenInt(packetHandle, "RoadsideSafetyMessage", newPath, value.classification);
  result = CheckLastError("RoadsideSafetyMessage", gkFuncRefGet, result);

  return result;
}

int GetRoadsideSafetyMessageParticipantDataParams(LONG packetHandle, struct RoadsideSafetyMessageParticipantData value, char oldPath[])
{
  char newPath[300];
  int result;

  result = 0;

  snprintf(newPath, elcount(newPath), "%s.%s", oldPath, "ptcType");
  value.ptcType = C2xGetTokenInt(packetHandle, "RoadsideSafetyMessage", newPath);
  result = CheckLastError("RoadsideSafetyMessage", gkFuncRefGet, result);

  snprintf(newPath, elcount(newPath), "%s.%s", oldPath, "ptcId");
  value.ptcId = C2xGetTokenInt(packetHandle, "RoadsideSafetyMessage", newPath);
  result = CheckLastError("RoadsideSafetyMessage", gkFuncRefGet, result);

  snprintf(newPath, elcount(newPath), "%s.%s", oldPath, "source");
  value.source = C2xGetTokenInt(packetHandle, "RoadsideSafetyMessage", newPath);
  result = CheckLastError("RoadsideSafetyMessage", gkFuncRefGet, result);

  snprintf(newPath, elcount(newPath), "%s.%s", oldPath, "id");
  value.id.isValidFlag = C2xIsTokenAvailable(packetHandle, "RoadsideSafetyMessage", newPath);
  if(value.id.isValidFlag==1)
  {
    value.id.isValidFlag = 1;
    value.id.stringLength = C2xGetTokenData(packetHandle, "RoadsideSafetyMessage", newPath, elcount(value.id.string), value.id.string);
  }
  snprintf(newPath, elcount(newPath), "%s.%s", oldPath, "plateNo");
  value.plateNo.isValidFlag = C2xIsTokenAvailable(packetHandle, "RoadsideSafetyMessage", newPath);
  if(value.plateNo.isValidFlag==1)
  {
    value.plateNo.isValidFlag = 1;
    value.plateNo.stringLength = C2xGetTokenData(packetHandle, "RoadsideSafetyMessage", newPath, elcount(value.plateNo.string), value.plateNo.string);
  }
  snprintf(newPath, elcount(newPath), "%s.%s", oldPath, "secMark");
  value.secMark = C2xGetTokenInt(packetHandle, "RoadsideSafetyMessage", newPath);
  result = CheckLastError("RoadsideSafetyMessage", gkFuncRefGet, result);

  snprintf(newPath, elcount(newPath), "%s.%s", oldPath, "pos");
  GetRoadsideSafetyMessagePositionOffsetLLVParams(packetHandle, value.pos, newPath);
  result = CheckLastError("RoadsideSafetyMessage", gkFuncRefGet, result);

  snprintf(newPath, elcount(newPath), "%s.%s", oldPath, "accuracy");
  GetRoadsideSafetyMessagePositionConfidenceSetParams(packetHandle, value.accuracy, newPath);
  result = CheckLastError("RoadsideSafetyMessage", gkFuncRefGet, result);

  snprintf(newPath, elcount(newPath), "%s.%s", oldPath, "transmission");
  value.transmission.isValidFlag = C2xIsTokenAvailable(packetHandle, "RoadsideSafetyMessage", newPath);
  if(value.transmission.isValidFlag==1)
  {
    value.transmission.value = C2xGetTokenInt(packetHandle, "RoadsideSafetyMessage", newPath);
    result = CheckLastError("RoadsideSafetyMessage", gkFuncRefGet, result);
  }
  snprintf(newPath, elcount(newPath), "%s.%s", oldPath, "speed");
  value.speed = C2xGetTokenInt(packetHandle, "RoadsideSafetyMessage", newPath);
  result = CheckLastError("RoadsideSafetyMessage", gkFuncRefGet, result);

  snprintf(newPath, elcount(newPath), "%s.%s", oldPath, "heading");
  value.heading = C2xGetTokenInt(packetHandle, "RoadsideSafetyMessage", newPath);
  result = CheckLastError("RoadsideSafetyMessage", gkFuncRefGet, result);

  snprintf(newPath, elcount(newPath), "%s.%s", oldPath, "angle");
  value.angle.isValidFlag = C2xIsTokenAvailable(packetHandle, "RoadsideSafetyMessage", newPath);
  if(value.angle.isValidFlag==1)
  {
    value.angle.value = C2xGetTokenInt(packetHandle, "RoadsideSafetyMessage", newPath);
    result = CheckLastError("RoadsideSafetyMessage", gkFuncRefGet, result);
  }
  snprintf(newPath, elcount(newPath), "%s.%s", oldPath, "motionCfd");
  value.motionCfd.isValidFlag = C2xIsTokenAvailable(packetHandle, "RoadsideSafetyMessage", newPath);
  if(value.motionCfd.isValidFlag==1)
  {
    GetRoadsideSafetyMessageMotionConfidenceSetParams(packetHandle, value.motionCfd, newPath);
    result = CheckLastError("RoadsideSafetyMessage", gkFuncRefGet, result);
  }
  snprintf(newPath, elcount(newPath), "%s.%s", oldPath, "accelSet");
  value.accelSet.isValidFlag = C2xIsTokenAvailable(packetHandle, "RoadsideSafetyMessage", newPath);
  if(value.accelSet.isValidFlag==1)
  {
    GetRoadsideSafetyMessageAccelerationSet4WayParams(packetHandle, value.accelSet, newPath);
    result = CheckLastError("RoadsideSafetyMessage", gkFuncRefGet, result);
  }
  snprintf(newPath, elcount(newPath), "%s.%s", oldPath, "size");
  GetRoadsideSafetyMessageVehicleSizeParams(packetHandle, value.size, newPath);
  result = CheckLastError("RoadsideSafetyMessage", gkFuncRefGet, result);

  snprintf(newPath, elcount(newPath), "%s.%s", oldPath, "vehicleClass");
  value.vehicleClass.isValidFlag = C2xIsTokenAvailable(packetHandle, "RoadsideSafetyMessage", newPath);
  if(value.vehicleClass.isValidFlag==1)
  {
    GetRoadsideSafetyMessageVehicleClassificationParams(packetHandle, value.vehicleClass, newPath);
    result = CheckLastError("RoadsideSafetyMessage", gkFuncRefGet, result);
  }
  return result;
}

int SetRoadsideSafetyMessageParticipantDataParams(LONG packetHandle, struct RoadsideSafetyMessageParticipantData value, char oldPath[])
{
  char newPath[300];
  int result;

  result = 0;

  snprintf(newPath, elcount(newPath), "%s.%s", oldPath, "ptcType");
  C2xSetTokenInt(packetHandle, "RoadsideSafetyMessage", newPath, value.ptcType);
  result = CheckLastError("RoadsideSafetyMessage", gkFuncRefGet, result);

  snprintf(newPath, elcount(newPath), "%s.%s", oldPath, "ptcId");
  C2xSetTokenInt(packetHandle, "RoadsideSafetyMessage", newPath, value.ptcId);
  result = CheckLastError("RoadsideSafetyMessage", gkFuncRefGet, result);

  snprintf(newPath, elcount(newPath), "%s.%s", oldPath, "source");
  C2xSetTokenInt(packetHandle, "RoadsideSafetyMessage", newPath, value.source);
  result = CheckLastError("RoadsideSafetyMessage", gkFuncRefGet, result);

  if(value.id.stringLength == 0)
  {
    value.id.stringLength = 8;
    memcpy(value.id.string, "00000000", value.id.stringLength);
  }

  snprintf(newPath, elcount(newPath), "%s.%s", oldPath, "id");
  if(value.id.isValidFlag==1)
  {
    C2xSetTokenData(packetHandle, "RoadsideSafetyMessage", newPath, value.id.stringLength, value.id.string);
  }
  else
  {
    if( C2xIsTokenAvailable(packetHandle, "RoadsideSafetyMessage", newPath) )
    {
      C2xRemoveToken(packetHandle, "RoadsideSafetyMessage", newPath);
    }
  }

  snprintf(newPath, elcount(newPath), "%s.%s", oldPath, "plateNo");
  if(value.plateNo.isValidFlag==1)
  {
    C2xSetTokenData(packetHandle, "RoadsideSafetyMessage", newPath, value.plateNo.stringLength, value.plateNo.string);
  }
  else
  {
    if( C2xIsTokenAvailable(packetHandle, "RoadsideSafetyMessage", newPath) )
    {
      C2xRemoveToken(packetHandle, "RoadsideSafetyMessage", newPath);
    }
  }

  snprintf(newPath, elcount(newPath), "%s.%s", oldPath, "secMark");
  C2xSetTokenInt(packetHandle, "RoadsideSafetyMessage", newPath, value.secMark);
  result = CheckLastError("RoadsideSafetyMessage", gkFuncRefGet, result);

  snprintf(newPath, elcount(newPath), "%s.%s", oldPath, "pos");
  SetRoadsideSafetyMessagePositionOffsetLLVParams(packetHandle, value.pos, newPath);
  result = CheckLastError("RoadsideSafetyMessage", gkFuncRefGet, result);

  snprintf(newPath, elcount(newPath), "%s.%s", oldPath, "accuracy");
  SetRoadsideSafetyMessagePositionConfidenceSetParams(packetHandle, value.accuracy, newPath);
  result = CheckLastError("RoadsideSafetyMessage", gkFuncRefGet, result);

  snprintf(newPath, elcount(newPath), "%s.%s", oldPath, "transmission");
  if(value.transmission.isValidFlag==1)
  {
    C2xSetTokenInt(packetHandle, "RoadsideSafetyMessage", newPath, value.transmission.value);
    result = CheckLastError("RoadsideSafetyMessage", gkFuncRefGet, result);
  }
  else
  {
    if( C2xIsTokenAvailable(packetHandle, "RoadsideSafetyMessage", newPath) )
    {
      C2xRemoveToken(packetHandle, "RoadsideSafetyMessage", newPath);
    }
  }

  snprintf(newPath, elcount(newPath), "%s.%s", oldPath, "speed");
  C2xSetTokenInt(packetHandle, "RoadsideSafetyMessage", newPath, value.speed);
  result = CheckLastError("RoadsideSafetyMessage", gkFuncRefGet, result);

  snprintf(newPath, elcount(newPath), "%s.%s", oldPath, "heading");
  C2xSetTokenInt(packetHandle, "RoadsideSafetyMessage", newPath, value.heading);
  result = CheckLastError("RoadsideSafetyMessage", gkFuncRefGet, result);

  snprintf(newPath, elcount(newPath), "%s.%s", oldPath, "angle");
  if(value.angle.isValidFlag==1)
  {
    C2xSetTokenInt(packetHandle, "RoadsideSafetyMessage", newPath, value.angle.value);
    result = CheckLastError("RoadsideSafetyMessage", gkFuncRefGet, result);
  }
  else
  {
    if( C2xIsTokenAvailable(packetHandle, "RoadsideSafetyMessage", newPath) )
    {
      C2xRemoveToken(packetHandle, "RoadsideSafetyMessage", newPath);
    }
  }

  snprintf(newPath, elcount(newPath), "%s.%s", oldPath, "motionCfd");
  if(value.motionCfd.isValidFlag==1)
  {
    SetRoadsideSafetyMessageMotionConfidenceSetParams(packetHandle, value.motionCfd, newPath);
    result = CheckLastError("RoadsideSafetyMessage", gkFuncRefGet, result);
  }
  else
  {
    if( C2xIsTokenAvailable(packetHandle, "RoadsideSafetyMessage", newPath) )
    {
      C2xRemoveToken(packetHandle, "RoadsideSafetyMessage", newPath);
    }
  }

  snprintf(newPath, elcount(newPath), "%s.%s", oldPath, "accelSet");
  if(value.accelSet.isValidFlag==1)
  {
    SetRoadsideSafetyMessageAccelerationSet4WayParams(packetHandle, value.accelSet, newPath);
    result = CheckLastError("RoadsideSafetyMessage", gkFuncRefGet, result);
  }
  else
  {
    if( C2xIsTokenAvailable(packetHandle, "RoadsideSafetyMessage", newPath) )
    {
      C2xRemoveToken(packetHandle, "RoadsideSafetyMessage", newPath);
    }
  }

  snprintf(newPath, elcount(newPath), "%s.%s", oldPath, "size");
  SetRoadsideSafetyMessageVehicleSizeParams(packetHandle, value.size, newPath);
  result = CheckLastError("RoadsideSafetyMessage", gkFuncRefGet, result);

  snprintf(newPath, elcount(newPath), "%s.%s", oldPath, "vehicleClass");
  if(value.vehicleClass.isValidFlag==1)
  {
    SetRoadsideSafetyMessageVehicleClassificationParams(packetHandle, value.vehicleClass, newPath);
    result = CheckLastError("RoadsideSafetyMessage", gkFuncRefGet, result);
  }
  else
  {
    if( C2xIsTokenAvailable(packetHandle, "RoadsideSafetyMessage", newPath) )
    {
      C2xRemoveToken(packetHandle, "RoadsideSafetyMessage", newPath);
    }
  }

  return result;
}

int GetRoadsideSafetyMessageParticipantListParams(LONG packetHandle, struct RoadsideSafetyMessageParticipantList value, char oldPath[])
{
  char newPath[300]; 
  int i;
  int result;

  result = 0;

  value.length = C2xGetTokenInt(packetHandle, "RoadsideSafetyMessage", oldPath);
  if((result = CheckLastError("RoadsideSafetyMessage", gkFuncRefGet, result))==0)
  {
    for(i=0; i<value.length; i++)
    {
      snprintf(newPath, elcount(newPath), "%s[%d]", oldPath, i);
      GetRoadsideSafetyMessageParticipantDataParams(packetHandle, value.arrayValue[i], newPath);
      result = CheckLastError("RoadsideSafetyMessage", gkFuncRefGet, result);
    }
  }
  return result;
}

int SetRoadsideSafetyMessageParticipantListParams(LONG packetHandle, struct RoadsideSafetyMessageParticipantList value, char oldPath[])
{
  char newPath[300]; 
  int i;
  int result;

  result = 0;

  C2xRemoveToken(packetHandle, "RoadsideSafetyMessage", oldPath);
  for(i=0; i<value.length; i++)
  {
    snprintf(newPath, elcount(newPath), "%s[%d]", oldPath, i);
    SetRoadsideSafetyMessageParticipantDataParams(packetHandle, value.arrayValue[i], newPath);
    result = CheckLastError("RoadsideSafetyMessage", gkFuncRefGet, result);
  }
  return result;
}

int GetRoadsideSafetyMessageRSMFrameParams(LONG packetHandle, struct RoadsideSafetyMessageRSMFrame value, char oldPath[])
{
  char newPath[300];
  int result;

  result = 0;

  snprintf(newPath, elcount(newPath), "%s.%s", oldPath, "msgCnt");
  value.msgCnt = C2xGetTokenInt(packetHandle, "RoadsideSafetyMessage", newPath);
  result = CheckLastError("RoadsideSafetyMessage", gkFuncRefGet, result);

  snprintf(newPath, elcount(newPath), "%s.%s", oldPath, "id");
  value.id.stringLength = C2xGetTokenData(packetHandle, "RoadsideSafetyMessage", newPath, elcount(value.id.string), value.id.string);
  snprintf(newPath, elcount(newPath), "%s.%s", oldPath, "refPos");
  GetRoadsideSafetyMessagePosition3DParams(packetHandle, value.refPos, newPath);
  result = CheckLastError("RoadsideSafetyMessage", gkFuncRefGet, result);

  snprintf(newPath, elcount(newPath), "%s.%s", oldPath, "participants");
  GetRoadsideSafetyMessageParticipantListParams(packetHandle, value.participants, newPath);
  result = CheckLastError("RoadsideSafetyMessage", gkFuncRefGet, result);

  return result;
}

int SetRoadsideSafetyMessageRSMFrameParams(LONG packetHandle, struct RoadsideSafetyMessageRSMFrame value, char oldPath[])
{
  char newPath[300];
  int result;

  result = 0;

  snprintf(newPath, elcount(newPath), "%s.%s", oldPath, "msgCnt");
  C2xSetTokenInt(packetHandle, "RoadsideSafetyMessage", newPath, value.msgCnt);
  result = CheckLastError("RoadsideSafetyMessage", gkFuncRefGet, result);

  if(value.id.stringLength == 0)
  {
    value.id.stringLength = 8;
    memcpy(value.id.string, "00000000", value.id.stringLength);
  }

  snprintf(newPath, elcount(newPath), "%s.%s", oldPath, "id");
  C2xSetTokenData(packetHandle, "RoadsideSafetyMessage", newPath, value.id.stringLength, value.id.string);

  snprintf(newPath, elcount(newPath), "%s.%s", oldPath, "refPos");
  SetRoadsideSafetyMessagePosition3DParams(packetHandle, value.refPos, newPath);
  result = CheckLastError("RoadsideSafetyMessage", gkFuncRefGet, result);

  snprintf(newPath, elcount(newPath), "%s.%s", oldPath, "participants");
  SetRoadsideSafetyMessageParticipantListParams(packetHandle, value.participants, newPath);
  result = CheckLastError("RoadsideSafetyMessage", gkFuncRefGet, result);

  return result;
}

int API_GetRoadsideSafetyMessageParams(LONG packetHandle, struct RoadsideSafetyMessage value)
{
  int result;
  result = 0;

  value.frameType = C2xGetTokenInt(packetHandle, "RoadsideSafetyMessage", "frameType");
  result = CheckLastError("RoadsideSafetyMessage", gkFuncRefGet, result);

  value.rsmFrame.isValidFlag = 1;
  GetRoadsideSafetyMessageRSMFrameParams(packetHandle, value.rsmFrame, "rsmFrame");
  result = CheckLastError("RoadsideSafetyMessage", gkFuncRefGet, result);

  return result;
}

int API_SetRoadsideSafetyMessageParams(LONG packetHandle, struct RoadsideSafetyMessage value)
{
  int result;
  result = 0;

  C2xSetTokenInt(packetHandle, "RoadsideSafetyMessage", "frameType", value.frameType);
  result = CheckLastError("RoadsideSafetyMessage", gkFuncRefGet, result);

  SetRoadsideSafetyMessageRSMFrameParams(packetHandle, value.rsmFrame, "rsmFrame");
  result = CheckLastError("RoadsideSafetyMessage", gkFuncRefGet, result);

  return result;
}

