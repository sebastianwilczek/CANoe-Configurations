/*@!Encoding:1252*/
/*
//  (c) Vector Informatik GmbH. All rights reserved.
//
//  This file contains definitions of structs and methods that may be used
//  to set and get the values of an ASN.1 defined packet's payload.
//
//  //This example demonstrates how to set a packet's payload:
//  LONG packetHandle;
//  struct CAM payload;
//  //you need to set the values of the variable "payload" yourself
//  packetHandle = API_InitCAMPacket();
//  if (packetHandle!=0) {
//    if (API_SetCAMParams(packetHandle, payload)==0) {
//      if (C2xCompletePacket(packetHandle)==0) {
//        C2xOutputPacket(packetHandle);
//      }
//    }
//  }
//                                                                             */
includes
{

}
variables
{
    struct CAMItsPduHeader {
        INT isValidFlag;   // necessary if this struct is used as an optional field of a SEQUENCE
        BYTE protocolVersion;  // INTEGER, 0..255;
        BYTE messageID;  // INTEGER, 0..255, denm(1), cam(2), poi(3), spat(4), map(5), ivi(6), ev_rsr(7), tistpgtransaction(8), srem(9), ssem(10), evcsn(11), saem(12), rtcmem(13);
        DWORD stationID;  // INTEGER, 0..4294967295;
    };
    
    struct CAMPosConfidenceEllipse {
        INT isValidFlag;   // necessary if this struct is used as an optional field of a SEQUENCE
        WORD semiMajorConfidence;  // INTEGER, 0..4095, outOfRange(4094), unavailable(4095);
        WORD semiMinorConfidence;  // INTEGER, 0..4095, outOfRange(4094), unavailable(4095);
        WORD semiMajorOrientation;  // INTEGER, 0..3601, unavailable(3601);
    };
    
    struct CAMAltitude {
        INT isValidFlag;   // necessary if this struct is used as an optional field of a SEQUENCE
        LONG altitudeValue;  // INTEGER, -100000..800001, unavailable(800001);
        INT altitudeConfidence;  // ENUMERATED, alt_000_01(0), alt_000_02(1), alt_000_05(2), alt_000_10(3), alt_000_20(4), alt_000_50(5), alt_001_00(6), alt_002_00(7), alt_005_00(8), alt_010_00(9), alt_020_00(10), alt_050_00(11), alt_100_00(12), alt_200_00(13), outOfRange(14), unavailable(15);
    };
    
    struct CAMReferencePosition {
        INT isValidFlag;   // necessary if this struct is used as an optional field of a SEQUENCE
        LONG latitude;  // INTEGER, -900000000..900000001, unavailable(900000001);
        LONG longitude;  // INTEGER, -1800000000..1800000001, unavailable(1800000001);
        struct CAMPosConfidenceEllipse positionConfidenceEllipse;  // SEQUENCE;
        struct CAMAltitude altitude;  // SEQUENCE;
    };
    
    struct CAMBasicContainer {
        INT isValidFlag;   // necessary if this struct is used as an optional field of a SEQUENCE
        BYTE stationType;  // INTEGER, 0..255, unknown(0), pedestrian(1), cyclist(2), moped(3), motorcycle(4), passengerCar(5), bus(6), lightTruck(7), heavyTruck(8), trailer(9), specialVehicles(10), tram(11), roadSideUnit(15);
        struct CAMReferencePosition referencePosition;  // SEQUENCE;
    };
    
    struct CAMHeading {
        INT isValidFlag;   // necessary if this struct is used as an optional field of a SEQUENCE
        WORD headingValue;  // INTEGER, 0..3601, unavailable(3601);
        BYTE headingConfidence;  // INTEGER, 1..127, outOfRange(126), unavailable(127);
    };
    
    struct CAMSpeed {
        INT isValidFlag;   // necessary if this struct is used as an optional field of a SEQUENCE
        WORD speedValue;  // INTEGER, 0..16383, unavailable(16383);
        BYTE speedConfidence;  // INTEGER, 1..127, outOfRange(126), unavailable(127);
    };
    
    struct CAMVehicleLength {
        INT isValidFlag;   // necessary if this struct is used as an optional field of a SEQUENCE
        WORD vehicleLengthValue;  // INTEGER, 1..1023, outOfRange(1022), unavailable(1023);
        INT vehicleLengthConfidenceIndication;  // ENUMERATED, noTrailerPresent(0), trailerPresentWithKnownLength(1), trailerPresentWithUnknownLength(2), trailerPresenceIsUnknown(3), unavailable(4);
    };
    
    struct CAMLongitudinalAcceleration {
        INT isValidFlag;   // necessary if this struct is used as an optional field of a SEQUENCE
        INT longitudinalAccelerationValue;  // INTEGER, -160..161, unavailable(161);
        BYTE longitudinalAccelerationConfidence;  // INTEGER, 0..102, outOfRange(101), unavailable(102);
    };
    
    struct CAMCurvature {
        INT isValidFlag;   // necessary if this struct is used as an optional field of a SEQUENCE
        INT curvatureValue;  // INTEGER, -1023..1023, straight(0), unavailable(1023);
        INT curvatureConfidence;  // ENUMERATED, onePerMeter_0_00002(0), onePerMeter_0_0001(1), onePerMeter_0_0005(2), onePerMeter_0_002(3), onePerMeter_0_01(4), onePerMeter_0_1(5), outOfRange(6), unavailable(7);
    };
    
    struct CAMYawRate {
        INT isValidFlag;   // necessary if this struct is used as an optional field of a SEQUENCE
        INT yawRateValue;  // INTEGER, -32766..32767, unavailable(32767);
        INT yawRateConfidence;  // ENUMERATED, degSec_000_01(0), degSec_000_05(1), degSec_000_10(2), degSec_001_00(3), degSec_005_00(4), degSec_010_00(5), degSec_100_00(6), outOfRange(7), unavailable(8);
    };
    
    struct CAMAccelerationControl {
        INT isValidFlag;   // necessary if this struct is used as an optional field of a SEQUENCE
        CHAR string[8];
        INT  stringLength;
    };
    
    struct CAMSteeringWheelAngle {
        INT isValidFlag;   // necessary if this struct is used as an optional field of a SEQUENCE
        INT steeringWheelAngleValue;  // INTEGER, -511..512, unavailable(512);
        BYTE steeringWheelAngleConfidence;  // INTEGER, 1..127, outOfRange(126), unavailable(127);
    };
    
    struct CAMLateralAcceleration {
        INT isValidFlag;   // necessary if this struct is used as an optional field of a SEQUENCE
        INT lateralAccelerationValue;  // INTEGER, -160..161, unavailable(161);
        BYTE lateralAccelerationConfidence;  // INTEGER, 0..102, outOfRange(101), unavailable(102);
    };
    
    struct CAMVerticalAcceleration {
        INT isValidFlag;   // necessary if this struct is used as an optional field of a SEQUENCE
        INT verticalAccelerationValue;  // INTEGER, -160..161, unavailable(161);
        BYTE verticalAccelerationConfidence;  // INTEGER, 0..102, outOfRange(101), unavailable(102);
    };
    
    struct CAMCenDsrcTollingZone {
        INT isValidFlag;   // necessary if this struct is used as an optional field of a SEQUENCE
        LONG protectedZoneLatitude;  // INTEGER, -900000000..900000001, unavailable(900000001);
        LONG protectedZoneLongitude;  // INTEGER, -1800000000..1800000001, unavailable(1800000001);
        struct OPT_DWORD_ASN cenDsrcTollingZoneID;  // INTEGER, OPTIONAL, 0..134217727;
    };
    
    struct CAMBasicVehicleContainerHighFrequency {
        INT isValidFlag;   // necessary if this struct is used as an optional field of a SEQUENCE
        struct CAMHeading heading;  // SEQUENCE;
        struct CAMSpeed speed;  // SEQUENCE;
        INT driveDirection;  // ENUMERATED, forward(0), backward(1), unavailable(2);
        struct CAMVehicleLength vehicleLength;  // SEQUENCE;
        BYTE vehicleWidth;  // INTEGER, 1..62, outOfRange(61), unavailable(62);
        struct CAMLongitudinalAcceleration longitudinalAcceleration;  // SEQUENCE;
        struct CAMCurvature curvature;  // SEQUENCE;
        INT curvatureCalculationMode;  // ENUMERATED, yawRateUsed(0), yawRateNotUsed(1), unavailable(2);
        struct CAMYawRate yawRate;  // SEQUENCE;
        struct CAMAccelerationControl accelerationControl;  // BITSTRING, OPTIONAL;
        struct OPT_INT_ASN lanePosition;  // INTEGER, OPTIONAL, -1..14, offTheRoad(-1), hardShoulder(0), outermostDrivingLane(1), secondLaneFromOutside(2);
        struct CAMSteeringWheelAngle steeringWheelAngle;  // SEQUENCE, OPTIONAL;
        struct CAMLateralAcceleration lateralAcceleration;  // SEQUENCE, OPTIONAL;
        struct CAMVerticalAcceleration verticalAcceleration;  // SEQUENCE, OPTIONAL;
        struct OPT_BYTE_ASN performanceClass;  // INTEGER, OPTIONAL, 0..7, unavailable(0), performanceClassA(1), performanceClassB(2);
        struct CAMCenDsrcTollingZone cenDsrcTollingZone;  // SEQUENCE, OPTIONAL;
    };
    
    struct CAMProtectedCommunicationZone {
        INT isValidFlag;   // necessary if this struct is used as an optional field of a SEQUENCE
        INT protectedZoneType;  // ENUMERATED, permanentCenDsrcTolling(0), temporaryCenDsrcTolling(1);
        struct OPT_QWORD_ASN expiryTime;  // INTEGER, OPTIONAL, 0..4398046511103;
        LONG protectedZoneLatitude;  // INTEGER, -900000000..900000001, unavailable(900000001);
        LONG protectedZoneLongitude;  // INTEGER, -1800000000..1800000001, unavailable(1800000001);
        struct OPT_BYTE_ASN protectedZoneRadius;  // INTEGER, OPTIONAL, 1..255, oneMeter(1);
        struct OPT_DWORD_ASN protectedZoneID;  // INTEGER, OPTIONAL, 0..134217727;
    };
    
    struct CAMProtectedCommunicationZonesRSU {
        INT isValidFlag;   // necessary if this struct is used as an optional field of a SEQUENCE
        INT length;
        struct CAMProtectedCommunicationZone arrayValue[16];  // SEQUENCE;
    };
    
    struct CAMRSUContainerHighFrequency {
        INT isValidFlag;   // necessary if this struct is used as an optional field of a SEQUENCE
        struct CAMProtectedCommunicationZonesRSU protectedCommunicationZonesRSU;  // SEQUENCEOF, OPTIONAL;
    };
    
    struct CAMHighFrequencyContainer {
        INT isValidFlag;   // necessary if this struct is used as an optional field of a SEQUENCE
        INT choice;
        struct CAMBasicVehicleContainerHighFrequency basicVehicleContainerHighFrequency;  // SEQUENCE;
        struct CAMRSUContainerHighFrequency rsuContainerHighFrequency;  // SEQUENCE;
    };
    
    struct CAMExteriorLights {
        INT isValidFlag;   // necessary if this struct is used as an optional field of a SEQUENCE
        CHAR string[9];
        INT  stringLength;
    };
    
    struct CAMDeltaReferencePosition {
        INT isValidFlag;   // necessary if this struct is used as an optional field of a SEQUENCE
        LONG deltaLatitude;  // INTEGER, -131071..131072, unavailable(131072);
        LONG deltaLongitude;  // INTEGER, -131071..131072, unavailable(131072);
        INT deltaAltitude;  // INTEGER, -12700..12800, unavailable(12800);
    };
    
    struct CAMPathPoint {
        INT isValidFlag;   // necessary if this struct is used as an optional field of a SEQUENCE
        struct CAMDeltaReferencePosition pathPosition;  // SEQUENCE;
        struct OPT_WORD_ASN pathDeltaTime;  // INTEGER, OPTIONAL, 1..65535;
    };
    
    struct CAMPathHistory {
        INT isValidFlag;   // necessary if this struct is used as an optional field of a SEQUENCE
        INT length;
        struct CAMPathPoint arrayValue[40];  // SEQUENCE;
    };
    
    struct CAMBasicVehicleContainerLowFrequency {
        INT isValidFlag;   // necessary if this struct is used as an optional field of a SEQUENCE
        INT vehicleRole;  // ENUMERATED, default(0), publicTransport(1), specialTransport(2), dangerousGoods(3), roadWork(4), rescue(5), emergency(6), safetyCar(7), agriculture(8), commercial(9), military(10), roadOperator(11), taxi(12), reserved1(13), reserved2(14), reserved3(15);
        struct CAMExteriorLights exteriorLights;  // BITSTRING;
        struct CAMPathHistory pathHistory;  // SEQUENCEOF;
    };
    
    struct CAMLowFrequencyContainer {
        INT isValidFlag;   // necessary if this struct is used as an optional field of a SEQUENCE
        INT choice;
        struct CAMBasicVehicleContainerLowFrequency basicVehicleContainerLowFrequency;  // SEQUENCE;
    };
    
    struct CAMPtActivationData {
        INT isValidFlag;   // necessary if this struct is used as an optional field of a SEQUENCE
        CHAR string[21];
        INT  stringLength;
    };
    
    struct CAMPtActivation {
        INT isValidFlag;   // necessary if this struct is used as an optional field of a SEQUENCE
        BYTE ptActivationType;  // INTEGER, 0..255, undefinedCodingType(0), r09_16CodingType(1), vdv_50149CodingType(2);
        struct CAMPtActivationData ptActivationData;  // OCTETSTRING;
    };
    
    struct CAMPublicTransportContainer {
        INT isValidFlag;   // necessary if this struct is used as an optional field of a SEQUENCE
        INT embarkationStatus;  // BOOLEAN;
        struct CAMPtActivation ptActivation;  // SEQUENCE, OPTIONAL;
    };
    
    struct CAMSpecialTransportType {
        INT isValidFlag;   // necessary if this struct is used as an optional field of a SEQUENCE
        CHAR string[5];
        INT  stringLength;
    };
    
    struct CAMLightBarSirenInUse {
        INT isValidFlag;   // necessary if this struct is used as an optional field of a SEQUENCE
        CHAR string[3];
        INT  stringLength;
    };
    
    struct CAMSpecialTransportContainer {
        INT isValidFlag;   // necessary if this struct is used as an optional field of a SEQUENCE
        struct CAMSpecialTransportType specialTransportType;  // BITSTRING;
        struct CAMLightBarSirenInUse lightBarSirenInUse;  // BITSTRING;
    };
    
    struct CAMDangerousGoodsContainer {
        INT isValidFlag;   // necessary if this struct is used as an optional field of a SEQUENCE
        INT dangerousGoodsBasic;  // ENUMERATED, explosives1(0), explosives2(1), explosives3(2), explosives4(3), explosives5(4), explosives6(5), flammableGases(6), nonFlammableGases(7), toxicGases(8), flammableLiquids(9), flammableSolids(10), substancesLiableToSpontaneousCombustion(11), substancesEmittingFlammableGasesUponContactWithWater(12), oxidizingSubstances(13), organicPeroxides(14), toxicSubstances(15), infectiousSubstances(16), radioactiveMaterial(17), corrosiveSubstances(18), miscellaneousDangerousSubstances(19);
    };
    
    struct CAMDrivingLaneStatus {
        INT isValidFlag;   // necessary if this struct is used as an optional field of a SEQUENCE
        CHAR string[14];
        INT  stringLength;
    };
    
    struct CAMClosedLanes {
        INT isValidFlag;   // necessary if this struct is used as an optional field of a SEQUENCE
        struct OPT_ENUM_ASN innerhardShoulderStatus;  // ENUMERATED, OPTIONAL, availableForStopping(0), closed(1), availableForDriving(2);
        struct OPT_ENUM_ASN outerhardShoulderStatus;  // ENUMERATED, OPTIONAL, availableForStopping(0), closed(1), availableForDriving(2);
        struct CAMDrivingLaneStatus drivingLaneStatus;  // BITSTRING, OPTIONAL;
    };
    
    struct CAMRoadWorksContainerBasic {
        INT isValidFlag;   // necessary if this struct is used as an optional field of a SEQUENCE
        struct OPT_BYTE_ASN roadworksSubCauseCode;  // INTEGER, OPTIONAL, 0..255, unavailable(0), majorRoadworks(1), roadMarkingWork(2), slowMovingRoadMaintenance(3), shortTermStationaryRoadworks(4), streetCleaning(5), winterService(6);
        struct CAMLightBarSirenInUse lightBarSirenInUse;  // BITSTRING;
        struct CAMClosedLanes closedLanes;  // SEQUENCE, OPTIONAL;
    };
    
    struct CAMRescueContainer {
        INT isValidFlag;   // necessary if this struct is used as an optional field of a SEQUENCE
        struct CAMLightBarSirenInUse lightBarSirenInUse;  // BITSTRING;
    };
    
    struct CAMCauseCode {
        INT isValidFlag;   // necessary if this struct is used as an optional field of a SEQUENCE
        BYTE causeCode;  // INTEGER, 0..255, reserved(0), trafficCondition(1), accident(2), roadworks(3), impassability(5), adverseWeatherCondition_Adhesion(6), aquaplannning(7), hazardousLocation_SurfaceCondition(9), hazardousLocation_ObstacleOnTheRoad(10), hazardousLocation_AnimalOnTheRoad(11), humanPresenceOnTheRoad(12), wrongWayDriving(14), rescueAndRecoveryWorkInProgress(15), adverseWeatherCondition_ExtremeWeatherCondition(17), adverseWeatherCondition_Visibility(18), adverseWeatherCondition_Precipitation(19), slowVehicle(26), dangerousEndOfQueue(27), vehicleBreakdown(91), postCrash(92), humanProblem(93), stationaryVehicle(94), emergencyVehicleApproaching(95), hazardousLocation_DangerousCurve(96), collisionRisk(97), signalViolation(98), dangerousSituation(99);
        BYTE subCauseCode;  // INTEGER, 0..255;
    };
    
    struct CAMEmergencyPriority {
        INT isValidFlag;   // necessary if this struct is used as an optional field of a SEQUENCE
        CHAR string[3];
        INT  stringLength;
    };
    
    struct CAMEmergencyContainer {
        INT isValidFlag;   // necessary if this struct is used as an optional field of a SEQUENCE
        struct CAMLightBarSirenInUse lightBarSirenInUse;  // BITSTRING;
        struct CAMCauseCode incidentIndication;  // SEQUENCE, OPTIONAL;
        struct CAMEmergencyPriority emergencyPriority;  // BITSTRING, OPTIONAL;
    };
    
    struct CAMSafetyCarContainer {
        INT isValidFlag;   // necessary if this struct is used as an optional field of a SEQUENCE
        struct CAMLightBarSirenInUse lightBarSirenInUse;  // BITSTRING;
        struct CAMCauseCode incidentIndication;  // SEQUENCE, OPTIONAL;
        struct OPT_ENUM_ASN trafficRule;  // ENUMERATED, OPTIONAL, noPassing(0), noPassingForTrucks(1), passToRight(2), passToLeft(3);
        struct OPT_BYTE_ASN speedLimit;  // INTEGER, OPTIONAL, 1..255;
    };
    
    struct CAMSpecialVehicleContainer {
        INT isValidFlag;   // necessary if this struct is used as an optional field of a SEQUENCE
        INT choice;
        struct CAMPublicTransportContainer publicTransportContainer;  // SEQUENCE;
        struct CAMSpecialTransportContainer specialTransportContainer;  // SEQUENCE;
        struct CAMDangerousGoodsContainer dangerousGoodsContainer;  // SEQUENCE;
        struct CAMRoadWorksContainerBasic roadWorksContainerBasic;  // SEQUENCE;
        struct CAMRescueContainer rescueContainer;  // SEQUENCE;
        struct CAMEmergencyContainer emergencyContainer;  // SEQUENCE;
        struct CAMSafetyCarContainer safetyCarContainer;  // SEQUENCE;
    };
    
    struct CAMCamParameters {
        INT isValidFlag;   // necessary if this struct is used as an optional field of a SEQUENCE
        struct CAMBasicContainer basicContainer;  // SEQUENCE;
        struct CAMHighFrequencyContainer highFrequencyContainer;  // CHOICE;
        struct CAMLowFrequencyContainer lowFrequencyContainer;  // CHOICE, OPTIONAL;
        struct CAMSpecialVehicleContainer specialVehicleContainer;  // CHOICE, OPTIONAL;
    };
    
    struct CAMCoopAwareness {
        INT isValidFlag;   // necessary if this struct is used as an optional field of a SEQUENCE
        WORD generationDeltaTime;  // INTEGER, 0..65535, oneMilliSec(1);
        struct CAMCamParameters camParameters;  // SEQUENCE;
    };
    
    struct CAM {
        INT isValidFlag;   // necessary if this struct is used as an optional field of a SEQUENCE
        struct CAMItsPduHeader header;  // SEQUENCE;
        struct CAMCoopAwareness cam;  // SEQUENCE;
    };
    
}

/*
// init function to create a simple packet handle
*/ 
LONG API_InitCAMPacket()
{
  return C2xInitPacket("CAM"); 
}

/*
// init function to create a simple packet handle and
// initialize the struct with valid data
*/ 
LONG API_InitCAMPacket(struct CAM msgStruct)
{
  long pktHandle;

  pktHandle = API_InitCAMPacket();

  if (pktHandle != 0)
  {
    // create valid message and application data
    if (C2xCompletePacket(pktHandle) == 0) 
    {
      API_GetCAMParams(pktHandle, msgStruct);
    }
  }
  return pktHandle;
}

/*
// init function to create a packet with security layer and
// initialize the struct with valid data
*/ 
LONG API_InitCAMPacket(struct CAM msgStruct, char packetTypeDesignator[], char certificateName[])
{
  long pktHandle, certHdl;

  // initialize the packet
  pktHandle = C2xInitPacket("CAM", packetTypeDesignator);

  if (pktHandle != 0)
  {
    certHdl = C2xSecCertificateGetHandle(certificateName);  // get the certificate handle for the cert with name "certificateName"
    if (certHdl != 0) 
    {
      C2xSecPacketSetSignerHandle(pktHandle, certHdl); // set the certHdl to the packet
    }

    // create valid message and application data
    if (C2xCompletePacket(pktHandle) == 0) 
    {
      // copy application data to the application structure
      API_GetCAMParams(pktHandle, msgStruct);
    }
  }
  return pktHandle;
}
    

int GetCAMItsPduHeaderParams(LONG packetHandle, struct CAMItsPduHeader value, char oldPath[])
{
  char newPath[300];
  int result;

  result = 0;

  snprintf(newPath, elcount(newPath), "%s.%s", oldPath, "protocolVersion");
  value.protocolVersion = C2xGetTokenInt(packetHandle, "CAM", newPath);
  result = CheckLastError("CAM", gkFuncRefGet, result);

  snprintf(newPath, elcount(newPath), "%s.%s", oldPath, "messageID");
  value.messageID = C2xGetTokenInt(packetHandle, "CAM", newPath);
  result = CheckLastError("CAM", gkFuncRefGet, result);

  snprintf(newPath, elcount(newPath), "%s.%s", oldPath, "stationID");
  value.stationID = C2xGetTokenInt64(packetHandle, "CAM", newPath);
  result = CheckLastError("CAM", gkFuncRefGet, result);

  return result;
}

int SetCAMItsPduHeaderParams(LONG packetHandle, struct CAMItsPduHeader value, char oldPath[])
{
  char newPath[300];
  int result;

  result = 0;

  snprintf(newPath, elcount(newPath), "%s.%s", oldPath, "protocolVersion");
  C2xSetTokenInt(packetHandle, "CAM", newPath, value.protocolVersion);
  result = CheckLastError("CAM", gkFuncRefGet, result);

  snprintf(newPath, elcount(newPath), "%s.%s", oldPath, "messageID");
  C2xSetTokenInt(packetHandle, "CAM", newPath, value.messageID);
  result = CheckLastError("CAM", gkFuncRefGet, result);

  snprintf(newPath, elcount(newPath), "%s.%s", oldPath, "stationID");
  C2xSetTokenInt64(packetHandle, "CAM", newPath, value.stationID);
  result = CheckLastError("CAM", gkFuncRefGet, result);

  return result;
}

int GetCAMPosConfidenceEllipseParams(LONG packetHandle, struct CAMPosConfidenceEllipse value, char oldPath[])
{
  char newPath[300];
  int result;

  result = 0;

  snprintf(newPath, elcount(newPath), "%s.%s", oldPath, "semiMajorConfidence");
  value.semiMajorConfidence = C2xGetTokenInt(packetHandle, "CAM", newPath);
  result = CheckLastError("CAM", gkFuncRefGet, result);

  snprintf(newPath, elcount(newPath), "%s.%s", oldPath, "semiMinorConfidence");
  value.semiMinorConfidence = C2xGetTokenInt(packetHandle, "CAM", newPath);
  result = CheckLastError("CAM", gkFuncRefGet, result);

  snprintf(newPath, elcount(newPath), "%s.%s", oldPath, "semiMajorOrientation");
  value.semiMajorOrientation = C2xGetTokenInt(packetHandle, "CAM", newPath);
  result = CheckLastError("CAM", gkFuncRefGet, result);

  return result;
}

int SetCAMPosConfidenceEllipseParams(LONG packetHandle, struct CAMPosConfidenceEllipse value, char oldPath[])
{
  char newPath[300];
  int result;

  result = 0;

  snprintf(newPath, elcount(newPath), "%s.%s", oldPath, "semiMajorConfidence");
  C2xSetTokenInt(packetHandle, "CAM", newPath, value.semiMajorConfidence);
  result = CheckLastError("CAM", gkFuncRefGet, result);

  snprintf(newPath, elcount(newPath), "%s.%s", oldPath, "semiMinorConfidence");
  C2xSetTokenInt(packetHandle, "CAM", newPath, value.semiMinorConfidence);
  result = CheckLastError("CAM", gkFuncRefGet, result);

  snprintf(newPath, elcount(newPath), "%s.%s", oldPath, "semiMajorOrientation");
  C2xSetTokenInt(packetHandle, "CAM", newPath, value.semiMajorOrientation);
  result = CheckLastError("CAM", gkFuncRefGet, result);

  return result;
}

int GetCAMAltitudeParams(LONG packetHandle, struct CAMAltitude value, char oldPath[])
{
  char newPath[300];
  int result;

  result = 0;

  snprintf(newPath, elcount(newPath), "%s.%s", oldPath, "altitudeValue");
  value.altitudeValue = C2xGetTokenInt(packetHandle, "CAM", newPath);
  result = CheckLastError("CAM", gkFuncRefGet, result);

  snprintf(newPath, elcount(newPath), "%s.%s", oldPath, "altitudeConfidence");
  value.altitudeConfidence = C2xGetTokenInt(packetHandle, "CAM", newPath);
  result = CheckLastError("CAM", gkFuncRefGet, result);

  return result;
}

int SetCAMAltitudeParams(LONG packetHandle, struct CAMAltitude value, char oldPath[])
{
  char newPath[300];
  int result;

  result = 0;

  snprintf(newPath, elcount(newPath), "%s.%s", oldPath, "altitudeValue");
  C2xSetTokenInt(packetHandle, "CAM", newPath, value.altitudeValue);
  result = CheckLastError("CAM", gkFuncRefGet, result);

  snprintf(newPath, elcount(newPath), "%s.%s", oldPath, "altitudeConfidence");
  C2xSetTokenInt(packetHandle, "CAM", newPath, value.altitudeConfidence);
  result = CheckLastError("CAM", gkFuncRefGet, result);

  return result;
}

int GetCAMReferencePositionParams(LONG packetHandle, struct CAMReferencePosition value, char oldPath[])
{
  char newPath[300];
  int result;

  result = 0;

  snprintf(newPath, elcount(newPath), "%s.%s", oldPath, "latitude");
  value.latitude = C2xGetTokenInt(packetHandle, "CAM", newPath);
  result = CheckLastError("CAM", gkFuncRefGet, result);

  snprintf(newPath, elcount(newPath), "%s.%s", oldPath, "longitude");
  value.longitude = C2xGetTokenInt(packetHandle, "CAM", newPath);
  result = CheckLastError("CAM", gkFuncRefGet, result);

  snprintf(newPath, elcount(newPath), "%s.%s", oldPath, "positionConfidenceEllipse");
  GetCAMPosConfidenceEllipseParams(packetHandle, value.positionConfidenceEllipse, newPath);
  result = CheckLastError("CAM", gkFuncRefGet, result);

  snprintf(newPath, elcount(newPath), "%s.%s", oldPath, "altitude");
  GetCAMAltitudeParams(packetHandle, value.altitude, newPath);
  result = CheckLastError("CAM", gkFuncRefGet, result);

  return result;
}

int SetCAMReferencePositionParams(LONG packetHandle, struct CAMReferencePosition value, char oldPath[])
{
  char newPath[300];
  int result;

  result = 0;

  snprintf(newPath, elcount(newPath), "%s.%s", oldPath, "latitude");
  C2xSetTokenInt(packetHandle, "CAM", newPath, value.latitude);
  result = CheckLastError("CAM", gkFuncRefGet, result);

  snprintf(newPath, elcount(newPath), "%s.%s", oldPath, "longitude");
  C2xSetTokenInt(packetHandle, "CAM", newPath, value.longitude);
  result = CheckLastError("CAM", gkFuncRefGet, result);

  snprintf(newPath, elcount(newPath), "%s.%s", oldPath, "positionConfidenceEllipse");
  SetCAMPosConfidenceEllipseParams(packetHandle, value.positionConfidenceEllipse, newPath);
  result = CheckLastError("CAM", gkFuncRefGet, result);

  snprintf(newPath, elcount(newPath), "%s.%s", oldPath, "altitude");
  SetCAMAltitudeParams(packetHandle, value.altitude, newPath);
  result = CheckLastError("CAM", gkFuncRefGet, result);

  return result;
}

int GetCAMBasicContainerParams(LONG packetHandle, struct CAMBasicContainer value, char oldPath[])
{
  char newPath[300];
  int result;

  result = 0;

  snprintf(newPath, elcount(newPath), "%s.%s", oldPath, "stationType");
  value.stationType = C2xGetTokenInt(packetHandle, "CAM", newPath);
  result = CheckLastError("CAM", gkFuncRefGet, result);

  snprintf(newPath, elcount(newPath), "%s.%s", oldPath, "referencePosition");
  GetCAMReferencePositionParams(packetHandle, value.referencePosition, newPath);
  result = CheckLastError("CAM", gkFuncRefGet, result);

  return result;
}

int SetCAMBasicContainerParams(LONG packetHandle, struct CAMBasicContainer value, char oldPath[])
{
  char newPath[300];
  int result;

  result = 0;

  snprintf(newPath, elcount(newPath), "%s.%s", oldPath, "stationType");
  C2xSetTokenInt(packetHandle, "CAM", newPath, value.stationType);
  result = CheckLastError("CAM", gkFuncRefGet, result);

  snprintf(newPath, elcount(newPath), "%s.%s", oldPath, "referencePosition");
  SetCAMReferencePositionParams(packetHandle, value.referencePosition, newPath);
  result = CheckLastError("CAM", gkFuncRefGet, result);

  return result;
}

int GetCAMHeadingParams(LONG packetHandle, struct CAMHeading value, char oldPath[])
{
  char newPath[300];
  int result;

  result = 0;

  snprintf(newPath, elcount(newPath), "%s.%s", oldPath, "headingValue");
  value.headingValue = C2xGetTokenInt(packetHandle, "CAM", newPath);
  result = CheckLastError("CAM", gkFuncRefGet, result);

  snprintf(newPath, elcount(newPath), "%s.%s", oldPath, "headingConfidence");
  value.headingConfidence = C2xGetTokenInt(packetHandle, "CAM", newPath);
  result = CheckLastError("CAM", gkFuncRefGet, result);

  return result;
}

int SetCAMHeadingParams(LONG packetHandle, struct CAMHeading value, char oldPath[])
{
  char newPath[300];
  int result;

  result = 0;

  snprintf(newPath, elcount(newPath), "%s.%s", oldPath, "headingValue");
  C2xSetTokenInt(packetHandle, "CAM", newPath, value.headingValue);
  result = CheckLastError("CAM", gkFuncRefGet, result);

  snprintf(newPath, elcount(newPath), "%s.%s", oldPath, "headingConfidence");
  C2xSetTokenInt(packetHandle, "CAM", newPath, value.headingConfidence);
  result = CheckLastError("CAM", gkFuncRefGet, result);

  return result;
}

int GetCAMSpeedParams(LONG packetHandle, struct CAMSpeed value, char oldPath[])
{
  char newPath[300];
  int result;

  result = 0;

  snprintf(newPath, elcount(newPath), "%s.%s", oldPath, "speedValue");
  value.speedValue = C2xGetTokenInt(packetHandle, "CAM", newPath);
  result = CheckLastError("CAM", gkFuncRefGet, result);

  snprintf(newPath, elcount(newPath), "%s.%s", oldPath, "speedConfidence");
  value.speedConfidence = C2xGetTokenInt(packetHandle, "CAM", newPath);
  result = CheckLastError("CAM", gkFuncRefGet, result);

  return result;
}

int SetCAMSpeedParams(LONG packetHandle, struct CAMSpeed value, char oldPath[])
{
  char newPath[300];
  int result;

  result = 0;

  snprintf(newPath, elcount(newPath), "%s.%s", oldPath, "speedValue");
  C2xSetTokenInt(packetHandle, "CAM", newPath, value.speedValue);
  result = CheckLastError("CAM", gkFuncRefGet, result);

  snprintf(newPath, elcount(newPath), "%s.%s", oldPath, "speedConfidence");
  C2xSetTokenInt(packetHandle, "CAM", newPath, value.speedConfidence);
  result = CheckLastError("CAM", gkFuncRefGet, result);

  return result;
}

int GetCAMVehicleLengthParams(LONG packetHandle, struct CAMVehicleLength value, char oldPath[])
{
  char newPath[300];
  int result;

  result = 0;

  snprintf(newPath, elcount(newPath), "%s.%s", oldPath, "vehicleLengthValue");
  value.vehicleLengthValue = C2xGetTokenInt(packetHandle, "CAM", newPath);
  result = CheckLastError("CAM", gkFuncRefGet, result);

  snprintf(newPath, elcount(newPath), "%s.%s", oldPath, "vehicleLengthConfidenceIndication");
  value.vehicleLengthConfidenceIndication = C2xGetTokenInt(packetHandle, "CAM", newPath);
  result = CheckLastError("CAM", gkFuncRefGet, result);

  return result;
}

int SetCAMVehicleLengthParams(LONG packetHandle, struct CAMVehicleLength value, char oldPath[])
{
  char newPath[300];
  int result;

  result = 0;

  snprintf(newPath, elcount(newPath), "%s.%s", oldPath, "vehicleLengthValue");
  C2xSetTokenInt(packetHandle, "CAM", newPath, value.vehicleLengthValue);
  result = CheckLastError("CAM", gkFuncRefGet, result);

  snprintf(newPath, elcount(newPath), "%s.%s", oldPath, "vehicleLengthConfidenceIndication");
  C2xSetTokenInt(packetHandle, "CAM", newPath, value.vehicleLengthConfidenceIndication);
  result = CheckLastError("CAM", gkFuncRefGet, result);

  return result;
}

int GetCAMLongitudinalAccelerationParams(LONG packetHandle, struct CAMLongitudinalAcceleration value, char oldPath[])
{
  char newPath[300];
  int result;

  result = 0;

  snprintf(newPath, elcount(newPath), "%s.%s", oldPath, "longitudinalAccelerationValue");
  value.longitudinalAccelerationValue = C2xGetTokenInt(packetHandle, "CAM", newPath);
  result = CheckLastError("CAM", gkFuncRefGet, result);

  snprintf(newPath, elcount(newPath), "%s.%s", oldPath, "longitudinalAccelerationConfidence");
  value.longitudinalAccelerationConfidence = C2xGetTokenInt(packetHandle, "CAM", newPath);
  result = CheckLastError("CAM", gkFuncRefGet, result);

  return result;
}

int SetCAMLongitudinalAccelerationParams(LONG packetHandle, struct CAMLongitudinalAcceleration value, char oldPath[])
{
  char newPath[300];
  int result;

  result = 0;

  snprintf(newPath, elcount(newPath), "%s.%s", oldPath, "longitudinalAccelerationValue");
  C2xSetTokenInt(packetHandle, "CAM", newPath, value.longitudinalAccelerationValue);
  result = CheckLastError("CAM", gkFuncRefGet, result);

  snprintf(newPath, elcount(newPath), "%s.%s", oldPath, "longitudinalAccelerationConfidence");
  C2xSetTokenInt(packetHandle, "CAM", newPath, value.longitudinalAccelerationConfidence);
  result = CheckLastError("CAM", gkFuncRefGet, result);

  return result;
}

int GetCAMCurvatureParams(LONG packetHandle, struct CAMCurvature value, char oldPath[])
{
  char newPath[300];
  int result;

  result = 0;

  snprintf(newPath, elcount(newPath), "%s.%s", oldPath, "curvatureValue");
  value.curvatureValue = C2xGetTokenInt(packetHandle, "CAM", newPath);
  result = CheckLastError("CAM", gkFuncRefGet, result);

  snprintf(newPath, elcount(newPath), "%s.%s", oldPath, "curvatureConfidence");
  value.curvatureConfidence = C2xGetTokenInt(packetHandle, "CAM", newPath);
  result = CheckLastError("CAM", gkFuncRefGet, result);

  return result;
}

int SetCAMCurvatureParams(LONG packetHandle, struct CAMCurvature value, char oldPath[])
{
  char newPath[300];
  int result;

  result = 0;

  snprintf(newPath, elcount(newPath), "%s.%s", oldPath, "curvatureValue");
  C2xSetTokenInt(packetHandle, "CAM", newPath, value.curvatureValue);
  result = CheckLastError("CAM", gkFuncRefGet, result);

  snprintf(newPath, elcount(newPath), "%s.%s", oldPath, "curvatureConfidence");
  C2xSetTokenInt(packetHandle, "CAM", newPath, value.curvatureConfidence);
  result = CheckLastError("CAM", gkFuncRefGet, result);

  return result;
}

int GetCAMYawRateParams(LONG packetHandle, struct CAMYawRate value, char oldPath[])
{
  char newPath[300];
  int result;

  result = 0;

  snprintf(newPath, elcount(newPath), "%s.%s", oldPath, "yawRateValue");
  value.yawRateValue = C2xGetTokenInt(packetHandle, "CAM", newPath);
  result = CheckLastError("CAM", gkFuncRefGet, result);

  snprintf(newPath, elcount(newPath), "%s.%s", oldPath, "yawRateConfidence");
  value.yawRateConfidence = C2xGetTokenInt(packetHandle, "CAM", newPath);
  result = CheckLastError("CAM", gkFuncRefGet, result);

  return result;
}

int SetCAMYawRateParams(LONG packetHandle, struct CAMYawRate value, char oldPath[])
{
  char newPath[300];
  int result;

  result = 0;

  snprintf(newPath, elcount(newPath), "%s.%s", oldPath, "yawRateValue");
  C2xSetTokenInt(packetHandle, "CAM", newPath, value.yawRateValue);
  result = CheckLastError("CAM", gkFuncRefGet, result);

  snprintf(newPath, elcount(newPath), "%s.%s", oldPath, "yawRateConfidence");
  C2xSetTokenInt(packetHandle, "CAM", newPath, value.yawRateConfidence);
  result = CheckLastError("CAM", gkFuncRefGet, result);

  return result;
}

int GetCAMSteeringWheelAngleParams(LONG packetHandle, struct CAMSteeringWheelAngle value, char oldPath[])
{
  char newPath[300];
  int result;

  result = 0;

  snprintf(newPath, elcount(newPath), "%s.%s", oldPath, "steeringWheelAngleValue");
  value.steeringWheelAngleValue = C2xGetTokenInt(packetHandle, "CAM", newPath);
  result = CheckLastError("CAM", gkFuncRefGet, result);

  snprintf(newPath, elcount(newPath), "%s.%s", oldPath, "steeringWheelAngleConfidence");
  value.steeringWheelAngleConfidence = C2xGetTokenInt(packetHandle, "CAM", newPath);
  result = CheckLastError("CAM", gkFuncRefGet, result);

  return result;
}

int SetCAMSteeringWheelAngleParams(LONG packetHandle, struct CAMSteeringWheelAngle value, char oldPath[])
{
  char newPath[300];
  int result;

  result = 0;

  snprintf(newPath, elcount(newPath), "%s.%s", oldPath, "steeringWheelAngleValue");
  C2xSetTokenInt(packetHandle, "CAM", newPath, value.steeringWheelAngleValue);
  result = CheckLastError("CAM", gkFuncRefGet, result);

  snprintf(newPath, elcount(newPath), "%s.%s", oldPath, "steeringWheelAngleConfidence");
  C2xSetTokenInt(packetHandle, "CAM", newPath, value.steeringWheelAngleConfidence);
  result = CheckLastError("CAM", gkFuncRefGet, result);

  return result;
}

int GetCAMLateralAccelerationParams(LONG packetHandle, struct CAMLateralAcceleration value, char oldPath[])
{
  char newPath[300];
  int result;

  result = 0;

  snprintf(newPath, elcount(newPath), "%s.%s", oldPath, "lateralAccelerationValue");
  value.lateralAccelerationValue = C2xGetTokenInt(packetHandle, "CAM", newPath);
  result = CheckLastError("CAM", gkFuncRefGet, result);

  snprintf(newPath, elcount(newPath), "%s.%s", oldPath, "lateralAccelerationConfidence");
  value.lateralAccelerationConfidence = C2xGetTokenInt(packetHandle, "CAM", newPath);
  result = CheckLastError("CAM", gkFuncRefGet, result);

  return result;
}

int SetCAMLateralAccelerationParams(LONG packetHandle, struct CAMLateralAcceleration value, char oldPath[])
{
  char newPath[300];
  int result;

  result = 0;

  snprintf(newPath, elcount(newPath), "%s.%s", oldPath, "lateralAccelerationValue");
  C2xSetTokenInt(packetHandle, "CAM", newPath, value.lateralAccelerationValue);
  result = CheckLastError("CAM", gkFuncRefGet, result);

  snprintf(newPath, elcount(newPath), "%s.%s", oldPath, "lateralAccelerationConfidence");
  C2xSetTokenInt(packetHandle, "CAM", newPath, value.lateralAccelerationConfidence);
  result = CheckLastError("CAM", gkFuncRefGet, result);

  return result;
}

int GetCAMVerticalAccelerationParams(LONG packetHandle, struct CAMVerticalAcceleration value, char oldPath[])
{
  char newPath[300];
  int result;

  result = 0;

  snprintf(newPath, elcount(newPath), "%s.%s", oldPath, "verticalAccelerationValue");
  value.verticalAccelerationValue = C2xGetTokenInt(packetHandle, "CAM", newPath);
  result = CheckLastError("CAM", gkFuncRefGet, result);

  snprintf(newPath, elcount(newPath), "%s.%s", oldPath, "verticalAccelerationConfidence");
  value.verticalAccelerationConfidence = C2xGetTokenInt(packetHandle, "CAM", newPath);
  result = CheckLastError("CAM", gkFuncRefGet, result);

  return result;
}

int SetCAMVerticalAccelerationParams(LONG packetHandle, struct CAMVerticalAcceleration value, char oldPath[])
{
  char newPath[300];
  int result;

  result = 0;

  snprintf(newPath, elcount(newPath), "%s.%s", oldPath, "verticalAccelerationValue");
  C2xSetTokenInt(packetHandle, "CAM", newPath, value.verticalAccelerationValue);
  result = CheckLastError("CAM", gkFuncRefGet, result);

  snprintf(newPath, elcount(newPath), "%s.%s", oldPath, "verticalAccelerationConfidence");
  C2xSetTokenInt(packetHandle, "CAM", newPath, value.verticalAccelerationConfidence);
  result = CheckLastError("CAM", gkFuncRefGet, result);

  return result;
}

int GetCAMCenDsrcTollingZoneParams(LONG packetHandle, struct CAMCenDsrcTollingZone value, char oldPath[])
{
  char newPath[300];
  int result;

  result = 0;

  snprintf(newPath, elcount(newPath), "%s.%s", oldPath, "protectedZoneLatitude");
  value.protectedZoneLatitude = C2xGetTokenInt(packetHandle, "CAM", newPath);
  result = CheckLastError("CAM", gkFuncRefGet, result);

  snprintf(newPath, elcount(newPath), "%s.%s", oldPath, "protectedZoneLongitude");
  value.protectedZoneLongitude = C2xGetTokenInt(packetHandle, "CAM", newPath);
  result = CheckLastError("CAM", gkFuncRefGet, result);

  snprintf(newPath, elcount(newPath), "%s.%s", oldPath, "cenDsrcTollingZoneID");
  value.cenDsrcTollingZoneID.isValidFlag = C2xIsTokenAvailable(packetHandle, "CAM", newPath);
  if(value.cenDsrcTollingZoneID.isValidFlag==1)
  {
    value.cenDsrcTollingZoneID.value = C2xGetTokenInt(packetHandle, "CAM", newPath);
    result = CheckLastError("CAM", gkFuncRefGet, result);
  }
  return result;
}

int SetCAMCenDsrcTollingZoneParams(LONG packetHandle, struct CAMCenDsrcTollingZone value, char oldPath[])
{
  char newPath[300];
  int result;

  result = 0;

  snprintf(newPath, elcount(newPath), "%s.%s", oldPath, "protectedZoneLatitude");
  C2xSetTokenInt(packetHandle, "CAM", newPath, value.protectedZoneLatitude);
  result = CheckLastError("CAM", gkFuncRefGet, result);

  snprintf(newPath, elcount(newPath), "%s.%s", oldPath, "protectedZoneLongitude");
  C2xSetTokenInt(packetHandle, "CAM", newPath, value.protectedZoneLongitude);
  result = CheckLastError("CAM", gkFuncRefGet, result);

  snprintf(newPath, elcount(newPath), "%s.%s", oldPath, "cenDsrcTollingZoneID");
  if(value.cenDsrcTollingZoneID.isValidFlag==1)
  {
    C2xSetTokenInt(packetHandle, "CAM", newPath, value.cenDsrcTollingZoneID.value);
    result = CheckLastError("CAM", gkFuncRefGet, result);
  }
  else
  {
    if( C2xIsTokenAvailable(packetHandle, "CAM", newPath) )
    {
      C2xRemoveToken(packetHandle, "CAM", newPath);
    }
  }

  return result;
}

int GetCAMBasicVehicleContainerHighFrequencyParams(LONG packetHandle, struct CAMBasicVehicleContainerHighFrequency value, char oldPath[])
{
  char newPath[300]; 
  int j; 
  int k;
  int result;

  result = 0;

  snprintf(newPath, elcount(newPath), "%s.%s", oldPath, "heading");
  GetCAMHeadingParams(packetHandle, value.heading, newPath);
  result = CheckLastError("CAM", gkFuncRefGet, result);

  snprintf(newPath, elcount(newPath), "%s.%s", oldPath, "speed");
  GetCAMSpeedParams(packetHandle, value.speed, newPath);
  result = CheckLastError("CAM", gkFuncRefGet, result);

  snprintf(newPath, elcount(newPath), "%s.%s", oldPath, "driveDirection");
  value.driveDirection = C2xGetTokenInt(packetHandle, "CAM", newPath);
  result = CheckLastError("CAM", gkFuncRefGet, result);

  snprintf(newPath, elcount(newPath), "%s.%s", oldPath, "vehicleLength");
  GetCAMVehicleLengthParams(packetHandle, value.vehicleLength, newPath);
  result = CheckLastError("CAM", gkFuncRefGet, result);

  snprintf(newPath, elcount(newPath), "%s.%s", oldPath, "vehicleWidth");
  value.vehicleWidth = C2xGetTokenInt(packetHandle, "CAM", newPath);
  result = CheckLastError("CAM", gkFuncRefGet, result);

  snprintf(newPath, elcount(newPath), "%s.%s", oldPath, "longitudinalAcceleration");
  GetCAMLongitudinalAccelerationParams(packetHandle, value.longitudinalAcceleration, newPath);
  result = CheckLastError("CAM", gkFuncRefGet, result);

  snprintf(newPath, elcount(newPath), "%s.%s", oldPath, "curvature");
  GetCAMCurvatureParams(packetHandle, value.curvature, newPath);
  result = CheckLastError("CAM", gkFuncRefGet, result);

  snprintf(newPath, elcount(newPath), "%s.%s", oldPath, "curvatureCalculationMode");
  value.curvatureCalculationMode = C2xGetTokenInt(packetHandle, "CAM", newPath);
  result = CheckLastError("CAM", gkFuncRefGet, result);

  snprintf(newPath, elcount(newPath), "%s.%s", oldPath, "yawRate");
  GetCAMYawRateParams(packetHandle, value.yawRate, newPath);
  result = CheckLastError("CAM", gkFuncRefGet, result);

  snprintf(newPath, elcount(newPath), "%s.%s", oldPath, "accelerationControl");
  value.accelerationControl.isValidFlag = C2xIsTokenAvailable(packetHandle, "CAM", newPath);
  if(value.accelerationControl.isValidFlag==1)
  {
    value.accelerationControl.isValidFlag = 1;
    value.accelerationControl.stringLength = C2xGetTokenLengthBit(packetHandle, "CAM", newPath);
    if ((result = CheckLastError("CAM", gkFuncRefGet, result))==0)
    {
      if(value.accelerationControl.stringLength > 0)
      {
        for(j=0; j<value.accelerationControl.stringLength; j++)
        {
          if(C2xGetTokenBitOfBitString(packetHandle, "CAM", newPath, j) == 0)
          {
            value.accelerationControl.string[j] = '0';
          }
          else if(C2xGetTokenBitOfBitString(packetHandle, "CAM", newPath, j) == 1)
          {
            value.accelerationControl.string[j] = '1';
          }

          if(value.accelerationControl.stringLength == 1)
          {
            value.accelerationControl.string[1] = '0';
          }
          result = CheckLastError("CAM", gkFuncRefGet, result);
        }
      }
      else
      {
        for(k = value.accelerationControl.stringLength+1; k > -1; k--)
        {
          if(value.accelerationControl.string[k] == '1')
          {
            value.accelerationControl.string[k] = '0';
          }
        }
      }
    }

  }
  snprintf(newPath, elcount(newPath), "%s.%s", oldPath, "lanePosition");
  value.lanePosition.isValidFlag = C2xIsTokenAvailable(packetHandle, "CAM", newPath);
  if(value.lanePosition.isValidFlag==1)
  {
    value.lanePosition.value = C2xGetTokenInt(packetHandle, "CAM", newPath);
    result = CheckLastError("CAM", gkFuncRefGet, result);
  }
  snprintf(newPath, elcount(newPath), "%s.%s", oldPath, "steeringWheelAngle");
  value.steeringWheelAngle.isValidFlag = C2xIsTokenAvailable(packetHandle, "CAM", newPath);
  if(value.steeringWheelAngle.isValidFlag==1)
  {
    GetCAMSteeringWheelAngleParams(packetHandle, value.steeringWheelAngle, newPath);
    result = CheckLastError("CAM", gkFuncRefGet, result);
  }
  snprintf(newPath, elcount(newPath), "%s.%s", oldPath, "lateralAcceleration");
  value.lateralAcceleration.isValidFlag = C2xIsTokenAvailable(packetHandle, "CAM", newPath);
  if(value.lateralAcceleration.isValidFlag==1)
  {
    GetCAMLateralAccelerationParams(packetHandle, value.lateralAcceleration, newPath);
    result = CheckLastError("CAM", gkFuncRefGet, result);
  }
  snprintf(newPath, elcount(newPath), "%s.%s", oldPath, "verticalAcceleration");
  value.verticalAcceleration.isValidFlag = C2xIsTokenAvailable(packetHandle, "CAM", newPath);
  if(value.verticalAcceleration.isValidFlag==1)
  {
    GetCAMVerticalAccelerationParams(packetHandle, value.verticalAcceleration, newPath);
    result = CheckLastError("CAM", gkFuncRefGet, result);
  }
  snprintf(newPath, elcount(newPath), "%s.%s", oldPath, "performanceClass");
  value.performanceClass.isValidFlag = C2xIsTokenAvailable(packetHandle, "CAM", newPath);
  if(value.performanceClass.isValidFlag==1)
  {
    value.performanceClass.value = C2xGetTokenInt(packetHandle, "CAM", newPath);
    result = CheckLastError("CAM", gkFuncRefGet, result);
  }
  snprintf(newPath, elcount(newPath), "%s.%s", oldPath, "cenDsrcTollingZone");
  value.cenDsrcTollingZone.isValidFlag = C2xIsTokenAvailable(packetHandle, "CAM", newPath);
  if(value.cenDsrcTollingZone.isValidFlag==1)
  {
    GetCAMCenDsrcTollingZoneParams(packetHandle, value.cenDsrcTollingZone, newPath);
    result = CheckLastError("CAM", gkFuncRefGet, result);
  }
  return result;
}

int SetCAMBasicVehicleContainerHighFrequencyParams(LONG packetHandle, struct CAMBasicVehicleContainerHighFrequency value, char oldPath[])
{
  char newPath[300]; 
  int j;
  int result;

  result = 0;

  snprintf(newPath, elcount(newPath), "%s.%s", oldPath, "heading");
  SetCAMHeadingParams(packetHandle, value.heading, newPath);
  result = CheckLastError("CAM", gkFuncRefGet, result);

  snprintf(newPath, elcount(newPath), "%s.%s", oldPath, "speed");
  SetCAMSpeedParams(packetHandle, value.speed, newPath);
  result = CheckLastError("CAM", gkFuncRefGet, result);

  snprintf(newPath, elcount(newPath), "%s.%s", oldPath, "driveDirection");
  C2xSetTokenInt(packetHandle, "CAM", newPath, value.driveDirection);
  result = CheckLastError("CAM", gkFuncRefGet, result);

  snprintf(newPath, elcount(newPath), "%s.%s", oldPath, "vehicleLength");
  SetCAMVehicleLengthParams(packetHandle, value.vehicleLength, newPath);
  result = CheckLastError("CAM", gkFuncRefGet, result);

  snprintf(newPath, elcount(newPath), "%s.%s", oldPath, "vehicleWidth");
  C2xSetTokenInt(packetHandle, "CAM", newPath, value.vehicleWidth);
  result = CheckLastError("CAM", gkFuncRefGet, result);

  snprintf(newPath, elcount(newPath), "%s.%s", oldPath, "longitudinalAcceleration");
  SetCAMLongitudinalAccelerationParams(packetHandle, value.longitudinalAcceleration, newPath);
  result = CheckLastError("CAM", gkFuncRefGet, result);

  snprintf(newPath, elcount(newPath), "%s.%s", oldPath, "curvature");
  SetCAMCurvatureParams(packetHandle, value.curvature, newPath);
  result = CheckLastError("CAM", gkFuncRefGet, result);

  snprintf(newPath, elcount(newPath), "%s.%s", oldPath, "curvatureCalculationMode");
  C2xSetTokenInt(packetHandle, "CAM", newPath, value.curvatureCalculationMode);
  result = CheckLastError("CAM", gkFuncRefGet, result);

  snprintf(newPath, elcount(newPath), "%s.%s", oldPath, "yawRate");
  SetCAMYawRateParams(packetHandle, value.yawRate, newPath);
  result = CheckLastError("CAM", gkFuncRefGet, result);

  snprintf(newPath, elcount(newPath), "%s.%s", oldPath, "accelerationControl");
  if(value.accelerationControl.isValidFlag==1)
  {
      for(j=0; j<value.accelerationControl.stringLength; j++)
      {
        if(value.accelerationControl.string[j] == '0')
        {
          C2xSetTokenBitOfBitString(packetHandle, "CAM", newPath, j, 0);
        }
        else
        {
          C2xSetTokenBitOfBitString(packetHandle, "CAM", newPath, j, 1);
        }
        result = CheckLastError("CAM", gkFuncRefGet, result);
      }
  }
  else
  {
    if( C2xIsTokenAvailable(packetHandle, "CAM", newPath) )
    {
      C2xRemoveToken(packetHandle, "CAM", newPath);
    }
  }

  snprintf(newPath, elcount(newPath), "%s.%s", oldPath, "lanePosition");
  if(value.lanePosition.isValidFlag==1)
  {
    C2xSetTokenInt(packetHandle, "CAM", newPath, value.lanePosition.value);
    result = CheckLastError("CAM", gkFuncRefGet, result);
  }
  else
  {
    if( C2xIsTokenAvailable(packetHandle, "CAM", newPath) )
    {
      C2xRemoveToken(packetHandle, "CAM", newPath);
    }
  }

  snprintf(newPath, elcount(newPath), "%s.%s", oldPath, "steeringWheelAngle");
  if(value.steeringWheelAngle.isValidFlag==1)
  {
    SetCAMSteeringWheelAngleParams(packetHandle, value.steeringWheelAngle, newPath);
    result = CheckLastError("CAM", gkFuncRefGet, result);
  }
  else
  {
    if( C2xIsTokenAvailable(packetHandle, "CAM", newPath) )
    {
      C2xRemoveToken(packetHandle, "CAM", newPath);
    }
  }

  snprintf(newPath, elcount(newPath), "%s.%s", oldPath, "lateralAcceleration");
  if(value.lateralAcceleration.isValidFlag==1)
  {
    SetCAMLateralAccelerationParams(packetHandle, value.lateralAcceleration, newPath);
    result = CheckLastError("CAM", gkFuncRefGet, result);
  }
  else
  {
    if( C2xIsTokenAvailable(packetHandle, "CAM", newPath) )
    {
      C2xRemoveToken(packetHandle, "CAM", newPath);
    }
  }

  snprintf(newPath, elcount(newPath), "%s.%s", oldPath, "verticalAcceleration");
  if(value.verticalAcceleration.isValidFlag==1)
  {
    SetCAMVerticalAccelerationParams(packetHandle, value.verticalAcceleration, newPath);
    result = CheckLastError("CAM", gkFuncRefGet, result);
  }
  else
  {
    if( C2xIsTokenAvailable(packetHandle, "CAM", newPath) )
    {
      C2xRemoveToken(packetHandle, "CAM", newPath);
    }
  }

  snprintf(newPath, elcount(newPath), "%s.%s", oldPath, "performanceClass");
  if(value.performanceClass.isValidFlag==1)
  {
    C2xSetTokenInt(packetHandle, "CAM", newPath, value.performanceClass.value);
    result = CheckLastError("CAM", gkFuncRefGet, result);
  }
  else
  {
    if( C2xIsTokenAvailable(packetHandle, "CAM", newPath) )
    {
      C2xRemoveToken(packetHandle, "CAM", newPath);
    }
  }

  snprintf(newPath, elcount(newPath), "%s.%s", oldPath, "cenDsrcTollingZone");
  if(value.cenDsrcTollingZone.isValidFlag==1)
  {
    SetCAMCenDsrcTollingZoneParams(packetHandle, value.cenDsrcTollingZone, newPath);
    result = CheckLastError("CAM", gkFuncRefGet, result);
  }
  else
  {
    if( C2xIsTokenAvailable(packetHandle, "CAM", newPath) )
    {
      C2xRemoveToken(packetHandle, "CAM", newPath);
    }
  }

  return result;
}

int GetCAMProtectedCommunicationZoneParams(LONG packetHandle, struct CAMProtectedCommunicationZone value, char oldPath[])
{
  char newPath[300];
  int result;

  result = 0;

  snprintf(newPath, elcount(newPath), "%s.%s", oldPath, "protectedZoneType");
  value.protectedZoneType = C2xGetTokenInt(packetHandle, "CAM", newPath);
  result = CheckLastError("CAM", gkFuncRefGet, result);

  snprintf(newPath, elcount(newPath), "%s.%s", oldPath, "expiryTime");
  value.expiryTime.isValidFlag = C2xIsTokenAvailable(packetHandle, "CAM", newPath);
  if(value.expiryTime.isValidFlag==1)
  {
    value.expiryTime.value = C2xGetTokenInt64(packetHandle, "CAM", newPath);
    result = CheckLastError("CAM", gkFuncRefGet, result);
  }
  snprintf(newPath, elcount(newPath), "%s.%s", oldPath, "protectedZoneLatitude");
  value.protectedZoneLatitude = C2xGetTokenInt(packetHandle, "CAM", newPath);
  result = CheckLastError("CAM", gkFuncRefGet, result);

  snprintf(newPath, elcount(newPath), "%s.%s", oldPath, "protectedZoneLongitude");
  value.protectedZoneLongitude = C2xGetTokenInt(packetHandle, "CAM", newPath);
  result = CheckLastError("CAM", gkFuncRefGet, result);

  snprintf(newPath, elcount(newPath), "%s.%s", oldPath, "protectedZoneRadius");
  value.protectedZoneRadius.isValidFlag = C2xIsTokenAvailable(packetHandle, "CAM", newPath);
  if(value.protectedZoneRadius.isValidFlag==1)
  {
    value.protectedZoneRadius.value = C2xGetTokenInt(packetHandle, "CAM", newPath);
    result = CheckLastError("CAM", gkFuncRefGet, result);
  }
  snprintf(newPath, elcount(newPath), "%s.%s", oldPath, "protectedZoneID");
  value.protectedZoneID.isValidFlag = C2xIsTokenAvailable(packetHandle, "CAM", newPath);
  if(value.protectedZoneID.isValidFlag==1)
  {
    value.protectedZoneID.value = C2xGetTokenInt(packetHandle, "CAM", newPath);
    result = CheckLastError("CAM", gkFuncRefGet, result);
  }
  return result;
}

int SetCAMProtectedCommunicationZoneParams(LONG packetHandle, struct CAMProtectedCommunicationZone value, char oldPath[])
{
  char newPath[300];
  int result;

  result = 0;

  snprintf(newPath, elcount(newPath), "%s.%s", oldPath, "protectedZoneType");
  C2xSetTokenInt(packetHandle, "CAM", newPath, value.protectedZoneType);
  result = CheckLastError("CAM", gkFuncRefGet, result);

  snprintf(newPath, elcount(newPath), "%s.%s", oldPath, "expiryTime");
  if(value.expiryTime.isValidFlag==1)
  {
    C2xSetTokenInt64(packetHandle, "CAM", newPath, value.expiryTime.value);
    result = CheckLastError("CAM", gkFuncRefGet, result);
  }
  else
  {
    if( C2xIsTokenAvailable(packetHandle, "CAM", newPath) )
    {
      C2xRemoveToken(packetHandle, "CAM", newPath);
    }
  }

  snprintf(newPath, elcount(newPath), "%s.%s", oldPath, "protectedZoneLatitude");
  C2xSetTokenInt(packetHandle, "CAM", newPath, value.protectedZoneLatitude);
  result = CheckLastError("CAM", gkFuncRefGet, result);

  snprintf(newPath, elcount(newPath), "%s.%s", oldPath, "protectedZoneLongitude");
  C2xSetTokenInt(packetHandle, "CAM", newPath, value.protectedZoneLongitude);
  result = CheckLastError("CAM", gkFuncRefGet, result);

  snprintf(newPath, elcount(newPath), "%s.%s", oldPath, "protectedZoneRadius");
  if(value.protectedZoneRadius.isValidFlag==1)
  {
    C2xSetTokenInt(packetHandle, "CAM", newPath, value.protectedZoneRadius.value);
    result = CheckLastError("CAM", gkFuncRefGet, result);
  }
  else
  {
    if( C2xIsTokenAvailable(packetHandle, "CAM", newPath) )
    {
      C2xRemoveToken(packetHandle, "CAM", newPath);
    }
  }

  snprintf(newPath, elcount(newPath), "%s.%s", oldPath, "protectedZoneID");
  if(value.protectedZoneID.isValidFlag==1)
  {
    C2xSetTokenInt(packetHandle, "CAM", newPath, value.protectedZoneID.value);
    result = CheckLastError("CAM", gkFuncRefGet, result);
  }
  else
  {
    if( C2xIsTokenAvailable(packetHandle, "CAM", newPath) )
    {
      C2xRemoveToken(packetHandle, "CAM", newPath);
    }
  }

  return result;
}

int GetCAMProtectedCommunicationZonesRSUParams(LONG packetHandle, struct CAMProtectedCommunicationZonesRSU value, char oldPath[])
{
  char newPath[300]; 
  int i;
  int result;

  result = 0;

  value.length = C2xGetTokenInt(packetHandle, "CAM", oldPath);
  if((result = CheckLastError("CAM", gkFuncRefGet, result))==0)
  {
    for(i=0; i<value.length; i++)
    {
      snprintf(newPath, elcount(newPath), "%s[%d]", oldPath, i);
      GetCAMProtectedCommunicationZoneParams(packetHandle, value.arrayValue[i], newPath);
      result = CheckLastError("CAM", gkFuncRefGet, result);
    }
  }
  return result;
}

int SetCAMProtectedCommunicationZonesRSUParams(LONG packetHandle, struct CAMProtectedCommunicationZonesRSU value, char oldPath[])
{
  char newPath[300]; 
  int i;
  int result;

  result = 0;

  C2xRemoveToken(packetHandle, "CAM", oldPath);
  for(i=0; i<value.length; i++)
  {
    snprintf(newPath, elcount(newPath), "%s[%d]", oldPath, i);
    SetCAMProtectedCommunicationZoneParams(packetHandle, value.arrayValue[i], newPath);
    result = CheckLastError("CAM", gkFuncRefGet, result);
  }
  return result;
}

int GetCAMRSUContainerHighFrequencyParams(LONG packetHandle, struct CAMRSUContainerHighFrequency value, char oldPath[])
{
  char newPath[300];
  int result;

  result = 0;

  snprintf(newPath, elcount(newPath), "%s.%s", oldPath, "protectedCommunicationZonesRSU");
  value.protectedCommunicationZonesRSU.isValidFlag = C2xIsTokenAvailable(packetHandle, "CAM", newPath);
  if(value.protectedCommunicationZonesRSU.isValidFlag==1)
  {
    GetCAMProtectedCommunicationZonesRSUParams(packetHandle, value.protectedCommunicationZonesRSU, newPath);
    result = CheckLastError("CAM", gkFuncRefGet, result);
  }
  return result;
}

int SetCAMRSUContainerHighFrequencyParams(LONG packetHandle, struct CAMRSUContainerHighFrequency value, char oldPath[])
{
  char newPath[300];
  int result;

  result = 0;

  snprintf(newPath, elcount(newPath), "%s.%s", oldPath, "protectedCommunicationZonesRSU");
  if(value.protectedCommunicationZonesRSU.isValidFlag==1)
  {
    SetCAMProtectedCommunicationZonesRSUParams(packetHandle, value.protectedCommunicationZonesRSU, newPath);
    result = CheckLastError("CAM", gkFuncRefGet, result);
  }
  else
  {
    if( C2xIsTokenAvailable(packetHandle, "CAM", newPath) )
    {
      C2xRemoveToken(packetHandle, "CAM", newPath);
    }
  }

  return result;
}

int GetCAMHighFrequencyContainerParams(LONG packetHandle, struct CAMHighFrequencyContainer value, char oldPath[])
{
  char newPath[300];
  int result;

  result = 0;

  value.choice = C2xGetTokenInt(packetHandle, "CAM", oldPath);

  switch(value.choice)
  {
    case 0:
    {
      snprintf(newPath, elcount(newPath), "%s.%s", oldPath, "basicVehicleContainerHighFrequency");
      GetCAMBasicVehicleContainerHighFrequencyParams(packetHandle, value.basicVehicleContainerHighFrequency, newPath);
      result = CheckLastError("CAM", gkFuncRefGet, result);
    }
    break;
    case 1:
    {
      snprintf(newPath, elcount(newPath), "%s.%s", oldPath, "rsuContainerHighFrequency");
      GetCAMRSUContainerHighFrequencyParams(packetHandle, value.rsuContainerHighFrequency, newPath);
      result = CheckLastError("CAM", gkFuncRefGet, result);
    }
    break;
  }
  return result;
}

int SetCAMHighFrequencyContainerParams(LONG packetHandle, struct CAMHighFrequencyContainer value, char oldPath[])
{
  char newPath[300];
  int result;

  result = 0;

  switch(value.choice)
  {
    case 0:
    {
      snprintf(newPath, elcount(newPath), "%s.%s", oldPath, "basicVehicleContainerHighFrequency");
      SetCAMBasicVehicleContainerHighFrequencyParams(packetHandle, value.basicVehicleContainerHighFrequency, newPath);
      result = CheckLastError("CAM", gkFuncRefGet, result);
    }
    break;
    case 1:
    {
      snprintf(newPath, elcount(newPath), "%s.%s", oldPath, "rsuContainerHighFrequency");
      SetCAMRSUContainerHighFrequencyParams(packetHandle, value.rsuContainerHighFrequency, newPath);
      result = CheckLastError("CAM", gkFuncRefGet, result);
    }
    break;
  }
  return result;
}

int GetCAMDeltaReferencePositionParams(LONG packetHandle, struct CAMDeltaReferencePosition value, char oldPath[])
{
  char newPath[300];
  int result;

  result = 0;

  snprintf(newPath, elcount(newPath), "%s.%s", oldPath, "deltaLatitude");
  value.deltaLatitude = C2xGetTokenInt(packetHandle, "CAM", newPath);
  result = CheckLastError("CAM", gkFuncRefGet, result);

  snprintf(newPath, elcount(newPath), "%s.%s", oldPath, "deltaLongitude");
  value.deltaLongitude = C2xGetTokenInt(packetHandle, "CAM", newPath);
  result = CheckLastError("CAM", gkFuncRefGet, result);

  snprintf(newPath, elcount(newPath), "%s.%s", oldPath, "deltaAltitude");
  value.deltaAltitude = C2xGetTokenInt(packetHandle, "CAM", newPath);
  result = CheckLastError("CAM", gkFuncRefGet, result);

  return result;
}

int SetCAMDeltaReferencePositionParams(LONG packetHandle, struct CAMDeltaReferencePosition value, char oldPath[])
{
  char newPath[300];
  int result;

  result = 0;

  snprintf(newPath, elcount(newPath), "%s.%s", oldPath, "deltaLatitude");
  C2xSetTokenInt(packetHandle, "CAM", newPath, value.deltaLatitude);
  result = CheckLastError("CAM", gkFuncRefGet, result);

  snprintf(newPath, elcount(newPath), "%s.%s", oldPath, "deltaLongitude");
  C2xSetTokenInt(packetHandle, "CAM", newPath, value.deltaLongitude);
  result = CheckLastError("CAM", gkFuncRefGet, result);

  snprintf(newPath, elcount(newPath), "%s.%s", oldPath, "deltaAltitude");
  C2xSetTokenInt(packetHandle, "CAM", newPath, value.deltaAltitude);
  result = CheckLastError("CAM", gkFuncRefGet, result);

  return result;
}

int GetCAMPathPointParams(LONG packetHandle, struct CAMPathPoint value, char oldPath[])
{
  char newPath[300];
  int result;

  result = 0;

  snprintf(newPath, elcount(newPath), "%s.%s", oldPath, "pathPosition");
  GetCAMDeltaReferencePositionParams(packetHandle, value.pathPosition, newPath);
  result = CheckLastError("CAM", gkFuncRefGet, result);

  snprintf(newPath, elcount(newPath), "%s.%s", oldPath, "pathDeltaTime");
  value.pathDeltaTime.isValidFlag = C2xIsTokenAvailable(packetHandle, "CAM", newPath);
  if(value.pathDeltaTime.isValidFlag==1)
  {
    value.pathDeltaTime.value = C2xGetTokenInt(packetHandle, "CAM", newPath);
    result = CheckLastError("CAM", gkFuncRefGet, result);
  }
  return result;
}

int SetCAMPathPointParams(LONG packetHandle, struct CAMPathPoint value, char oldPath[])
{
  char newPath[300];
  int result;

  result = 0;

  snprintf(newPath, elcount(newPath), "%s.%s", oldPath, "pathPosition");
  SetCAMDeltaReferencePositionParams(packetHandle, value.pathPosition, newPath);
  result = CheckLastError("CAM", gkFuncRefGet, result);

  snprintf(newPath, elcount(newPath), "%s.%s", oldPath, "pathDeltaTime");
  if(value.pathDeltaTime.isValidFlag==1)
  {
    C2xSetTokenInt(packetHandle, "CAM", newPath, value.pathDeltaTime.value);
    result = CheckLastError("CAM", gkFuncRefGet, result);
  }
  else
  {
    if( C2xIsTokenAvailable(packetHandle, "CAM", newPath) )
    {
      C2xRemoveToken(packetHandle, "CAM", newPath);
    }
  }

  return result;
}

int GetCAMPathHistoryParams(LONG packetHandle, struct CAMPathHistory value, char oldPath[])
{
  char newPath[300]; 
  int i;
  int result;

  result = 0;

  value.length = C2xGetTokenInt(packetHandle, "CAM", oldPath);
  if((result = CheckLastError("CAM", gkFuncRefGet, result))==0)
  {
    for(i=0; i<value.length; i++)
    {
      snprintf(newPath, elcount(newPath), "%s[%d]", oldPath, i);
      GetCAMPathPointParams(packetHandle, value.arrayValue[i], newPath);
      result = CheckLastError("CAM", gkFuncRefGet, result);
    }
  }
  return result;
}

int SetCAMPathHistoryParams(LONG packetHandle, struct CAMPathHistory value, char oldPath[])
{
  char newPath[300]; 
  int i;
  int result;

  result = 0;

  C2xRemoveToken(packetHandle, "CAM", oldPath);
  for(i=0; i<value.length; i++)
  {
    snprintf(newPath, elcount(newPath), "%s[%d]", oldPath, i);
    SetCAMPathPointParams(packetHandle, value.arrayValue[i], newPath);
    result = CheckLastError("CAM", gkFuncRefGet, result);
  }
  return result;
}

int GetCAMBasicVehicleContainerLowFrequencyParams(LONG packetHandle, struct CAMBasicVehicleContainerLowFrequency value, char oldPath[])
{
  char newPath[300]; 
  int j; 
  int k;
  int result;

  result = 0;

  snprintf(newPath, elcount(newPath), "%s.%s", oldPath, "vehicleRole");
  value.vehicleRole = C2xGetTokenInt(packetHandle, "CAM", newPath);
  result = CheckLastError("CAM", gkFuncRefGet, result);

  snprintf(newPath, elcount(newPath), "%s.%s", oldPath, "exteriorLights");
  value.exteriorLights.isValidFlag = 1;
  value.exteriorLights.stringLength = C2xGetTokenLengthBit(packetHandle, "CAM", newPath);
  if ((result = CheckLastError("CAM", gkFuncRefGet, result))==0)
  {
    if(value.exteriorLights.stringLength > 0)
    {
      for(j=0; j<value.exteriorLights.stringLength; j++)
      {
        if(C2xGetTokenBitOfBitString(packetHandle, "CAM", newPath, j) == 0)
        {
          value.exteriorLights.string[j] = '0';
        }
        else if(C2xGetTokenBitOfBitString(packetHandle, "CAM", newPath, j) == 1)
        {
          value.exteriorLights.string[j] = '1';
        }

        if(value.exteriorLights.stringLength == 1)
        {
          value.exteriorLights.string[1] = '0';
        }
        result = CheckLastError("CAM", gkFuncRefGet, result);
      }
    }
    else
    {
      for(k = value.exteriorLights.stringLength+1; k > -1; k--)
      {
        if(value.exteriorLights.string[k] == '1')
        {
          value.exteriorLights.string[k] = '0';
        }
      }
    }
  }

  snprintf(newPath, elcount(newPath), "%s.%s", oldPath, "pathHistory");
  GetCAMPathHistoryParams(packetHandle, value.pathHistory, newPath);
  result = CheckLastError("CAM", gkFuncRefGet, result);

  return result;
}

int SetCAMBasicVehicleContainerLowFrequencyParams(LONG packetHandle, struct CAMBasicVehicleContainerLowFrequency value, char oldPath[])
{
  char newPath[300]; 
  int j;
  int result;

  result = 0;

  snprintf(newPath, elcount(newPath), "%s.%s", oldPath, "vehicleRole");
  C2xSetTokenInt(packetHandle, "CAM", newPath, value.vehicleRole);
  result = CheckLastError("CAM", gkFuncRefGet, result);

  snprintf(newPath, elcount(newPath), "%s.%s", oldPath, "exteriorLights");
    for(j=0; j<value.exteriorLights.stringLength; j++)
    {
      if(value.exteriorLights.string[j] == '0')
      {
        C2xSetTokenBitOfBitString(packetHandle, "CAM", newPath, j, 0);
      }
      else
      {
        C2xSetTokenBitOfBitString(packetHandle, "CAM", newPath, j, 1);
      }
      result = CheckLastError("CAM", gkFuncRefGet, result);
    }

  snprintf(newPath, elcount(newPath), "%s.%s", oldPath, "pathHistory");
  SetCAMPathHistoryParams(packetHandle, value.pathHistory, newPath);
  result = CheckLastError("CAM", gkFuncRefGet, result);

  return result;
}

int GetCAMLowFrequencyContainerParams(LONG packetHandle, struct CAMLowFrequencyContainer value, char oldPath[])
{
  char newPath[300];
  int result;

  result = 0;

  value.choice = C2xGetTokenInt(packetHandle, "CAM", oldPath);

  switch(value.choice)
  {
    case 0:
    {
      snprintf(newPath, elcount(newPath), "%s.%s", oldPath, "basicVehicleContainerLowFrequency");
      GetCAMBasicVehicleContainerLowFrequencyParams(packetHandle, value.basicVehicleContainerLowFrequency, newPath);
      result = CheckLastError("CAM", gkFuncRefGet, result);
    }
    break;
  }
  return result;
}

int SetCAMLowFrequencyContainerParams(LONG packetHandle, struct CAMLowFrequencyContainer value, char oldPath[])
{
  char newPath[300];
  int result;

  result = 0;

  switch(value.choice)
  {
    case 0:
    {
      snprintf(newPath, elcount(newPath), "%s.%s", oldPath, "basicVehicleContainerLowFrequency");
      SetCAMBasicVehicleContainerLowFrequencyParams(packetHandle, value.basicVehicleContainerLowFrequency, newPath);
      result = CheckLastError("CAM", gkFuncRefGet, result);
    }
    break;
  }
  return result;
}

int GetCAMPtActivationParams(LONG packetHandle, struct CAMPtActivation value, char oldPath[])
{
  char newPath[300];
  int result;

  result = 0;

  snprintf(newPath, elcount(newPath), "%s.%s", oldPath, "ptActivationType");
  value.ptActivationType = C2xGetTokenInt(packetHandle, "CAM", newPath);
  result = CheckLastError("CAM", gkFuncRefGet, result);

  snprintf(newPath, elcount(newPath), "%s.%s", oldPath, "ptActivationData");
  value.ptActivationData.stringLength = C2xGetTokenData(packetHandle, "CAM", newPath, elcount(value.ptActivationData.string), value.ptActivationData.string);
  return result;
}

int SetCAMPtActivationParams(LONG packetHandle, struct CAMPtActivation value, char oldPath[])
{
  char newPath[300];
  int result;

  result = 0;

  snprintf(newPath, elcount(newPath), "%s.%s", oldPath, "ptActivationType");
  C2xSetTokenInt(packetHandle, "CAM", newPath, value.ptActivationType);
  result = CheckLastError("CAM", gkFuncRefGet, result);

  snprintf(newPath, elcount(newPath), "%s.%s", oldPath, "ptActivationData");
  C2xSetTokenData(packetHandle, "CAM", newPath, value.ptActivationData.stringLength, value.ptActivationData.string);

  return result;
}

int GetCAMPublicTransportContainerParams(LONG packetHandle, struct CAMPublicTransportContainer value, char oldPath[])
{
  char newPath[300];
  int result;

  result = 0;

  snprintf(newPath, elcount(newPath), "%s.%s", oldPath, "embarkationStatus");
  value.embarkationStatus = C2xGetTokenInt64(packetHandle, "CAM", newPath);
  result = CheckLastError("CAM", gkFuncRefGet, result);

  snprintf(newPath, elcount(newPath), "%s.%s", oldPath, "ptActivation");
  value.ptActivation.isValidFlag = C2xIsTokenAvailable(packetHandle, "CAM", newPath);
  if(value.ptActivation.isValidFlag==1)
  {
    GetCAMPtActivationParams(packetHandle, value.ptActivation, newPath);
    result = CheckLastError("CAM", gkFuncRefGet, result);
  }
  return result;
}

int SetCAMPublicTransportContainerParams(LONG packetHandle, struct CAMPublicTransportContainer value, char oldPath[])
{
  char newPath[300];
  int result;

  result = 0;

  snprintf(newPath, elcount(newPath), "%s.%s", oldPath, "embarkationStatus");
  C2xSetTokenInt64(packetHandle, "CAM", newPath, value.embarkationStatus);
  result = CheckLastError("CAM", gkFuncRefGet, result);

  snprintf(newPath, elcount(newPath), "%s.%s", oldPath, "ptActivation");
  if(value.ptActivation.isValidFlag==1)
  {
    SetCAMPtActivationParams(packetHandle, value.ptActivation, newPath);
    result = CheckLastError("CAM", gkFuncRefGet, result);
  }
  else
  {
    if( C2xIsTokenAvailable(packetHandle, "CAM", newPath) )
    {
      C2xRemoveToken(packetHandle, "CAM", newPath);
    }
  }

  return result;
}

int GetCAMSpecialTransportContainerParams(LONG packetHandle, struct CAMSpecialTransportContainer value, char oldPath[])
{
  char newPath[300]; 
  int j; 
  int k;
  int result;

  result = 0;

  snprintf(newPath, elcount(newPath), "%s.%s", oldPath, "specialTransportType");
  value.specialTransportType.isValidFlag = 1;
  value.specialTransportType.stringLength = C2xGetTokenLengthBit(packetHandle, "CAM", newPath);
  if ((result = CheckLastError("CAM", gkFuncRefGet, result))==0)
  {
    if(value.specialTransportType.stringLength > 0)
    {
      for(j=0; j<value.specialTransportType.stringLength; j++)
      {
        if(C2xGetTokenBitOfBitString(packetHandle, "CAM", newPath, j) == 0)
        {
          value.specialTransportType.string[j] = '0';
        }
        else if(C2xGetTokenBitOfBitString(packetHandle, "CAM", newPath, j) == 1)
        {
          value.specialTransportType.string[j] = '1';
        }

        if(value.specialTransportType.stringLength == 1)
        {
          value.specialTransportType.string[1] = '0';
        }
        result = CheckLastError("CAM", gkFuncRefGet, result);
      }
    }
    else
    {
      for(k = value.specialTransportType.stringLength+1; k > -1; k--)
      {
        if(value.specialTransportType.string[k] == '1')
        {
          value.specialTransportType.string[k] = '0';
        }
      }
    }
  }

  snprintf(newPath, elcount(newPath), "%s.%s", oldPath, "lightBarSirenInUse");
  value.lightBarSirenInUse.isValidFlag = 1;
  value.lightBarSirenInUse.stringLength = C2xGetTokenLengthBit(packetHandle, "CAM", newPath);
  if ((result = CheckLastError("CAM", gkFuncRefGet, result))==0)
  {
    if(value.lightBarSirenInUse.stringLength > 0)
    {
      for(j=0; j<value.lightBarSirenInUse.stringLength; j++)
      {
        if(C2xGetTokenBitOfBitString(packetHandle, "CAM", newPath, j) == 0)
        {
          value.lightBarSirenInUse.string[j] = '0';
        }
        else if(C2xGetTokenBitOfBitString(packetHandle, "CAM", newPath, j) == 1)
        {
          value.lightBarSirenInUse.string[j] = '1';
        }

        if(value.lightBarSirenInUse.stringLength == 1)
        {
          value.lightBarSirenInUse.string[1] = '0';
        }
        result = CheckLastError("CAM", gkFuncRefGet, result);
      }
    }
    else
    {
      for(k = value.lightBarSirenInUse.stringLength+1; k > -1; k--)
      {
        if(value.lightBarSirenInUse.string[k] == '1')
        {
          value.lightBarSirenInUse.string[k] = '0';
        }
      }
    }
  }

  return result;
}

int SetCAMSpecialTransportContainerParams(LONG packetHandle, struct CAMSpecialTransportContainer value, char oldPath[])
{
  char newPath[300]; 
  int j;
  int result;

  result = 0;

  snprintf(newPath, elcount(newPath), "%s.%s", oldPath, "specialTransportType");
    for(j=0; j<value.specialTransportType.stringLength; j++)
    {
      if(value.specialTransportType.string[j] == '0')
      {
        C2xSetTokenBitOfBitString(packetHandle, "CAM", newPath, j, 0);
      }
      else
      {
        C2xSetTokenBitOfBitString(packetHandle, "CAM", newPath, j, 1);
      }
      result = CheckLastError("CAM", gkFuncRefGet, result);
    }

  snprintf(newPath, elcount(newPath), "%s.%s", oldPath, "lightBarSirenInUse");
    for(j=0; j<value.lightBarSirenInUse.stringLength; j++)
    {
      if(value.lightBarSirenInUse.string[j] == '0')
      {
        C2xSetTokenBitOfBitString(packetHandle, "CAM", newPath, j, 0);
      }
      else
      {
        C2xSetTokenBitOfBitString(packetHandle, "CAM", newPath, j, 1);
      }
      result = CheckLastError("CAM", gkFuncRefGet, result);
    }

  return result;
}

int GetCAMDangerousGoodsContainerParams(LONG packetHandle, struct CAMDangerousGoodsContainer value, char oldPath[])
{
  char newPath[300];
  int result;

  result = 0;

  snprintf(newPath, elcount(newPath), "%s.%s", oldPath, "dangerousGoodsBasic");
  value.dangerousGoodsBasic = C2xGetTokenInt(packetHandle, "CAM", newPath);
  result = CheckLastError("CAM", gkFuncRefGet, result);

  return result;
}

int SetCAMDangerousGoodsContainerParams(LONG packetHandle, struct CAMDangerousGoodsContainer value, char oldPath[])
{
  char newPath[300];
  int result;

  result = 0;

  snprintf(newPath, elcount(newPath), "%s.%s", oldPath, "dangerousGoodsBasic");
  C2xSetTokenInt(packetHandle, "CAM", newPath, value.dangerousGoodsBasic);
  result = CheckLastError("CAM", gkFuncRefGet, result);

  return result;
}

int GetCAMClosedLanesParams(LONG packetHandle, struct CAMClosedLanes value, char oldPath[])
{
  char newPath[300]; 
  int j; 
  int k;
  int result;

  result = 0;

  snprintf(newPath, elcount(newPath), "%s.%s", oldPath, "innerhardShoulderStatus");
  value.innerhardShoulderStatus.isValidFlag = C2xIsTokenAvailable(packetHandle, "CAM", newPath);
  if(value.innerhardShoulderStatus.isValidFlag==1)
  {
    value.innerhardShoulderStatus.value = C2xGetTokenInt(packetHandle, "CAM", newPath);
    result = CheckLastError("CAM", gkFuncRefGet, result);
  }
  snprintf(newPath, elcount(newPath), "%s.%s", oldPath, "outerhardShoulderStatus");
  value.outerhardShoulderStatus.isValidFlag = C2xIsTokenAvailable(packetHandle, "CAM", newPath);
  if(value.outerhardShoulderStatus.isValidFlag==1)
  {
    value.outerhardShoulderStatus.value = C2xGetTokenInt(packetHandle, "CAM", newPath);
    result = CheckLastError("CAM", gkFuncRefGet, result);
  }
  snprintf(newPath, elcount(newPath), "%s.%s", oldPath, "drivingLaneStatus");
  value.drivingLaneStatus.isValidFlag = C2xIsTokenAvailable(packetHandle, "CAM", newPath);
  if(value.drivingLaneStatus.isValidFlag==1)
  {
    value.drivingLaneStatus.isValidFlag = 1;
    value.drivingLaneStatus.stringLength = C2xGetTokenLengthBit(packetHandle, "CAM", newPath);
    if ((result = CheckLastError("CAM", gkFuncRefGet, result))==0)
    {
      if(value.drivingLaneStatus.stringLength > 0)
      {
        for(j=0; j<value.drivingLaneStatus.stringLength; j++)
        {
          if(C2xGetTokenBitOfBitString(packetHandle, "CAM", newPath, j) == 0)
          {
            value.drivingLaneStatus.string[j] = '0';
          }
          else if(C2xGetTokenBitOfBitString(packetHandle, "CAM", newPath, j) == 1)
          {
            value.drivingLaneStatus.string[j] = '1';
          }

          if(value.drivingLaneStatus.stringLength == 1)
          {
            value.drivingLaneStatus.string[1] = '0';
          }
          result = CheckLastError("CAM", gkFuncRefGet, result);
        }
      }
      else
      {
        for(k = value.drivingLaneStatus.stringLength+1; k > -1; k--)
        {
          if(value.drivingLaneStatus.string[k] == '1')
          {
            value.drivingLaneStatus.string[k] = '0';
          }
        }
      }
    }

  }
  return result;
}

int SetCAMClosedLanesParams(LONG packetHandle, struct CAMClosedLanes value, char oldPath[])
{
  char newPath[300]; 
  int j;
  int result;

  result = 0;

  snprintf(newPath, elcount(newPath), "%s.%s", oldPath, "innerhardShoulderStatus");
  if(value.innerhardShoulderStatus.isValidFlag==1)
  {
    C2xSetTokenInt(packetHandle, "CAM", newPath, value.innerhardShoulderStatus.value);
    result = CheckLastError("CAM", gkFuncRefGet, result);
  }
  else
  {
    if( C2xIsTokenAvailable(packetHandle, "CAM", newPath) )
    {
      C2xRemoveToken(packetHandle, "CAM", newPath);
    }
  }

  snprintf(newPath, elcount(newPath), "%s.%s", oldPath, "outerhardShoulderStatus");
  if(value.outerhardShoulderStatus.isValidFlag==1)
  {
    C2xSetTokenInt(packetHandle, "CAM", newPath, value.outerhardShoulderStatus.value);
    result = CheckLastError("CAM", gkFuncRefGet, result);
  }
  else
  {
    if( C2xIsTokenAvailable(packetHandle, "CAM", newPath) )
    {
      C2xRemoveToken(packetHandle, "CAM", newPath);
    }
  }

  snprintf(newPath, elcount(newPath), "%s.%s", oldPath, "drivingLaneStatus");
  if(value.drivingLaneStatus.isValidFlag==1)
  {
      for(j=0; j<value.drivingLaneStatus.stringLength; j++)
      {
        if(value.drivingLaneStatus.string[j] == '0')
        {
          C2xSetTokenBitOfBitString(packetHandle, "CAM", newPath, j, 0);
        }
        else
        {
          C2xSetTokenBitOfBitString(packetHandle, "CAM", newPath, j, 1);
        }
        result = CheckLastError("CAM", gkFuncRefGet, result);
      }
  }
  else
  {
    if( C2xIsTokenAvailable(packetHandle, "CAM", newPath) )
    {
      C2xRemoveToken(packetHandle, "CAM", newPath);
    }
  }

  return result;
}

int GetCAMRoadWorksContainerBasicParams(LONG packetHandle, struct CAMRoadWorksContainerBasic value, char oldPath[])
{
  char newPath[300]; 
  int j; 
  int k;
  int result;

  result = 0;

  snprintf(newPath, elcount(newPath), "%s.%s", oldPath, "roadworksSubCauseCode");
  value.roadworksSubCauseCode.isValidFlag = C2xIsTokenAvailable(packetHandle, "CAM", newPath);
  if(value.roadworksSubCauseCode.isValidFlag==1)
  {
    value.roadworksSubCauseCode.value = C2xGetTokenInt(packetHandle, "CAM", newPath);
    result = CheckLastError("CAM", gkFuncRefGet, result);
  }
  snprintf(newPath, elcount(newPath), "%s.%s", oldPath, "lightBarSirenInUse");
  value.lightBarSirenInUse.isValidFlag = 1;
  value.lightBarSirenInUse.stringLength = C2xGetTokenLengthBit(packetHandle, "CAM", newPath);
  if ((result = CheckLastError("CAM", gkFuncRefGet, result))==0)
  {
    if(value.lightBarSirenInUse.stringLength > 0)
    {
      for(j=0; j<value.lightBarSirenInUse.stringLength; j++)
      {
        if(C2xGetTokenBitOfBitString(packetHandle, "CAM", newPath, j) == 0)
        {
          value.lightBarSirenInUse.string[j] = '0';
        }
        else if(C2xGetTokenBitOfBitString(packetHandle, "CAM", newPath, j) == 1)
        {
          value.lightBarSirenInUse.string[j] = '1';
        }

        if(value.lightBarSirenInUse.stringLength == 1)
        {
          value.lightBarSirenInUse.string[1] = '0';
        }
        result = CheckLastError("CAM", gkFuncRefGet, result);
      }
    }
    else
    {
      for(k = value.lightBarSirenInUse.stringLength+1; k > -1; k--)
      {
        if(value.lightBarSirenInUse.string[k] == '1')
        {
          value.lightBarSirenInUse.string[k] = '0';
        }
      }
    }
  }

  snprintf(newPath, elcount(newPath), "%s.%s", oldPath, "closedLanes");
  value.closedLanes.isValidFlag = C2xIsTokenAvailable(packetHandle, "CAM", newPath);
  if(value.closedLanes.isValidFlag==1)
  {
    GetCAMClosedLanesParams(packetHandle, value.closedLanes, newPath);
    result = CheckLastError("CAM", gkFuncRefGet, result);
  }
  return result;
}

int SetCAMRoadWorksContainerBasicParams(LONG packetHandle, struct CAMRoadWorksContainerBasic value, char oldPath[])
{
  char newPath[300]; 
  int j;
  int result;

  result = 0;

  snprintf(newPath, elcount(newPath), "%s.%s", oldPath, "roadworksSubCauseCode");
  if(value.roadworksSubCauseCode.isValidFlag==1)
  {
    C2xSetTokenInt(packetHandle, "CAM", newPath, value.roadworksSubCauseCode.value);
    result = CheckLastError("CAM", gkFuncRefGet, result);
  }
  else
  {
    if( C2xIsTokenAvailable(packetHandle, "CAM", newPath) )
    {
      C2xRemoveToken(packetHandle, "CAM", newPath);
    }
  }

  snprintf(newPath, elcount(newPath), "%s.%s", oldPath, "lightBarSirenInUse");
    for(j=0; j<value.lightBarSirenInUse.stringLength; j++)
    {
      if(value.lightBarSirenInUse.string[j] == '0')
      {
        C2xSetTokenBitOfBitString(packetHandle, "CAM", newPath, j, 0);
      }
      else
      {
        C2xSetTokenBitOfBitString(packetHandle, "CAM", newPath, j, 1);
      }
      result = CheckLastError("CAM", gkFuncRefGet, result);
    }

  snprintf(newPath, elcount(newPath), "%s.%s", oldPath, "closedLanes");
  if(value.closedLanes.isValidFlag==1)
  {
    SetCAMClosedLanesParams(packetHandle, value.closedLanes, newPath);
    result = CheckLastError("CAM", gkFuncRefGet, result);
  }
  else
  {
    if( C2xIsTokenAvailable(packetHandle, "CAM", newPath) )
    {
      C2xRemoveToken(packetHandle, "CAM", newPath);
    }
  }

  return result;
}

int GetCAMRescueContainerParams(LONG packetHandle, struct CAMRescueContainer value, char oldPath[])
{
  char newPath[300]; 
  int j; 
  int k;
  int result;

  result = 0;

  snprintf(newPath, elcount(newPath), "%s.%s", oldPath, "lightBarSirenInUse");
  value.lightBarSirenInUse.isValidFlag = 1;
  value.lightBarSirenInUse.stringLength = C2xGetTokenLengthBit(packetHandle, "CAM", newPath);
  if ((result = CheckLastError("CAM", gkFuncRefGet, result))==0)
  {
    if(value.lightBarSirenInUse.stringLength > 0)
    {
      for(j=0; j<value.lightBarSirenInUse.stringLength; j++)
      {
        if(C2xGetTokenBitOfBitString(packetHandle, "CAM", newPath, j) == 0)
        {
          value.lightBarSirenInUse.string[j] = '0';
        }
        else if(C2xGetTokenBitOfBitString(packetHandle, "CAM", newPath, j) == 1)
        {
          value.lightBarSirenInUse.string[j] = '1';
        }

        if(value.lightBarSirenInUse.stringLength == 1)
        {
          value.lightBarSirenInUse.string[1] = '0';
        }
        result = CheckLastError("CAM", gkFuncRefGet, result);
      }
    }
    else
    {
      for(k = value.lightBarSirenInUse.stringLength+1; k > -1; k--)
      {
        if(value.lightBarSirenInUse.string[k] == '1')
        {
          value.lightBarSirenInUse.string[k] = '0';
        }
      }
    }
  }

  return result;
}

int SetCAMRescueContainerParams(LONG packetHandle, struct CAMRescueContainer value, char oldPath[])
{
  char newPath[300]; 
  int j;
  int result;

  result = 0;

  snprintf(newPath, elcount(newPath), "%s.%s", oldPath, "lightBarSirenInUse");
    for(j=0; j<value.lightBarSirenInUse.stringLength; j++)
    {
      if(value.lightBarSirenInUse.string[j] == '0')
      {
        C2xSetTokenBitOfBitString(packetHandle, "CAM", newPath, j, 0);
      }
      else
      {
        C2xSetTokenBitOfBitString(packetHandle, "CAM", newPath, j, 1);
      }
      result = CheckLastError("CAM", gkFuncRefGet, result);
    }

  return result;
}

int GetCAMCauseCodeParams(LONG packetHandle, struct CAMCauseCode value, char oldPath[])
{
  char newPath[300];
  int result;

  result = 0;

  snprintf(newPath, elcount(newPath), "%s.%s", oldPath, "causeCode");
  value.causeCode = C2xGetTokenInt(packetHandle, "CAM", newPath);
  result = CheckLastError("CAM", gkFuncRefGet, result);

  snprintf(newPath, elcount(newPath), "%s.%s", oldPath, "subCauseCode");
  value.subCauseCode = C2xGetTokenInt(packetHandle, "CAM", newPath);
  result = CheckLastError("CAM", gkFuncRefGet, result);

  return result;
}

int SetCAMCauseCodeParams(LONG packetHandle, struct CAMCauseCode value, char oldPath[])
{
  char newPath[300];
  int result;

  result = 0;

  snprintf(newPath, elcount(newPath), "%s.%s", oldPath, "causeCode");
  C2xSetTokenInt(packetHandle, "CAM", newPath, value.causeCode);
  result = CheckLastError("CAM", gkFuncRefGet, result);

  snprintf(newPath, elcount(newPath), "%s.%s", oldPath, "subCauseCode");
  C2xSetTokenInt(packetHandle, "CAM", newPath, value.subCauseCode);
  result = CheckLastError("CAM", gkFuncRefGet, result);

  return result;
}

int GetCAMEmergencyContainerParams(LONG packetHandle, struct CAMEmergencyContainer value, char oldPath[])
{
  char newPath[300]; 
  int j; 
  int k;
  int result;

  result = 0;

  snprintf(newPath, elcount(newPath), "%s.%s", oldPath, "lightBarSirenInUse");
  value.lightBarSirenInUse.isValidFlag = 1;
  value.lightBarSirenInUse.stringLength = C2xGetTokenLengthBit(packetHandle, "CAM", newPath);
  if ((result = CheckLastError("CAM", gkFuncRefGet, result))==0)
  {
    if(value.lightBarSirenInUse.stringLength > 0)
    {
      for(j=0; j<value.lightBarSirenInUse.stringLength; j++)
      {
        if(C2xGetTokenBitOfBitString(packetHandle, "CAM", newPath, j) == 0)
        {
          value.lightBarSirenInUse.string[j] = '0';
        }
        else if(C2xGetTokenBitOfBitString(packetHandle, "CAM", newPath, j) == 1)
        {
          value.lightBarSirenInUse.string[j] = '1';
        }

        if(value.lightBarSirenInUse.stringLength == 1)
        {
          value.lightBarSirenInUse.string[1] = '0';
        }
        result = CheckLastError("CAM", gkFuncRefGet, result);
      }
    }
    else
    {
      for(k = value.lightBarSirenInUse.stringLength+1; k > -1; k--)
      {
        if(value.lightBarSirenInUse.string[k] == '1')
        {
          value.lightBarSirenInUse.string[k] = '0';
        }
      }
    }
  }

  snprintf(newPath, elcount(newPath), "%s.%s", oldPath, "incidentIndication");
  value.incidentIndication.isValidFlag = C2xIsTokenAvailable(packetHandle, "CAM", newPath);
  if(value.incidentIndication.isValidFlag==1)
  {
    GetCAMCauseCodeParams(packetHandle, value.incidentIndication, newPath);
    result = CheckLastError("CAM", gkFuncRefGet, result);
  }
  snprintf(newPath, elcount(newPath), "%s.%s", oldPath, "emergencyPriority");
  value.emergencyPriority.isValidFlag = C2xIsTokenAvailable(packetHandle, "CAM", newPath);
  if(value.emergencyPriority.isValidFlag==1)
  {
    value.emergencyPriority.isValidFlag = 1;
    value.emergencyPriority.stringLength = C2xGetTokenLengthBit(packetHandle, "CAM", newPath);
    if ((result = CheckLastError("CAM", gkFuncRefGet, result))==0)
    {
      if(value.emergencyPriority.stringLength > 0)
      {
        for(j=0; j<value.emergencyPriority.stringLength; j++)
        {
          if(C2xGetTokenBitOfBitString(packetHandle, "CAM", newPath, j) == 0)
          {
            value.emergencyPriority.string[j] = '0';
          }
          else if(C2xGetTokenBitOfBitString(packetHandle, "CAM", newPath, j) == 1)
          {
            value.emergencyPriority.string[j] = '1';
          }

          if(value.emergencyPriority.stringLength == 1)
          {
            value.emergencyPriority.string[1] = '0';
          }
          result = CheckLastError("CAM", gkFuncRefGet, result);
        }
      }
      else
      {
        for(k = value.emergencyPriority.stringLength+1; k > -1; k--)
        {
          if(value.emergencyPriority.string[k] == '1')
          {
            value.emergencyPriority.string[k] = '0';
          }
        }
      }
    }

  }
  return result;
}

int SetCAMEmergencyContainerParams(LONG packetHandle, struct CAMEmergencyContainer value, char oldPath[])
{
  char newPath[300]; 
  int j;
  int result;

  result = 0;

  snprintf(newPath, elcount(newPath), "%s.%s", oldPath, "lightBarSirenInUse");
    for(j=0; j<value.lightBarSirenInUse.stringLength; j++)
    {
      if(value.lightBarSirenInUse.string[j] == '0')
      {
        C2xSetTokenBitOfBitString(packetHandle, "CAM", newPath, j, 0);
      }
      else
      {
        C2xSetTokenBitOfBitString(packetHandle, "CAM", newPath, j, 1);
      }
      result = CheckLastError("CAM", gkFuncRefGet, result);
    }

  snprintf(newPath, elcount(newPath), "%s.%s", oldPath, "incidentIndication");
  if(value.incidentIndication.isValidFlag==1)
  {
    SetCAMCauseCodeParams(packetHandle, value.incidentIndication, newPath);
    result = CheckLastError("CAM", gkFuncRefGet, result);
  }
  else
  {
    if( C2xIsTokenAvailable(packetHandle, "CAM", newPath) )
    {
      C2xRemoveToken(packetHandle, "CAM", newPath);
    }
  }

  snprintf(newPath, elcount(newPath), "%s.%s", oldPath, "emergencyPriority");
  if(value.emergencyPriority.isValidFlag==1)
  {
      for(j=0; j<value.emergencyPriority.stringLength; j++)
      {
        if(value.emergencyPriority.string[j] == '0')
        {
          C2xSetTokenBitOfBitString(packetHandle, "CAM", newPath, j, 0);
        }
        else
        {
          C2xSetTokenBitOfBitString(packetHandle, "CAM", newPath, j, 1);
        }
        result = CheckLastError("CAM", gkFuncRefGet, result);
      }
  }
  else
  {
    if( C2xIsTokenAvailable(packetHandle, "CAM", newPath) )
    {
      C2xRemoveToken(packetHandle, "CAM", newPath);
    }
  }

  return result;
}

int GetCAMSafetyCarContainerParams(LONG packetHandle, struct CAMSafetyCarContainer value, char oldPath[])
{
  char newPath[300]; 
  int j; 
  int k;
  int result;

  result = 0;

  snprintf(newPath, elcount(newPath), "%s.%s", oldPath, "lightBarSirenInUse");
  value.lightBarSirenInUse.isValidFlag = 1;
  value.lightBarSirenInUse.stringLength = C2xGetTokenLengthBit(packetHandle, "CAM", newPath);
  if ((result = CheckLastError("CAM", gkFuncRefGet, result))==0)
  {
    if(value.lightBarSirenInUse.stringLength > 0)
    {
      for(j=0; j<value.lightBarSirenInUse.stringLength; j++)
      {
        if(C2xGetTokenBitOfBitString(packetHandle, "CAM", newPath, j) == 0)
        {
          value.lightBarSirenInUse.string[j] = '0';
        }
        else if(C2xGetTokenBitOfBitString(packetHandle, "CAM", newPath, j) == 1)
        {
          value.lightBarSirenInUse.string[j] = '1';
        }

        if(value.lightBarSirenInUse.stringLength == 1)
        {
          value.lightBarSirenInUse.string[1] = '0';
        }
        result = CheckLastError("CAM", gkFuncRefGet, result);
      }
    }
    else
    {
      for(k = value.lightBarSirenInUse.stringLength+1; k > -1; k--)
      {
        if(value.lightBarSirenInUse.string[k] == '1')
        {
          value.lightBarSirenInUse.string[k] = '0';
        }
      }
    }
  }

  snprintf(newPath, elcount(newPath), "%s.%s", oldPath, "incidentIndication");
  value.incidentIndication.isValidFlag = C2xIsTokenAvailable(packetHandle, "CAM", newPath);
  if(value.incidentIndication.isValidFlag==1)
  {
    GetCAMCauseCodeParams(packetHandle, value.incidentIndication, newPath);
    result = CheckLastError("CAM", gkFuncRefGet, result);
  }
  snprintf(newPath, elcount(newPath), "%s.%s", oldPath, "trafficRule");
  value.trafficRule.isValidFlag = C2xIsTokenAvailable(packetHandle, "CAM", newPath);
  if(value.trafficRule.isValidFlag==1)
  {
    value.trafficRule.value = C2xGetTokenInt(packetHandle, "CAM", newPath);
    result = CheckLastError("CAM", gkFuncRefGet, result);
  }
  snprintf(newPath, elcount(newPath), "%s.%s", oldPath, "speedLimit");
  value.speedLimit.isValidFlag = C2xIsTokenAvailable(packetHandle, "CAM", newPath);
  if(value.speedLimit.isValidFlag==1)
  {
    value.speedLimit.value = C2xGetTokenInt(packetHandle, "CAM", newPath);
    result = CheckLastError("CAM", gkFuncRefGet, result);
  }
  return result;
}

int SetCAMSafetyCarContainerParams(LONG packetHandle, struct CAMSafetyCarContainer value, char oldPath[])
{
  char newPath[300]; 
  int j;
  int result;

  result = 0;

  snprintf(newPath, elcount(newPath), "%s.%s", oldPath, "lightBarSirenInUse");
    for(j=0; j<value.lightBarSirenInUse.stringLength; j++)
    {
      if(value.lightBarSirenInUse.string[j] == '0')
      {
        C2xSetTokenBitOfBitString(packetHandle, "CAM", newPath, j, 0);
      }
      else
      {
        C2xSetTokenBitOfBitString(packetHandle, "CAM", newPath, j, 1);
      }
      result = CheckLastError("CAM", gkFuncRefGet, result);
    }

  snprintf(newPath, elcount(newPath), "%s.%s", oldPath, "incidentIndication");
  if(value.incidentIndication.isValidFlag==1)
  {
    SetCAMCauseCodeParams(packetHandle, value.incidentIndication, newPath);
    result = CheckLastError("CAM", gkFuncRefGet, result);
  }
  else
  {
    if( C2xIsTokenAvailable(packetHandle, "CAM", newPath) )
    {
      C2xRemoveToken(packetHandle, "CAM", newPath);
    }
  }

  snprintf(newPath, elcount(newPath), "%s.%s", oldPath, "trafficRule");
  if(value.trafficRule.isValidFlag==1)
  {
    C2xSetTokenInt(packetHandle, "CAM", newPath, value.trafficRule.value);
    result = CheckLastError("CAM", gkFuncRefGet, result);
  }
  else
  {
    if( C2xIsTokenAvailable(packetHandle, "CAM", newPath) )
    {
      C2xRemoveToken(packetHandle, "CAM", newPath);
    }
  }

  snprintf(newPath, elcount(newPath), "%s.%s", oldPath, "speedLimit");
  if(value.speedLimit.isValidFlag==1)
  {
    C2xSetTokenInt(packetHandle, "CAM", newPath, value.speedLimit.value);
    result = CheckLastError("CAM", gkFuncRefGet, result);
  }
  else
  {
    if( C2xIsTokenAvailable(packetHandle, "CAM", newPath) )
    {
      C2xRemoveToken(packetHandle, "CAM", newPath);
    }
  }

  return result;
}

int GetCAMSpecialVehicleContainerParams(LONG packetHandle, struct CAMSpecialVehicleContainer value, char oldPath[])
{
  char newPath[300];
  int result;

  result = 0;

  value.choice = C2xGetTokenInt(packetHandle, "CAM", oldPath);

  switch(value.choice)
  {
    case 0:
    {
      snprintf(newPath, elcount(newPath), "%s.%s", oldPath, "publicTransportContainer");
      GetCAMPublicTransportContainerParams(packetHandle, value.publicTransportContainer, newPath);
      result = CheckLastError("CAM", gkFuncRefGet, result);
    }
    break;
    case 1:
    {
      snprintf(newPath, elcount(newPath), "%s.%s", oldPath, "specialTransportContainer");
      GetCAMSpecialTransportContainerParams(packetHandle, value.specialTransportContainer, newPath);
      result = CheckLastError("CAM", gkFuncRefGet, result);
    }
    break;
    case 2:
    {
      snprintf(newPath, elcount(newPath), "%s.%s", oldPath, "dangerousGoodsContainer");
      GetCAMDangerousGoodsContainerParams(packetHandle, value.dangerousGoodsContainer, newPath);
      result = CheckLastError("CAM", gkFuncRefGet, result);
    }
    break;
    case 3:
    {
      snprintf(newPath, elcount(newPath), "%s.%s", oldPath, "roadWorksContainerBasic");
      GetCAMRoadWorksContainerBasicParams(packetHandle, value.roadWorksContainerBasic, newPath);
      result = CheckLastError("CAM", gkFuncRefGet, result);
    }
    break;
    case 4:
    {
      snprintf(newPath, elcount(newPath), "%s.%s", oldPath, "rescueContainer");
      GetCAMRescueContainerParams(packetHandle, value.rescueContainer, newPath);
      result = CheckLastError("CAM", gkFuncRefGet, result);
    }
    break;
    case 5:
    {
      snprintf(newPath, elcount(newPath), "%s.%s", oldPath, "emergencyContainer");
      GetCAMEmergencyContainerParams(packetHandle, value.emergencyContainer, newPath);
      result = CheckLastError("CAM", gkFuncRefGet, result);
    }
    break;
    case 6:
    {
      snprintf(newPath, elcount(newPath), "%s.%s", oldPath, "safetyCarContainer");
      GetCAMSafetyCarContainerParams(packetHandle, value.safetyCarContainer, newPath);
      result = CheckLastError("CAM", gkFuncRefGet, result);
    }
    break;
  }
  return result;
}

int SetCAMSpecialVehicleContainerParams(LONG packetHandle, struct CAMSpecialVehicleContainer value, char oldPath[])
{
  char newPath[300];
  int result;

  result = 0;

  switch(value.choice)
  {
    case 0:
    {
      snprintf(newPath, elcount(newPath), "%s.%s", oldPath, "publicTransportContainer");
      SetCAMPublicTransportContainerParams(packetHandle, value.publicTransportContainer, newPath);
      result = CheckLastError("CAM", gkFuncRefGet, result);
    }
    break;
    case 1:
    {
      snprintf(newPath, elcount(newPath), "%s.%s", oldPath, "specialTransportContainer");
      SetCAMSpecialTransportContainerParams(packetHandle, value.specialTransportContainer, newPath);
      result = CheckLastError("CAM", gkFuncRefGet, result);
    }
    break;
    case 2:
    {
      snprintf(newPath, elcount(newPath), "%s.%s", oldPath, "dangerousGoodsContainer");
      SetCAMDangerousGoodsContainerParams(packetHandle, value.dangerousGoodsContainer, newPath);
      result = CheckLastError("CAM", gkFuncRefGet, result);
    }
    break;
    case 3:
    {
      snprintf(newPath, elcount(newPath), "%s.%s", oldPath, "roadWorksContainerBasic");
      SetCAMRoadWorksContainerBasicParams(packetHandle, value.roadWorksContainerBasic, newPath);
      result = CheckLastError("CAM", gkFuncRefGet, result);
    }
    break;
    case 4:
    {
      snprintf(newPath, elcount(newPath), "%s.%s", oldPath, "rescueContainer");
      SetCAMRescueContainerParams(packetHandle, value.rescueContainer, newPath);
      result = CheckLastError("CAM", gkFuncRefGet, result);
    }
    break;
    case 5:
    {
      snprintf(newPath, elcount(newPath), "%s.%s", oldPath, "emergencyContainer");
      SetCAMEmergencyContainerParams(packetHandle, value.emergencyContainer, newPath);
      result = CheckLastError("CAM", gkFuncRefGet, result);
    }
    break;
    case 6:
    {
      snprintf(newPath, elcount(newPath), "%s.%s", oldPath, "safetyCarContainer");
      SetCAMSafetyCarContainerParams(packetHandle, value.safetyCarContainer, newPath);
      result = CheckLastError("CAM", gkFuncRefGet, result);
    }
    break;
  }
  return result;
}

int GetCAMCamParametersParams(LONG packetHandle, struct CAMCamParameters value, char oldPath[])
{
  char newPath[300];
  int result;

  result = 0;

  snprintf(newPath, elcount(newPath), "%s.%s", oldPath, "basicContainer");
  GetCAMBasicContainerParams(packetHandle, value.basicContainer, newPath);
  result = CheckLastError("CAM", gkFuncRefGet, result);

  snprintf(newPath, elcount(newPath), "%s.%s", oldPath, "highFrequencyContainer");
  GetCAMHighFrequencyContainerParams(packetHandle, value.highFrequencyContainer, newPath);
  result = CheckLastError("CAM", gkFuncRefGet, result);

  snprintf(newPath, elcount(newPath), "%s.%s", oldPath, "lowFrequencyContainer");
  value.lowFrequencyContainer.isValidFlag = C2xIsTokenAvailable(packetHandle, "CAM", newPath);
  if(value.lowFrequencyContainer.isValidFlag==1)
  {
    GetCAMLowFrequencyContainerParams(packetHandle, value.lowFrequencyContainer, newPath);
    result = CheckLastError("CAM", gkFuncRefGet, result);
  }
  snprintf(newPath, elcount(newPath), "%s.%s", oldPath, "specialVehicleContainer");
  value.specialVehicleContainer.isValidFlag = C2xIsTokenAvailable(packetHandle, "CAM", newPath);
  if(value.specialVehicleContainer.isValidFlag==1)
  {
    GetCAMSpecialVehicleContainerParams(packetHandle, value.specialVehicleContainer, newPath);
    result = CheckLastError("CAM", gkFuncRefGet, result);
  }
  return result;
}

int SetCAMCamParametersParams(LONG packetHandle, struct CAMCamParameters value, char oldPath[])
{
  char newPath[300];
  int result;

  result = 0;

  snprintf(newPath, elcount(newPath), "%s.%s", oldPath, "basicContainer");
  SetCAMBasicContainerParams(packetHandle, value.basicContainer, newPath);
  result = CheckLastError("CAM", gkFuncRefGet, result);

  snprintf(newPath, elcount(newPath), "%s.%s", oldPath, "highFrequencyContainer");
  SetCAMHighFrequencyContainerParams(packetHandle, value.highFrequencyContainer, newPath);
  result = CheckLastError("CAM", gkFuncRefGet, result);

  snprintf(newPath, elcount(newPath), "%s.%s", oldPath, "lowFrequencyContainer");
  if(value.lowFrequencyContainer.isValidFlag==1)
  {
    SetCAMLowFrequencyContainerParams(packetHandle, value.lowFrequencyContainer, newPath);
    result = CheckLastError("CAM", gkFuncRefGet, result);
  }
  else
  {
    if( C2xIsTokenAvailable(packetHandle, "CAM", newPath) )
    {
      C2xRemoveToken(packetHandle, "CAM", newPath);
    }
  }

  snprintf(newPath, elcount(newPath), "%s.%s", oldPath, "specialVehicleContainer");
  if(value.specialVehicleContainer.isValidFlag==1)
  {
    SetCAMSpecialVehicleContainerParams(packetHandle, value.specialVehicleContainer, newPath);
    result = CheckLastError("CAM", gkFuncRefGet, result);
  }
  else
  {
    if( C2xIsTokenAvailable(packetHandle, "CAM", newPath) )
    {
      C2xRemoveToken(packetHandle, "CAM", newPath);
    }
  }

  return result;
}

int GetCAMCoopAwarenessParams(LONG packetHandle, struct CAMCoopAwareness value, char oldPath[])
{
  char newPath[300];
  int result;

  result = 0;

  snprintf(newPath, elcount(newPath), "%s.%s", oldPath, "generationDeltaTime");
  value.generationDeltaTime = C2xGetTokenInt(packetHandle, "CAM", newPath);
  result = CheckLastError("CAM", gkFuncRefGet, result);

  snprintf(newPath, elcount(newPath), "%s.%s", oldPath, "camParameters");
  GetCAMCamParametersParams(packetHandle, value.camParameters, newPath);
  result = CheckLastError("CAM", gkFuncRefGet, result);

  return result;
}

int SetCAMCoopAwarenessParams(LONG packetHandle, struct CAMCoopAwareness value, char oldPath[])
{
  char newPath[300];
  int result;

  result = 0;

  snprintf(newPath, elcount(newPath), "%s.%s", oldPath, "generationDeltaTime");
  C2xSetTokenInt(packetHandle, "CAM", newPath, value.generationDeltaTime);
  result = CheckLastError("CAM", gkFuncRefGet, result);

  snprintf(newPath, elcount(newPath), "%s.%s", oldPath, "camParameters");
  SetCAMCamParametersParams(packetHandle, value.camParameters, newPath);
  result = CheckLastError("CAM", gkFuncRefGet, result);

  return result;
}

int API_GetCAMParams(LONG packetHandle, struct CAM value)
{
  int result;
  result = 0;

  value.header.isValidFlag = 1;
  GetCAMItsPduHeaderParams(packetHandle, value.header, "header");
  result = CheckLastError("CAM", gkFuncRefGet, result);

  value.cam.isValidFlag = 1;
  GetCAMCoopAwarenessParams(packetHandle, value.cam, "cam");
  result = CheckLastError("CAM", gkFuncRefGet, result);

  return result;
}

int API_SetCAMParams(LONG packetHandle, struct CAM value)
{
  int result;
  result = 0;

  SetCAMItsPduHeaderParams(packetHandle, value.header, "header");
  result = CheckLastError("CAM", gkFuncRefGet, result);

  SetCAMCoopAwarenessParams(packetHandle, value.cam, "cam");
  result = CheckLastError("CAM", gkFuncRefGet, result);

  return result;
}

