/*@!Encoding:1252*/
includes
{
  #include "Includes\IVIM_Visualizer.cin"
}

variables
{
  struct IVIM ivim;
}

on start
{
  enum CallbackType {OnRx, PreTx};
  C2xRegisterCallback(OnRx, "OnRxIVIM", "IVIM");
}

void OnRxIVIM(long channel, long dir, long radioChannel, long signalStrength, long signalQuality, long packet)
{
  API_GetIVIMParams(packet, ivim);
  API_VisualizeIVIM(ivim);
}