/*@!Encoding:1252*/
includes
{
  #pragma library("..\..\CAPLdll\Release\capldll.dll")
}

void CreatePictogram(char outputPath[], long pictoServiceCategory, long pictoNature, long pictoSerial, long pictoAttributesCount, struct PictogramAttributes pictoAttributes[])
{
  int  attributeNr;
  long pictoSpeed;
  
  for (attributeNr = 0; attributeNr < pictoAttributesCount; attributeNr++)
  {
    pictoSpeed = pictoAttributes[attributeNr].speed;
  }
  
  if (pictoServiceCategory == 12 && pictoNature == 5 && pictoSerial == 44)        // Regulatory sign (12): Overtaking goods vehicles prohibited (544)
  {
    CreatePictogram12544(outputPath);
  }
  else if (pictoServiceCategory == 12 && pictoNature == 5 && pictoSerial == 57)   // Regulatory sign (12): Maximum speed limited to the figure indicated (557)
  {
    CreatePictogram12557(outputPath, pictoSpeed);
  }
  else
  {
    CreateUnknownPictogram(outputPath, pictoServiceCategory, pictoNature, pictoSerial);
  }
}

void CombineImages(char output[], char outer[], char inner[], float innerScale, int innerOffsetX, int innerOffsetY)
{
  if (!DLLFileExists(output))
  {
    DLLCombineImages(output, outer, inner, innerScale, innerOffsetX, innerOffsetY);
  }
}

void CombineImageAndText(char output[], char image[], char text[], float textSize, int textOffsetX, int textOffsetY)
{
  if (!DLLFileExists(output))
  {
    DLLCombineImageAndText(output, image, text, textSize, textOffsetX, textOffsetY);
  }
}

void CreateUnknownPictogram(char output[], long pictoServiceCategory, long pictoNature, long pictoSerial)
{  
  char image[1024], text[1024];
  
  if (DLLGetRoadSignDescription(text, pictoServiceCategory * 1000 + pictoNature * 100 + pictoSerial) == -1)
  {
    // No description available, display the pictogram code
    snprintf(output, elcount(output), "Images\\Generated\\%d%d%d_noinfo.png", pictoServiceCategory, pictoNature, pictoSerial);
    snprintf(image,  elcount(image),  "Images\\Outer\\Rectangle.png");
  }
  else
  {
    // A description is available, use a bigger sign to display it
    snprintf(output, elcount(output), "Images\\Generated\\%d%d%d_info.png", pictoServiceCategory, pictoNature, pictoSerial);
    snprintf(image,  elcount(image),  "Images\\Outer\\Square.png");
  }
  
  CombineImageAndText(output, image, text, 24.0, 0, 0);
}

// Regulatory sign (12): Overtaking goods vehicles prohibited (544)
void CreatePictogram12544(char output[])
{  
  char outer[1024], inner[1024];
  
  snprintf(output, elcount(output), "Images\\Generated\\12544.png");
  snprintf(outer,  elcount(outer),  "Images\\Outer\\CircleRed.png");
  snprintf(inner,  elcount(inner),  "Images\\Inner\\NoTruckPassingByCar.png");
  
  CombineImages(output, outer, inner, 1.0, 0, 0);
}

// Regulatory sign (12): Maximum speed limited to the figure indicated (557)
void CreatePictogram12557(char output[], long speed)
{  
  char outer[1024], inner[1024];
  
  snprintf(output, elcount(output), "Images\\Generated\\12557_%d.png", speed);
  snprintf(outer,  elcount(outer),  "Images\\Outer\\CircleRed.png");
  snprintf(inner,  elcount(inner),  "Images\\Inner\\%d.png", speed);
  
  CombineImages(output, outer, inner, 1.0, 0, 0);
}