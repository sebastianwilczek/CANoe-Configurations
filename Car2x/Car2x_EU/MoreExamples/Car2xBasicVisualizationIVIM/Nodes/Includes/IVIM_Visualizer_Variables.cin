/*@!Encoding:1252*/
includes
{
  #include "..\..\DataSources_Templates\ASNV_Template_BaseDatatypes.cin"
  #include "..\..\DataSources_Templates\ASNV_Template_IVIM.cin"
}

variables
{
  /////////////////////
  /////// Enums ///////
  /////////////////////
  
  enum gEnumFigures {Square = 1, Rectangle = 2, Ellipse = 3, Cross = 4, Triangle = 5, Line = 6, Bitmap = 7, Text = 8};
  
  /////////////////////
  ///// Constants /////
  /////////////////////
  
  const long  gMaxDeltaPositions      =  32;
  const long  gMaxAbsolutePositions   =  32;
  const long  gMaxPartNr              =  16;
  const long  gMaxPictogramAttributes =  8;
  const long  gMaxDetectionZones      =  8;
  const long  gMaxRelevanceZones      =  8;
  const long  gMaxRoadSigns           =  4;
  const long  gMaxGivNr               =  16;
  const long  gMaxIviNr               =  50;
  
  const float gFactorGeoPos           =  10000000.0;
  
  const float gRefPosSize             =  60.0;
  
  const float gIviTextSize            =  20.0;
  const float gIviTextOffsetLat       =  0.0;
  const float gIviTextOffsetLon       = -0.0005;
  
  const float gPictogramSize          =  60.0;
  const float gPictogramOffsetLat     =  0.0;
  const float gPictogramOffsetLon     =  0.0005;
  const float gPictogramGapLat        =  0.0;
  const float gPictogramGapLon        =  0.00025;
  
  const float gDetectionZoneOffsetLat = -0.00001;
  const float gDetectionZoneOffsetLon = -0.00001;  
  const float gRelevanceZoneOffsetLat =  0.00001;
  const float gRelevanceZoneOffsetLon =  0.00001;
  const float gZonePenWidth           =  4.0;
  
  /////////////////////
  ////// Structs //////
  /////////////////////
  
  struct Position
  {
    long   lat;
    long   lon;
  };
  
  struct Parts
  {
    long   zoneId;
    
    long   deltaPositionsCount;
    struct Position deltaPositions[gMaxDeltaPositions];
    
    long   absolutePositionsCount;
    struct Position absolutePositions[gMaxAbsolutePositions];
  };
  
  struct GLC
  {
    long   refLat;
    long   refLon;
    
    long   partsCount;
    struct Parts parts[gMaxPartNr];
  };
  
  struct PictogramAttributes
  {
    long   speed;
  };

  struct RoadSign
  {
    long   pictogramServiceCategory;
    long   pictogramNature;
    long   pictogramSerial;
    
    long   pictogramAttributesCount;
    struct PictogramAttributes pictogramAttributes[gMaxPictogramAttributes];
  };

  struct GIV
  {
    long   detectionZoneIdsCount;
    int    detectionZoneIds[gMaxDetectionZones];
    
    long   relevanceZoneIdsCount;
    int    relevanceZoneIds[gMaxRelevanceZones];
    
    long   roadSignsCount;
    struct RoadSign roadSigns[gMaxRoadSigns];
  };

  struct DrawHandles
  {
    long   refPos;
    long   textId;
    long   pictograms[gMaxRoadSigns];
    long   deltaZones[gMaxDeltaPositions];
    long   absoluteZones[gMaxAbsolutePositions];
  };
  
  struct IVI_Params
  {
    long   id;
    
    struct GLC glc;
    
    long   givCount;
    struct GIV giv[gMaxGivNr];

    struct DrawHandles drawHandles;    
  };
  
  /////////////////////
  ////// Members //////
  /////////////////////
  
  long   gIviCount = 0;
  struct IVI_Params iviParams[gMaxIviNr];
}