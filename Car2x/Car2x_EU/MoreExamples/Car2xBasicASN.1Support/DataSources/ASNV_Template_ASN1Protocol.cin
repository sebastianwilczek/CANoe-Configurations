/*@!Encoding:1252*/
/*
//  (c) Vector Informatik GmbH. All rights reserved.
//
//  This file contains definitions of structs and methods that may be used
//  to set and get the values of an ASN.1 defined packet's payload.
//
//  //This example demonstrates how to set a packet's payload:
//  LONG packetHandle;
//  struct ASN1Protocol payload;
//  //you need to set the values of the variable "payload" yourself
//  packetHandle = API_InitASN1ProtocolPacket();
//  if (packetHandle!=0) {
//    if (API_SetASN1ProtocolParams(packetHandle, payload)==0) {
//      if (C2xCompletePacket(packetHandle)==0) {
//        C2xOutputPacket(packetHandle);
//      }
//    }
//  }
//                                                                             */
includes
{
  #include "ASNV_Template_BaseDatatypes.cin"  // If warning "Duplicate #include, ignoring this include" appears, please remove the ASNV_Template_BaseDatatypes.cin include from your other *.cin files in the project.
}
variables
{
    struct ASN1Protocol_ASN1Protocol_bitStringField {
        INT isValidFlag;   // necessary if this struct is used as an optional field of a SEQUENCE
        CHAR string[256];
        INT  stringLength;
    };
    
    struct ASN1Protocol_SeperatlyDefinedChoice_ia5StringChoice {
        INT isValidFlag;   // necessary if this struct is used as an optional field of a SEQUENCE
        CHAR string[256];
        INT  stringLength;
    };
    
    struct ASN1ProtocolSeperatlyDefinedChoice {
        INT isValidFlag;   // necessary if this struct is used as an optional field of a SEQUENCE
        INT choice;
        BYTE numberChoice;  // INTEGER, .., namedNumber(123);
        struct ASN1Protocol_SeperatlyDefinedChoice_ia5StringChoice ia5StringChoice;  // IA5STRING;
    };
    
    struct ASN1Protocol_ASN1Protocol_arrayField {
        INT isValidFlag;   // necessary if this struct is used as an optional field of a SEQUENCE
        INT length;
        struct ASN1ProtocolSeperatlyDefinedChoice arrayValue[10];  // CHOICE;
    };
    
    struct ASN1Protocol_ASN1Protocol_sequenceField {
        INT isValidFlag;   // necessary if this struct is used as an optional field of a SEQUENCE
        INT booleanField;  // BOOLEAN;
        struct ASN1Protocol_ASN1Protocol_bitStringField bitStringField;  // BITSTRING;
        INT enumeratedField;  // ENUMERATED, low(0), middle(1), high(2);
        struct ASN1Protocol_ASN1Protocol_arrayField arrayField;  // SEQUENCEOF;
        struct OPT_BYTE_ASN intFieldOptional;  // INTEGER, OPTIONAL, 0..255;
        BYTE intFieldPhys;  // INTEGER, 0..255;
    };
    
    struct ASN1Protocol_Blob_Definition {
        INT isValidFlag;   // necessary if this struct is used as an optional field of a SEQUENCE
        BYTE integerValue;  // INTEGER, 0..255;
        BYTE integerValue2;  // INTEGER, 0..255;
    };
    
    struct ASN1Protocol_ASN1Protocol_octetString {
        INT isValidFlag;   // necessary if this struct is used as an optional field of a SEQUENCE
        CHAR string[2];
        INT  stringLength;
        struct ASN1Protocol_Blob_Definition _Blob_Definition;  // SEQUENCE;
    };
    
    struct ASN1Protocol {
        INT isValidFlag;   // necessary if this struct is used as an optional field of a SEQUENCE
        BYTE messageCounter;  // INTEGER, 0..255;
        struct ASN1Protocol_ASN1Protocol_sequenceField sequenceField;  // SEQUENCE;
        struct ASN1Protocol_ASN1Protocol_octetString octetString;  // OCTETSTRING;
    };
    
}

/*
// init function to create a simple packet handle
*/ 
LONG API_InitASN1ProtocolPacket()
{
  return C2xInitPacket("ASN1Protocol"); 
}

/*
// init function to create a simple packet handle and
// initialize the struct with valid data
*/ 
LONG API_InitASN1ProtocolPacket(struct ASN1Protocol msgStruct)
{
  long pktHandle;

  pktHandle = API_InitASN1ProtocolPacket();

  if (pktHandle != 0)
  {
    // create valid message and application data
    if (C2xCompletePacket(pktHandle) == 0) 
    {
      API_GetASN1ProtocolParams(pktHandle, msgStruct);
    }
  }
  return pktHandle;
}

/*
// init function to create a packet with security layer and
// initialize the struct with valid data
*/ 
LONG API_InitASN1ProtocolPacket(struct ASN1Protocol msgStruct, char packetTypeDesignator[], char certificateName[])
{
  long pktHandle, certHdl;

  // initialize the packet
  pktHandle = C2xInitPacket("ASN1Protocol", packetTypeDesignator);

  if (pktHandle != 0)
  {
    certHdl = C2xSecCertificateGetHandle(certificateName);  // get the certificate handle for the cert with name "certificateName"
    if (certHdl != 0) 
    {
      C2xSecPacketSetSignerHandle(pktHandle, certHdl); // set the certHdl to the packet
    }

    // create valid message and application data
    if (C2xCompletePacket(pktHandle) == 0) 
    {
      // copy application data to the application structure
      API_GetASN1ProtocolParams(pktHandle, msgStruct);
    }
  }
  return pktHandle;
}
    

int GetASN1ProtocolSeperatlyDefinedChoiceParams(LONG packetHandle, struct ASN1ProtocolSeperatlyDefinedChoice value, char oldPath[])
{
  char newPath[300];
  int result;

  result = 0;

  value.choice = C2xGetTokenInt(packetHandle, "ASN1Protocol", oldPath);

  switch(value.choice)
  {
    case 0:
    {
      snprintf(newPath, elcount(newPath), "%s.%s", oldPath, "numberChoice");
      value.numberChoice = C2xGetTokenInt64(packetHandle, "ASN1Protocol", newPath);
      result = CheckLastError("ASN1Protocol", gkFuncRefGet, result);
    }
    break;
    case 1:
    {
      snprintf(newPath, elcount(newPath), "%s.%s", oldPath, "ia5StringChoice");
      value.ia5StringChoice.stringLength = C2xGetTokenData(packetHandle, "ASN1Protocol", newPath, elcount(value.ia5StringChoice.string), value.ia5StringChoice.string);
      result = CheckLastError("ASN1Protocol", gkFuncRefGet, result);
    }
    break;
  }
  return result;
}

int SetASN1ProtocolSeperatlyDefinedChoiceParams(LONG packetHandle, struct ASN1ProtocolSeperatlyDefinedChoice value, char oldPath[])
{
  char newPath[300];
  int result;

  result = 0;

  switch(value.choice)
  {
    case 0:
    {
      snprintf(newPath, elcount(newPath), "%s.%s", oldPath, "numberChoice");
      C2xSetTokenInt64(packetHandle, "ASN1Protocol", newPath, value.numberChoice);
      result = CheckLastError("ASN1Protocol", gkFuncRefGet, result);
    }
    break;
    case 1:
    {
      snprintf(newPath, elcount(newPath), "%s.%s", oldPath, "ia5StringChoice");
      C2xSetTokenData(packetHandle, "ASN1Protocol", newPath, value.ia5StringChoice.stringLength, value.ia5StringChoice.string);
      result = CheckLastError("ASN1Protocol", gkFuncRefGet, result);
    }
    break;
  }
  return result;
}

int GetASN1Protocol_ASN1Protocol_arrayFieldParams(LONG packetHandle, struct ASN1Protocol_ASN1Protocol_arrayField value, char oldPath[])
{
  char newPath[300]; 
  int i;
  int result;

  result = 0;

  value.length = C2xGetTokenInt(packetHandle, "ASN1Protocol", oldPath);
  if((result = CheckLastError("ASN1Protocol", gkFuncRefGet, result))==0)
  {
    for(i=0; i<value.length; i++)
    {
      snprintf(newPath, elcount(newPath), "%s[%d]", oldPath, i);
      GetASN1ProtocolSeperatlyDefinedChoiceParams(packetHandle, value.arrayValue[i], newPath);
      result = CheckLastError("ASN1Protocol", gkFuncRefGet, result);
    }
  }
  return result;
}

int SetASN1Protocol_ASN1Protocol_arrayFieldParams(LONG packetHandle, struct ASN1Protocol_ASN1Protocol_arrayField value, char oldPath[])
{
  char newPath[300]; 
  int i;
  int result;

  result = 0;

  C2xRemoveToken(packetHandle, "ASN1Protocol", oldPath);
  for(i=0; i<value.length; i++)
  {
    snprintf(newPath, elcount(newPath), "%s[%d]", oldPath, i);
    SetASN1ProtocolSeperatlyDefinedChoiceParams(packetHandle, value.arrayValue[i], newPath);
    result = CheckLastError("ASN1Protocol", gkFuncRefGet, result);
  }
  return result;
}

int GetASN1Protocol_ASN1Protocol_sequenceFieldParams(LONG packetHandle, struct ASN1Protocol_ASN1Protocol_sequenceField value, char oldPath[])
{
  char newPath[300]; 
  int j; 
  int k;
  int result;

  result = 0;

  snprintf(newPath, elcount(newPath), "%s.%s", oldPath, "booleanField");
  value.booleanField = C2xGetTokenInt64(packetHandle, "ASN1Protocol", newPath);
  result = CheckLastError("ASN1Protocol", gkFuncRefGet, result);

  snprintf(newPath, elcount(newPath), "%s.%s", oldPath, "bitStringField");
  value.bitStringField.isValidFlag = 1;
  value.bitStringField.stringLength = C2xGetTokenLengthBit(packetHandle, "ASN1Protocol", newPath);
  if ((result = CheckLastError("ASN1Protocol", gkFuncRefGet, result))==0)
  {
    if(value.bitStringField.stringLength > 0)
    {
      for(j=0; j<value.bitStringField.stringLength; j++)
      {
        if(C2xGetTokenBitOfBitString(packetHandle, "ASN1Protocol", newPath, j) == 0)
        {
          value.bitStringField.string[j] = '0';
        }
        else if(C2xGetTokenBitOfBitString(packetHandle, "ASN1Protocol", newPath, j) == 1)
        {
          value.bitStringField.string[j] = '1';
        }

        if(value.bitStringField.stringLength == 1)
        {
          value.bitStringField.string[1] = '0';
        }
        result = CheckLastError("ASN1Protocol", gkFuncRefGet, result);
      }
    }
    else
    {
      for(k = value.bitStringField.stringLength+1; k > -1; k--)
      {
        if(value.bitStringField.string[k] == '1')
        {
          value.bitStringField.string[k] = '0';
        }
      }
    }
  }

  snprintf(newPath, elcount(newPath), "%s.%s", oldPath, "enumeratedField");
  value.enumeratedField = C2xGetTokenInt(packetHandle, "ASN1Protocol", newPath);
  result = CheckLastError("ASN1Protocol", gkFuncRefGet, result);

  snprintf(newPath, elcount(newPath), "%s.%s", oldPath, "arrayField");
  GetASN1Protocol_ASN1Protocol_arrayFieldParams(packetHandle, value.arrayField, newPath);
  result = CheckLastError("ASN1Protocol", gkFuncRefGet, result);

  snprintf(newPath, elcount(newPath), "%s.%s", oldPath, "intFieldOptional");
  value.intFieldOptional.isValidFlag = C2xIsTokenAvailable(packetHandle, "ASN1Protocol", newPath);
  if(value.intFieldOptional.isValidFlag==1)
  {
    value.intFieldOptional.value = C2xGetTokenInt(packetHandle, "ASN1Protocol", newPath);
    result = CheckLastError("ASN1Protocol", gkFuncRefGet, result);
  }
  snprintf(newPath, elcount(newPath), "%s.%s", oldPath, "intFieldPhys");
  value.intFieldPhys = C2xGetTokenInt(packetHandle, "ASN1Protocol", newPath);
  result = CheckLastError("ASN1Protocol", gkFuncRefGet, result);

  return result;
}

int SetASN1Protocol_ASN1Protocol_sequenceFieldParams(LONG packetHandle, struct ASN1Protocol_ASN1Protocol_sequenceField value, char oldPath[])
{
  char newPath[300]; 
  int j;
  int result;

  result = 0;

  snprintf(newPath, elcount(newPath), "%s.%s", oldPath, "booleanField");
  C2xSetTokenInt64(packetHandle, "ASN1Protocol", newPath, value.booleanField);
  result = CheckLastError("ASN1Protocol", gkFuncRefGet, result);

  snprintf(newPath, elcount(newPath), "%s.%s", oldPath, "bitStringField");
    for(j=0; j<value.bitStringField.stringLength; j++)
    {
      if(value.bitStringField.string[j] == '0')
      {
        C2xSetTokenBitOfBitString(packetHandle, "ASN1Protocol", newPath, j, 0);
      }
      else
      {
        C2xSetTokenBitOfBitString(packetHandle, "ASN1Protocol", newPath, j, 1);
      }
      result = CheckLastError("ASN1Protocol", gkFuncRefGet, result);
    }

  snprintf(newPath, elcount(newPath), "%s.%s", oldPath, "enumeratedField");
  C2xSetTokenInt(packetHandle, "ASN1Protocol", newPath, value.enumeratedField);
  result = CheckLastError("ASN1Protocol", gkFuncRefGet, result);

  snprintf(newPath, elcount(newPath), "%s.%s", oldPath, "arrayField");
  SetASN1Protocol_ASN1Protocol_arrayFieldParams(packetHandle, value.arrayField, newPath);
  result = CheckLastError("ASN1Protocol", gkFuncRefGet, result);

  snprintf(newPath, elcount(newPath), "%s.%s", oldPath, "intFieldOptional");
  if(value.intFieldOptional.isValidFlag==1)
  {
    C2xSetTokenInt(packetHandle, "ASN1Protocol", newPath, value.intFieldOptional.value);
    result = CheckLastError("ASN1Protocol", gkFuncRefGet, result);
  }
  else
  {
    if( C2xIsTokenAvailable(packetHandle, "ASN1Protocol", newPath) )
    {
      C2xRemoveToken(packetHandle, "ASN1Protocol", newPath);
    }
  }

  snprintf(newPath, elcount(newPath), "%s.%s", oldPath, "intFieldPhys");
  C2xSetTokenInt(packetHandle, "ASN1Protocol", newPath, value.intFieldPhys);
  result = CheckLastError("ASN1Protocol", gkFuncRefGet, result);

  return result;
}

int GetASN1Protocol_Blob_DefinitionParams(LONG packetHandle, struct ASN1Protocol_Blob_Definition value, char oldPath[])
{
  char newPath[300];
  int result;

  result = 0;

  snprintf(newPath, elcount(newPath), "%s.%s", oldPath, "integerValue");
  value.integerValue = C2xGetTokenInt(packetHandle, "ASN1Protocol", newPath);
  result = CheckLastError("ASN1Protocol", gkFuncRefGet, result);

  snprintf(newPath, elcount(newPath), "%s.%s", oldPath, "integerValue2");
  value.integerValue2 = C2xGetTokenInt(packetHandle, "ASN1Protocol", newPath);
  result = CheckLastError("ASN1Protocol", gkFuncRefGet, result);

  return result;
}

int SetASN1Protocol_Blob_DefinitionParams(LONG packetHandle, struct ASN1Protocol_Blob_Definition value, char oldPath[])
{
  char newPath[300];
  int result;

  result = 0;

  snprintf(newPath, elcount(newPath), "%s.%s", oldPath, "integerValue");
  C2xSetTokenInt(packetHandle, "ASN1Protocol", newPath, value.integerValue);
  result = CheckLastError("ASN1Protocol", gkFuncRefGet, result);

  snprintf(newPath, elcount(newPath), "%s.%s", oldPath, "integerValue2");
  C2xSetTokenInt(packetHandle, "ASN1Protocol", newPath, value.integerValue2);
  result = CheckLastError("ASN1Protocol", gkFuncRefGet, result);

  return result;
}

int GetASN1Protocol_ASN1Protocol_octetStringParams(LONG packetHandle, struct ASN1Protocol_ASN1Protocol_octetString value, char oldPath[])
{
  char newPath[300];
  int result;

  result = 0;

  snprintf(newPath, elcount(newPath), "%s.%s", oldPath, "_Blob_Definition");
  GetASN1Protocol_Blob_DefinitionParams(packetHandle, value._Blob_Definition, newPath);
  result = CheckLastError("ASN1Protocol", gkFuncRefGet, result);

  return result;
}

int SetASN1Protocol_ASN1Protocol_octetStringParams(LONG packetHandle, struct ASN1Protocol_ASN1Protocol_octetString value, char oldPath[])
{
  char newPath[300];
  int result;

  result = 0;

  snprintf(newPath, elcount(newPath), "%s.%s", oldPath, "_Blob_Definition");
  SetASN1Protocol_Blob_DefinitionParams(packetHandle, value._Blob_Definition, newPath);
  result = CheckLastError("ASN1Protocol", gkFuncRefGet, result);

  return result;
}

int API_GetASN1ProtocolParams(LONG packetHandle, struct ASN1Protocol value)
{
  int result;
  result = 0;

  value.messageCounter = C2xGetTokenInt(packetHandle, "ASN1Protocol", "messageCounter");
  result = CheckLastError("ASN1Protocol", gkFuncRefGet, result);

  value.sequenceField.isValidFlag = 1;
  GetASN1Protocol_ASN1Protocol_sequenceFieldParams(packetHandle, value.sequenceField, "sequenceField");
  result = CheckLastError("ASN1Protocol", gkFuncRefGet, result);

  value.octetString.isValidFlag = 1;
  GetASN1Protocol_ASN1Protocol_octetStringParams(packetHandle, value.octetString, "octetString");
  result = CheckLastError("ASN1Protocol", gkFuncRefGet, result);

  return result;
}

int API_SetASN1ProtocolParams(LONG packetHandle, struct ASN1Protocol value)
{
  int result;
  result = 0;

  C2xSetTokenInt(packetHandle, "ASN1Protocol", "messageCounter", value.messageCounter);
  result = CheckLastError("ASN1Protocol", gkFuncRefGet, result);

  SetASN1Protocol_ASN1Protocol_sequenceFieldParams(packetHandle, value.sequenceField, "sequenceField");
  result = CheckLastError("ASN1Protocol", gkFuncRefGet, result);

  SetASN1Protocol_ASN1Protocol_octetStringParams(packetHandle, value.octetString, "octetString");
  result = CheckLastError("ASN1Protocol", gkFuncRefGet, result);

  return result;
}

