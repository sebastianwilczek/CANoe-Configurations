/*@!Encoding:1252*/
includes
{
  #include "..\DataSources_Templates\ASNV_Template_BaseDatatypes.cin"
  #include "..\DataSources_Templates\ASNV_Template_CAM.cin"
  #include "..\DataSources_Templates\ASNV_Template_DENM.cin"
  #include "..\DataSources_Templates\ASNV_Template_MAP.cin"
  #include "..\DataSources_Templates\ASNV_Template_SPAT.cin"
  #include "..\DataSources_Templates\ASNV_Template_IVIM.cin"
}

// On start, callback functions for the most common application messages CAM and DENM are registered.
// It is possible to do the same with the other application messages if needed.
on start
{
  enum CallbackType { OnRx, PreTx };
  
  C2xRegisterCallback(OnRx,  "OnRxCAM",    "CAM");
  C2xRegisterCallback(PreTx, "OnPreTxCAM", "CAM");
  
  C2xRegisterCallback(OnRx,  "OnRxDENM",    "DENM");
  C2xRegisterCallback(PreTx, "OnPreTxDENM", "DENM");
}

// Callback function on receiving CAM messages
void OnRxCAM(long channel, long dir, long radioChannel, long signalStrength, long signalQuality, long packet)
{

}

// Callback function before sending CAM messages from IL
void OnPreTxCAM(LONG packet)
{

}

// Callback function on receiving DENM messages
void OnRxDENM(long channel, long dir, long radioChannel, long signalStrength, long signalQuality, long packet)
{

}

// Callback function before sending DENM messages from IL
void OnPreTxDENM(LONG packet)
{

}