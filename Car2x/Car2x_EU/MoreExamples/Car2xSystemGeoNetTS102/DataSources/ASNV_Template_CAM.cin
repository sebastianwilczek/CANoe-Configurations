/*
//  (c) Vector Informatik GmbH. All rights reserved.
//
//  This file contains definitions of structs and methods that may be used
//  to set and get the values of an ASN.1 defined packet's payload.
//
//  //This example demonstrates how to set a packet's payload:
//  LONG packetHandle;
//  struct CAM payload;
//  //you need to set the values of the variable "payload" yourself
//  packetHandle = API_InitCAMPacket();
//  if (packetHandle!=0) {
//    if (API_SetCAMParams(packetHandle, payload)==0) {
//      if (C2xCompletePacket(packetHandle)==0) {
//        C2xOutputPacket(packetHandle);
//      }
//    }
//  }
//                                                                             */
includes
{
  #include "ASNV_Template_BaseDatatypes.cin"
}
variables
{

  struct CAMItsPduHeader {
    INT isValidFlag;   //necessary if this struct is used as an optional field of a SEQUENCE
    LONG protocolVersion;   //INTEGER, 0...255, currentVersion(1)
    LONG messageID;   //INTEGER, 0...255, denm(1), cam(2), poi(3)
    INT64 stationID;   //INTEGER, 0...4294967295
  };

  struct CAMDirection {
    INT isValidFlag;   //necessary if this struct is used as an optional field of a SEQUENCE
    LONG directionValue;   //INTEGER, 0...3600
    DWORD directionConfidence;   //INTEGER, 1...127, withinZeroPointOneDegree(1), withinOneDegree(10), unavailable(127)
  };

  struct CAMPosConfidenceEllipse {
    INT isValidFlag;   //necessary if this struct is used as an optional field of a SEQUENCE
    LONG semiMajorConfidence;   //INTEGER, 0...4095, oneCentimeter(1), unavailable(4095)
    LONG semiMinorConfidence;   //INTEGER, 0...4095, oneCentimeter(1), unavailable(4095)
    struct CAMDirection semiMajorOrientation;   //SEQUENCE
  };

  struct CAMElevation {
    INT isValidFlag;   //necessary if this struct is used as an optional field of a SEQUENCE
    LONG elevationValue;   //INTEGER, -1000...7191
    DWORD elevationConfidence;   //INTEGER, 1...127, withinOneMeter(1), unavailable(127)
  };

  struct CAMReferencePosition {
    INT isValidFlag;   //necessary if this struct is used as an optional field of a SEQUENCE
    LONG latitude;   //INTEGER, -900000000...900000001
    LONG longitude;   //INTEGER, -1800000000...1800000001
    struct CAMPosConfidenceEllipse positionConfidenceEllipse;   //SEQUENCE
    struct CAMElevation elevation;   //SEQUENCE
  };

  struct CAMBasicContainer {
    INT isValidFlag;   //necessary if this struct is used as an optional field of a SEQUENCE
    LONG stationType;   //INTEGER, 0...255, unknown(0), pedestrian(1), cyclist(2), moped(3), motorcycle(4), passengerCar(5), bus(6), lightTruck(7), heavyTruck(8), trailer(9), specialVehicles(10), tram(11), roadSideUnit(15)
    struct CAMReferencePosition referencePosition;   //SEQUENCE
  };

  struct CAMMovement {
    INT isValidFlag;   //necessary if this struct is used as an optional field of a SEQUENCE
    LONG vehicleSpeed;   //INTEGER, 0...16383
    DWORD vehicleSpeedConfidence;   //INTEGER, 1...127, withinOneCentimeterPerSec(1), withinOneMeterPerSec(100), outOfRange(126), unavailable(127)
  };

  struct CAMLongitudinalAcceleration {
    INT isValidFlag;   //necessary if this struct is used as an optional field of a SEQUENCE
    LONG longitudinalAccelerationValue;   //INTEGER, -160...160
    LONG longitudinalAccelerationConfidence;   //INTEGER, 0...102, pointOneMeterPerSecSquared(1), outOfRange(101), unavailable(102)
  };

  struct CAMCurvature {
    INT isValidFlag;   //necessary if this struct is used as an optional field of a SEQUENCE
    LONG curvatureValue;   //INTEGER, -30000...30000, straight(0), reciprocalOf1MeterRadiusToRight(1), reciprocalOf1MeterRadiusToLeft(-1)
    LONG curvatureConfidence;   //INTEGER, 0...12, lessThanOnePercentDeviation(0), onePercentDeviation(1), tenPercentDeviation(10), overTenPercentDeviation(11), notAvailable(12)
  };

  struct CAMAccelerationControl {
    INT isValidFlag;   //necessary if this struct is used as an optional field of a SEQUENCE
    CHAR string[7];
    INT  stringLength;
  };

  struct CAMBasicVehicleContainerHighFrequency {
    INT isValidFlag;   //necessary if this struct is used as an optional field of a SEQUENCE
    struct CAMDirection direction;   //SEQUENCE
    struct CAMMovement movement;   //SEQUENCE
    INT driveDirection;   //ENUMERATED, forward(0), backward(1)
    struct CAMLongitudinalAcceleration longitudinalAcceleration;   //SEQUENCE
    struct CAMCurvature curvature;   //SEQUENCE
    INT curvatureCalculationMode;   //ENUMERATED, yawRateNotUsed(0), yawRateUsed(1)
    struct CAMAccelerationControl accelerationControl;   //BIT STRING, OPTIONAL
    struct OPT_LONG_ASN laneNumber;   //INTEGER, OPTIONAL, -1...14, offTheRoad(-1), hardShoulder(0), outermostDrivingLane(1), secondLaneFromOutside(2)
    struct OPT_LONG_ASN steeringWheelAngle;   //INTEGER, OPTIONAL, -126...126, straight(0), onePointFiveDegreesToRight(1), onePointFiveDegreesToLeft(-1), outOfRangeToRight(126), outOfRangeToLeft(-126)
    struct OPT_LONG_ASN lateralAcceleration;   //INTEGER, OPTIONAL, -160...160, pointOneMeterPerSecSquaredToRight(1), pointOneMeterPerSecSquaredToLeft(-1)
    struct OPT_LONG_ASN verticalAcceleration;   //INTEGER, OPTIONAL, -127...127, eightCentimeterPerSecSquaredUp(1), eightCentimeterPerSecSquaredDown(-1)
  };

  struct CAMHighFrequencyContainer {
    INT isValidFlag;   //necessary if this struct is used as an optional field of a SEQUENCE
    INT choice;
    struct CAMBasicVehicleContainerHighFrequency basicVehicleContainerHighFrequency;   //SEQUENCE
  };

  struct CAMVehicleLength {
    INT isValidFlag;   //necessary if this struct is used as an optional field of a SEQUENCE
    DWORD vehicleLengthValue;   //INTEGER, 1...1023
    INT vehicleLengthConfidenceIndication;   //ENUMERATED, noTrailerPresent(0), trailerPresentWithKnownLength(1), trailerPresentWithUnknownLength(2), trailerPresenceIsUnknown(3)
  };

  struct CAMExteriorLights {
    INT isValidFlag;   //necessary if this struct is used as an optional field of a SEQUENCE
    CHAR string[8];
    INT  stringLength;
  };

  struct CAMDeltaReferencePosition {
    INT isValidFlag;   //necessary if this struct is used as an optional field of a SEQUENCE
    LONG deltaLatitude;   //INTEGER, -131072...131071
    LONG deltaLongitude;   //INTEGER, -131072...131071
    LONG deltaElevation;   //INTEGER, -127...128
  };

  struct CAMPathPoint {
    INT isValidFlag;   //necessary if this struct is used as an optional field of a SEQUENCE
    struct CAMDeltaReferencePosition pathPosition;   //SEQUENCE
    LONG pathDeltaTime;   //INTEGER, 0...65535, tenMilliSecondsInPast(1)
  };

  struct CAMPathHistory {
    INT length;
    INT isValidFlag;   //necessary if this struct is used as an optional field of a SEQUENCE
    struct CAMPathPoint arrayValue[40];   //SEQUENCE
  };

  struct CAMBasicVehicleContainerLowFrequency {
    INT isValidFlag;   //necessary if this struct is used as an optional field of a SEQUENCE
    INT vehicleRole;   //ENUMERATED, default(0), publicTransport(1), specialTransport(2), dangerousGoods(3), roadWork(4), rescue(5), emergency(6), safetyCar(7)
    struct CAMVehicleLength vehicleLength;   //SEQUENCE
    DWORD vehicleWidth;   //INTEGER, 1...62
    struct CAMExteriorLights exteriorLights;   //BIT STRING
    struct CAMPathHistory pathHistory;   //SEQUENCE OF
  };

  struct CAMLowFrequencyContainer {
    INT isValidFlag;   //necessary if this struct is used as an optional field of a SEQUENCE
    INT choice;
    struct CAMBasicVehicleContainerLowFrequency basicVehicleContainerLowFrequency;   //SEQUENCE
  };

  struct CAMPtLineNumber {
    INT isValidFlag;   //necessary if this struct is used as an optional field of a SEQUENCE
    CHAR string[5];
    INT  stringLength;
  };

  struct CAMPublicTransportContainer {
    INT isValidFlag;   //necessary if this struct is used as an optional field of a SEQUENCE
    INT embarkationStatus;   //BOOLEAN
    struct CAMPtLineNumber ptLineNumber;   //UTF8String, OPTIONAL
    struct OPT_LONG_ASN ptScheduleDelay;   //INTEGER, OPTIONAL, -300...3795, oneSecondAheadOfSchedule(-1), noDelay(0), oneSecondDelay(1)
    struct OPT_LONG_ASN ptPriority;   //INTEGER, OPTIONAL, 0...3, lowest(0), highest(3)
  };

  struct CAMSpecialTransportType {
    INT isValidFlag;   //necessary if this struct is used as an optional field of a SEQUENCE
    CHAR string[4];
    INT  stringLength;
  };

  struct CAMLightBarSirenInUse {
    INT isValidFlag;   //necessary if this struct is used as an optional field of a SEQUENCE
    CHAR string[2];
    INT  stringLength;
  };

  struct CAMSpecialTransportContainer {
    INT isValidFlag;   //necessary if this struct is used as an optional field of a SEQUENCE
    struct CAMSpecialTransportType specialTransportType;   //BIT STRING
    struct CAMLightBarSirenInUse lightBarSirenInUse;   //BIT STRING
  };

  struct CAMDangerousGoodsContainer {
    INT isValidFlag;   //necessary if this struct is used as an optional field of a SEQUENCE
    INT dangerousGoodsBasic;   //ENUMERATED, explosives1(0), explosives2(1), explosives3(2), explosives4(3), explosives5(4), explosives6(5), flammableGases(6), nonFlammableGases(7), toxicGases(8), flammableLiquids(9), flammableSolids(10), substancesLiableToSpontaneousCombustion(11), substancesEmittingFlammableGasesUponContactWithWater(12), oxidizingSubstances(13), organicPeroxides(14), toxicSubstances(15), infectiousSubstances(16), radioactiveMaterial(17), corrosiveSubstances(18), miscellaneousDangerousSubstances(19)
  };

  struct CAMLaneClosure {
    INT isValidFlag;   //necessary if this struct is used as an optional field of a SEQUENCE
    CHAR string[14];
    INT  stringLength;
  };

  struct CAMRoadWorksContainerBasic {
    INT isValidFlag;   //necessary if this struct is used as an optional field of a SEQUENCE
    struct OPT_LONG_ASN roadworksSubCauseCode;   //INTEGER, OPTIONAL, 0...255, unavailable(0), majorRoadworks(1), roadMarkingWork(2), slowMovingRoadMaintenance(3), winterService(4), streetCleaning(5)
    struct CAMLightBarSirenInUse lightBarSirenInUse;   //BIT STRING
    struct CAMLaneClosure laneClosure;   //BIT STRING, OPTIONAL
  };

  struct CAMRescueContainer {
    INT isValidFlag;   //necessary if this struct is used as an optional field of a SEQUENCE
    struct CAMLightBarSirenInUse lightBarSirenInUse;   //BIT STRING
    struct OPT_LONG_ASN emergencyPriority;   //INTEGER, OPTIONAL, 0...1, requestForRightOfWay(0), requestForFreeCrossingAtATrafficLight(1)
  };

  struct CAMCauseCode {
    INT isValidFlag;   //necessary if this struct is used as an optional field of a SEQUENCE
    LONG causeCode;   //INTEGER, 0...255, reserved(0), trafficCondition(1), accident(2), roadworks(3), adverseWeatherCondition-Adhesion(6), hazardousLocation-SurfaceCondition(9), hazardousLocation-ObstacleOnTheRoad(10), hazardousLocation-AnimalOnTheRoad(11), humanPresenceOnTheRoad(12), wrongWayDriving(14), rescueAndRecoveryWorkInProgress(15), adverseWeatherCondition-ExtremeWeatherCondition(17), adverseWeatherCondition-Visibility(18), adverseWeatherCondition-Precipitation(19), slowVehicle(26), dangerousEndOfQueue(27), vehicleBreakdown(91), postCrash(92), humanProblem(93), stationaryVehicle(94), emergencyVehicleApproaching(95), hazardousLocation-DangerousCurve(96), collisionRisk(97), signalViolation(98), dangerousSituation(99)
    LONG subCauseCode;   //INTEGER, 0...255
  };

  struct CAMEmergencyContainer {
    INT isValidFlag;   //necessary if this struct is used as an optional field of a SEQUENCE
    struct CAMLightBarSirenInUse lightBarSirenInUse;   //BIT STRING
    struct CAMCauseCode incidentIndication;   //SEQUENCE, OPTIONAL
    struct OPT_LONG_ASN emergencyPriority;   //INTEGER, OPTIONAL, 0...1, requestForRightOfWay(0), requestForFreeCrossingAtATrafficLight(1)
  };

  struct CAMSafetyCarContainer {
    INT isValidFlag;   //necessary if this struct is used as an optional field of a SEQUENCE
    struct CAMLightBarSirenInUse lightBarSirenInUse;   //BIT STRING
    struct CAMCauseCode incidentIndication;   //SEQUENCE, OPTIONAL
    struct OPT_ENUM_ASN trafficRule;   //ENUMERATED, OPTIONAL, noPassing(0), noPassingForTrucks(1)
    struct OPT_LONG_ASN speedLimit;   //INTEGER, OPTIONAL, 0...150
  };

  struct CAMSpecialVehicleContainer {
    INT isValidFlag;   //necessary if this struct is used as an optional field of a SEQUENCE
    INT choice;
    struct CAMPublicTransportContainer publicTransportContainer;   //SEQUENCE
    struct CAMSpecialTransportContainer specialTransportContainer;   //SEQUENCE
    struct CAMDangerousGoodsContainer dangerousGoodsContainer;   //SEQUENCE
    struct CAMRoadWorksContainerBasic roadWorksContainerBasic;   //SEQUENCE
    struct CAMRescueContainer rescueContainer;   //SEQUENCE
    struct CAMEmergencyContainer emergencyContainer;   //SEQUENCE
    struct CAMSafetyCarContainer safetyCarContainer;   //SEQUENCE
  };

  struct CAMCamParameters {
    INT isValidFlag;   //necessary if this struct is used as an optional field of a SEQUENCE
    struct CAMBasicContainer basicContainer;   //SEQUENCE
    struct CAMHighFrequencyContainer highFrequencyContainer;   //CHOICE
    struct CAMLowFrequencyContainer lowFrequencyContainer;   //CHOICE, OPTIONAL
    struct CAMSpecialVehicleContainer specialVehicleContainer;   //CHOICE, OPTIONAL
  };

  struct CAMCoopAwareness {
    INT isValidFlag;   //necessary if this struct is used as an optional field of a SEQUENCE
    LONG generationDeltaTime;   //INTEGER, 0...65535
    struct CAMCamParameters camParameters;   //SEQUENCE
  };

  struct CAM {
    INT isValidFlag;   //necessary if this struct is used as an optional field of a SEQUENCE
    struct CAMItsPduHeader header;   //SEQUENCE
    struct CAMCoopAwareness cam;   //SEQUENCE
  };

}

LONG API_InitCAMPacket()
{
  return C2xInitPacket("CAM"); 
}

int API_SetCAMParams(LONG packetHandle, struct CAM value)
{
    int result;

  result = 0;

  SetCAMItsPduHeaderParams(packetHandle, value.header, "header");
  result = CheckLastError("CAM", gkFuncRefSet, result);

  SetCAMCoopAwarenessParams(packetHandle, value.cam, "cam");
  result = CheckLastError("CAM", gkFuncRefSet, result);

  return result;
}
int API_GetCAMParams(LONG packetHandle, struct CAM value)
{
    int result;

  result = 0;

  value.header.isValidFlag = 1;
  GetCAMItsPduHeaderParams(packetHandle, value.header, "header");
  result = CheckLastError("CAM", gkFuncRefGet, result);

  value.cam.isValidFlag = 1;
  GetCAMCoopAwarenessParams(packetHandle, value.cam, "cam");
  result = CheckLastError("CAM", gkFuncRefGet, result);

  return result;
}

int SetCAMCoopAwarenessParams(LONG packetHandle, struct CAMCoopAwareness value, char oldPath[])
{
  char newPath[300];
  int result;

  result = 0;

  snprintf(newPath, elcount(newPath), "%s.%s", oldPath, "generationDeltaTime");
  C2xSetTokenInt( packetHandle, "CAM", newPath, value.generationDeltaTime);
  result = CheckLastError("CAM", gkFuncRefSet, result);

  snprintf(newPath, elcount(newPath), "%s.%s", oldPath, "camParameters");
  SetCAMCamParametersParams(packetHandle, value.camParameters, newPath);
  result = CheckLastError("CAM", gkFuncRefSet, result);

  return result;
}
int GetCAMCoopAwarenessParams(LONG packetHandle, struct CAMCoopAwareness value, char oldPath[])
{
  char newPath[300];
  int result;

  result = 0;

  snprintf(newPath, elcount(newPath), "%s.%s", oldPath, "generationDeltaTime");
  value.generationDeltaTime = C2xGetTokenInt(packetHandle, "CAM", newPath);
  result = CheckLastError("CAM", gkFuncRefGet, result);

  snprintf(newPath, elcount(newPath), "%s.%s", oldPath, "camParameters");
  value.camParameters.isValidFlag = 1;
  GetCAMCamParametersParams(packetHandle, value.camParameters, newPath);
  result = CheckLastError("CAM", gkFuncRefGet, result);

  return result;
}

int SetCAMCamParametersParams(LONG packetHandle, struct CAMCamParameters value, char oldPath[])
{
  char newPath[300];
  int result;

  result = 0;

  snprintf(newPath, elcount(newPath), "%s.%s", oldPath, "basicContainer");
  SetCAMBasicContainerParams(packetHandle, value.basicContainer, newPath);
  result = CheckLastError("CAM", gkFuncRefSet, result);

  snprintf(newPath, elcount(newPath), "%s.%s", oldPath, "highFrequencyContainer");
  SetCAMHighFrequencyContainerParams(packetHandle, value.highFrequencyContainer, newPath);
  result = CheckLastError("CAM", gkFuncRefSet, result);

  snprintf(newPath, elcount(newPath), "%s.%s", oldPath, "lowFrequencyContainer");
  if (value.lowFrequencyContainer.isValidFlag==1)
  {
    SetCAMLowFrequencyContainerParams(packetHandle, value.lowFrequencyContainer, newPath);
    result = CheckLastError("CAM", gkFuncRefSet, result);
  }
  else
  {
    C2xRemoveToken(packetHandle, "CAM", newPath);
    result = CheckLastError("CAM", gkFuncRefRemove, result);
  }

  snprintf(newPath, elcount(newPath), "%s.%s", oldPath, "specialVehicleContainer");
  if (value.specialVehicleContainer.isValidFlag==1)
  {
    SetCAMSpecialVehicleContainerParams(packetHandle, value.specialVehicleContainer, newPath);
    result = CheckLastError("CAM", gkFuncRefSet, result);
  }
  else
  {
    C2xRemoveToken(packetHandle, "CAM", newPath);
    result = CheckLastError("CAM", gkFuncRefRemove, result);
  }

  return result;
}
int GetCAMCamParametersParams(LONG packetHandle, struct CAMCamParameters value, char oldPath[])
{
  char newPath[300];
  int result;

  result = 0;

  snprintf(newPath, elcount(newPath), "%s.%s", oldPath, "basicContainer");
  value.basicContainer.isValidFlag = 1;
  GetCAMBasicContainerParams(packetHandle, value.basicContainer, newPath);
  result = CheckLastError("CAM", gkFuncRefGet, result);

  snprintf(newPath, elcount(newPath), "%s.%s", oldPath, "highFrequencyContainer");
  value.highFrequencyContainer.isValidFlag = 1;
  GetCAMHighFrequencyContainerParams(packetHandle, value.highFrequencyContainer, newPath);
  result = CheckLastError("CAM", gkFuncRefGet, result);

  snprintf(newPath, elcount(newPath), "%s.%s", oldPath, "lowFrequencyContainer");
  value.lowFrequencyContainer.isValidFlag = C2xIsTokenAvailable(packetHandle, "CAM", newPath);
  if (value.lowFrequencyContainer.isValidFlag==1)
  {
    GetCAMLowFrequencyContainerParams(packetHandle, value.lowFrequencyContainer, newPath);
    result = CheckLastError("CAM", gkFuncRefGet, result);
  }

  snprintf(newPath, elcount(newPath), "%s.%s", oldPath, "specialVehicleContainer");
  value.specialVehicleContainer.isValidFlag = C2xIsTokenAvailable(packetHandle, "CAM", newPath);
  if (value.specialVehicleContainer.isValidFlag==1)
  {
    GetCAMSpecialVehicleContainerParams(packetHandle, value.specialVehicleContainer, newPath);
    result = CheckLastError("CAM", gkFuncRefGet, result);
  }

  return result;
}

int SetCAMSpecialVehicleContainerParams(LONG packetHandle, struct CAMSpecialVehicleContainer value, char oldPath[])
{
  char newPath[300];
  int result;

  result = 0;

  if (value.choice==0)
  {
    snprintf(newPath, elcount(newPath), "%s.%s", oldPath, "publicTransportContainer");
    SetCAMPublicTransportContainerParams(packetHandle, value.publicTransportContainer, newPath);
    result = CheckLastError("CAM", gkFuncRefSet, result);
  }
  else if (value.choice==1)
  {
    snprintf(newPath, elcount(newPath), "%s.%s", oldPath, "specialTransportContainer");
    SetCAMSpecialTransportContainerParams(packetHandle, value.specialTransportContainer, newPath);
    result = CheckLastError("CAM", gkFuncRefSet, result);
  }
  else if (value.choice==2)
  {
    snprintf(newPath, elcount(newPath), "%s.%s", oldPath, "dangerousGoodsContainer");
    SetCAMDangerousGoodsContainerParams(packetHandle, value.dangerousGoodsContainer, newPath);
    result = CheckLastError("CAM", gkFuncRefSet, result);
  }
  else if (value.choice==3)
  {
    snprintf(newPath, elcount(newPath), "%s.%s", oldPath, "roadWorksContainerBasic");
    SetCAMRoadWorksContainerBasicParams(packetHandle, value.roadWorksContainerBasic, newPath);
    result = CheckLastError("CAM", gkFuncRefSet, result);
  }
  else if (value.choice==4)
  {
    snprintf(newPath, elcount(newPath), "%s.%s", oldPath, "rescueContainer");
    SetCAMRescueContainerParams(packetHandle, value.rescueContainer, newPath);
    result = CheckLastError("CAM", gkFuncRefSet, result);
  }
  else if (value.choice==5)
  {
    snprintf(newPath, elcount(newPath), "%s.%s", oldPath, "emergencyContainer");
    SetCAMEmergencyContainerParams(packetHandle, value.emergencyContainer, newPath);
    result = CheckLastError("CAM", gkFuncRefSet, result);
  }
  else if (value.choice==6)
  {
    snprintf(newPath, elcount(newPath), "%s.%s", oldPath, "safetyCarContainer");
    SetCAMSafetyCarContainerParams(packetHandle, value.safetyCarContainer, newPath);
    result = CheckLastError("CAM", gkFuncRefSet, result);
  }

  return result;
}
int GetCAMSpecialVehicleContainerParams(LONG packetHandle, struct CAMSpecialVehicleContainer value, char oldPath[])
{
  char newPath[300];
  int result;

  result = 0;

  value.choice = C2xGetTokenInt(packetHandle, "CAM", oldPath);
  if ((result = CheckLastError("CAM", gkFuncRefGet, result))==0)
  {
    if (value.choice==0)
    {
      snprintf(newPath, elcount(newPath), "%s.%s", oldPath, "publicTransportContainer");
  value.publicTransportContainer.isValidFlag = 1;
      GetCAMPublicTransportContainerParams(packetHandle, value.publicTransportContainer, newPath);
      result = CheckLastError("CAM", gkFuncRefGet, result);
    }
    else if (value.choice==1)
    {
      snprintf(newPath, elcount(newPath), "%s.%s", oldPath, "specialTransportContainer");
  value.specialTransportContainer.isValidFlag = 1;
      GetCAMSpecialTransportContainerParams(packetHandle, value.specialTransportContainer, newPath);
      result = CheckLastError("CAM", gkFuncRefGet, result);
    }
    else if (value.choice==2)
    {
      snprintf(newPath, elcount(newPath), "%s.%s", oldPath, "dangerousGoodsContainer");
  value.dangerousGoodsContainer.isValidFlag = 1;
      GetCAMDangerousGoodsContainerParams(packetHandle, value.dangerousGoodsContainer, newPath);
      result = CheckLastError("CAM", gkFuncRefGet, result);
    }
    else if (value.choice==3)
    {
      snprintf(newPath, elcount(newPath), "%s.%s", oldPath, "roadWorksContainerBasic");
  value.roadWorksContainerBasic.isValidFlag = 1;
      GetCAMRoadWorksContainerBasicParams(packetHandle, value.roadWorksContainerBasic, newPath);
      result = CheckLastError("CAM", gkFuncRefGet, result);
    }
    else if (value.choice==4)
    {
      snprintf(newPath, elcount(newPath), "%s.%s", oldPath, "rescueContainer");
  value.rescueContainer.isValidFlag = 1;
      GetCAMRescueContainerParams(packetHandle, value.rescueContainer, newPath);
      result = CheckLastError("CAM", gkFuncRefGet, result);
    }
    else if (value.choice==5)
    {
      snprintf(newPath, elcount(newPath), "%s.%s", oldPath, "emergencyContainer");
  value.emergencyContainer.isValidFlag = 1;
      GetCAMEmergencyContainerParams(packetHandle, value.emergencyContainer, newPath);
      result = CheckLastError("CAM", gkFuncRefGet, result);
    }
    else if (value.choice==6)
    {
      snprintf(newPath, elcount(newPath), "%s.%s", oldPath, "safetyCarContainer");
  value.safetyCarContainer.isValidFlag = 1;
      GetCAMSafetyCarContainerParams(packetHandle, value.safetyCarContainer, newPath);
      result = CheckLastError("CAM", gkFuncRefGet, result);
    }
  }

  return result;
}

int SetCAMSafetyCarContainerParams(LONG packetHandle, struct CAMSafetyCarContainer value, char oldPath[])
{
  char newPath[300];
  int j;
  int result;

  result = 0;

  snprintf(newPath, elcount(newPath), "%s.%s", oldPath, "lightBarSirenInUse");
  for (j=0; j<value.lightBarSirenInUse.stringLength; j++)
  {
    C2xSetTokenBitOfBitString(packetHandle, "CAM", newPath, j, value.lightBarSirenInUse.string[j]);
    result = CheckLastError("CAM", gkFuncRefSet, result);
  }

  snprintf(newPath, elcount(newPath), "%s.%s", oldPath, "incidentIndication");
  if (value.incidentIndication.isValidFlag==1)
  {
    SetCAMCauseCodeParams(packetHandle, value.incidentIndication, newPath);
    result = CheckLastError("CAM", gkFuncRefSet, result);
  }
  else
  {
    C2xRemoveToken(packetHandle, "CAM", newPath);
    result = CheckLastError("CAM", gkFuncRefRemove, result);
  }

  snprintf(newPath, elcount(newPath), "%s.%s", oldPath, "trafficRule");
  if (value.trafficRule.isValidFlag==1)
  {
    C2xSetTokenInt( packetHandle, "CAM", newPath, value.trafficRule.value);
    result = CheckLastError("CAM", gkFuncRefSet, result);
  }
  else
  {
    C2xRemoveToken(packetHandle, "CAM", newPath);
    result = CheckLastError("CAM", gkFuncRefRemove, result);
  }

  snprintf(newPath, elcount(newPath), "%s.%s", oldPath, "speedLimit");
  if (value.speedLimit.isValidFlag==1)
  {
    C2xSetTokenInt( packetHandle, "CAM", newPath, value.speedLimit.value);
    result = CheckLastError("CAM", gkFuncRefSet, result);
  }
  else
  {
    C2xRemoveToken(packetHandle, "CAM", newPath);
    result = CheckLastError("CAM", gkFuncRefRemove, result);
  }

  return result;
}
int GetCAMSafetyCarContainerParams(LONG packetHandle, struct CAMSafetyCarContainer value, char oldPath[])
{
  char newPath[300];
  int j;
  int result;

  result = 0;

  snprintf(newPath, elcount(newPath), "%s.%s", oldPath, "lightBarSirenInUse");
  value.lightBarSirenInUse.isValidFlag = 1;
  value.lightBarSirenInUse.stringLength = C2xGetTokenInt(packetHandle, "CAM", newPath);
  if ((result = CheckLastError("CAM", gkFuncRefGet, result))==0)
  {
    for (j=0; j<value.lightBarSirenInUse.stringLength; j++)
    {
      value.lightBarSirenInUse.string[j] = C2xGetTokenBitOfBitString(packetHandle, "CAM", newPath, j);
      result = CheckLastError("CAM", gkFuncRefGet, result);
    }
  }

  snprintf(newPath, elcount(newPath), "%s.%s", oldPath, "incidentIndication");
  value.incidentIndication.isValidFlag = C2xIsTokenAvailable(packetHandle, "CAM", newPath);
  if (value.incidentIndication.isValidFlag==1)
  {
    GetCAMCauseCodeParams(packetHandle, value.incidentIndication, newPath);
    result = CheckLastError("CAM", gkFuncRefGet, result);
  }

  snprintf(newPath, elcount(newPath), "%s.%s", oldPath, "trafficRule");
  value.trafficRule.isValidFlag = C2xIsTokenAvailable(packetHandle, "CAM", newPath);
  if (value.trafficRule.isValidFlag==1)
  {
    value.trafficRule.value = C2xGetTokenInt(packetHandle, "CAM", newPath);
    result = CheckLastError("CAM", gkFuncRefGet, result);
  }

  snprintf(newPath, elcount(newPath), "%s.%s", oldPath, "speedLimit");
  value.speedLimit.isValidFlag = C2xIsTokenAvailable(packetHandle, "CAM", newPath);
  if (value.speedLimit.isValidFlag==1)
  {
    value.speedLimit.value = C2xGetTokenInt(packetHandle, "CAM", newPath);
    result = CheckLastError("CAM", gkFuncRefGet, result);
  }

  return result;
}

int SetCAMEmergencyContainerParams(LONG packetHandle, struct CAMEmergencyContainer value, char oldPath[])
{
  char newPath[300];
  int j;
  int result;

  result = 0;

  snprintf(newPath, elcount(newPath), "%s.%s", oldPath, "lightBarSirenInUse");
  for (j=0; j<value.lightBarSirenInUse.stringLength; j++)
  {
    C2xSetTokenBitOfBitString(packetHandle, "CAM", newPath, j, value.lightBarSirenInUse.string[j]);
    result = CheckLastError("CAM", gkFuncRefSet, result);
  }

  snprintf(newPath, elcount(newPath), "%s.%s", oldPath, "incidentIndication");
  if (value.incidentIndication.isValidFlag==1)
  {
    SetCAMCauseCodeParams(packetHandle, value.incidentIndication, newPath);
    result = CheckLastError("CAM", gkFuncRefSet, result);
  }
  else
  {
    C2xRemoveToken(packetHandle, "CAM", newPath);
    result = CheckLastError("CAM", gkFuncRefRemove, result);
  }

  snprintf(newPath, elcount(newPath), "%s.%s", oldPath, "emergencyPriority");
  if (value.emergencyPriority.isValidFlag==1)
  {
    C2xSetTokenInt( packetHandle, "CAM", newPath, value.emergencyPriority.value);
    result = CheckLastError("CAM", gkFuncRefSet, result);
  }
  else
  {
    C2xRemoveToken(packetHandle, "CAM", newPath);
    result = CheckLastError("CAM", gkFuncRefRemove, result);
  }

  return result;
}
int GetCAMEmergencyContainerParams(LONG packetHandle, struct CAMEmergencyContainer value, char oldPath[])
{
  char newPath[300];
  int j;
  int result;

  result = 0;

  snprintf(newPath, elcount(newPath), "%s.%s", oldPath, "lightBarSirenInUse");
  value.lightBarSirenInUse.isValidFlag = 1;
  value.lightBarSirenInUse.stringLength = C2xGetTokenInt(packetHandle, "CAM", newPath);
  if ((result = CheckLastError("CAM", gkFuncRefGet, result))==0)
  {
    for (j=0; j<value.lightBarSirenInUse.stringLength; j++)
    {
      value.lightBarSirenInUse.string[j] = C2xGetTokenBitOfBitString(packetHandle, "CAM", newPath, j);
      result = CheckLastError("CAM", gkFuncRefGet, result);
    }
  }

  snprintf(newPath, elcount(newPath), "%s.%s", oldPath, "incidentIndication");
  value.incidentIndication.isValidFlag = C2xIsTokenAvailable(packetHandle, "CAM", newPath);
  if (value.incidentIndication.isValidFlag==1)
  {
    GetCAMCauseCodeParams(packetHandle, value.incidentIndication, newPath);
    result = CheckLastError("CAM", gkFuncRefGet, result);
  }

  snprintf(newPath, elcount(newPath), "%s.%s", oldPath, "emergencyPriority");
  value.emergencyPriority.isValidFlag = C2xIsTokenAvailable(packetHandle, "CAM", newPath);
  if (value.emergencyPriority.isValidFlag==1)
  {
    value.emergencyPriority.value = C2xGetTokenInt(packetHandle, "CAM", newPath);
    result = CheckLastError("CAM", gkFuncRefGet, result);
  }

  return result;
}

int SetCAMCauseCodeParams(LONG packetHandle, struct CAMCauseCode value, char oldPath[])
{
  char newPath[300];
  int result;

  result = 0;

  snprintf(newPath, elcount(newPath), "%s.%s", oldPath, "causeCode");
  C2xSetTokenInt( packetHandle, "CAM", newPath, value.causeCode);
  result = CheckLastError("CAM", gkFuncRefSet, result);

  snprintf(newPath, elcount(newPath), "%s.%s", oldPath, "subCauseCode");
  C2xSetTokenInt( packetHandle, "CAM", newPath, value.subCauseCode);
  result = CheckLastError("CAM", gkFuncRefSet, result);

  return result;
}
int GetCAMCauseCodeParams(LONG packetHandle, struct CAMCauseCode value, char oldPath[])
{
  char newPath[300];
  int result;

  result = 0;

  snprintf(newPath, elcount(newPath), "%s.%s", oldPath, "causeCode");
  value.causeCode = C2xGetTokenInt(packetHandle, "CAM", newPath);
  result = CheckLastError("CAM", gkFuncRefGet, result);

  snprintf(newPath, elcount(newPath), "%s.%s", oldPath, "subCauseCode");
  value.subCauseCode = C2xGetTokenInt(packetHandle, "CAM", newPath);
  result = CheckLastError("CAM", gkFuncRefGet, result);

  return result;
}

int SetCAMRescueContainerParams(LONG packetHandle, struct CAMRescueContainer value, char oldPath[])
{
  char newPath[300];
  int j;
  int result;

  result = 0;

  snprintf(newPath, elcount(newPath), "%s.%s", oldPath, "lightBarSirenInUse");
  for (j=0; j<value.lightBarSirenInUse.stringLength; j++)
  {
    C2xSetTokenBitOfBitString(packetHandle, "CAM", newPath, j, value.lightBarSirenInUse.string[j]);
    result = CheckLastError("CAM", gkFuncRefSet, result);
  }

  snprintf(newPath, elcount(newPath), "%s.%s", oldPath, "emergencyPriority");
  if (value.emergencyPriority.isValidFlag==1)
  {
    C2xSetTokenInt( packetHandle, "CAM", newPath, value.emergencyPriority.value);
    result = CheckLastError("CAM", gkFuncRefSet, result);
  }
  else
  {
    C2xRemoveToken(packetHandle, "CAM", newPath);
    result = CheckLastError("CAM", gkFuncRefRemove, result);
  }

  return result;
}
int GetCAMRescueContainerParams(LONG packetHandle, struct CAMRescueContainer value, char oldPath[])
{
  char newPath[300];
  int j;
  int result;

  result = 0;

  snprintf(newPath, elcount(newPath), "%s.%s", oldPath, "lightBarSirenInUse");
  value.lightBarSirenInUse.isValidFlag = 1;
  value.lightBarSirenInUse.stringLength = C2xGetTokenInt(packetHandle, "CAM", newPath);
  if ((result = CheckLastError("CAM", gkFuncRefGet, result))==0)
  {
    for (j=0; j<value.lightBarSirenInUse.stringLength; j++)
    {
      value.lightBarSirenInUse.string[j] = C2xGetTokenBitOfBitString(packetHandle, "CAM", newPath, j);
      result = CheckLastError("CAM", gkFuncRefGet, result);
    }
  }

  snprintf(newPath, elcount(newPath), "%s.%s", oldPath, "emergencyPriority");
  value.emergencyPriority.isValidFlag = C2xIsTokenAvailable(packetHandle, "CAM", newPath);
  if (value.emergencyPriority.isValidFlag==1)
  {
    value.emergencyPriority.value = C2xGetTokenInt(packetHandle, "CAM", newPath);
    result = CheckLastError("CAM", gkFuncRefGet, result);
  }

  return result;
}

int SetCAMRoadWorksContainerBasicParams(LONG packetHandle, struct CAMRoadWorksContainerBasic value, char oldPath[])
{
  char newPath[300];
  int j;
  int result;

  result = 0;

  snprintf(newPath, elcount(newPath), "%s.%s", oldPath, "roadworksSubCauseCode");
  if (value.roadworksSubCauseCode.isValidFlag==1)
  {
    C2xSetTokenInt( packetHandle, "CAM", newPath, value.roadworksSubCauseCode.value);
    result = CheckLastError("CAM", gkFuncRefSet, result);
  }
  else
  {
    C2xRemoveToken(packetHandle, "CAM", newPath);
    result = CheckLastError("CAM", gkFuncRefRemove, result);
  }

  snprintf(newPath, elcount(newPath), "%s.%s", oldPath, "lightBarSirenInUse");
  for (j=0; j<value.lightBarSirenInUse.stringLength; j++)
  {
    C2xSetTokenBitOfBitString(packetHandle, "CAM", newPath, j, value.lightBarSirenInUse.string[j]);
    result = CheckLastError("CAM", gkFuncRefSet, result);
  }

  snprintf(newPath, elcount(newPath), "%s.%s", oldPath, "laneClosure");
  if (value.laneClosure.isValidFlag==1)
  {
    for (j=0; j<value.laneClosure.stringLength; j++)
    {
      C2xSetTokenBitOfBitString(packetHandle, "CAM", newPath, j, value.laneClosure.string[j]);
      result = CheckLastError("CAM", gkFuncRefSet, result);
    }
  }
  else
  {
    C2xRemoveToken(packetHandle, "CAM", newPath);
    result = CheckLastError("CAM", gkFuncRefRemove, result);
  }

  return result;
}
int GetCAMRoadWorksContainerBasicParams(LONG packetHandle, struct CAMRoadWorksContainerBasic value, char oldPath[])
{
  char newPath[300];
  int j;
  int result;

  result = 0;

  snprintf(newPath, elcount(newPath), "%s.%s", oldPath, "roadworksSubCauseCode");
  value.roadworksSubCauseCode.isValidFlag = C2xIsTokenAvailable(packetHandle, "CAM", newPath);
  if (value.roadworksSubCauseCode.isValidFlag==1)
  {
    value.roadworksSubCauseCode.value = C2xGetTokenInt(packetHandle, "CAM", newPath);
    result = CheckLastError("CAM", gkFuncRefGet, result);
  }

  snprintf(newPath, elcount(newPath), "%s.%s", oldPath, "lightBarSirenInUse");
  value.lightBarSirenInUse.isValidFlag = 1;
  value.lightBarSirenInUse.stringLength = C2xGetTokenInt(packetHandle, "CAM", newPath);
  if ((result = CheckLastError("CAM", gkFuncRefGet, result))==0)
  {
    for (j=0; j<value.lightBarSirenInUse.stringLength; j++)
    {
      value.lightBarSirenInUse.string[j] = C2xGetTokenBitOfBitString(packetHandle, "CAM", newPath, j);
      result = CheckLastError("CAM", gkFuncRefGet, result);
    }
  }

  snprintf(newPath, elcount(newPath), "%s.%s", oldPath, "laneClosure");
  value.laneClosure.isValidFlag = C2xIsTokenAvailable(packetHandle, "CAM", newPath);
  if (value.laneClosure.isValidFlag==1)
  {
    value.laneClosure.stringLength = C2xGetTokenInt(packetHandle, "CAM", newPath);
    if ((result = CheckLastError("CAM", gkFuncRefGet, result))==0)
    {
      for (j=0; j<value.laneClosure.stringLength; j++)
      {
        value.laneClosure.string[j] = C2xGetTokenBitOfBitString(packetHandle, "CAM", newPath, j);
        result = CheckLastError("CAM", gkFuncRefGet, result);
      }
    }
  }

  return result;
}


int SetCAMDangerousGoodsContainerParams(LONG packetHandle, struct CAMDangerousGoodsContainer value, char oldPath[])
{
  char newPath[300];
  int result;

  result = 0;

  snprintf(newPath, elcount(newPath), "%s.%s", oldPath, "dangerousGoodsBasic");
  C2xSetTokenInt(packetHandle, "CAM", newPath, value.dangerousGoodsBasic);
  result = CheckLastError("CAM", gkFuncRefSet, result);

  return result;
}
int GetCAMDangerousGoodsContainerParams(LONG packetHandle, struct CAMDangerousGoodsContainer value, char oldPath[])
{
  char newPath[300];
  int result;

  result = 0;

  snprintf(newPath, elcount(newPath), "%s.%s", oldPath, "dangerousGoodsBasic");
  value.dangerousGoodsBasic = C2xGetTokenInt(packetHandle, "CAM", newPath);
  result = CheckLastError("CAM", gkFuncRefGet, result);

  return result;
}

int SetCAMSpecialTransportContainerParams(LONG packetHandle, struct CAMSpecialTransportContainer value, char oldPath[])
{
  char newPath[300];
  int j;
  int result;

  result = 0;

  snprintf(newPath, elcount(newPath), "%s.%s", oldPath, "specialTransportType");
  for (j=0; j<value.specialTransportType.stringLength; j++)
  {
    C2xSetTokenBitOfBitString(packetHandle, "CAM", newPath, j, value.specialTransportType.string[j]);
    result = CheckLastError("CAM", gkFuncRefSet, result);
  }

  snprintf(newPath, elcount(newPath), "%s.%s", oldPath, "lightBarSirenInUse");
  for (j=0; j<value.lightBarSirenInUse.stringLength; j++)
  {
    C2xSetTokenBitOfBitString(packetHandle, "CAM", newPath, j, value.lightBarSirenInUse.string[j]);
    result = CheckLastError("CAM", gkFuncRefSet, result);
  }

  return result;
}
int GetCAMSpecialTransportContainerParams(LONG packetHandle, struct CAMSpecialTransportContainer value, char oldPath[])
{
  char newPath[300];
  int j;
  int result;

  result = 0;

  snprintf(newPath, elcount(newPath), "%s.%s", oldPath, "specialTransportType");
  value.specialTransportType.isValidFlag = 1;
  value.specialTransportType.stringLength = C2xGetTokenInt(packetHandle, "CAM", newPath);
  if ((result = CheckLastError("CAM", gkFuncRefGet, result))==0)
  {
    for (j=0; j<value.specialTransportType.stringLength; j++)
    {
      value.specialTransportType.string[j] = C2xGetTokenBitOfBitString(packetHandle, "CAM", newPath, j);
      result = CheckLastError("CAM", gkFuncRefGet, result);
    }
  }

  snprintf(newPath, elcount(newPath), "%s.%s", oldPath, "lightBarSirenInUse");
  value.lightBarSirenInUse.isValidFlag = 1;
  value.lightBarSirenInUse.stringLength = C2xGetTokenInt(packetHandle, "CAM", newPath);
  if ((result = CheckLastError("CAM", gkFuncRefGet, result))==0)
  {
    for (j=0; j<value.lightBarSirenInUse.stringLength; j++)
    {
      value.lightBarSirenInUse.string[j] = C2xGetTokenBitOfBitString(packetHandle, "CAM", newPath, j);
      result = CheckLastError("CAM", gkFuncRefGet, result);
    }
  }

  return result;
}



int SetCAMPublicTransportContainerParams(LONG packetHandle, struct CAMPublicTransportContainer value, char oldPath[])
{
  char newPath[300];
  int result;

  result = 0;

  snprintf(newPath, elcount(newPath), "%s.%s", oldPath, "embarkationStatus");
  C2xSetTokenInt( packetHandle, "CAM", newPath, value.embarkationStatus);
  result = CheckLastError("CAM", gkFuncRefSet, result);

  snprintf(newPath, elcount(newPath), "%s.%s", oldPath, "ptLineNumber");
  if (value.ptLineNumber.isValidFlag==1)
  {
    C2xSetTokenData( packetHandle, "CAM", newPath, value.ptLineNumber.stringLength, value.ptLineNumber.string);
    result = CheckLastError("CAM", gkFuncRefSet, result);
  }
  else
  {
    C2xRemoveToken(packetHandle, "CAM", newPath);
    result = CheckLastError("CAM", gkFuncRefRemove, result);
  }

  snprintf(newPath, elcount(newPath), "%s.%s", oldPath, "ptScheduleDelay");
  if (value.ptScheduleDelay.isValidFlag==1)
  {
    C2xSetTokenInt( packetHandle, "CAM", newPath, value.ptScheduleDelay.value);
    result = CheckLastError("CAM", gkFuncRefSet, result);
  }
  else
  {
    C2xRemoveToken(packetHandle, "CAM", newPath);
    result = CheckLastError("CAM", gkFuncRefRemove, result);
  }

  snprintf(newPath, elcount(newPath), "%s.%s", oldPath, "ptPriority");
  if (value.ptPriority.isValidFlag==1)
  {
    C2xSetTokenInt( packetHandle, "CAM", newPath, value.ptPriority.value);
    result = CheckLastError("CAM", gkFuncRefSet, result);
  }
  else
  {
    C2xRemoveToken(packetHandle, "CAM", newPath);
    result = CheckLastError("CAM", gkFuncRefRemove, result);
  }

  return result;
}
int GetCAMPublicTransportContainerParams(LONG packetHandle, struct CAMPublicTransportContainer value, char oldPath[])
{
  char newPath[300];
  int result;

  result = 0;

  snprintf(newPath, elcount(newPath), "%s.%s", oldPath, "embarkationStatus");
  value.embarkationStatus = C2xGetTokenInt(packetHandle, "CAM", newPath);
  result = CheckLastError("CAM", gkFuncRefGet, result);

  snprintf(newPath, elcount(newPath), "%s.%s", oldPath, "ptLineNumber");
  value.ptLineNumber.isValidFlag = C2xIsTokenAvailable(packetHandle, "CAM", newPath);
  if (value.ptLineNumber.isValidFlag==1)
  {
    value.ptLineNumber.stringLength = C2xGetTokenData(packetHandle, "CAM", newPath, elcount(value.ptLineNumber.string), value.ptLineNumber.string);
    result = CheckLastError("CAM", gkFuncRefGet, result);
  }

  snprintf(newPath, elcount(newPath), "%s.%s", oldPath, "ptScheduleDelay");
  value.ptScheduleDelay.isValidFlag = C2xIsTokenAvailable(packetHandle, "CAM", newPath);
  if (value.ptScheduleDelay.isValidFlag==1)
  {
    value.ptScheduleDelay.value = C2xGetTokenInt(packetHandle, "CAM", newPath);
    result = CheckLastError("CAM", gkFuncRefGet, result);
  }

  snprintf(newPath, elcount(newPath), "%s.%s", oldPath, "ptPriority");
  value.ptPriority.isValidFlag = C2xIsTokenAvailable(packetHandle, "CAM", newPath);
  if (value.ptPriority.isValidFlag==1)
  {
    value.ptPriority.value = C2xGetTokenInt(packetHandle, "CAM", newPath);
    result = CheckLastError("CAM", gkFuncRefGet, result);
  }

  return result;
}


int SetCAMLowFrequencyContainerParams(LONG packetHandle, struct CAMLowFrequencyContainer value, char oldPath[])
{
  char newPath[300];
  int result;

  result = 0;

  if (value.choice==0)
  {
    snprintf(newPath, elcount(newPath), "%s.%s", oldPath, "basicVehicleContainerLowFrequency");
    SetCAMBasicVehicleContainerLowFrequencyParams(packetHandle, value.basicVehicleContainerLowFrequency, newPath);
    result = CheckLastError("CAM", gkFuncRefSet, result);
  }

  return result;
}
int GetCAMLowFrequencyContainerParams(LONG packetHandle, struct CAMLowFrequencyContainer value, char oldPath[])
{
  char newPath[300];
  int result;

  result = 0;

  value.choice = C2xGetTokenInt(packetHandle, "CAM", oldPath);
  if ((result = CheckLastError("CAM", gkFuncRefGet, result))==0)
  {
    if (value.choice==0)
    {
      snprintf(newPath, elcount(newPath), "%s.%s", oldPath, "basicVehicleContainerLowFrequency");
  value.basicVehicleContainerLowFrequency.isValidFlag = 1;
      GetCAMBasicVehicleContainerLowFrequencyParams(packetHandle, value.basicVehicleContainerLowFrequency, newPath);
      result = CheckLastError("CAM", gkFuncRefGet, result);
    }
  }

  return result;
}

int SetCAMBasicVehicleContainerLowFrequencyParams(LONG packetHandle, struct CAMBasicVehicleContainerLowFrequency value, char oldPath[])
{
  char newPath[300];
  int j;
  int result;

  result = 0;

  snprintf(newPath, elcount(newPath), "%s.%s", oldPath, "vehicleRole");
  C2xSetTokenInt(packetHandle, "CAM", newPath, value.vehicleRole);
  result = CheckLastError("CAM", gkFuncRefSet, result);

  snprintf(newPath, elcount(newPath), "%s.%s", oldPath, "vehicleLength");
  SetCAMVehicleLengthParams(packetHandle, value.vehicleLength, newPath);
  result = CheckLastError("CAM", gkFuncRefSet, result);

  snprintf(newPath, elcount(newPath), "%s.%s", oldPath, "vehicleWidth");
  C2xSetTokenInt64( packetHandle, "CAM", newPath, value.vehicleWidth);
  result = CheckLastError("CAM", gkFuncRefSet, result);

  snprintf(newPath, elcount(newPath), "%s.%s", oldPath, "exteriorLights");
  for (j=0; j<value.exteriorLights.stringLength; j++)
  {
    C2xSetTokenBitOfBitString(packetHandle, "CAM", newPath, j, value.exteriorLights.string[j]);
    result = CheckLastError("CAM", gkFuncRefSet, result);
  }

  snprintf(newPath, elcount(newPath), "%s.%s", oldPath, "pathHistory");
  SetCAMPathHistoryParams(packetHandle, value.pathHistory, newPath);
  result = CheckLastError("CAM", gkFuncRefSet, result);

  return result;
}
int GetCAMBasicVehicleContainerLowFrequencyParams(LONG packetHandle, struct CAMBasicVehicleContainerLowFrequency value, char oldPath[])
{
  char newPath[300];
  int j;
  int result;

  result = 0;

  snprintf(newPath, elcount(newPath), "%s.%s", oldPath, "vehicleRole");
  value.vehicleRole = C2xGetTokenInt(packetHandle, "CAM", newPath);
  result = CheckLastError("CAM", gkFuncRefGet, result);

  snprintf(newPath, elcount(newPath), "%s.%s", oldPath, "vehicleLength");
  value.vehicleLength.isValidFlag = 1;
  GetCAMVehicleLengthParams(packetHandle, value.vehicleLength, newPath);
  result = CheckLastError("CAM", gkFuncRefGet, result);

  snprintf(newPath, elcount(newPath), "%s.%s", oldPath, "vehicleWidth");
  value.vehicleWidth = C2xGetTokenInt64(packetHandle, "CAM", newPath);
  result = CheckLastError("CAM", gkFuncRefGet, result);

  snprintf(newPath, elcount(newPath), "%s.%s", oldPath, "exteriorLights");
  value.exteriorLights.isValidFlag = 1;
  value.exteriorLights.stringLength = C2xGetTokenInt(packetHandle, "CAM", newPath);
  if ((result = CheckLastError("CAM", gkFuncRefGet, result))==0)
  {
    for (j=0; j<value.exteriorLights.stringLength; j++)
    {
      value.exteriorLights.string[j] = C2xGetTokenBitOfBitString(packetHandle, "CAM", newPath, j);
      result = CheckLastError("CAM", gkFuncRefGet, result);
    }
  }

  snprintf(newPath, elcount(newPath), "%s.%s", oldPath, "pathHistory");
  GetCAMPathHistoryParams(packetHandle, value.pathHistory, newPath);
  result = CheckLastError("CAM", gkFuncRefGet, result);

  return result;
}

int SetCAMPathHistoryParams(LONG packetHandle, struct CAMPathHistory value, char oldPath[])
{
  char newPath[300];
  int i;
  int result;

  result = 0;

  C2xRemoveToken(packetHandle, "CAM", oldPath);
  for (i=0; i<value.length; i++)
  {
    snprintf(newPath, elcount(newPath), "%s[%d]", oldPath, i);
    SetCAMPathPointParams(packetHandle, value.arrayValue[i], newPath);
    result = CheckLastError("CAM", gkFuncRefSet, result);
  }

  return result;
}
int GetCAMPathHistoryParams(LONG packetHandle, struct CAMPathHistory value, char oldPath[])
{
  char newPath[300];
  int i;
  int result;

  result = 0;

  value.length = C2xGetTokenInt(packetHandle, "CAM", oldPath);
  if ((result = CheckLastError("CAM", gkFuncRefGet, result))==0)
  {
    for (i=0; i<value.length; i++)
    {
      snprintf(newPath, elcount(newPath), "%s[%d]", oldPath, i);
      GetCAMPathPointParams(packetHandle, value.arrayValue[i], newPath);
      result = CheckLastError("CAM", gkFuncRefGet, result);
    }
  }

  return result;
}

int SetCAMPathPointParams(LONG packetHandle, struct CAMPathPoint value, char oldPath[])
{
  char newPath[300];
  int result;

  result = 0;

  snprintf(newPath, elcount(newPath), "%s.%s", oldPath, "pathPosition");
  SetCAMDeltaReferencePositionParams(packetHandle, value.pathPosition, newPath);
  result = CheckLastError("CAM", gkFuncRefSet, result);

  snprintf(newPath, elcount(newPath), "%s.%s", oldPath, "pathDeltaTime");
  C2xSetTokenInt( packetHandle, "CAM", newPath, value.pathDeltaTime);
  result = CheckLastError("CAM", gkFuncRefSet, result);

  return result;
}
int GetCAMPathPointParams(LONG packetHandle, struct CAMPathPoint value, char oldPath[])
{
  char newPath[300];
  int result;

  result = 0;

  snprintf(newPath, elcount(newPath), "%s.%s", oldPath, "pathPosition");
  value.pathPosition.isValidFlag = 1;
  GetCAMDeltaReferencePositionParams(packetHandle, value.pathPosition, newPath);
  result = CheckLastError("CAM", gkFuncRefGet, result);

  snprintf(newPath, elcount(newPath), "%s.%s", oldPath, "pathDeltaTime");
  value.pathDeltaTime = C2xGetTokenInt(packetHandle, "CAM", newPath);
  result = CheckLastError("CAM", gkFuncRefGet, result);

  return result;
}

int SetCAMDeltaReferencePositionParams(LONG packetHandle, struct CAMDeltaReferencePosition value, char oldPath[])
{
  char newPath[300];
  int result;

  result = 0;

  snprintf(newPath, elcount(newPath), "%s.%s", oldPath, "deltaLatitude");
  C2xSetTokenInt( packetHandle, "CAM", newPath, value.deltaLatitude);
  result = CheckLastError("CAM", gkFuncRefSet, result);

  snprintf(newPath, elcount(newPath), "%s.%s", oldPath, "deltaLongitude");
  C2xSetTokenInt( packetHandle, "CAM", newPath, value.deltaLongitude);
  result = CheckLastError("CAM", gkFuncRefSet, result);

  snprintf(newPath, elcount(newPath), "%s.%s", oldPath, "deltaElevation");
  C2xSetTokenInt( packetHandle, "CAM", newPath, value.deltaElevation);
  result = CheckLastError("CAM", gkFuncRefSet, result);

  return result;
}
int GetCAMDeltaReferencePositionParams(LONG packetHandle, struct CAMDeltaReferencePosition value, char oldPath[])
{
  char newPath[300];
  int result;

  result = 0;

  snprintf(newPath, elcount(newPath), "%s.%s", oldPath, "deltaLatitude");
  value.deltaLatitude = C2xGetTokenInt(packetHandle, "CAM", newPath);
  result = CheckLastError("CAM", gkFuncRefGet, result);

  snprintf(newPath, elcount(newPath), "%s.%s", oldPath, "deltaLongitude");
  value.deltaLongitude = C2xGetTokenInt(packetHandle, "CAM", newPath);
  result = CheckLastError("CAM", gkFuncRefGet, result);

  snprintf(newPath, elcount(newPath), "%s.%s", oldPath, "deltaElevation");
  value.deltaElevation = C2xGetTokenInt(packetHandle, "CAM", newPath);
  result = CheckLastError("CAM", gkFuncRefGet, result);

  return result;
}


int SetCAMVehicleLengthParams(LONG packetHandle, struct CAMVehicleLength value, char oldPath[])
{
  char newPath[300];
  int result;

  result = 0;

  snprintf(newPath, elcount(newPath), "%s.%s", oldPath, "vehicleLengthValue");
  C2xSetTokenInt64( packetHandle, "CAM", newPath, value.vehicleLengthValue);
  result = CheckLastError("CAM", gkFuncRefSet, result);

  snprintf(newPath, elcount(newPath), "%s.%s", oldPath, "vehicleLengthConfidenceIndication");
  C2xSetTokenInt(packetHandle, "CAM", newPath, value.vehicleLengthConfidenceIndication);
  result = CheckLastError("CAM", gkFuncRefSet, result);

  return result;
}
int GetCAMVehicleLengthParams(LONG packetHandle, struct CAMVehicleLength value, char oldPath[])
{
  char newPath[300];
  int result;

  result = 0;

  snprintf(newPath, elcount(newPath), "%s.%s", oldPath, "vehicleLengthValue");
  value.vehicleLengthValue = C2xGetTokenInt64(packetHandle, "CAM", newPath);
  result = CheckLastError("CAM", gkFuncRefGet, result);

  snprintf(newPath, elcount(newPath), "%s.%s", oldPath, "vehicleLengthConfidenceIndication");
  value.vehicleLengthConfidenceIndication = C2xGetTokenInt(packetHandle, "CAM", newPath);
  result = CheckLastError("CAM", gkFuncRefGet, result);

  return result;
}

int SetCAMHighFrequencyContainerParams(LONG packetHandle, struct CAMHighFrequencyContainer value, char oldPath[])
{
  char newPath[300];
  int result;

  result = 0;

  if (value.choice==0)
  {
    snprintf(newPath, elcount(newPath), "%s.%s", oldPath, "basicVehicleContainerHighFrequency");
    SetCAMBasicVehicleContainerHighFrequencyParams(packetHandle, value.basicVehicleContainerHighFrequency, newPath);
    result = CheckLastError("CAM", gkFuncRefSet, result);
  }
  else if (value.choice==1)
  {
    snprintf(newPath, elcount(newPath), "%s.%s", oldPath, "emptyRSUContainerHighFrequency");
    result = CheckLastError("CAM", gkFuncRefSet, result);
  }

  return result;
}
int GetCAMHighFrequencyContainerParams(LONG packetHandle, struct CAMHighFrequencyContainer value, char oldPath[])
{
  char newPath[300];
  int result;

  result = 0;

  value.choice = C2xGetTokenInt(packetHandle, "CAM", oldPath);
  if ((result = CheckLastError("CAM", gkFuncRefGet, result))==0)
  {
    if (value.choice==0)
    {
      snprintf(newPath, elcount(newPath), "%s.%s", oldPath, "basicVehicleContainerHighFrequency");
  value.basicVehicleContainerHighFrequency.isValidFlag = 1;
      GetCAMBasicVehicleContainerHighFrequencyParams(packetHandle, value.basicVehicleContainerHighFrequency, newPath);
      result = CheckLastError("CAM", gkFuncRefGet, result);
    }
    else if (value.choice==1)
    {
      snprintf(newPath, elcount(newPath), "%s.%s", oldPath, "emptyRSUContainerHighFrequency");
      result = CheckLastError("CAM", gkFuncRefGet, result);
    }
  }

  return result;
}

int SetCAMBasicVehicleContainerHighFrequencyParams(LONG packetHandle, struct CAMBasicVehicleContainerHighFrequency value, char oldPath[])
{
  char newPath[300];
  int j;
  int result;

  result = 0;

  snprintf(newPath, elcount(newPath), "%s.%s", oldPath, "direction");
  SetCAMDirectionParams(packetHandle, value.direction, newPath);
  result = CheckLastError("CAM", gkFuncRefSet, result);

  snprintf(newPath, elcount(newPath), "%s.%s", oldPath, "movement");
  SetCAMMovementParams(packetHandle, value.movement, newPath);
  result = CheckLastError("CAM", gkFuncRefSet, result);

  snprintf(newPath, elcount(newPath), "%s.%s", oldPath, "driveDirection");
  C2xSetTokenInt(packetHandle, "CAM", newPath, value.driveDirection);
  result = CheckLastError("CAM", gkFuncRefSet, result);

  snprintf(newPath, elcount(newPath), "%s.%s", oldPath, "longitudinalAcceleration");
  SetCAMLongitudinalAccelerationParams(packetHandle, value.longitudinalAcceleration, newPath);
  result = CheckLastError("CAM", gkFuncRefSet, result);

  snprintf(newPath, elcount(newPath), "%s.%s", oldPath, "curvature");
  SetCAMCurvatureParams(packetHandle, value.curvature, newPath);
  result = CheckLastError("CAM", gkFuncRefSet, result);

  snprintf(newPath, elcount(newPath), "%s.%s", oldPath, "curvatureCalculationMode");
  C2xSetTokenInt(packetHandle, "CAM", newPath, value.curvatureCalculationMode);
  result = CheckLastError("CAM", gkFuncRefSet, result);

  snprintf(newPath, elcount(newPath), "%s.%s", oldPath, "accelerationControl");
  if (value.accelerationControl.isValidFlag==1)
  {
    for (j=0; j<value.accelerationControl.stringLength; j++)
    {
      C2xSetTokenBitOfBitString(packetHandle, "CAM", newPath, j, value.accelerationControl.string[j]);
      result = CheckLastError("CAM", gkFuncRefSet, result);
    }
  }
  else
  {
    C2xRemoveToken(packetHandle, "CAM", newPath);
    result = CheckLastError("CAM", gkFuncRefRemove, result);
  }

  snprintf(newPath, elcount(newPath), "%s.%s", oldPath, "laneNumber");
  if (value.laneNumber.isValidFlag==1)
  {
    C2xSetTokenInt( packetHandle, "CAM", newPath, value.laneNumber.value);
    result = CheckLastError("CAM", gkFuncRefSet, result);
  }
  else
  {
    C2xRemoveToken(packetHandle, "CAM", newPath);
    result = CheckLastError("CAM", gkFuncRefRemove, result);
  }

  snprintf(newPath, elcount(newPath), "%s.%s", oldPath, "steeringWheelAngle");
  if (value.steeringWheelAngle.isValidFlag==1)
  {
    C2xSetTokenInt( packetHandle, "CAM", newPath, value.steeringWheelAngle.value);
    result = CheckLastError("CAM", gkFuncRefSet, result);
  }
  else
  {
    C2xRemoveToken(packetHandle, "CAM", newPath);
    result = CheckLastError("CAM", gkFuncRefRemove, result);
  }

  snprintf(newPath, elcount(newPath), "%s.%s", oldPath, "lateralAcceleration");
  if (value.lateralAcceleration.isValidFlag==1)
  {
    C2xSetTokenInt( packetHandle, "CAM", newPath, value.lateralAcceleration.value);
    result = CheckLastError("CAM", gkFuncRefSet, result);
  }
  else
  {
    C2xRemoveToken(packetHandle, "CAM", newPath);
    result = CheckLastError("CAM", gkFuncRefRemove, result);
  }

  snprintf(newPath, elcount(newPath), "%s.%s", oldPath, "verticalAcceleration");
  if (value.verticalAcceleration.isValidFlag==1)
  {
    C2xSetTokenInt( packetHandle, "CAM", newPath, value.verticalAcceleration.value);
    result = CheckLastError("CAM", gkFuncRefSet, result);
  }
  else
  {
    C2xRemoveToken(packetHandle, "CAM", newPath);
    result = CheckLastError("CAM", gkFuncRefRemove, result);
  }

  return result;
}
int GetCAMBasicVehicleContainerHighFrequencyParams(LONG packetHandle, struct CAMBasicVehicleContainerHighFrequency value, char oldPath[])
{
  char newPath[300];
  int j;
  int result;

  result = 0;

  snprintf(newPath, elcount(newPath), "%s.%s", oldPath, "direction");
  value.direction.isValidFlag = 1;
  GetCAMDirectionParams(packetHandle, value.direction, newPath);
  result = CheckLastError("CAM", gkFuncRefGet, result);

  snprintf(newPath, elcount(newPath), "%s.%s", oldPath, "movement");
  value.movement.isValidFlag = 1;
  GetCAMMovementParams(packetHandle, value.movement, newPath);
  result = CheckLastError("CAM", gkFuncRefGet, result);

  snprintf(newPath, elcount(newPath), "%s.%s", oldPath, "driveDirection");
  value.driveDirection = C2xGetTokenInt(packetHandle, "CAM", newPath);
  result = CheckLastError("CAM", gkFuncRefGet, result);

  snprintf(newPath, elcount(newPath), "%s.%s", oldPath, "longitudinalAcceleration");
  value.longitudinalAcceleration.isValidFlag = 1;
  GetCAMLongitudinalAccelerationParams(packetHandle, value.longitudinalAcceleration, newPath);
  result = CheckLastError("CAM", gkFuncRefGet, result);

  snprintf(newPath, elcount(newPath), "%s.%s", oldPath, "curvature");
  value.curvature.isValidFlag = 1;
  GetCAMCurvatureParams(packetHandle, value.curvature, newPath);
  result = CheckLastError("CAM", gkFuncRefGet, result);

  snprintf(newPath, elcount(newPath), "%s.%s", oldPath, "curvatureCalculationMode");
  value.curvatureCalculationMode = C2xGetTokenInt(packetHandle, "CAM", newPath);
  result = CheckLastError("CAM", gkFuncRefGet, result);

  snprintf(newPath, elcount(newPath), "%s.%s", oldPath, "accelerationControl");
  value.accelerationControl.isValidFlag = C2xIsTokenAvailable(packetHandle, "CAM", newPath);
  if (value.accelerationControl.isValidFlag==1)
  {
    value.accelerationControl.stringLength = C2xGetTokenInt(packetHandle, "CAM", newPath);
    if ((result = CheckLastError("CAM", gkFuncRefGet, result))==0)
    {
      for (j=0; j<value.accelerationControl.stringLength; j++)
      {
        value.accelerationControl.string[j] = C2xGetTokenBitOfBitString(packetHandle, "CAM", newPath, j);
        result = CheckLastError("CAM", gkFuncRefGet, result);
      }
    }
  }

  snprintf(newPath, elcount(newPath), "%s.%s", oldPath, "laneNumber");
  value.laneNumber.isValidFlag = C2xIsTokenAvailable(packetHandle, "CAM", newPath);
  if (value.laneNumber.isValidFlag==1)
  {
    value.laneNumber.value = C2xGetTokenInt(packetHandle, "CAM", newPath);
    result = CheckLastError("CAM", gkFuncRefGet, result);
  }

  snprintf(newPath, elcount(newPath), "%s.%s", oldPath, "steeringWheelAngle");
  value.steeringWheelAngle.isValidFlag = C2xIsTokenAvailable(packetHandle, "CAM", newPath);
  if (value.steeringWheelAngle.isValidFlag==1)
  {
    value.steeringWheelAngle.value = C2xGetTokenInt(packetHandle, "CAM", newPath);
    result = CheckLastError("CAM", gkFuncRefGet, result);
  }

  snprintf(newPath, elcount(newPath), "%s.%s", oldPath, "lateralAcceleration");
  value.lateralAcceleration.isValidFlag = C2xIsTokenAvailable(packetHandle, "CAM", newPath);
  if (value.lateralAcceleration.isValidFlag==1)
  {
    value.lateralAcceleration.value = C2xGetTokenInt(packetHandle, "CAM", newPath);
    result = CheckLastError("CAM", gkFuncRefGet, result);
  }

  snprintf(newPath, elcount(newPath), "%s.%s", oldPath, "verticalAcceleration");
  value.verticalAcceleration.isValidFlag = C2xIsTokenAvailable(packetHandle, "CAM", newPath);
  if (value.verticalAcceleration.isValidFlag==1)
  {
    value.verticalAcceleration.value = C2xGetTokenInt(packetHandle, "CAM", newPath);
    result = CheckLastError("CAM", gkFuncRefGet, result);
  }

  return result;
}


int SetCAMCurvatureParams(LONG packetHandle, struct CAMCurvature value, char oldPath[])
{
  char newPath[300];
  int result;

  result = 0;

  snprintf(newPath, elcount(newPath), "%s.%s", oldPath, "curvatureValue");
  C2xSetTokenInt( packetHandle, "CAM", newPath, value.curvatureValue);
  result = CheckLastError("CAM", gkFuncRefSet, result);

  snprintf(newPath, elcount(newPath), "%s.%s", oldPath, "curvatureConfidence");
  C2xSetTokenInt( packetHandle, "CAM", newPath, value.curvatureConfidence);
  result = CheckLastError("CAM", gkFuncRefSet, result);

  return result;
}
int GetCAMCurvatureParams(LONG packetHandle, struct CAMCurvature value, char oldPath[])
{
  char newPath[300];
  int result;

  result = 0;

  snprintf(newPath, elcount(newPath), "%s.%s", oldPath, "curvatureValue");
  value.curvatureValue = C2xGetTokenInt(packetHandle, "CAM", newPath);
  result = CheckLastError("CAM", gkFuncRefGet, result);

  snprintf(newPath, elcount(newPath), "%s.%s", oldPath, "curvatureConfidence");
  value.curvatureConfidence = C2xGetTokenInt(packetHandle, "CAM", newPath);
  result = CheckLastError("CAM", gkFuncRefGet, result);

  return result;
}

int SetCAMLongitudinalAccelerationParams(LONG packetHandle, struct CAMLongitudinalAcceleration value, char oldPath[])
{
  char newPath[300];
  int result;

  result = 0;

  snprintf(newPath, elcount(newPath), "%s.%s", oldPath, "longitudinalAccelerationValue");
  C2xSetTokenInt( packetHandle, "CAM", newPath, value.longitudinalAccelerationValue);
  result = CheckLastError("CAM", gkFuncRefSet, result);

  snprintf(newPath, elcount(newPath), "%s.%s", oldPath, "longitudinalAccelerationConfidence");
  C2xSetTokenInt( packetHandle, "CAM", newPath, value.longitudinalAccelerationConfidence);
  result = CheckLastError("CAM", gkFuncRefSet, result);

  return result;
}
int GetCAMLongitudinalAccelerationParams(LONG packetHandle, struct CAMLongitudinalAcceleration value, char oldPath[])
{
  char newPath[300];
  int result;

  result = 0;

  snprintf(newPath, elcount(newPath), "%s.%s", oldPath, "longitudinalAccelerationValue");
  value.longitudinalAccelerationValue = C2xGetTokenInt(packetHandle, "CAM", newPath);
  result = CheckLastError("CAM", gkFuncRefGet, result);

  snprintf(newPath, elcount(newPath), "%s.%s", oldPath, "longitudinalAccelerationConfidence");
  value.longitudinalAccelerationConfidence = C2xGetTokenInt(packetHandle, "CAM", newPath);
  result = CheckLastError("CAM", gkFuncRefGet, result);

  return result;
}

int SetCAMMovementParams(LONG packetHandle, struct CAMMovement value, char oldPath[])
{
  char newPath[300];
  int result;

  result = 0;

  snprintf(newPath, elcount(newPath), "%s.%s", oldPath, "vehicleSpeed");
  C2xSetTokenInt( packetHandle, "CAM", newPath, value.vehicleSpeed);
  result = CheckLastError("CAM", gkFuncRefSet, result);

  snprintf(newPath, elcount(newPath), "%s.%s", oldPath, "vehicleSpeedConfidence");
  C2xSetTokenInt64( packetHandle, "CAM", newPath, value.vehicleSpeedConfidence);
  result = CheckLastError("CAM", gkFuncRefSet, result);

  return result;
}
int GetCAMMovementParams(LONG packetHandle, struct CAMMovement value, char oldPath[])
{
  char newPath[300];
  int result;

  result = 0;

  snprintf(newPath, elcount(newPath), "%s.%s", oldPath, "vehicleSpeed");
  value.vehicleSpeed = C2xGetTokenInt(packetHandle, "CAM", newPath);
  result = CheckLastError("CAM", gkFuncRefGet, result);

  snprintf(newPath, elcount(newPath), "%s.%s", oldPath, "vehicleSpeedConfidence");
  value.vehicleSpeedConfidence = C2xGetTokenInt64(packetHandle, "CAM", newPath);
  result = CheckLastError("CAM", gkFuncRefGet, result);

  return result;
}

int SetCAMBasicContainerParams(LONG packetHandle, struct CAMBasicContainer value, char oldPath[])
{
  char newPath[300];
  int result;

  result = 0;

  snprintf(newPath, elcount(newPath), "%s.%s", oldPath, "stationType");
  C2xSetTokenInt( packetHandle, "CAM", newPath, value.stationType);
  result = CheckLastError("CAM", gkFuncRefSet, result);

  snprintf(newPath, elcount(newPath), "%s.%s", oldPath, "referencePosition");
  SetCAMReferencePositionParams(packetHandle, value.referencePosition, newPath);
  result = CheckLastError("CAM", gkFuncRefSet, result);

  return result;
}
int GetCAMBasicContainerParams(LONG packetHandle, struct CAMBasicContainer value, char oldPath[])
{
  char newPath[300];
  int result;

  result = 0;

  snprintf(newPath, elcount(newPath), "%s.%s", oldPath, "stationType");
  value.stationType = C2xGetTokenInt(packetHandle, "CAM", newPath);
  result = CheckLastError("CAM", gkFuncRefGet, result);

  snprintf(newPath, elcount(newPath), "%s.%s", oldPath, "referencePosition");
  value.referencePosition.isValidFlag = 1;
  GetCAMReferencePositionParams(packetHandle, value.referencePosition, newPath);
  result = CheckLastError("CAM", gkFuncRefGet, result);

  return result;
}

int SetCAMReferencePositionParams(LONG packetHandle, struct CAMReferencePosition value, char oldPath[])
{
  char newPath[300];
  int result;

  result = 0;

  snprintf(newPath, elcount(newPath), "%s.%s", oldPath, "latitude");
  C2xSetTokenInt( packetHandle, "CAM", newPath, value.latitude);
  result = CheckLastError("CAM", gkFuncRefSet, result);

  snprintf(newPath, elcount(newPath), "%s.%s", oldPath, "longitude");
  C2xSetTokenInt( packetHandle, "CAM", newPath, value.longitude);
  result = CheckLastError("CAM", gkFuncRefSet, result);

  snprintf(newPath, elcount(newPath), "%s.%s", oldPath, "positionConfidenceEllipse");
  SetCAMPosConfidenceEllipseParams(packetHandle, value.positionConfidenceEllipse, newPath);
  result = CheckLastError("CAM", gkFuncRefSet, result);

  snprintf(newPath, elcount(newPath), "%s.%s", oldPath, "elevation");
  SetCAMElevationParams(packetHandle, value.elevation, newPath);
  result = CheckLastError("CAM", gkFuncRefSet, result);

  return result;
}
int GetCAMReferencePositionParams(LONG packetHandle, struct CAMReferencePosition value, char oldPath[])
{
  char newPath[300];
  int result;

  result = 0;

  snprintf(newPath, elcount(newPath), "%s.%s", oldPath, "latitude");
  value.latitude = C2xGetTokenInt(packetHandle, "CAM", newPath);
  result = CheckLastError("CAM", gkFuncRefGet, result);

  snprintf(newPath, elcount(newPath), "%s.%s", oldPath, "longitude");
  value.longitude = C2xGetTokenInt(packetHandle, "CAM", newPath);
  result = CheckLastError("CAM", gkFuncRefGet, result);

  snprintf(newPath, elcount(newPath), "%s.%s", oldPath, "positionConfidenceEllipse");
  value.positionConfidenceEllipse.isValidFlag = 1;
  GetCAMPosConfidenceEllipseParams(packetHandle, value.positionConfidenceEllipse, newPath);
  result = CheckLastError("CAM", gkFuncRefGet, result);

  snprintf(newPath, elcount(newPath), "%s.%s", oldPath, "elevation");
  value.elevation.isValidFlag = 1;
  GetCAMElevationParams(packetHandle, value.elevation, newPath);
  result = CheckLastError("CAM", gkFuncRefGet, result);

  return result;
}

int SetCAMElevationParams(LONG packetHandle, struct CAMElevation value, char oldPath[])
{
  char newPath[300];
  int result;

  result = 0;

  snprintf(newPath, elcount(newPath), "%s.%s", oldPath, "elevationValue");
  C2xSetTokenInt( packetHandle, "CAM", newPath, value.elevationValue);
  result = CheckLastError("CAM", gkFuncRefSet, result);

  snprintf(newPath, elcount(newPath), "%s.%s", oldPath, "elevationConfidence");
  C2xSetTokenInt64( packetHandle, "CAM", newPath, value.elevationConfidence);
  result = CheckLastError("CAM", gkFuncRefSet, result);

  return result;
}
int GetCAMElevationParams(LONG packetHandle, struct CAMElevation value, char oldPath[])
{
  char newPath[300];
  int result;

  result = 0;

  snprintf(newPath, elcount(newPath), "%s.%s", oldPath, "elevationValue");
  value.elevationValue = C2xGetTokenInt(packetHandle, "CAM", newPath);
  result = CheckLastError("CAM", gkFuncRefGet, result);

  snprintf(newPath, elcount(newPath), "%s.%s", oldPath, "elevationConfidence");
  value.elevationConfidence = C2xGetTokenInt64(packetHandle, "CAM", newPath);
  result = CheckLastError("CAM", gkFuncRefGet, result);

  return result;
}

int SetCAMPosConfidenceEllipseParams(LONG packetHandle, struct CAMPosConfidenceEllipse value, char oldPath[])
{
  char newPath[300];
  int result;

  result = 0;

  snprintf(newPath, elcount(newPath), "%s.%s", oldPath, "semiMajorConfidence");
  C2xSetTokenInt( packetHandle, "CAM", newPath, value.semiMajorConfidence);
  result = CheckLastError("CAM", gkFuncRefSet, result);

  snprintf(newPath, elcount(newPath), "%s.%s", oldPath, "semiMinorConfidence");
  C2xSetTokenInt( packetHandle, "CAM", newPath, value.semiMinorConfidence);
  result = CheckLastError("CAM", gkFuncRefSet, result);

  snprintf(newPath, elcount(newPath), "%s.%s", oldPath, "semiMajorOrientation");
  SetCAMDirectionParams(packetHandle, value.semiMajorOrientation, newPath);
  result = CheckLastError("CAM", gkFuncRefSet, result);

  return result;
}
int GetCAMPosConfidenceEllipseParams(LONG packetHandle, struct CAMPosConfidenceEllipse value, char oldPath[])
{
  char newPath[300];
  int result;

  result = 0;

  snprintf(newPath, elcount(newPath), "%s.%s", oldPath, "semiMajorConfidence");
  value.semiMajorConfidence = C2xGetTokenInt(packetHandle, "CAM", newPath);
  result = CheckLastError("CAM", gkFuncRefGet, result);

  snprintf(newPath, elcount(newPath), "%s.%s", oldPath, "semiMinorConfidence");
  value.semiMinorConfidence = C2xGetTokenInt(packetHandle, "CAM", newPath);
  result = CheckLastError("CAM", gkFuncRefGet, result);

  snprintf(newPath, elcount(newPath), "%s.%s", oldPath, "semiMajorOrientation");
  value.semiMajorOrientation.isValidFlag = 1;
  GetCAMDirectionParams(packetHandle, value.semiMajorOrientation, newPath);
  result = CheckLastError("CAM", gkFuncRefGet, result);

  return result;
}

int SetCAMDirectionParams(LONG packetHandle, struct CAMDirection value, char oldPath[])
{
  char newPath[300];
  int result;

  result = 0;

  snprintf(newPath, elcount(newPath), "%s.%s", oldPath, "directionValue");
  C2xSetTokenInt( packetHandle, "CAM", newPath, value.directionValue);
  result = CheckLastError("CAM", gkFuncRefSet, result);

  snprintf(newPath, elcount(newPath), "%s.%s", oldPath, "directionConfidence");
  C2xSetTokenInt64( packetHandle, "CAM", newPath, value.directionConfidence);
  result = CheckLastError("CAM", gkFuncRefSet, result);

  return result;
}
int GetCAMDirectionParams(LONG packetHandle, struct CAMDirection value, char oldPath[])
{
  char newPath[300];
  int result;

  result = 0;

  snprintf(newPath, elcount(newPath), "%s.%s", oldPath, "directionValue");
  value.directionValue = C2xGetTokenInt(packetHandle, "CAM", newPath);
  result = CheckLastError("CAM", gkFuncRefGet, result);

  snprintf(newPath, elcount(newPath), "%s.%s", oldPath, "directionConfidence");
  value.directionConfidence = C2xGetTokenInt64(packetHandle, "CAM", newPath);
  result = CheckLastError("CAM", gkFuncRefGet, result);

  return result;
}

int SetCAMItsPduHeaderParams(LONG packetHandle, struct CAMItsPduHeader value, char oldPath[])
{
  char newPath[300];
  int result;

  result = 0;

  snprintf(newPath, elcount(newPath), "%s.%s", oldPath, "protocolVersion");
  C2xSetTokenInt( packetHandle, "CAM", newPath, value.protocolVersion);
  result = CheckLastError("CAM", gkFuncRefSet, result);

  snprintf(newPath, elcount(newPath), "%s.%s", oldPath, "messageID");
  C2xSetTokenInt( packetHandle, "CAM", newPath, value.messageID);
  result = CheckLastError("CAM", gkFuncRefSet, result);

  snprintf(newPath, elcount(newPath), "%s.%s", oldPath, "stationID");
  C2xSetTokenInt64( packetHandle, "CAM", newPath, value.stationID);
  result = CheckLastError("CAM", gkFuncRefSet, result);

  return result;
}
int GetCAMItsPduHeaderParams(LONG packetHandle, struct CAMItsPduHeader value, char oldPath[])
{
  char newPath[300];
  int result;

  result = 0;

  snprintf(newPath, elcount(newPath), "%s.%s", oldPath, "protocolVersion");
  value.protocolVersion = C2xGetTokenInt(packetHandle, "CAM", newPath);
  result = CheckLastError("CAM", gkFuncRefGet, result);

  snprintf(newPath, elcount(newPath), "%s.%s", oldPath, "messageID");
  value.messageID = C2xGetTokenInt(packetHandle, "CAM", newPath);
  result = CheckLastError("CAM", gkFuncRefGet, result);

  snprintf(newPath, elcount(newPath), "%s.%s", oldPath, "stationID");
  value.stationID = C2xGetTokenInt64(packetHandle, "CAM", newPath);
  result = CheckLastError("CAM", gkFuncRefGet, result);

  return result;
}

