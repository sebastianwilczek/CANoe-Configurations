/*@@var:*/
variables
{
}
/*@@end*/

/*@@caplFunc:SetSpatMessageParams(LONG):*/
LONG SetSpatMessageParams(LONG packetHandle)
{
  LONG result;

  //nexts ASN.1 data type is ENUMERATED 
  if ((result = C2xSetTokenInt64(packetHandle, "SpatMessage", "trafficLightInfo.trafficLightState", 0)) != 0) 
  { 
    return result;
  }
  //nexts ASN.1 data type is INTEGER 
  if ((result = C2xSetTokenInt64(packetHandle, "SpatMessage", "trafficLightInfo.timeToChange", 0)) != 0) 
  { 
    return result;
  }
  //nexts ASN.1 data type is ENUMERATED 
  if ((result = C2xSetTokenInt64(packetHandle, "SpatMessage", "position.latitude.hemisphere", 0)) != 0) 
  { 
    return result;
  }
  //nexts ASN.1 data type is INTEGER 
  if ((result = C2xSetTokenInt64(packetHandle, "SpatMessage", "position.latitude.degree", 0)) != 0) 
  { 
    return result;
  }
  //nexts ASN.1 data type is ENUMERATED 
  if ((result = C2xSetTokenInt64(packetHandle, "SpatMessage", "position.longitude.hemisphere", 0)) != 0) 
  { 
    return result;
  }
  //nexts ASN.1 data type is INTEGER 
  if ((result = C2xSetTokenInt64(packetHandle, "SpatMessage", "position.longitude.degree", 0)) != 0) 
  { 
    return result;
  }
  return 0;
}
/*@@end*/

