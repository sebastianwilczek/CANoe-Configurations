includes
{
  #include "SimCar.cin"
}

/****************************************************************/
//
// SimCar includes the SimCar.cin in which the behaviour
// is implemented. This CAPL programm configures the behaviour
// of the included CAPL programm.
//
/****************************************************************/
variables
{
  // no local variables defined
}

on start
{
  StartSimCar_1();
}

/*******************************************************/
//
// call this function to start SimCar 1
//
/*******************************************************/
void StartSimCar_1 ()
{
  // configure sim car
  gDriveCourseClockwise = 0;
  gUseDisplay           = 0;   // this option can only be enabled for one CAPL programm to use the car panel
  gkCommRange           = 100; // range in meter, in which messages are passed through to application
  gSimCar_UpdPosTimer   = 400; // configures how "fast" the vehicle moves (rate in ms to read GPS pos from file)
  gkCarId               = 5;   // last BYTE of MAC Id (also used in Network Address)

  // call init and start function of included SimCar CAPL programm
  Appl_Init();
  Appl_Start();
}

on key '5'
{
	if (gVehicleIsActive == 0) {
    gVehicleIsActive = 1;
  }
  else {
    gVehicleIsActive = 0;
  }
}

