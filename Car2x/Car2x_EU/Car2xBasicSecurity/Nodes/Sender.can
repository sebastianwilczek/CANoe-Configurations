/*@!Encoding:1252*/
includes
{
  
}

variables
{
  long pktCamHdl;      // CAM message
  long pktDenmHdl;     // DENM message
  
  long certValidHdl;   // valid certificate
  long certInvalidHdl; // invalid certificate

  long shVersion ;          // either 111                or 121                         or 131
  char shPcolDesc[16] ;     // either "geo_sh"           or "geo_sh_121"                or "wssv3"
  char shPcolAttrCam[32]  ; // either "BTP-B|TSB-SHB|SH" or "BTP-B|TSB-SHB|SH_121"      or "BTP-B|TSB-SHB|WSS_V3"
  char shPcolAttrDenm[32] ; // either "BTP-A|GBC|SH"     or "BTP-A|GBC|SH_121"          or "BTP-A|GBC|WSS_V3"
}

void evalShVersion()
{
  // the configuration contains three root certificates, "Demo Root 1.3.1", "Demo Root 1.2.1", "Demo Root 1.1.1"
  // depending on the version configured in CANoe one of them is visible.
  if (C2xSecCertificateGetHandle("Vector Demo Root 1.3.1") != 0)
  {
    shVersion = 131 ;
    strncpy(shPcolDesc    , "wssv3"          , elcount(shPcolDesc    )) ;
    strncpy(shPcolAttrCam , "BTP-B|TSB-SHB|SH*", elcount(shPcolAttrCam )) ;
    strncpy(shPcolAttrDenm, "BTP-A|GBC|SH*"    , elcount(shPcolAttrDenm)) ;
    SysSetVariableString(sysvar::ShVersion, "ETSI 103 097 1.3.1") ;
  }
  else if (C2xSecCertificateGetHandle("Vector Demo Root 1.2.1") != 0)
  {
    shVersion = 121 ;
    strncpy(shPcolDesc    , "geo_sh_121"          , elcount(shPcolDesc    )) ;
    strncpy(shPcolAttrCam , "BTP-B|TSB-SHB|SH_121", elcount(shPcolAttrCam )) ;
    strncpy(shPcolAttrDenm, "BTP-A|GBC|SH_121"    , elcount(shPcolAttrDenm)) ;
    SysSetVariableString(sysvar::ShVersion, "ETSI 103 097 1.2.1") ;
  }
  else if (C2xSecCertificateGetHandle("Vector Demo Root 1.1.1") != 0)
  {
    shVersion = 111 ;
    strncpy(shPcolDesc    , "geo_sh"          , elcount(shPcolDesc    )) ;
    strncpy(shPcolAttrCam , "BTP-B|TSB-SHB|SH", elcount(shPcolAttrCam )) ;
    strncpy(shPcolAttrDenm, "BTP-A|GBC|SH"    , elcount(shPcolAttrDenm)) ;
    SysSetVariableString(sysvar::ShVersion, "ETSI 103 097 1.1.1") ;
  }
}

on start
{
  evalShVersion() ;
  
  // initialize CAM, DENM message
  pktCamHdl  = C2xInitPacket("CAM",  shPcolAttrCam );
  pktDenmHdl = C2xInitPacket("DENM", shPcolAttrDenm);
  
  // get certificates
  certValidHdl   = C2xSecCertificateGetHandle("Vector Demo ITS PC Valid");
  certInvalidHdl = C2xSecCertificateGetHandle("Vector Demo ITS PC Invalid");
}


on sysvar CAM::Send
{
  long certHdl;
  
  if (@this)
  {
    // set signer certificate and signer type
    certHdl = (@CAM::Certificate == @CAM::Certificate::Valid) ? certValidHdl : certInvalidHdl ;
    C2xSecPacketSetSignerHandle(pktCamHdl, certHdl);
    C2xSetTokenInt(pktCamHdl, shPcolDesc, "signerType", @CAM::Type);

    // set fields mandatory for CAM security profile
    switch (shVersion)
    {
    case 111:
      C2xSetTokenInt64(pktCamHdl, shPcolDesc, "generationTime", C2xConvertTimeToMSSinceUTC(C2xGetITSTimestamp(), 1)*1000); 
      C2xSetTokenInt(pktCamHdl, shPcolDesc, "securityProfile", 1);
      C2xSetTokenInt(pktCamHdl, shPcolDesc, "messageType", 2);
      break ;
    case 121:
      C2xSetTokenInt64(pktCamHdl, shPcolDesc, "generationTime", C2xConvertTimeToMSSinceUTC(C2xGetITSTimestamp(), 0)*1000); 
      C2xSetTokenInt(pktCamHdl, shPcolDesc, "itsAid", 0x24) ;
      break ;
    case 131:
      C2xSetTokenInt64(pktCamHdl, shPcolDesc, "generationTime", C2xConvertTimeToMSSinceUTC(C2xGetITSTimestamp(), 0)*1000); 
      C2xSetTokenInt(pktCamHdl, shPcolDesc, "psid", 0x24) ;
      break ;
    }
    // optional requestCertificates omitted
    
    // encode, sign and output message
    C2xCompletePacket(pktCamHdl);
    C2xOutputPacket(pktCamHdl);
  }
}


on sysvar DENM::Send
{
  long certHdl;
  
  if (@this)
  {
    // set signer certificate and signer type
    certHdl = (@DENM::Certificate == @DENM::Certificate::Valid) ? certValidHdl : certInvalidHdl ;
    C2xSecPacketSetSignerHandle(pktDenmHdl, certHdl);
    C2xSetTokenInt(pktDenmHdl, shPcolDesc, "signerType", @DENM::Type);
    
    // set fields mandatory for DENM security profile
    switch (shVersion)
    {
    case 111:
      C2xSetTokenInt64(pktDenmHdl, shPcolDesc, "generationTime", C2xConvertTimeToMSSinceUTC(C2xGetITSTimestamp(), 1)*1000); 
      C2xSetTokenInt(pktDenmHdl, shPcolDesc, "securityProfile", 2);
      C2xSetTokenInt(pktDenmHdl, shPcolDesc, "messageType", 1);
      break ;
    case 121:
      C2xSetTokenInt64(pktDenmHdl, shPcolDesc, "generationTime", C2xConvertTimeToMSSinceUTC(C2xGetITSTimestamp(), 0)*1000); 
      C2xSetTokenInt(pktDenmHdl, shPcolDesc, "itsAid", 0x25) ;
      break ;
    case 131:
      C2xSetTokenInt64(pktDenmHdl, shPcolDesc, "generationTime", C2xConvertTimeToMSSinceUTC(C2xGetITSTimestamp(), 0)*1000); 
      C2xSetTokenInt(pktDenmHdl, shPcolDesc, "psid", 0x25) ;
      break ;
    }    
    
    // encode, sign and output message
    C2xCompletePacket(pktDenmHdl);
    C2xOutputPacket(pktDenmHdl);
  }
}

