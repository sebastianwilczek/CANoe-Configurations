/*@!Encoding:1252*/
// *************************************************************************************
//
//  Constants for the C2x API functions
//
// *************************************************************************************

variables
{
  ////////////////////////////////////////
  // Register Callback
  ////////////////////////////////////////

  enum VRegisterCallback
  {
    kRxIndication    = 0,
    kPreTxIndication = 1
  };


  ////////////////////////////////////////
  // MAP API constants
  ////////////////////////////////////////

  // Figures of the CAPL-Map Drawining-API
  enum VEnumFigures { kSquare = 1, kRectangle = 2, kEllipse = 3, kCross = 4, kTriangle = 5, kLine = 6, kBitmap = 7, kText = 8 };

  // RGB color codes
  const double kWhite       = 0xFFFFFF;
  const double kTurquoise   = 0x00FFFF;
  const double kMagenta     = 0xFF00FF;
  const double kRed         = 0x0000FF;
  const double kGrey        = 0xC0C0C0;
  const double kYellow      = 0xFFFF00;
  const double kGreen       = 0x00FF00;
  const double kBlue        = 0xFF0000;
  const double kBlack       = 0x000000;
  const double kTransparent = -1;
}

////////////////////////////////////////////////////////////////////////////////
// EOF
////////////////////////////////////////////////////////////////////////////////
