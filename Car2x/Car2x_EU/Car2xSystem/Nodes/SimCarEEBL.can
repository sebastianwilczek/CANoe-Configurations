/*@!Encoding:1252*/
includes
{
  #include "SimCar.cin"
}

/****************************************************************/
// SimCar includes the SimCar.cin in which the behaviour
// is implemented. This CAPL programm configures the behaviour
// of the included CAPL programm.
/****************************************************************/
void VehicleSetup()
{
  strncpy(gGps.name, ".\\Course_logs\\SimCarEEBL.log", elcount(gGps.name)) ; // direction of car
  
  // EEBL Cause Codes
  gVehicle.causeCode = 99;
  gVehicle.subCauseCode = 1;
  
  gVehicle.mobileOrStationaryFlag = 128; // 0 = RSU, 128 = Vehicle

  gVehicle.stationId = 3;
}

int IsDenmEnabled()
{
  return @sysvar::Usecases::SendEEBLDenm ;
}

void SetAnimationState(int state)
{
  @SimCar_EEBL::AnimationState = state ;
}
