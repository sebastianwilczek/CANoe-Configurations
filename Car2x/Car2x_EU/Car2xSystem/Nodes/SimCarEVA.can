/*@!Encoding:1252*/
includes
{
  #include "SimCar.cin"
}

/****************************************************************/
// SimCar includes the SimCar.cin in which the behaviour
// is implemented. This CAPL programm configures the behaviour
// of the included CAPL programm.
/****************************************************************/
void VehicleSetup()
{
  strncpy(gGps.name, ".\\Course_logs\\SimCarEVA.log", elcount(gGps.name)) ; // direction of car
  
  // EVA Cause Code
  gVehicle.causeCode = 95;
  
  gVehicle.mobileOrStationaryFlag = 128; // 0 = RSU, 128 = Vehicle

  gVehicle.stationId = 5;
}

int IsDenmEnabled()
{
  return @sysvar::Usecases::SendEVADenm ;
}

void SetAnimationState(int state)
{
  @SimCar_EVA::AnimationState = state ;
}
