/*@!Encoding:1252*/
////////////////////////////////////////////////////////////////////////////////
//
// DUT
//
// drives a loop and shows events in the dash board
//
////////////////////////////////////////////////////////////////////////////////

includes
{
  #include "Car2xAPI.cin"
  #include "TrackLoader.cin"
  #include "Position.cin"
  #include "..\DataSources_Templates\ASNV_Template_BaseDatatypes.cin"
  #include "..\DataSources_Templates\ASNV_Template_CAM.cin"
  #include "..\DataSources_Templates\ASNV_Template_DENM.cin"
  #include "..\DataSources_Templates\ASNV_Template_MAP.cin"
  #include "..\DataSources_Templates\ASNV_Template_SPAT.cin"

  #include "PathPoints.cin"
}

variables
{
  char gErrorString[1024];

  struct Vehicle // vehicle information
  {
    struct Pos3D pos;       // position
    int64  timestampTai;    // position update milli seconds tai 2004
    struct PathPoints pathPoints; // path points
    double speed;
    double heading;
  };
  struct Vehicle gVehicle =
    {
      pos       = { 48.824735, 9.094252, 355.90 }
    };

  struct Gps
  {
    char   name[256];
    long   handle;
  };
  struct Gps gGps =
    { ".\\Course_logs\\DUT.log", 0 };

  struct ItsStation
  {
    struct Pos2D position;
    int    relevanceArea;

    int    active; // receiving SPATs|DENMs
    int    approaching;
    double distance;
    double distanceOld;
  };

  const double DistanceInfinite = 1e99;
  
  struct TrafficLight
  {
    struct ItsStation station ;
    int    state;            // 0 green, 1 yellow, 2 red (for selected intersection/signal group)
    int    timeToSwitch;     // 0.1 second units
    
    int    intersectionId;
    int    signalGroupId;
  };
  struct TrafficLight gTL =  // Traffic Light
    {
      station = { relevanceArea = 20 },
      intersectionId = 1,  // only interested in intersection 1, signal group 3 (west<->east lane)
      signalGroupId = 3
    };

  struct ItsStation gRWW;   // Road Works Warning
  
  struct ItsStation gEEBL = // Electronic Emergency Brake Light
    {
      relevanceArea = 5
    };
  struct ItsStation gEVA =  // Emergency Vehicle Approaching Warning
    {
      relevanceArea = 5
    };
  
  msTimer timerWatchdogTL;
  msTimer timerWatchdogRWW;
  msTimer timerWatchdogEEBL;
  msTimer timerWatchdogEVA;
}

////////////////////////////////////////////////////////////////////////////////
// Start / init packet, track info
////////////////////////////////////////////////////////////////////////////////
on start
{
  LONG errCode;

  C2xRegisterCallback(kRxIndication   , "OnRx");
  C2xRegisterCallback(kPreTxIndication, "OnTxCAM", "CAM") ;

  // init path points structure
  API_PathPointsInit(gVehicle.pathPoints, 6) ;
  
  // open gps route file
  gGps.handle = API_SetFilePathLogFile(gGps.name, 0); // GPS file

  DistanceReset(gTL.station);
  DistanceReset(gRWW);
  DistanceReset(gEEBL);
  DistanceReset(gEVA);
}

////////////////////////////////////////////////////////////////////////////////
// update DUT position data
////////////////////////////////////////////////////////////////////////////////
void UpdatePosition()
{
  int64 nowTai ;
  int i ;
  struct PositionData gpsPos;
  struct PathPointPos newPathPoint;

  // check if car is allowed to move (e.g. stop in front of traffic light)
  if (!gTL.station.active ||                          // not receiving SPATs
      (gTL.station.distance != 0) ||                  // traffic light is not near
      (gTL.state == 0))                                // traffic light shows green
  {
    API_StartReadingPositions(gGps.handle);

    API_GetTrackData(gGps.Handle, gpsPos) ;

    nowTai = C2xConvertTimeToMSSinceUTC(C2xGetITSTimestamp(), 0);

    API_PathPointPosAssign(newPathPoint, gVehicle.pos.latitude, gVehicle.pos.longitude, gVehicle.pos.elevation, gVehicle.timeStampTai) ;

    if (((nowTai - gVehicle.pathPoints.pos[0].timestampTai) > 1500) && // new waypoint every 1.5s and
        !API_PathPointsEqualLocation(gVehicle.pathPoints, newPathPoint))   // if position changed
    {
      API_PathPointsAdd(gVehicle.pathPoints, newPathPoint) ;
    }
  
    gVehicle.timestampTai  = nowTai;
    gVehicle.pos.latitude  = gpsPos.latitude;
    gVehicle.pos.longitude = gpsPos.longitude;
    //gVehicle.pos.elevation = gpsPos.altitude;
    gVehicle.speed         = gpsPos.speed;
    gVehicle.heading       = gpsPos.heading;
    
    DistanceUpdate(gTL.station, gVehicle.pos);
    DistanceUpdate(gRWW       , gVehicle.pos);
    DistanceUpdate(gEEBL      , gVehicle.pos);
    DistanceUpdate(gEVA       , gVehicle.pos);
    
    @sysvar::DUT::Current_lat  = gpsPos.latitude;
    @sysvar::DUT::Current_lon  = gpsPos.longitude;
    @sysvar::DUT::Current_head = gpsPos.heading;
  }
  else
  {
    API_StopReadingPositions(gGps.handle);
    
    gVehicle.timestampTai = C2xConvertTimeToMSSinceUTC(C2xGetITSTimestamp(), 0);
    gVehicle.speed = 0;
  }

  Gui_Update();
}

////////////////////////////////////////////////////////////////////////////////
//  Callback called before CAM is transmitted
////////////////////////////////////////////////////////////////////////////////
void OnTxCAM(LONG packet)
{
  struct CAM cam ;
  int   i;
  struct PathPointPos ppPos;
  byte  first = 1;
  long  errCode;

  if (first)
  {
    InitCamData(cam);
    first = 0;
  }
  else
  {
    API_GetCAMParams(packet, cam) ;
  }

  UpdatePosition() ;
  
  // update extended header data
  C2xSetTokenInt64(packet, "geo_eh", "lpvTimeStamp", gVehicle.timestampTai  & 0xffffffff) ;
  C2xSetTokenInt64(packet, "geo_eh", "lpvLatitude" , gVehicle.pos.latitude  * 1e7    ) ;
  C2xSetTokenInt64(packet, "geo_eh", "lpvLongitude", gVehicle.pos.longitude * 1e7    ) ;
  C2xSetTokenInt64(packet, "geo_eh", "lpvSpeed"    , gVehicle.speed         * 100/3.6) ;
  C2xSetTokenInt64(packet, "geo_eh", "lpvHeading"  , gVehicle.heading       * 10     ) ;

  // Update CAM data
  cam.cam.generationDeltaTime = gVehicle.timestampTai % 0xffff;
  cam.cam.camParameters.basicContainer.referencePosition.latitude = gVehicle.pos.latitude  * 1e7;
  cam.cam.camParameters.basicContainer.referencePosition.longitude = gVehicle.pos.longitude * 1e7;
  cam.cam.camParameters.basicContainer.referencePosition.positionConfidenceEllipse.semiMajorOrientation = gVehicle.heading * 10;
  cam.cam.camParameters.highFrequencyContainer.basicVehicleContainerHighFrequency.heading.headingValue = gVehicle.heading * 10;
  cam.cam.camParameters.highFrequencyContainer.basicVehicleContainerHighFrequency.speed.speedValue = gVehicle.speed * 100/3.6;

  // update path history
  cam.cam.camParameters.lowFrequencyContainer.isValidFlag = 0;
  
  if(@sysvar::DUT::SendPathPoints && gVehicle.pathPoints.count)
  {
    cam.cam.camParameters.lowFrequencyContainer.isValidFlag = 1;
    cam.cam.camParameters.lowFrequencyContainer.basicVehicleContainerLowFrequency.pathHistory.length = gVehicle.pathPoints.count;
    
    API_PathPointPosAssign(ppPos, gVehicle.pos.latitude, gVehicle.pos.longitude, gVehicle.pos.elevation, gVehicle.timestampTai);

    for (i = 0 ; i < gVehicle.pathPoints.count ; ++i)
    {
      cam.cam.camParameters.lowFrequencyContainer.basicVehicleContainerLowFrequency.pathHistory.arrayValue[i].pathPosition.deltaLatitude  = (gVehicle.pathPoints.pos[i].latitude  - ppPos.latitude ) * 1e7;
      cam.cam.camParameters.lowFrequencyContainer.basicVehicleContainerLowFrequency.pathHistory.arrayValue[i].pathPosition.deltaLongitude = (gVehicle.pathPoints.pos[i].longitude - ppPos.longitude) * 1e7;
      cam.cam.camParameters.lowFrequencyContainer.basicVehicleContainerLowFrequency.pathHistory.arrayValue[i].pathPosition.deltaAltitude  = (gVehicle.pathPoints.pos[i].elevation - ppPos.elevation) * 100;
      cam.cam.camParameters.lowFrequencyContainer.basicVehicleContainerLowFrequency.pathHistory.arrayValue[i].pathDeltaTime.isValidFlag = 1;
      cam.cam.camParameters.lowFrequencyContainer.basicVehicleContainerLowFrequency.pathHistory.arrayValue[i].pathDeltaTime.value = (ppPos.timestampTai - gVehicle.pathPoints.pos[i].timestampTai) / 10;

      API_PathPointPosAssign(ppPos, gVehicle.pathPoints.pos[i]) ;
    }
  }

  API_SetCAMParams(packet, cam) ;
}


////////////////////////////////////////////////////////////////////////////////
//  set CAM
////////////////////////////////////////////////////////////////////////////////
void InitCamData(struct CAM cam)
{
  cam.header.protocolVersion = 1;
  cam.header.messageID = 2;
  cam.header.stationID = 1 ;

  cam.cam.camParameters.basicContainer.stationType = 5;

  cam.cam.camParameters.basicContainer.referencePosition.positionConfidenceEllipse.semiMajorConfidence = 1;
  cam.cam.camParameters.basicContainer.referencePosition.positionConfidenceEllipse.semiMinorConfidence = 1;
  cam.cam.camParameters.basicContainer.referencePosition.altitude.altitudeValue = 32000;
  cam.cam.camParameters.basicContainer.referencePosition.altitude.altitudeConfidence = 1;

  cam.cam.camParameters.highFrequencyContainer.basicVehicleContainerHighFrequency.heading.headingConfidence = 1;
  cam.cam.camParameters.highFrequencyContainer.basicVehicleContainerHighFrequency.speed.speedConfidence = 1;
  cam.cam.camParameters.highFrequencyContainer.basicVehicleContainerHighFrequency.driveDirection = 0;
  cam.cam.camParameters.highFrequencyContainer.basicVehicleContainerHighFrequency.vehicleLength.vehicleLengthValue = 40;
  cam.cam.camParameters.highFrequencyContainer.basicVehicleContainerHighFrequency.vehicleLength.vehicleLengthConfidenceIndication = 0;
  cam.cam.camParameters.highFrequencyContainer.basicVehicleContainerHighFrequency.vehicleWidth = 20;
  cam.cam.camParameters.highFrequencyContainer.basicVehicleContainerHighFrequency.longitudinalAcceleration.longitudinalAccelerationValue = 0;
  cam.cam.camParameters.highFrequencyContainer.basicVehicleContainerHighFrequency.longitudinalAcceleration.longitudinalAccelerationConfidence = 1;
  cam.cam.camParameters.highFrequencyContainer.basicVehicleContainerHighFrequency.curvature.curvatureValue = 0;
  cam.cam.camParameters.highFrequencyContainer.basicVehicleContainerHighFrequency.curvature.curvatureConfidence = 1;
  cam.cam.camParameters.highFrequencyContainer.basicVehicleContainerHighFrequency.curvatureCalculationMode = 1;
}

////////////////////////////////////////////////////////////////////////////////
//  function is called when a packet is received
////////////////////////////////////////////////////////////////////////////////
void OnRx(LONG channel, LONG dir, LONG radioChannel, LONG signalStrength, LONG sigQuality, LONG packet)
{
  struct DENM denmPdu ;
  struct MAP  mapPdu ;
  struct SPAT spatPdu ;
  int    btpPort;
  
  if ((dir == RX) &&                                                  // if it is a received message
      (C2xIsTokenAvailable(packet, "btp", "destination")))            // application layer is present
  {
    switch (C2xGetTokenInt(packet, "btp", "destination"))
    {
    case 2001: // CAM
      // ignore
      break;
    case 2002: // DENM
      if (!API_GetDENMParams(packet, denmPdu))
      {
        switch (denmPdu.denm.situation.eventType.causeCode)
        {
        case  3: // roadworks
          RxRWW(packet, denmPdu);
          break;
        case 95: // emergencyVehicleApproaching
          RxEVA(packet, denmPdu);
          break;
        case 99: // dangerousSituation
          switch (denmPdu.denm.situation.eventType.subCauseCode)
          {
          case 1: // emergencyElectronicBrakeEngaged
            RxEEBL(packet, denmPdu);
            break ;
          default:
            break ;
          }
          break;
        default:
          break;
        }
      }
      break;
    case 2003: // MAP
      if (!API_GetMAPParams(packet, mapPdu))
        RxTlMAP(packet, mapPdu);
      break;
    case 2004: // SPAT
      if (!API_GetSPATParams(packet, spatPdu))
        RxTlSPAT(packet, spatPdu);
      break;
    }
  }
}

////////////////////////////////////////////////////////////////////////////////
// handle DENM from RSU RWW
////////////////////////////////////////////////////////////////////////////////
void RxRWW(long packet, struct DENM denmPdu)
{
    gRWW.relevanceArea = denmPdu.denm.management.relevanceDistance.value;

    switch(gRWW.relevanceArea)
    {
      case 0: gRWW.relevanceArea =    50; break;
      case 1: gRWW.relevanceArea =   100; break;
      case 2: gRWW.relevanceArea =   200; break;
      case 3: gRWW.relevanceArea =   500; break;
      case 4: gRWW.relevanceArea =  1000; break;
      case 5: gRWW.relevanceArea =  5000; break;
      case 6: gRWW.relevanceArea = 10000; break;
      case 7: gRWW.relevanceArea = 15000; break;
    }

    // eventposition
    gRWW.position.longitude = (double)denmPdu.denm.management.eventPosition.longitude / 1e7;
    gRWW.position.latitude  = (double)denmPdu.denm.management.eventPosition.latitude  / 1e7;

    setTimer(timerWatchdogRWW, 1500);
    gRWW.active = 1;
}

////////////////////////////////////////////////////////////////////////////////
// handle DENM from EEBL
////////////////////////////////////////////////////////////////////////////////
void RxEEBL(long packet, struct DENM denmPdu)
{
  gEEBL.position.longitude = (double)denmPdu.denm.management.eventPosition.longitude / 1e7;
  gEEBL.position.latitude  = (double)denmPdu.denm.management.eventPosition.latitude  / 1e7;

  setTimer(timerWatchdogEEBL, 1500);
  gEEBL.active = 1;
}

////////////////////////////////////////////////////////////////////////////////
// handle DENM from EVA
////////////////////////////////////////////////////////////////////////////////
void RxEVA(long packet, struct DENM denmPdu)
{
  gEVA.position.longitude = (double)denmPdu.denm.management.eventPosition.longitude / 1e7;
  gEVA.position.latitude  = (double)denmPdu.denm.management.eventPosition.latitude  / 1e7;

  setTimer(timerWatchdogEVA, 1500);
  gEVA.active = 1;
}

////////////////////////////////////////////////////////////////////////////////
// RWW watchdog timer
////////////////////////////////////////////////////////////////////////////////
on timer timerWatchdogRWW
{
  DistanceReset(gRWW);
  Gui_Update();
}

////////////////////////////////////////////////////////////////////////////////
// EEBL watchdog timer
////////////////////////////////////////////////////////////////////////////////
on timer timerWatchdogEEBL
{
  DistanceReset(gEEBL);
  Gui_Update();
}

////////////////////////////////////////////////////////////////////////////////
// EVA watchdog timer
////////////////////////////////////////////////////////////////////////////////
on timer timerWatchdogEVA
{
  DistanceReset(gEVA);
  Gui_Update();
}

////////////////////////////////////////////////////////////////////////////////
// handle MAP from RSU TL
////////////////////////////////////////////////////////////////////////////////
void RxTlMAP(long packet, struct MAP mapPdu)
{
  int64 value;
  long iIntersection;
  long found;

  found = 0;
  if (mapPdu.map.intersections.isValidFlag)
  {
    for (iIntersection = 0 ; iIntersection < mapPdu.map.intersections.length ; ++iIntersection)
    {
      found = mapPdu.map.intersections.arrayValue[iIntersection].id.id == gTL.intersectionId;
      if (found)
        break ;
    }
  }
  if (!found)
    return;

  gTL.station.position.latitude  = mapPdu.map.intersections.arrayValue[iIntersection].refPoint.lat / 1e7;
  gTL.station.position.longitude = mapPdu.map.intersections.arrayValue[iIntersection].refPoint.lon / 1e7;
}

////////////////////////////////////////////////////////////////////////////////
// handle SPAT from RSU TL
////////////////////////////////////////////////////////////////////////////////
void RxTlSPAT(long packet, struct SPAT spatPdu)
{
  long iIntersection;
  long iState;
  long found;
  int64 nowUtc; // utc 0.1 seconds since 1970

  if (gTL.station.position.latitude == 0.0) // no MAP received yet
    return;

  found = 0;
  for (iIntersection = 0 ; iIntersection < spatPdu.spat.intersections.length ; ++iIntersection)
  {
    found = spatPdu.spat.intersections.arrayValue[iIntersection].id.id == gTL.intersectionId;
    if (found)
      break ;
  }
  if (!found)
    return;

  found = 0;
  for (iState = 0 ; iState < spatPdu.spat.intersections.arrayValue[iIntersection].states.length ; ++iState)
  {
    found = spatPdu.spat.intersections.arrayValue[iIntersection].states.arrayValue[iState].signalGroup == gTL.signalGroupId ;
    if (found)
      break ;
  }
  if (!found)
    return;

  switch (spatPdu.spat.intersections.arrayValue[iIntersection].states.arrayValue[iState].state_time_speed.arrayValue[0].eventState)
  {
  default:
  case 3: // stop and remain
    gTL.state = 2;
    break;
  case 5: // permissive movement allowed
  case 6: // protected movevemnt allowed
    gTL.state = 0;
    break;
  case 4: // pre movement
  case 7: // permissive clearance
  case 8: // protected clearance
    gTL.state = 1;
    break;
  }

  if ((spatPdu.spat.intersections.arrayValue[iIntersection].states.arrayValue[iState].state_time_speed.length > 0) &&
      spatPdu.spat.intersections.arrayValue[iIntersection].states.arrayValue[iState].state_time_speed.arrayValue[0].timing.isValidFlag)
  {
    nowUtc = (C2xGetITSTimestamp() / 100) % 36000;

    gTL.timeToSwitch = spatPdu.spat.intersections.arrayValue[iIntersection].states.arrayValue[iState].state_time_speed.arrayValue[0].timing.minEndTime - nowUtc;
    if (gTL.timeToSwitch < 0)
      gTL.timeToSwitch += 36000;
    if (gTL.timeToSwitch > 18000)
      gTL.timeToSwitch = 0;
  }

  setTimer(timerWatchdogTL, 1500);
  gTL.station.active = 1;
}

////////////////////////////////////////////////////////////////////////////////
// TL watchdog timer
////////////////////////////////////////////////////////////////////////////////
on timer timerWatchdogTL
{
  DistanceReset(gTL.station);
  Gui_Update();
}

////////////////////////////////////////////////////////////////////////////////
// DistanceReset
////////////////////////////////////////////////////////////////////////////////
void DistanceReset(struct ItsStation station)
{
  station.active = 0;
  station.approaching = 0;
  station.distance = DistanceInfinite;
  station.distanceOld = DistanceInfinite;
}

////////////////////////////////////////////////////////////////////////////////
// DistanceUpdate
////////////////////////////////////////////////////////////////////////////////
void DistanceUpdate(struct ItsStation station, struct Pos3d pos)
{
  double distanceNew;
  
  if (!station.active)
    return;
  
  distanceNew = API_PosCalcDistance(station.position.latitude, station.position.longitude, pos.latitude, pos.longitude);

  if ((0.0 <= distanceNew) && (distanceNew <= DistanceInfinite))
  {
    station.distanceOld = station.distance;
    station.distance = (distanceNew > station.relevanceArea) ? distanceNew - station.relevanceArea : 0.0 ;
  }
  else
  {
    station.distanceOld = DistanceInfinite;
    station.distance    = DistanceInfinite;
  }

  if ((station.distance == 0.0) || (station.distanceOld == 0.0) || (station.distance == DistanceInfinite) || (station.distanceOld == DistanceInfinite))
    return;

  if      ((station.distanceOld - station.distance   ) / station.distance    > 0.04) station.approaching = 1;
  else if ((station.distance    - station.distanceOld) / station.distanceOld > 0.01) station.approaching = 0;

}

////////////////////////////////////////////////////////////////////////////////
// GUI
////////////////////////////////////////////////////////////////////////////////
void Gui_Update()
{
  @sysVar::DUT::Speed  = gVehicle.speed;
  
  if (gTL.station.active &&
      gTL.station.approaching)
  {
    @sysvar::DUT::DisplayState = 1;
    @sysvar::DUT::Distance     = gTL.station.distance;
    @sysvar::DUT::DistancePB   = (double)gTL.station.distance / (double)@sysVar::DUT::Horizont;
    
    @sysvar::DUT::TlState      = gTL.state; 
    @sysvar::DUT::TlTimeToChangeState = gTL.timeToSwitch/10;
    @sysvar::DUT::DistToTrafficLight = gTL.station.distance;
    
    SysSetVariableString("Usecases", "UsecaseName", "Green Light Optimal Speed Advisory");
    setPictureBoxImage  ("Head Unit Device Under Test", "pbUsecases", "\\BMP\\GLOSA.jpg");
    SetControlVisibility("Head Unit Device Under Test", "progressBarDistance", 1);
    SetControlVisibility("Head Unit Device Under Test", "stDistanceBar", 1);
    SetControlVisibility("Head Unit Device Under Test", "pbUsecases", 1);
    
    SetControlVisibility("Head Unit Device Under Test", "TL", 1);
    SetControlVisibility("Head Unit Device Under Test", "TL_TTS", 1);
    SetControlVisibility("Head Unit Device Under Test", "TL_TTS_Text", 1);
    SetControlVisibility("Head Unit Device Under Test", "pbDefault", 0);
    
    SetControlVisibility("Head Unit Device Under Test", "ioDistance", 1);
  }
  else if(gEEBL.active &&
          gEEBL.approaching)
  {
    @sysvar::DUT::DisplayState = 2;
    @sysvar::DUT::Distance     = gEEBL.distance;
    @sysvar::DUT::DistancePB   = (double)gEEBL.distance / (double)@sysVar::DUT::Horizont;

    @sysvar::DUT::TlState      = 3;
    @sysvar::DUT::TlTimeToChangeState = 0;
    @sysvar::DUT::DistToTrafficLight = 0;

    SysSetVariableString("Usecases", "UsecaseName", "Electronic Emergency Brake Light");
    setPictureBoxImage  ("Head Unit Device Under Test", "pbUsecases", "\\BMP\\EEBL.jpg");
    SetControlVisibility("Head Unit Device Under Test", "progressBarDistance", 1);
    SetControlVisibility("Head Unit Device Under Test", "stDistanceBar", 1);
    SetControlVisibility("Head Unit Device Under Test", "pbUsecases", 1);
    SetControlVisibility("Head Unit Device Under Test", "pbDefault", 0);
    
    SetControlVisibility("Head Unit Device Under Test", "TL", 0);
    SetControlVisibility("Head Unit Device Under Test", "TL_TTS", 0);
    SetControlVisibility("Head Unit Device Under Test", "TL_TTS_Text", 0);
    
    SetControlVisibility("Head Unit Device Under Test", "ioDistance", 1);    
  }
  else if (gRWW.active &&
           gRWW.approaching &&
           (gRWW.distance <= gRWW.relevanceArea)) // inside road works relevance area
  {
    @sysvar::DUT::DisplayState = 3;
    @sysvar::DUT::Distance     = gRWW.distance;
    @sysvar::DUT::DistancePB   = (double)gRWW.distance / (double)@sysVar::DUT::Horizont;

    @sysvar::DUT::TlState      = 3;
    @sysvar::DUT::TlTimeToChangeState = 0;
    @sysvar::DUT::DistToTrafficLight = 0;
    
    SysSetVariableString("Usecases", "UsecaseName", "Road Works Warning");
    setPictureBoxImage  ("Head Unit Device Under Test", "pbUsecases", "\\BMP\\RWW.jpg");
    SetControlVisibility("Head Unit Device Under Test", "progressBarDistance", 1);
    SetControlVisibility("Head Unit Device Under Test", "stDistanceBar", 1);
    SetControlVisibility("Head Unit Device Under Test", "pbUsecases", 1);
    SetControlVisibility("Head Unit Device Under Test", "pbDefault", 0);
    
    SetControlVisibility("Head Unit Device Under Test", "TL", 0);
    SetControlVisibility("Head Unit Device Under Test", "TL_TTS", 0);
    SetControlVisibility("Head Unit Device Under Test", "TL_TTS_Text", 0);
    
    SetControlVisibility("Head Unit Device Under Test", "ioDistance", 1);  
    
  }
  else if(gEVA.active &&
          gEVA.approaching || gEVA.distance < 120 &&
          !(gEVA.position.latitude > gVehicle.pos.latitude  &&  gEVA.position.longitude < gVehicle.pos.longitude)) // DUT drives in front of EVA
  {
      @sysvar::DUT::DisplayState = 4;
      @sysvar::DUT::Distance     = gEVA.distance;
      @sysvar::DUT::DistancePB   = 1 -((double)gEVA.distance / (double)@sysVar::DUT::Horizont);
      
      @sysvar::DUT::TlState      = 3;
      @sysvar::DUT::TlTimeToChangeState = 0;
      @sysvar::DUT::DistToTrafficLight = 0;
      
      SysSetVariableString("Usecases", "UsecaseName", "Emergency Vehicle Approaching");
      setPictureBoxImage  ("Head Unit Device Under Test", "pbUsecases", "\\BMP\\EVA.jpg");
      SetControlVisibility("Head Unit Device Under Test", "progressBarDistance", 1);
      SetControlVisibility("Head Unit Device Under Test", "stDistanceBar", 1);
      SetControlVisibility("Head Unit Device Under Test", "pbUsecases", 1);
      SetControlVisibility("Head Unit Device Under Test", "pbDefault", 0);
      
      SetControlVisibility("Head Unit Device Under Test", "TL", 0);
      SetControlVisibility("Head Unit Device Under Test", "TL_TTS", 0);
      SetControlVisibility("Head Unit Device Under Test", "TL_TTS_Text", 0);
      
      SetControlVisibility("Head Unit Device Under Test", "ioDistance", 1);    
  }
  else
  {
    @sysvar::DUT::DisplayState = 0;
    @sysvar::DUT::Distance     = 0; // no dist value
    @sysvar::DUT::DistancePB   = 0; // no bar

    @sysvar::DUT::TlState      = 3; // white
    @sysvar::DUT::TlTimeToChangeState = 0;
    @sysvar::DUT::DistToTrafficLight = 0;
    
    SysSetVariableString("Usecases", "UsecaseName", "");
    SetControlVisibility("Head Unit Device Under Test", "pbUsecases", 0);
    SetControlVisibility("Head Unit Device Under Test", "pbDefault", 1);
    SetControlVisibility("Head Unit Device Under Test", "progressBarDistance", 0);
    SetControlVisibility("Head Unit Device Under Test", "stDistanceBar", 0);
    SetControlVisibility("Head Unit Device Under Test", "ioDistance", 0);
    
    SetControlVisibility("Head Unit Device Under Test", "TL", 0);
    SetControlVisibility("Head Unit Device Under Test", "TL_TTS", 0);
    SetControlVisibility("Head Unit Device Under Test", "TL_TTS_Text", 0);
  }
}

////////////////////////////////////////////////////////////////////////////////
// EOF
////////////////////////////////////////////////////////////////////////////////
