/*@!Encoding:1252*/
// *************************************************************************************
//
//  Visualizes Messages (e.g. DENMs). Currently supported:
//
// *************************************************************************************

includes
{
  #include "VisualizerDUT.cin"   // device under test
}


////////////////////////////////////////////////////////////////////////////////
// EOF
////////////////////////////////////////////////////////////////////////////////
