/*@!Encoding:1252*/
includes
{
  #include "GNSS_API.cin"
}

variables
{
  int useSimulatedData = 1;   // 0: Real device like VN4610 attached. Data from this GNSS receiver is used
                              // 1: No real device attached. Simulated data is used.
}

on start
{   
  // Initialize the GNSS device
  API_Init_GNSS_Device("GNSS Device on Ath1");
}

// Used if a real device with GNSS information (e.g. VN4610) is attached 
on sysvar GNSS::Ath1
{ 
  g_gnssItem.latitude  = @GNSS::Ath1.Latitude;
  g_gnssItem.longitude = @GNSS::Ath1.Longitude;
  g_gnssItem.direction = @GNSS::Ath1.Direction;

  API_Draw_Device(g_gnssItem, @GNSS::ShowDeviceOnMap);
}

// Function implements the use of simulated data for the GNSS visualization
on sysvar DUT::Current_lat
{
  if(useSimulatedData)
  {
    g_gnssItem.latitude  = @DUT::Current_lat;
    g_gnssItem.longitude = @DUT::Current_lon;
    g_gnssItem.direction = @DUT::Current_head;

    API_Draw_Device(g_gnssItem, @GNSS::ShowDeviceOnMap);
  }
}

on sysvar GNSS::ShowDeviceOnMap
{
  API_SetVisibility_GNSS_Device(@GNSS::ShowDeviceOnMap);
}
