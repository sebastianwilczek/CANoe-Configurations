/*@!Encoding:1252*/
/*
//  (c) Vector Informatik GmbH. All rights reserved.
//
//  This file contains definitions of structs and methods that may be used
//  to set and get the values of an ASN.1 defined packet's payload.
//
//  //This example demonstrates how to set a packet's payload:
//  LONG packetHandle;
//  struct IVIM payload;
//  //you need to set the values of the variable "payload" yourself
//  packetHandle = API_InitIVIMPacket();
//  if (packetHandle!=0) {
//    if (API_SetIVIMParams(packetHandle, payload)==0) {
//      if (C2xCompletePacket(packetHandle)==0) {
//        C2xOutputPacket(packetHandle);
//      }
//    }
//  }
//                                                                             */
includes
{

}
variables
{
    struct IVIMITS_Container_ItsPduHeader {
        INT isValidFlag;   // necessary if this struct is used as an optional field of a SEQUENCE
        BYTE protocolVersion;  // INTEGER, 0..255;
        BYTE messageID;  // INTEGER, 0..255, denm(1), cam(2), poi(3), spat(4), map(5), ivi(6), ev_rsr(7), tistpgtransaction(8), srem(9), ssem(10), evcsn(11), saem(12), rtcmem(13);
        DWORD stationID;  // INTEGER, 0..4294967295;
    };
    
    struct IVIMAVIAEINumberingAndDataStructures_CountryCode {
        INT isValidFlag;   // necessary if this struct is used as an optional field of a SEQUENCE
        CHAR string[11];
        INT  stringLength;
    };
    
    struct IVIMEfcDsrcApplication_Provider {
        INT isValidFlag;   // necessary if this struct is used as an optional field of a SEQUENCE
        struct IVIMAVIAEINumberingAndDataStructures_CountryCode countryCode;  // BITSTRING;
        WORD providerIdentifier;  // INTEGER, 0..16383;
    };
    
    struct IVIMIVI_IVIManagementContainer_connectedIviStructures {
        INT isValidFlag;   // necessary if this struct is used as an optional field of a SEQUENCE
        INT length;
        WORD arrayValue[8];  // INTEGER, 1..32767;
    };
    
    struct IVIMIVI_IVIManagementContainer {
        INT isValidFlag;   // necessary if this struct is used as an optional field of a SEQUENCE
        struct IVIMEfcDsrcApplication_Provider serviceProviderId;  // SEQUENCE;
        WORD iviIdentificationNumber;  // INTEGER, 1..32767;
        struct OPT_QWORD_ASN timeStamp;  // INTEGER, OPTIONAL, 0..4398046511103, utcStartOf2004(0), oneMillisecAfterUTCStartOf2004(1);
        struct OPT_QWORD_ASN validFrom;  // INTEGER, OPTIONAL, 0..4398046511103, utcStartOf2004(0), oneMillisecAfterUTCStartOf2004(1);
        struct OPT_QWORD_ASN validTo;  // INTEGER, OPTIONAL, 0..4398046511103, utcStartOf2004(0), oneMillisecAfterUTCStartOf2004(1);
        struct IVIMIVI_IVIManagementContainer_connectedIviStructures connectedIviStructures;  // SEQUENCEOF, OPTIONAL;
        BYTE iviStatus;  // INTEGER, 0..7, new(0), update(1), cancellation(2), negation(3);
    };
    
    struct IVIMITS_Container_PosConfidenceEllipse {
        INT isValidFlag;   // necessary if this struct is used as an optional field of a SEQUENCE
        WORD semiMajorConfidence;  // INTEGER, 0..4095, oneCentimeter(1), outOfRange(4094), unavailable(4095);
        WORD semiMinorConfidence;  // INTEGER, 0..4095, oneCentimeter(1), outOfRange(4094), unavailable(4095);
        WORD semiMajorOrientation;  // INTEGER, 0..3601, wgs84North(0), wgs84East(900), wgs84South(1800), wgs84West(2700), unavailable(3601);
    };
    
    struct IVIMITS_Container_Altitude {
        INT isValidFlag;   // necessary if this struct is used as an optional field of a SEQUENCE
        LONG altitudeValue;  // INTEGER, -100000..800001, referenceEllipsoidSurface(0), oneCentimeter(1), unavailable(800001);
        INT altitudeConfidence;  // ENUMERATED, alt_000_01(0), alt_000_02(1), alt_000_05(2), alt_000_10(3), alt_000_20(4), alt_000_50(5), alt_001_00(6), alt_002_00(7), alt_005_00(8), alt_010_00(9), alt_020_00(10), alt_050_00(11), alt_100_00(12), alt_200_00(13), outOfRange(14), unavailable(15);
    };
    
    struct IVIMITS_Container_ReferencePosition {
        INT isValidFlag;   // necessary if this struct is used as an optional field of a SEQUENCE
        LONG latitude;  // INTEGER, -900000000..900000001, unavailable(900000001);
        LONG longitude;  // INTEGER, -1800000000..1800000001, unavailable(1800000001);
        struct IVIMITS_Container_PosConfidenceEllipse positionConfidenceEllipse;  // SEQUENCE;
        struct IVIMITS_Container_Altitude altitude;  // SEQUENCE;
    };
    
    struct IVIMITS_Container_Heading {
        INT isValidFlag;   // necessary if this struct is used as an optional field of a SEQUENCE
        WORD headingValue;  // INTEGER, 0..3601, wgs84North(0), wgs84East(900), wgs84South(1800), wgs84West(2700), unavailable(3601);
        BYTE headingConfidence;  // INTEGER, 1..127, equalOrWithinZeroPointOneDegree(1), equalOrWithinOneDegree(10), outOfRange(126), unavailable(127);
    };
    
    struct IVIMITS_Container_Speed {
        INT isValidFlag;   // necessary if this struct is used as an optional field of a SEQUENCE
        WORD speedValue;  // INTEGER, 0..16383, standstill(0), oneCentimeterPerSec(1), unavailable(16383);
        BYTE speedConfidence;  // INTEGER, 1..127, equalOrWithinOneCentimeterPerSec(1), equalOrWithinOneMeterPerSec(100), outOfRange(126), unavailable(127);
    };
    
    struct IVIMIVI_DeltaPosition {
        INT isValidFlag;   // necessary if this struct is used as an optional field of a SEQUENCE
        LONG deltaLatitude;  // INTEGER, -131071..131072, oneMicrodegreeNorth(10), oneMicrodegreeSouth(-10), unavailable(131072);
        LONG deltaLongitude;  // INTEGER, -131071..131072, oneMicrodegreeEast(10), oneMicrodegreeWest(-10), unavailable(131072);
    };
    
    struct IVIMIVI_PolygonalLine_deltaPositions {
        INT isValidFlag;   // necessary if this struct is used as an optional field of a SEQUENCE
        INT length;
        struct IVIMIVI_DeltaPosition arrayValue[32];  // SEQUENCE;
    };
    
    struct IVIMITS_Container_DeltaReferencePosition {
        INT isValidFlag;   // necessary if this struct is used as an optional field of a SEQUENCE
        LONG deltaLatitude;  // INTEGER, -131071..131072, oneMicrodegreeNorth(10), oneMicrodegreeSouth(-10), unavailable(131072);
        LONG deltaLongitude;  // INTEGER, -131071..131072, oneMicrodegreeEast(10), oneMicrodegreeWest(-10), unavailable(131072);
        INT deltaAltitude;  // INTEGER, -12700..12800, oneCentimeterUp(1), oneCentimeterDown(-1), unavailable(12800);
    };
    
    struct IVIMIVI_PolygonalLine_deltaPositionsWithAltitude {
        INT isValidFlag;   // necessary if this struct is used as an optional field of a SEQUENCE
        INT length;
        struct IVIMITS_Container_DeltaReferencePosition arrayValue[32];  // SEQUENCE;
    };
    
    struct IVIMIVI_AbsolutePosition {
        INT isValidFlag;   // necessary if this struct is used as an optional field of a SEQUENCE
        LONG latitude;  // INTEGER, -900000000..900000001, unavailable(900000001);
        LONG longitude;  // INTEGER, -1800000000..1800000001, unavailable(1800000001);
    };
    
    struct IVIMIVI_PolygonalLine_absolutePositions {
        INT isValidFlag;   // necessary if this struct is used as an optional field of a SEQUENCE
        INT length;
        struct IVIMIVI_AbsolutePosition arrayValue[8];  // SEQUENCE;
    };
    
    struct IVIMIVI_AbsolutePositionWAltitude {
        INT isValidFlag;   // necessary if this struct is used as an optional field of a SEQUENCE
        LONG latitude;  // INTEGER, -900000000..900000001, unavailable(900000001);
        LONG longitude;  // INTEGER, -1800000000..1800000001, unavailable(1800000001);
        struct IVIMITS_Container_Altitude altitude;  // SEQUENCE;
    };
    
    struct IVIMIVI_PolygonalLine_absolutePositionsWithAltitude {
        INT isValidFlag;   // necessary if this struct is used as an optional field of a SEQUENCE
        INT length;
        struct IVIMIVI_AbsolutePositionWAltitude arrayValue[8];  // SEQUENCE;
    };
    
    struct IVIMIVI_PolygonalLine {
        INT isValidFlag;   // necessary if this struct is used as an optional field of a SEQUENCE
        INT choice;
        struct IVIMIVI_PolygonalLine_deltaPositions deltaPositions;  // SEQUENCEOF;
        struct IVIMIVI_PolygonalLine_deltaPositionsWithAltitude deltaPositionsWithAltitude;  // SEQUENCEOF;
        struct IVIMIVI_PolygonalLine_absolutePositions absolutePositions;  // SEQUENCEOF;
        struct IVIMIVI_PolygonalLine_absolutePositionsWithAltitude absolutePositionsWithAltitude;  // SEQUENCEOF;
    };
    
    struct IVIMIVI_Segment {
        INT isValidFlag;   // necessary if this struct is used as an optional field of a SEQUENCE
        struct IVIMIVI_PolygonalLine line;  // CHOICE;
        struct OPT_WORD_ASN laneWidth;  // INTEGER, OPTIONAL, 0..1023;
    };
    
    struct IVIMIVI_ComputedSegment {
        INT isValidFlag;   // necessary if this struct is used as an optional field of a SEQUENCE
        BYTE zoneId;  // INTEGER, 1..32;
        INT laneNumber;  // INTEGER, -1..14, offTheRoad(-1), hardShoulder(0), outermostDrivingLane(1), secondLaneFromOutside(2);
        WORD laneWidth;  // INTEGER, 0..1023;
        struct OPT_INT_ASN offsetDistance;  // INTEGER, OPTIONAL, -32768..32767;
        struct IVIMITS_Container_DeltaReferencePosition offsetPosition;  // SEQUENCE, OPTIONAL;
    };
    
    struct IVIMIVI_Zone {
        INT isValidFlag;   // necessary if this struct is used as an optional field of a SEQUENCE
        INT choice;
        struct IVIMIVI_Segment segment;  // SEQUENCE;
        struct IVIMIVI_PolygonalLine area;  // CHOICE;
        struct IVIMIVI_ComputedSegment computedSegment;  // SEQUENCE;
    };
    
    struct IVIMIVI_GlcPart {
        INT isValidFlag;   // necessary if this struct is used as an optional field of a SEQUENCE
        BYTE zoneId;  // INTEGER, 1..32;
        struct OPT_INT_ASN laneNumber;  // INTEGER, OPTIONAL, -1..14, offTheRoad(-1), hardShoulder(0), outermostDrivingLane(1), secondLaneFromOutside(2);
        struct OPT_BYTE_ASN zoneExtension;  // INTEGER, OPTIONAL, 0..255;
        struct OPT_WORD_ASN zoneHeading;  // INTEGER, OPTIONAL, 0..3601, wgs84North(0), wgs84East(900), wgs84South(1800), wgs84West(2700), unavailable(3601);
        struct IVIMIVI_Zone zone;  // CHOICE, OPTIONAL;
    };
    
    struct IVIMIVI_GeographicLocationContainer_parts {
        INT isValidFlag;   // necessary if this struct is used as an optional field of a SEQUENCE
        INT length;
        struct IVIMIVI_GlcPart arrayValue[16];  // SEQUENCE;
    };
    
    struct IVIMIVI_GeographicLocationContainer {
        INT isValidFlag;   // necessary if this struct is used as an optional field of a SEQUENCE
        struct IVIMITS_Container_ReferencePosition referencePosition;  // SEQUENCE;
        struct OPT_QWORD_ASN referencePositionTime;  // INTEGER, OPTIONAL, 0..4398046511103, utcStartOf2004(0), oneMillisecAfterUTCStartOf2004(1);
        struct IVIMITS_Container_Heading referencePositionHeading;  // SEQUENCE, OPTIONAL;
        struct IVIMITS_Container_Speed referencePositionSpeed;  // SEQUENCE, OPTIONAL;
        struct IVIMIVI_GeographicLocationContainer_parts parts;  // SEQUENCEOF;
    };
    
    struct IVIMIVI_GicPart_detectionZoneIds {
        INT isValidFlag;   // necessary if this struct is used as an optional field of a SEQUENCE
        INT length;
        BYTE arrayValue[8];  // INTEGER, 1..32;
    };
    
    struct IVIMCITSapplMgmtIDs_Ext2 {
        INT isValidFlag;   // necessary if this struct is used as an optional field of a SEQUENCE
        INT choice;
        DWORD content;  // INTEGER, 16512..2113663;
        DWORD extension;  // INTEGER, 2113664..270549119;
    };
    
    struct IVIMCITSapplMgmtIDs_Ext1 {
        INT isValidFlag;   // necessary if this struct is used as an optional field of a SEQUENCE
        INT choice;
        WORD content;  // INTEGER, 128..16511;
        struct IVIMCITSapplMgmtIDs_Ext2 extension;  // CHOICE;
    };
    
    struct IVIMCITSapplMgmtIDs_VarLengthNumber {
        INT isValidFlag;   // necessary if this struct is used as an optional field of a SEQUENCE
        INT choice;
        BYTE content;  // INTEGER, 0..127;
        struct IVIMCITSapplMgmtIDs_Ext1 extension;  // CHOICE;
    };
    
    struct IVIMIVI_GicPart_relevanceZoneIds {
        INT isValidFlag;   // necessary if this struct is used as an optional field of a SEQUENCE
        INT length;
        BYTE arrayValue[8];  // INTEGER, 1..32;
    };
    
    struct IVIMIVI_GicPart_driverAwarenessZoneIds {
        INT isValidFlag;   // necessary if this struct is used as an optional field of a SEQUENCE
        INT length;
        BYTE arrayValue[8];  // INTEGER, 1..32;
    };
    
    struct IVIMIVI_GicPart_applicableLanes {
        INT isValidFlag;   // necessary if this struct is used as an optional field of a SEQUENCE
        INT length;
        INT arrayValue[8];  // INTEGER, -1..14, offTheRoad(-1), hardShoulder(0), outermostDrivingLane(1), secondLaneFromOutside(2);
    };
    
    struct IVIMElectronicRegistrationIdentificationVehicleDataModule_EuVehicleCategoryCode {
        INT isValidFlag;   // necessary if this struct is used as an optional field of a SEQUENCE
        INT choice;
        INT euVehicleCategoryL;  // ENUMERATED, l1(0), l2(1), l3(2), l4(3), l5(4), l6(5), l7(6);
        INT euVehicleCategoryM;  // ENUMERATED, m1(0), m2(1), m3(2);
        INT euVehicleCategoryN;  // ENUMERATED, n1(0), n2(1), n3(2);
        INT euVehicleCategoryO;  // ENUMERATED, o1(0), o2(1), o3(2), o4(3);
    };
    
    struct IVIMEfcDsrcApplication_EnvironmentalCharacteristics {
        INT isValidFlag;   // necessary if this struct is used as an optional field of a SEQUENCE
        INT euroValue;  // ENUMERATED, noEntry(0), euro_1(1), euro_2(2), euro_3(3), euro_4(4), euro_5(5), euro_6(6), reservedForUse1(7), reservedForUse2(8), reservedForUse3(9), reservedForUse4(10), reservedForUse5(11), reservedForUse6(12), reservedForUse7(13), reservedForUse8(14), eev(15);
        INT copValue;  // ENUMERATED, noEntry(0), co2class1(1), co2class2(2), co2class3(3), co2class4(4), co2class5(5), co2class6(6), co2class7(7), reservedforUse(8);
    };
    
    struct IVIMITS_Container_SpecialTransportType {
        INT isValidFlag;   // necessary if this struct is used as an optional field of a SEQUENCE
        CHAR string[5];
        INT  stringLength;
    };
    
    struct IVIMIVI_LoadType {
        INT isValidFlag;   // necessary if this struct is used as an optional field of a SEQUENCE
        BYTE goodsType;  // INTEGER, 0..15, ammunition(0), chemicals(1), empty(2), fuel(3), glass(4), dangerous(5), liquid(6), liveStock(7), dangerousForPeople(8), dangerousForTheEnvironment(9), dangerousForWater(10), perishableProducts(11), pharmaceutical(12), vehicles(13);
        INT dangerousGoodsType;  // ENUMERATED, explosives1(0), explosives2(1), explosives3(2), explosives4(3), explosives5(4), explosives6(5), flammableGases(6), nonFlammableGases(7), toxicGases(8), flammableLiquids(9), flammableSolids(10), substancesLiableToSpontaneousCombustion(11), substancesEmittingFlammableGasesUponContactWithWater(12), oxidizingSubstances(13), organicPeroxides(14), toxicSubstances(15), infectiousSubstances(16), radioactiveMaterial(17), corrosiveSubstances(18), miscellaneousDangerousSubstances(19);
        struct IVIMITS_Container_SpecialTransportType specialTransportType;  // BITSTRING;
    };
    
    struct IVIMIVI_VehicleCharacteristicsFixValues {
        INT isValidFlag;   // necessary if this struct is used as an optional field of a SEQUENCE
        INT choice;
        BYTE simpleVehicleType;  // INTEGER, 0..255, unknown(0), pedestrian(1), cyclist(2), moped(3), motorcycle(4), passengerCar(5), bus(6), lightTruck(7), heavyTruck(8), trailer(9), specialVehicles(10), tram(11), roadSideUnit(15);
        struct IVIMElectronicRegistrationIdentificationVehicleDataModule_EuVehicleCategoryCode euVehicleCategoryCode;  // CHOICE;
        BYTE iso3833VehicleType;  // INTEGER, 0..255, passengerCar(0), saloon(1), convertibleSaloon(2), pullmanSaloon(3), stationWagon(4), truckStationWagon(5), coupe(6), convertible(7), multipurposePassengerCar(8), forwardControlPassengerCar(9), specialPassengerCar(10), bus(11), minibus(12), urbanBus(13), interurbanCoach(14), longDistanceCoach(15), articulatedBus(16), trolleyBus(17), specialBus(18), commercialVehicle(19), specialCommercialVehicle(20), specialVehicle(21), trailingTowingVehicle(22), semiTrailerTowingVehicle(23), trailer(24), busTrailer(25), generalPurposeTrailer(26), caravan(27), specialTrailer(28), semiTrailer(29), busSemiTrailer(30), generalPurposeSemiTrailer(31), specialSemiTrailer(32), roadTrain(33), passengerRoadTrain(34), articulatedRoadTrain(35), doubleRoadTrain(36), compositeRoadTrain(37), specialRoadTrain(38), moped(39), motorCycle(40);
        struct IVIMEfcDsrcApplication_EnvironmentalCharacteristics euroAndCo2value;  // SEQUENCE;
        BYTE engineCharacteristics;  // INTEGER, 0..255, noEntry(0), noEngine(1), petrolUnleaded(2), petrolLeaded(3), diesel(4), lPG(5), battery(6), solar(7), hybrid(8), hydrogen(9);
        struct IVIMIVI_LoadType loadType;  // SEQUENCE;
        INT usage;  // ENUMERATED, default(0), publicTransport(1), specialTransport(2), dangerousGoods(3), roadWork(4), rescue(5), emergency(6), safetyCar(7), agriculture(8), commercial(9), military(10), roadOperator(11), taxi(12), reserved1(13), reserved2(14), reserved3(15);
    };
    
    struct IVIMIVI_TractorCharacteristics_equalTo {
        INT isValidFlag;   // necessary if this struct is used as an optional field of a SEQUENCE
        INT length;
        struct IVIMIVI_VehicleCharacteristicsFixValues arrayValue[4];  // CHOICE;
    };
    
    struct IVIMIVI_TractorCharacteristics_notEqualTo {
        INT isValidFlag;   // necessary if this struct is used as an optional field of a SEQUENCE
        INT length;
        struct IVIMIVI_VehicleCharacteristicsFixValues arrayValue[4];  // CHOICE;
    };
    
    struct IVIMEfcDsrcApplication_VehicleDimensions {
        INT isValidFlag;   // necessary if this struct is used as an optional field of a SEQUENCE
        BYTE vehicleLengthOverall;  // INTEGER, 0..255;
        BYTE vehicleHeigthOverall;  // INTEGER, 0..255;
        BYTE vehicleWidthOverall;  // INTEGER, 0..255;
    };
    
    struct IVIMEfcDsrcApplication_VehicleWeightLimits {
        INT isValidFlag;   // necessary if this struct is used as an optional field of a SEQUENCE
        WORD vehicleMaxLadenWeight;  // INTEGER, 0..65535;
        WORD vehicleTrainMaximumWeight;  // INTEGER, 0..65535;
        WORD vehicleWeightUnladen;  // INTEGER, 0..65535;
    };
    
    struct IVIMEfcDsrcApplication_AxleWeightLimits {
        INT isValidFlag;   // necessary if this struct is used as an optional field of a SEQUENCE
        WORD maxLadenweightOnAxle1;  // INTEGER, 0..65535;
        WORD maxLadenweightOnAxle2;  // INTEGER, 0..65535;
        WORD maxLadenweightOnAxle3;  // INTEGER, 0..65535;
        WORD maxLadenweightOnAxle4;  // INTEGER, 0..65535;
        WORD maxLadenweightOnAxle5;  // INTEGER, 0..65535;
    };
    
    struct IVIMEfcDsrcApplication_PassengerCapacity {
        INT isValidFlag;   // necessary if this struct is used as an optional field of a SEQUENCE
        BYTE numberOfSeats;  // INTEGER, 0..255;
        BYTE numberOfStandingPlaces;  // INTEGER, 0..255;
    };
    
    struct IVIMEfcDsrcApplication_ExhaustEmissionValues {
        INT isValidFlag;   // necessary if this struct is used as an optional field of a SEQUENCE
        INT unitType;  // ENUMERATED, mg_km(0), mg_kWh(1);
        WORD emissionCO;  // INTEGER, 0..32767;
        WORD emissionHC;  // INTEGER, 0..65535;
        WORD emissionNOX;  // INTEGER, 0..65535;
        WORD emissionHCNOX;  // INTEGER, 0..65535;
    };
    
    struct IVIMEfcDsrcApplication_DieselEmissionValues_particulate {
        INT isValidFlag;   // necessary if this struct is used as an optional field of a SEQUENCE
        INT unitType;  // ENUMERATED, mg_km(0), mg_kWh(1);
        WORD value;  // INTEGER, 0..32767;
    };
    
    struct IVIMEfcDsrcApplication_DieselEmissionValues {
        INT isValidFlag;   // necessary if this struct is used as an optional field of a SEQUENCE
        struct IVIMEfcDsrcApplication_DieselEmissionValues_particulate particulate;  // SEQUENCE;
        WORD absorptionCoeff;  // INTEGER, 0..65535;
    };
    
    struct IVIMEfcDsrcApplication_SoundLevel {
        INT isValidFlag;   // necessary if this struct is used as an optional field of a SEQUENCE
        BYTE soundstationary;  // INTEGER, 0..255;
        BYTE sounddriveby;  // INTEGER, 0..255;
    };
    
    struct IVIMIVI_VehicleCharacteristicsRanges_limits {
        INT isValidFlag;   // necessary if this struct is used as an optional field of a SEQUENCE
        INT choice;
        BYTE numberOfAxles;  // INTEGER, 0..7;
        struct IVIMEfcDsrcApplication_VehicleDimensions vehicleDimensions;  // SEQUENCE;
        struct IVIMEfcDsrcApplication_VehicleWeightLimits vehicleWeightLimits;  // SEQUENCE;
        struct IVIMEfcDsrcApplication_AxleWeightLimits axleWeightLimits;  // SEQUENCE;
        struct IVIMEfcDsrcApplication_PassengerCapacity passengerCapacity;  // SEQUENCE;
        struct IVIMEfcDsrcApplication_ExhaustEmissionValues exhaustEmissionValues;  // SEQUENCE;
        struct IVIMEfcDsrcApplication_DieselEmissionValues dieselEmissionValues;  // SEQUENCE;
        struct IVIMEfcDsrcApplication_SoundLevel soundLevel;  // SEQUENCE;
    };
    
    struct IVIMIVI_VehicleCharacteristicsRanges {
        INT isValidFlag;   // necessary if this struct is used as an optional field of a SEQUENCE
        BYTE comparisonOperator;  // INTEGER, 0..3, greaterThan(0), greaterThanOrEqualTo(1), lessThan(2), lessThanOrEqualTo(3);
        struct IVIMIVI_VehicleCharacteristicsRanges_limits limits;  // CHOICE;
    };
    
    struct IVIMIVI_TractorCharacteristics_ranges {
        INT isValidFlag;   // necessary if this struct is used as an optional field of a SEQUENCE
        INT length;
        struct IVIMIVI_VehicleCharacteristicsRanges arrayValue[4];  // SEQUENCE;
    };
    
    struct IVIMIVI_TractorCharacteristics {
        INT isValidFlag;   // necessary if this struct is used as an optional field of a SEQUENCE
        struct IVIMIVI_TractorCharacteristics_equalTo equalTo;  // SEQUENCEOF, OPTIONAL;
        struct IVIMIVI_TractorCharacteristics_notEqualTo notEqualTo;  // SEQUENCEOF, OPTIONAL;
        struct IVIMIVI_TractorCharacteristics_ranges ranges;  // SEQUENCEOF, OPTIONAL;
    };
    
    struct IVIMIVI_TrailerCharacteristics_equalTo {
        INT isValidFlag;   // necessary if this struct is used as an optional field of a SEQUENCE
        INT length;
        struct IVIMIVI_VehicleCharacteristicsFixValues arrayValue[4];  // CHOICE;
    };
    
    struct IVIMIVI_TrailerCharacteristics_notEqualTo {
        INT isValidFlag;   // necessary if this struct is used as an optional field of a SEQUENCE
        INT length;
        struct IVIMIVI_VehicleCharacteristicsFixValues arrayValue[4];  // CHOICE;
    };
    
    struct IVIMIVI_TrailerCharacteristics_ranges {
        INT isValidFlag;   // necessary if this struct is used as an optional field of a SEQUENCE
        INT length;
        struct IVIMIVI_VehicleCharacteristicsRanges arrayValue[4];  // SEQUENCE;
    };
    
    struct IVIMIVI_TrailerCharacteristics {
        INT isValidFlag;   // necessary if this struct is used as an optional field of a SEQUENCE
        struct IVIMIVI_TrailerCharacteristics_equalTo equalTo;  // SEQUENCEOF, OPTIONAL;
        struct IVIMIVI_TrailerCharacteristics_notEqualTo notEqualTo;  // SEQUENCEOF, OPTIONAL;
        struct IVIMIVI_TrailerCharacteristics_ranges ranges;  // SEQUENCEOF, OPTIONAL;
    };
    
    struct IVIMIVI_CompleteVehicleCharacteristics_trailer {
        INT isValidFlag;   // necessary if this struct is used as an optional field of a SEQUENCE
        INT length;
        struct IVIMIVI_TrailerCharacteristics arrayValue[3];  // SEQUENCE;
    };
    
    struct IVIMIVI_CompleteVehicleCharacteristics {
        INT isValidFlag;   // necessary if this struct is used as an optional field of a SEQUENCE
        struct IVIMIVI_TractorCharacteristics tractor;  // SEQUENCE, OPTIONAL;
        struct IVIMIVI_CompleteVehicleCharacteristics_trailer trailer;  // SEQUENCEOF, OPTIONAL;
        struct IVIMIVI_TractorCharacteristics train;  // SEQUENCE, OPTIONAL;
    };
    
    struct IVIMIVI_GicPart_vehicleCharacteristics {
        INT isValidFlag;   // necessary if this struct is used as an optional field of a SEQUENCE
        INT length;
        struct IVIMIVI_CompleteVehicleCharacteristics arrayValue[8];  // SEQUENCE;
    };
    
    struct IVIMIVI_DTM_year {
        INT isValidFlag;   // necessary if this struct is used as an optional field of a SEQUENCE
        WORD syr;  // INTEGER, 2000..2127;
        WORD eyr;  // INTEGER, 2000..2127;
    };
    
    struct IVIMIVI_MonthDay {
        INT isValidFlag;   // necessary if this struct is used as an optional field of a SEQUENCE
        BYTE month;  // INTEGER, 1..12;
        BYTE day;  // INTEGER, 1..31;
    };
    
    struct IVIMIVI_DTM_month_day {
        INT isValidFlag;   // necessary if this struct is used as an optional field of a SEQUENCE
        struct IVIMIVI_MonthDay smd;  // SEQUENCE;
        struct IVIMIVI_MonthDay emd;  // SEQUENCE;
    };
    
    struct IVIMIVI_PMD {
        INT isValidFlag;   // necessary if this struct is used as an optional field of a SEQUENCE
        CHAR string[5];
        INT  stringLength;
    };
    
    struct IVIMIVI_HoursMinutes {
        INT isValidFlag;   // necessary if this struct is used as an optional field of a SEQUENCE
        BYTE hours;  // INTEGER, 0..23;
        BYTE mins;  // INTEGER, 0..59;
    };
    
    struct IVIMIVI_DTM_hourMinutes {
        INT isValidFlag;   // necessary if this struct is used as an optional field of a SEQUENCE
        struct IVIMIVI_HoursMinutes shm;  // SEQUENCE;
        struct IVIMIVI_HoursMinutes ehm;  // SEQUENCE;
    };
    
    struct IVIMIVI_DayOfWeek {
        INT isValidFlag;   // necessary if this struct is used as an optional field of a SEQUENCE
        CHAR string[9];
        INT  stringLength;
    };
    
    struct IVIMIVI_DTM {
        INT isValidFlag;   // necessary if this struct is used as an optional field of a SEQUENCE
        struct IVIMIVI_DTM_year year;  // SEQUENCE, OPTIONAL;
        struct IVIMIVI_DTM_month_day month_day;  // SEQUENCE, OPTIONAL;
        struct IVIMIVI_PMD pmd;  // BITSTRING, OPTIONAL;
        struct IVIMIVI_DTM_hourMinutes hourMinutes;  // SEQUENCE, OPTIONAL;
        struct IVIMIVI_DayOfWeek dayOfWeek;  // BITSTRING, OPTIONAL;
        struct IVIMIVI_HoursMinutes period;  // SEQUENCE, OPTIONAL;
    };
    
    struct IVIMIVI_VcCode_validity {
        INT isValidFlag;   // necessary if this struct is used as an optional field of a SEQUENCE
        INT length;
        struct IVIMIVI_DTM arrayValue[8];  // SEQUENCE;
    };
    
    struct IVIMIVI_VcCode {
        INT isValidFlag;   // necessary if this struct is used as an optional field of a SEQUENCE
        BYTE roadSignClass;  // INTEGER, 0..7, classA(0), classB(1), classC(2), classD(3), classE(4), classF(5), classG(6), classH(7);
        BYTE roadSignCode;  // INTEGER, 1..64;
        BYTE vcOption;  // INTEGER, 0..7, none(0), a(1), b(2), c(3), d(4), e(5), f(6), g(7);
        struct IVIMIVI_VcCode_validity validity;  // SEQUENCEOF, OPTIONAL;
        struct OPT_WORD_ASN value;  // INTEGER, OPTIONAL, 0..65535;
        struct OPT_BYTE_ASN unit;  // INTEGER, OPTIONAL, 0..15, kmperh(0), milesperh(1), kilometer(2), meter(3), decimeter(4), centimeter(5), mile(6), yard(7), foot(8), minutesOfTime(9), tonnes(10), hundredkg(11), pound(12), rateOfIncline(13);
    };
    
    struct IVIMIVI_ISO14823Code_pictogramCode_countryCode {
        INT isValidFlag;   // necessary if this struct is used as an optional field of a SEQUENCE
        CHAR string[3];
        INT  stringLength;
    };
    
    struct IVIMIVI_ISO14823Code_pictogramCode_serviceCategoryCode {
        INT isValidFlag;   // necessary if this struct is used as an optional field of a SEQUENCE
        INT choice;
        INT trafficSignPictogram;  // ENUMERATED, dangerWarning(0), regulatory(1), informative(2);
        INT publicFacilitiesPictogram;  // ENUMERATED, publicFacilities(0);
        INT ambientOrRoadConditionPictogram;  // ENUMERATED, ambientCondition(0), roadCondition(1);
    };
    
    struct IVIMIVI_ISO14823Code_pictogramCode_pictogramCategoryCode {
        INT isValidFlag;   // necessary if this struct is used as an optional field of a SEQUENCE
        BYTE nature;  // INTEGER, 1..9;
        BYTE serialNumber;  // INTEGER, 0..99;
    };
    
    struct IVIMIVI_ISO14823Code_pictogramCode {
        INT isValidFlag;   // necessary if this struct is used as an optional field of a SEQUENCE
        struct IVIMIVI_ISO14823Code_pictogramCode_countryCode countryCode;  // OCTETSTRING, OPTIONAL;
        struct IVIMIVI_ISO14823Code_pictogramCode_serviceCategoryCode serviceCategoryCode;  // CHOICE;
        struct IVIMIVI_ISO14823Code_pictogramCode_pictogramCategoryCode pictogramCategoryCode;  // SEQUENCE;
    };
    
    struct IVIMIVI_Distance {
        INT isValidFlag;   // necessary if this struct is used as an optional field of a SEQUENCE
        WORD value;  // INTEGER, 1..16384;
        BYTE unit;  // INTEGER, 2..8, kilometer(2), meter(3), decimeter(4), centimeter(5), mile(6), yard(7), foot(8);
    };
    
    struct IVIMIVI_Weight {
        INT isValidFlag;   // necessary if this struct is used as an optional field of a SEQUENCE
        WORD value;  // INTEGER, 1..16384;
        BYTE unit;  // INTEGER, 10..12, tonnes(10), hundredkg(11), pound(12);
    };
    
    struct IVIMIVI_VED {
        INT isValidFlag;   // necessary if this struct is used as an optional field of a SEQUENCE
        struct IVIMIVI_Distance hei;  // SEQUENCE, OPTIONAL;
        struct IVIMIVI_Distance wid;  // SEQUENCE, OPTIONAL;
        struct IVIMIVI_Distance vln;  // SEQUENCE, OPTIONAL;
        struct IVIMIVI_Weight wei;  // SEQUENCE, OPTIONAL;
    };
    
    struct IVIMIVI_SPE {
        INT isValidFlag;   // necessary if this struct is used as an optional field of a SEQUENCE
        struct OPT_BYTE_ASN spm;  // INTEGER, OPTIONAL, 0..250;
        struct OPT_BYTE_ASN mns;  // INTEGER, OPTIONAL, 0..250;
        BYTE unit;  // INTEGER, 0..1, kmperh(0), milesperh(1);
    };
    
    struct IVIMIVI_ISO14823Code {
        INT isValidFlag;   // necessary if this struct is used as an optional field of a SEQUENCE
        struct IVIMIVI_ISO14823Code_pictogramCode pictogramCode;  // SEQUENCE;
        //struct IVIMIVI_ISO14823Attributes attributes;  // SEQUENCEOF, OPTIONAL;
    };
    
    struct IVIMIVI_DestinationPlace_depBlob {
        INT isValidFlag;   // necessary if this struct is used as an optional field of a SEQUENCE
        CHAR string[256];
        INT  stringLength;
    };
    
    struct IVIMIVI_DestinationPlace_plnText {
        INT isValidFlag;   // necessary if this struct is used as an optional field of a SEQUENCE
        CHAR string[256];
        INT  stringLength;
    };
    
    struct IVIMIVI_DestinationPlace {
        INT isValidFlag;   // necessary if this struct is used as an optional field of a SEQUENCE
        BYTE depType;  // INTEGER, 0..15, none(0), importantArea(1), principalArea(2), generalArea(3), wellKnownPoint(4), country(5), city(6), street(7), industrialArea(8), historicArea(9), touristicArea(10), culturalArea(11), touristicRoute(12), recommendedRoute(13), touristicAttraction(14), geographicArea(15);
        struct IVIMIVI_ISO14823Code depRSCode;  // SEQUENCE, OPTIONAL;
        struct IVIMIVI_DestinationPlace_depBlob depBlob;  // OCTETSTRING, OPTIONAL;
        struct OPT_WORD_ASN plnId;  // INTEGER, OPTIONAL, 1..999;
        struct IVIMIVI_DestinationPlace_plnText plnText;  // UTF8STRING, OPTIONAL;
    };
    
    struct IVIMIVI_DDD_IO_dp {
        INT isValidFlag;   // necessary if this struct is used as an optional field of a SEQUENCE
        INT length;
        struct IVIMIVI_DestinationPlace arrayValue[4];  // SEQUENCE;
    };
    
    struct IVIMIVI_DestinationRoad_ronText {
        INT isValidFlag;   // necessary if this struct is used as an optional field of a SEQUENCE
        CHAR string[256];
        INT  stringLength;
    };
    
    struct IVIMIVI_DestinationRoad {
        INT isValidFlag;   // necessary if this struct is used as an optional field of a SEQUENCE
        BYTE derType;  // INTEGER, 0..15, none(0), nationalHighway(1), localHighway(2), tollExpresswayMotorway(3), internationalHighway(4), highway(5), expressway(6), nationalRoad(7), regionalProvincialRoad(8), localRoad(9), motorwayJunction(10), diversion(11), rfu1(12), rfu2(13), rfu3(14), rfu4(15);
        struct OPT_WORD_ASN ronId;  // INTEGER, OPTIONAL, 1..999;
        struct IVIMIVI_DestinationRoad_ronText ronText;  // UTF8STRING, OPTIONAL;
    };
    
    struct IVIMIVI_DDD_IO_dr {
        INT isValidFlag;   // necessary if this struct is used as an optional field of a SEQUENCE
        INT length;
        struct IVIMIVI_DestinationRoad arrayValue[4];  // SEQUENCE;
    };
    
    struct IVIMIVI_DDD_IO_stnText {
        INT isValidFlag;   // necessary if this struct is used as an optional field of a SEQUENCE
        CHAR string[256];
        INT  stringLength;
    };
    
    struct IVIMIVI_DistanceOrDuration {
        INT isValidFlag;   // necessary if this struct is used as an optional field of a SEQUENCE
        WORD value;  // INTEGER, 1..16384;
        BYTE unit;  // INTEGER, 2..9, kilometer(2), meter(3), decimeter(4), centimeter(5), mile(6), yard(7), foot(8), minutesOfTime(9);
    };
    
    struct IVIMIVI_DDD_IO {
        INT isValidFlag;   // necessary if this struct is used as an optional field of a SEQUENCE
        BYTE drn;  // INTEGER, 0..7;
        struct IVIMIVI_DDD_IO_dp dp;  // SEQUENCEOF, OPTIONAL;
        struct IVIMIVI_DDD_IO_dr dr;  // SEQUENCEOF, OPTIONAL;
        struct OPT_WORD_ASN rne;  // INTEGER, OPTIONAL, 1..999;
        struct OPT_WORD_ASN stnId;  // INTEGER, OPTIONAL, 1..999;
        struct IVIMIVI_DDD_IO_stnText stnText;  // UTF8STRING, OPTIONAL;
        struct IVIMIVI_DistanceOrDuration dcp;  // SEQUENCE, OPTIONAL;
        struct IVIMIVI_DistanceOrDuration ddp;  // SEQUENCE, OPTIONAL;
    };
    
    struct IVIMIVI_DDD_ioList {
        INT isValidFlag;   // necessary if this struct is used as an optional field of a SEQUENCE
        INT length;
        struct IVIMIVI_DDD_IO arrayValue[8];  // SEQUENCE;
    };
    
    struct IVIMIVI_DDD {
        INT isValidFlag;   // necessary if this struct is used as an optional field of a SEQUENCE
        struct OPT_BYTE_ASN dcj;  // INTEGER, OPTIONAL, 1..128;
        struct OPT_BYTE_ASN dcr;  // INTEGER, OPTIONAL, 1..128;
        struct OPT_BYTE_ASN tpl;  // INTEGER, OPTIONAL, 1..128;
        struct IVIMIVI_DDD_ioList ioList;  // SEQUENCEOF;
    };
    
    struct IVIMIVI_ISO14823Attributes_ {
        INT isValidFlag;   // necessary if this struct is used as an optional field of a SEQUENCE
        INT choice;
        struct IVIMIVI_DTM dtm;  // SEQUENCE;
        struct IVIMIVI_DTM edt;  // SEQUENCE;
        BYTE dfl;  // INTEGER, 1..8, sDL(1), sLT(2), sRT(3), lTO(4), rTO(5), cLL(6), cRI(7), oVL(8);
        struct IVIMIVI_VED ved;  // SEQUENCE;
        struct IVIMIVI_SPE spe;  // SEQUENCE;
        BYTE roi;  // INTEGER, 1..32;
        struct IVIMIVI_Distance dbv;  // SEQUENCE;
        struct IVIMIVI_DDD ddd;  // SEQUENCE;
    };
    
    struct IVIMIVI_ISO14823Attributes {
        INT isValidFlag;   // necessary if this struct is used as an optional field of a SEQUENCE
        INT length;
        struct IVIMIVI_ISO14823Attributes_ arrayValue[8];  // CHOICE;
    };
    
    struct IVIMIVI_AnyCatalogue {
        INT isValidFlag;   // necessary if this struct is used as an optional field of a SEQUENCE
        struct IVIMEfcDsrcApplication_Provider owner;  // SEQUENCE;
        BYTE version;  // INTEGER, 0..255;
        WORD pictogramCode;  // INTEGER, 0..65535;
        struct OPT_WORD_ASN value;  // INTEGER, OPTIONAL, 0..65535;
        struct OPT_BYTE_ASN unit;  // INTEGER, OPTIONAL, 0..15, kmperh(0), milesperh(1), kilometer(2), meter(3), decimeter(4), centimeter(5), mile(6), yard(7), foot(8), minutesOfTime(9), tonnes(10), hundredkg(11), pound(12), rateOfIncline(13);
        struct IVIMIVI_ISO14823Attributes attributes;  // SEQUENCEOF, OPTIONAL;
    };
    
    struct IVIMIVI_RSCode_code {
        INT isValidFlag;   // necessary if this struct is used as an optional field of a SEQUENCE
        INT choice;
        struct IVIMIVI_VcCode viennaConvention;  // SEQUENCE;
        struct IVIMIVI_ISO14823Code iso14823;  // SEQUENCE;
        WORD itisCodes;  // INTEGER, 0..65535;
        struct IVIMIVI_AnyCatalogue anyCatalogue;  // SEQUENCE;
    };
    
    struct IVIMIVI_RSCode {
        INT isValidFlag;   // necessary if this struct is used as an optional field of a SEQUENCE
        struct OPT_BYTE_ASN layoutComponentId;  // INTEGER, OPTIONAL, 1..4;
        struct IVIMIVI_RSCode_code code;  // CHOICE;
    };
    
    struct IVIMIVI_GicPart_roadSignCodes {
        INT isValidFlag;   // necessary if this struct is used as an optional field of a SEQUENCE
        INT length;
        struct IVIMIVI_RSCode arrayValue[4];  // SEQUENCE;
    };
    
    struct IVIMIVI_Text_language {
        INT isValidFlag;   // necessary if this struct is used as an optional field of a SEQUENCE
        CHAR string[11];
        INT  stringLength;
    };
    
    struct IVIMIVI_Text_textContent {
        INT isValidFlag;   // necessary if this struct is used as an optional field of a SEQUENCE
        CHAR string[256];
        INT  stringLength;
    };
    
    struct IVIMIVI_Text {
        INT isValidFlag;   // necessary if this struct is used as an optional field of a SEQUENCE
        struct OPT_BYTE_ASN layoutComponentId;  // INTEGER, OPTIONAL, 1..4;
        struct IVIMIVI_Text_language language;  // BITSTRING;
        struct IVIMIVI_Text_textContent textContent;  // UTF8STRING;
    };
    
    struct IVIMIVI_GicPart_extraText {
        INT isValidFlag;   // necessary if this struct is used as an optional field of a SEQUENCE
        INT length;
        struct IVIMIVI_Text arrayValue[4];  // SEQUENCE;
    };
    
    struct IVIMIVI_GicPart {
        INT isValidFlag;   // necessary if this struct is used as an optional field of a SEQUENCE
        struct IVIMIVI_GicPart_detectionZoneIds detectionZoneIds;  // SEQUENCEOF, OPTIONAL;
        struct IVIMCITSapplMgmtIDs_VarLengthNumber its_Rrid;  // CHOICE, OPTIONAL;
        struct IVIMIVI_GicPart_relevanceZoneIds relevanceZoneIds;  // SEQUENCEOF, OPTIONAL;
        struct OPT_BYTE_ASN direction;  // INTEGER, OPTIONAL, 0..3, sameDirection(0), oppositeDirection(1), bothDirections(2), valueNotUsed(3);
        struct IVIMIVI_GicPart_driverAwarenessZoneIds driverAwarenessZoneIds;  // SEQUENCEOF, OPTIONAL;
        struct OPT_BYTE_ASN minimumAwarenessTime;  // INTEGER, OPTIONAL, 0..255;
        struct IVIMIVI_GicPart_applicableLanes applicableLanes;  // SEQUENCEOF, OPTIONAL;
        BYTE iviType;  // INTEGER, 0..7, immediateDangerWarningMessages(0), regulatoryMessages(1), trafficRelatedInformationMessages(2), pollutionMessages(3), notTrafficRelatedInformationMessages(4);
        struct OPT_BYTE_ASN iviPurpose;  // INTEGER, OPTIONAL, 0..3, safety(0), environmental(1), trafficOptimisation(2);
        struct OPT_BYTE_ASN laneStatus;  // INTEGER, OPTIONAL, 0..7, open(0), closed(1), mergeR(2), mergeL(3), mergeLR(4), provisionallyOpen(5), diverging(6);
        struct IVIMIVI_GicPart_vehicleCharacteristics vehicleCharacteristics;  // SEQUENCEOF, OPTIONAL;
        struct OPT_BYTE_ASN driverCharacteristics;  // INTEGER, OPTIONAL, 0..3, unexperiencedDrivers(0), experiencedDrivers(1), rfu1(2), rfu2(3);
        struct OPT_BYTE_ASN layoutId;  // INTEGER, OPTIONAL, 1..4;
        struct OPT_BYTE_ASN preStoredlayoutId;  // INTEGER, OPTIONAL, 1..64;
        struct IVIMIVI_GicPart_roadSignCodes roadSignCodes;  // SEQUENCEOF;
        struct IVIMIVI_GicPart_extraText extraText;  // SEQUENCEOF, OPTIONAL;
    };
    
    struct IVIMIVI_GeneralIviContainer {
        INT isValidFlag;   // necessary if this struct is used as an optional field of a SEQUENCE
        INT length;
        struct IVIMIVI_GicPart arrayValue[16];  // SEQUENCE;
    };
    
    struct IVIMIVI_RccPart_zoneIds {
        INT isValidFlag;   // necessary if this struct is used as an optional field of a SEQUENCE
        INT length;
        BYTE arrayValue[8];  // INTEGER, 1..32;
    };
    
    struct IVIMIVI_LaneInformation {
        INT isValidFlag;   // necessary if this struct is used as an optional field of a SEQUENCE
        INT laneNumber;  // INTEGER, -1..14, offTheRoad(-1), hardShoulder(0), outermostDrivingLane(1), secondLaneFromOutside(2);
        BYTE direction;  // INTEGER, 0..3, sameDirection(0), oppositeDirection(1), bothDirections(2), valueNotUsed(3);
        struct IVIMIVI_DTM validity;  // SEQUENCE, OPTIONAL;
        BYTE laneType;  // INTEGER, 0..31, traffic(0), through(1), reversible(2), acceleration(3), deceleration(4), leftHandTurning(5), rightHandTurning(6), dedicatedVehicle(7), bus(8), taxi(9), hov(10), hot(11), pedestrian(12), bikeLane(13), median(14), striping(15), trackedVehicle(16), parking(17), emergency(18), verge(19);
        struct IVIMIVI_CompleteVehicleCharacteristics laneTypeQualifier;  // SEQUENCE, OPTIONAL;
        BYTE laneStatus;  // INTEGER, 0..7, open(0), closed(1), mergeR(2), mergeL(3), mergeLR(4), provisionallyOpen(5), diverging(6);
        struct OPT_WORD_ASN laneWidth;  // INTEGER, OPTIONAL, 0..1023;
    };
    
    struct IVIMIVI_RccPart_laneConfiguration {
        INT isValidFlag;   // necessary if this struct is used as an optional field of a SEQUENCE
        INT length;
        struct IVIMIVI_LaneInformation arrayValue[16];  // SEQUENCE;
    };
    
    struct IVIMIVI_RccPart {
        INT isValidFlag;   // necessary if this struct is used as an optional field of a SEQUENCE
        struct IVIMIVI_RccPart_zoneIds zoneIds;  // SEQUENCEOF;
        INT roadType;  // ENUMERATED, urban_NoStructuralSeparationToOppositeLanes(0), urban_WithStructuralSeparationToOppositeLanes(1), nonUrban_NoStructuralSeparationToOppositeLanes(2), nonUrban_WithStructuralSeparationToOppositeLanes(3);
        struct IVIMIVI_RccPart_laneConfiguration laneConfiguration;  // SEQUENCEOF;
    };
    
    struct IVIMIVI_RoadConfigurationContainer {
        INT isValidFlag;   // necessary if this struct is used as an optional field of a SEQUENCE
        INT length;
        struct IVIMIVI_RccPart arrayValue[16];  // SEQUENCE;
    };
    
    struct IVIMIVI_TcPart_detectionZoneIds {
        INT isValidFlag;   // necessary if this struct is used as an optional field of a SEQUENCE
        INT length;
        BYTE arrayValue[8];  // INTEGER, 1..32;
    };
    
    struct IVIMIVI_TcPart_relevanceZoneIds {
        INT isValidFlag;   // necessary if this struct is used as an optional field of a SEQUENCE
        INT length;
        BYTE arrayValue[8];  // INTEGER, 1..32;
    };
    
    struct IVIMIVI_TcPart_driverAwarenessZoneIds {
        INT isValidFlag;   // necessary if this struct is used as an optional field of a SEQUENCE
        INT length;
        BYTE arrayValue[8];  // INTEGER, 1..32;
    };
    
    struct IVIMIVI_TcPart_applicableLanes {
        INT isValidFlag;   // necessary if this struct is used as an optional field of a SEQUENCE
        INT length;
        INT arrayValue[8];  // INTEGER, -1..14, offTheRoad(-1), hardShoulder(0), outermostDrivingLane(1), secondLaneFromOutside(2);
    };
    
    struct IVIMIVI_TcPart_text {
        INT isValidFlag;   // necessary if this struct is used as an optional field of a SEQUENCE
        INT length;
        struct IVIMIVI_Text arrayValue[4];  // SEQUENCE;
    };
    
    struct IVIMIVI_TcPart_data {
        INT isValidFlag;   // necessary if this struct is used as an optional field of a SEQUENCE
        CHAR string[256];
        INT  stringLength;
    };
    
    struct IVIMIVI_TcPart {
        INT isValidFlag;   // necessary if this struct is used as an optional field of a SEQUENCE
        struct IVIMIVI_TcPart_detectionZoneIds detectionZoneIds;  // SEQUENCEOF, OPTIONAL;
        struct IVIMIVI_TcPart_relevanceZoneIds relevanceZoneIds;  // SEQUENCEOF;
        struct OPT_BYTE_ASN direction;  // INTEGER, OPTIONAL, 0..3, sameDirection(0), oppositeDirection(1), bothDirections(2), valueNotUsed(3);
        struct IVIMIVI_TcPart_driverAwarenessZoneIds driverAwarenessZoneIds;  // SEQUENCEOF, OPTIONAL;
        struct OPT_BYTE_ASN minimumAwarenessTime;  // INTEGER, OPTIONAL, 0..255;
        struct IVIMIVI_TcPart_applicableLanes applicableLanes;  // SEQUENCEOF, OPTIONAL;
        struct OPT_BYTE_ASN layoutId;  // INTEGER, OPTIONAL, 1..4;
        struct OPT_BYTE_ASN preStoredlayoutId;  // INTEGER, OPTIONAL, 1..64;
        struct IVIMIVI_TcPart_text text;  // SEQUENCEOF, OPTIONAL;
        struct IVIMIVI_TcPart_data data;  // OCTETSTRING;
    };
    
    struct IVIMIVI_TextContainer {
        INT isValidFlag;   // necessary if this struct is used as an optional field of a SEQUENCE
        INT length;
        struct IVIMIVI_TcPart arrayValue[16];  // SEQUENCE;
    };
    
    struct IVIMIVI_LayoutComponent {
        INT isValidFlag;   // necessary if this struct is used as an optional field of a SEQUENCE
        BYTE layoutComponentId;  // INTEGER, 1..8;
        BYTE height;  // INTEGER, 10..73;
        WORD width;  // INTEGER, 10..265;
        WORD x;  // INTEGER, 10..265;
        BYTE y;  // INTEGER, 10..73;
        BYTE textScripting;  // INTEGER, 0..1, horizontal(0), vertical(1);
    };
    
    struct IVIMIVI_LayoutContainer_layoutComponents {
        INT isValidFlag;   // necessary if this struct is used as an optional field of a SEQUENCE
        INT length;
        struct IVIMIVI_LayoutComponent arrayValue[4];  // SEQUENCE;
    };
    
    struct IVIMIVI_LayoutContainer {
        INT isValidFlag;   // necessary if this struct is used as an optional field of a SEQUENCE
        BYTE layoutId;  // INTEGER, 1..4;
        struct OPT_BYTE_ASN height;  // INTEGER, OPTIONAL, 10..73;
        struct OPT_WORD_ASN width;  // INTEGER, OPTIONAL, 10..265;
        struct IVIMIVI_LayoutContainer_layoutComponents layoutComponents;  // SEQUENCEOF;
    };
    
    struct IVIMIVI_IviContainer {
        INT isValidFlag;   // necessary if this struct is used as an optional field of a SEQUENCE
        INT choice;
        struct IVIMIVI_GeographicLocationContainer glc;  // SEQUENCE;
        struct IVIMIVI_GeneralIviContainer giv;  // SEQUENCEOF;
        struct IVIMIVI_RoadConfigurationContainer rcc;  // SEQUENCEOF;
        struct IVIMIVI_TextContainer tc;  // SEQUENCEOF;
        struct IVIMIVI_LayoutContainer lac;  // SEQUENCE;
    };
    
    struct IVIMIVI_IviStructure_optional {
        INT isValidFlag;   // necessary if this struct is used as an optional field of a SEQUENCE
        INT length;
        struct IVIMIVI_IviContainer arrayValue[8];  // CHOICE;
    };
    
    struct IVIMIVI_IviStructure {
        INT isValidFlag;   // necessary if this struct is used as an optional field of a SEQUENCE
        struct IVIMIVI_IVIManagementContainer mandatory;  // SEQUENCE;
        struct IVIMIVI_IviStructure_optional optional;  // SEQUENCEOF, OPTIONAL;
    };
    
    struct IVIM {
        INT isValidFlag;   // necessary if this struct is used as an optional field of a SEQUENCE
        struct IVIMITS_Container_ItsPduHeader header;  // SEQUENCE;
        struct IVIMIVI_IviStructure ivi;  // SEQUENCE;
    };
    
}

/*
// init function to create a simple packet handle
*/ 
LONG API_InitIVIMPacket()
{
  return C2xInitPacket("IVIM"); 
}

/*
// init function to create a simple packet handle and
// initialize the struct with valid data
*/ 
LONG API_InitIVIMPacket(struct IVIM msgStruct)
{
  long pktHandle;

  pktHandle = API_InitIVIMPacket();

  if (pktHandle != 0)
  {
    // create valid message and application data
    if (C2xCompletePacket(pktHandle) == 0) 
    {
      API_GetIVIMParams(pktHandle, msgStruct);
    }
  }
  return pktHandle;
}

/*
// init function to create a packet with security layer and
// initialize the struct with valid data
*/ 
LONG API_InitIVIMPacket(struct IVIM msgStruct, char packetTypeDesignator[], char certificateName[])
{
  long pktHandle, certHdl;

  // initialize the packet
  pktHandle = C2xInitPacket("IVIM", packetTypeDesignator);

  if (pktHandle != 0)
  {
    certHdl = C2xSecCertificateGetHandle(certificateName);  // get the certificate handle for the cert with name "certificateName"
    if (certHdl != 0) 
    {
      C2xSecPacketSetSignerHandle(pktHandle, certHdl); // set the certHdl to the packet
    }

    // create valid message and application data
    if (C2xCompletePacket(pktHandle) == 0) 
    {
      // copy application data to the application structure
      API_GetIVIMParams(pktHandle, msgStruct);
    }
  }
  return pktHandle;
}
    

int GetIVIMITS_Container_ItsPduHeaderParams(LONG packetHandle, struct IVIMITS_Container_ItsPduHeader value, char oldPath[])
{
  char newPath[300];
  int result;

  result = 0;

  snprintf(newPath, elcount(newPath), "%s.%s", oldPath, "protocolVersion");
  value.protocolVersion = C2xGetTokenInt(packetHandle, "IVIM", newPath);
  result = CheckLastError("IVIM", gkFuncRefGet, result);

  snprintf(newPath, elcount(newPath), "%s.%s", oldPath, "messageID");
  value.messageID = C2xGetTokenInt(packetHandle, "IVIM", newPath);
  result = CheckLastError("IVIM", gkFuncRefGet, result);

  snprintf(newPath, elcount(newPath), "%s.%s", oldPath, "stationID");
  value.stationID = C2xGetTokenInt64(packetHandle, "IVIM", newPath);
  result = CheckLastError("IVIM", gkFuncRefGet, result);

  return result;
}

int SetIVIMITS_Container_ItsPduHeaderParams(LONG packetHandle, struct IVIMITS_Container_ItsPduHeader value, char oldPath[])
{
  char newPath[300];
  int result;

  result = 0;

  snprintf(newPath, elcount(newPath), "%s.%s", oldPath, "protocolVersion");
  C2xSetTokenInt(packetHandle, "IVIM", newPath, value.protocolVersion);
  result = CheckLastError("IVIM", gkFuncRefGet, result);

  snprintf(newPath, elcount(newPath), "%s.%s", oldPath, "messageID");
  C2xSetTokenInt(packetHandle, "IVIM", newPath, value.messageID);
  result = CheckLastError("IVIM", gkFuncRefGet, result);

  snprintf(newPath, elcount(newPath), "%s.%s", oldPath, "stationID");
  C2xSetTokenInt64(packetHandle, "IVIM", newPath, value.stationID);
  result = CheckLastError("IVIM", gkFuncRefGet, result);

  return result;
}

int GetIVIMEfcDsrcApplication_ProviderParams(LONG packetHandle, struct IVIMEfcDsrcApplication_Provider value, char oldPath[])
{
  char newPath[300]; 
  int j; 
  int k;
  int result;

  result = 0;

  snprintf(newPath, elcount(newPath), "%s.%s", oldPath, "countryCode");
  value.countryCode.isValidFlag = 1;
  value.countryCode.stringLength = C2xGetTokenLengthBit(packetHandle, "IVIM", newPath);
  if ((result = CheckLastError("IVIM", gkFuncRefGet, result))==0)
  {
    if(value.countryCode.stringLength > 0)
    {
      for(j=0; j<value.countryCode.stringLength; j++)
      {
        if(C2xGetTokenBitOfBitString(packetHandle, "IVIM", newPath, j) == 0)
        {
          value.countryCode.string[j] = '0';
        }
        else if(C2xGetTokenBitOfBitString(packetHandle, "IVIM", newPath, j) == 1)
        {
          value.countryCode.string[j] = '1';
        }

        if(value.countryCode.stringLength == 1)
        {
          value.countryCode.string[1] = '0';
        }
        result = CheckLastError("IVIM", gkFuncRefGet, result);
      }
    }
    else
    {
      for(k = value.countryCode.stringLength+1; k > -1; k--)
      {
        if(value.countryCode.string[k] == '1')
        {
          value.countryCode.string[k] = '0';
        }
      }
    }
  }

  snprintf(newPath, elcount(newPath), "%s.%s", oldPath, "providerIdentifier");
  value.providerIdentifier = C2xGetTokenInt(packetHandle, "IVIM", newPath);
  result = CheckLastError("IVIM", gkFuncRefGet, result);

  return result;
}

int SetIVIMEfcDsrcApplication_ProviderParams(LONG packetHandle, struct IVIMEfcDsrcApplication_Provider value, char oldPath[])
{
  char newPath[300]; 
  int j;
  int result;

  result = 0;

  snprintf(newPath, elcount(newPath), "%s.%s", oldPath, "countryCode");
    for(j=0; j<value.countryCode.stringLength; j++)
    {
      if(value.countryCode.string[j] == '0')
      {
        C2xSetTokenBitOfBitString(packetHandle, "IVIM", newPath, j, 0);
      }
      else
      {
        C2xSetTokenBitOfBitString(packetHandle, "IVIM", newPath, j, 1);
      }
      result = CheckLastError("IVIM", gkFuncRefGet, result);
    }

  snprintf(newPath, elcount(newPath), "%s.%s", oldPath, "providerIdentifier");
  C2xSetTokenInt(packetHandle, "IVIM", newPath, value.providerIdentifier);
  result = CheckLastError("IVIM", gkFuncRefGet, result);

  return result;
}

int GetIVIMIVI_IVIManagementContainer_connectedIviStructuresParams(LONG packetHandle, struct IVIMIVI_IVIManagementContainer_connectedIviStructures value, char oldPath[])
{
  char newPath[300]; 
  int i;
  int result;

  result = 0;

  value.length = C2xGetTokenInt(packetHandle, "IVIM", oldPath);
  if((result = CheckLastError("IVIM", gkFuncRefGet, result))==0)
  {
    for(i=0; i<value.length; i++)
    {
      snprintf(newPath, elcount(newPath), "%s[%d]", oldPath, i);
      value.arrayValue[i] = C2xGetTokenInt64(packetHandle, "IVIM", newPath);
      result = CheckLastError("IVIM", gkFuncRefGet, result);
    }
  }
  return result;
}

int SetIVIMIVI_IVIManagementContainer_connectedIviStructuresParams(LONG packetHandle, struct IVIMIVI_IVIManagementContainer_connectedIviStructures value, char oldPath[])
{
  char newPath[300]; 
  int i;
  int result;

  result = 0;

  C2xRemoveToken(packetHandle, "IVIM", oldPath);
  for(i=0; i<value.length; i++)
  {
    snprintf(newPath, elcount(newPath), "%s[%d]", oldPath, i);
    C2xSetTokenInt64(packetHandle, "IVIM", newPath, value.arrayValue[i]);
    result = CheckLastError("IVIM", gkFuncRefGet, result);
  }
  return result;
}

int GetIVIMIVI_IVIManagementContainerParams(LONG packetHandle, struct IVIMIVI_IVIManagementContainer value, char oldPath[])
{
  char newPath[300];
  int result;

  result = 0;

  snprintf(newPath, elcount(newPath), "%s.%s", oldPath, "serviceProviderId");
  GetIVIMEfcDsrcApplication_ProviderParams(packetHandle, value.serviceProviderId, newPath);
  result = CheckLastError("IVIM", gkFuncRefGet, result);

  snprintf(newPath, elcount(newPath), "%s.%s", oldPath, "iviIdentificationNumber");
  value.iviIdentificationNumber = C2xGetTokenInt(packetHandle, "IVIM", newPath);
  result = CheckLastError("IVIM", gkFuncRefGet, result);

  snprintf(newPath, elcount(newPath), "%s.%s", oldPath, "timeStamp");
  value.timeStamp.isValidFlag = C2xIsTokenAvailable(packetHandle, "IVIM", newPath);
  if(value.timeStamp.isValidFlag==1)
  {
    value.timeStamp.value = C2xGetTokenInt64(packetHandle, "IVIM", newPath);
    result = CheckLastError("IVIM", gkFuncRefGet, result);
  }
  snprintf(newPath, elcount(newPath), "%s.%s", oldPath, "validFrom");
  value.validFrom.isValidFlag = C2xIsTokenAvailable(packetHandle, "IVIM", newPath);
  if(value.validFrom.isValidFlag==1)
  {
    value.validFrom.value = C2xGetTokenInt64(packetHandle, "IVIM", newPath);
    result = CheckLastError("IVIM", gkFuncRefGet, result);
  }
  snprintf(newPath, elcount(newPath), "%s.%s", oldPath, "validTo");
  value.validTo.isValidFlag = C2xIsTokenAvailable(packetHandle, "IVIM", newPath);
  if(value.validTo.isValidFlag==1)
  {
    value.validTo.value = C2xGetTokenInt64(packetHandle, "IVIM", newPath);
    result = CheckLastError("IVIM", gkFuncRefGet, result);
  }
  snprintf(newPath, elcount(newPath), "%s.%s", oldPath, "connectedIviStructures");
  value.connectedIviStructures.isValidFlag = C2xIsTokenAvailable(packetHandle, "IVIM", newPath);
  if(value.connectedIviStructures.isValidFlag==1)
  {
    GetIVIMIVI_IVIManagementContainer_connectedIviStructuresParams(packetHandle, value.connectedIviStructures, newPath);
    result = CheckLastError("IVIM", gkFuncRefGet, result);
  }
  snprintf(newPath, elcount(newPath), "%s.%s", oldPath, "iviStatus");
  value.iviStatus = C2xGetTokenInt(packetHandle, "IVIM", newPath);
  result = CheckLastError("IVIM", gkFuncRefGet, result);

  return result;
}

int SetIVIMIVI_IVIManagementContainerParams(LONG packetHandle, struct IVIMIVI_IVIManagementContainer value, char oldPath[])
{
  char newPath[300];
  int result;

  result = 0;

  snprintf(newPath, elcount(newPath), "%s.%s", oldPath, "serviceProviderId");
  SetIVIMEfcDsrcApplication_ProviderParams(packetHandle, value.serviceProviderId, newPath);
  result = CheckLastError("IVIM", gkFuncRefGet, result);

  snprintf(newPath, elcount(newPath), "%s.%s", oldPath, "iviIdentificationNumber");
  C2xSetTokenInt(packetHandle, "IVIM", newPath, value.iviIdentificationNumber);
  result = CheckLastError("IVIM", gkFuncRefGet, result);

  snprintf(newPath, elcount(newPath), "%s.%s", oldPath, "timeStamp");
  if(value.timeStamp.isValidFlag==1)
  {
    C2xSetTokenInt64(packetHandle, "IVIM", newPath, value.timeStamp.value);
    result = CheckLastError("IVIM", gkFuncRefGet, result);
  }
  else
  {
    if( C2xIsTokenAvailable(packetHandle, "IVIM", newPath) )
    {
      C2xRemoveToken(packetHandle, "IVIM", newPath);
    }
  }

  snprintf(newPath, elcount(newPath), "%s.%s", oldPath, "validFrom");
  if(value.validFrom.isValidFlag==1)
  {
    C2xSetTokenInt64(packetHandle, "IVIM", newPath, value.validFrom.value);
    result = CheckLastError("IVIM", gkFuncRefGet, result);
  }
  else
  {
    if( C2xIsTokenAvailable(packetHandle, "IVIM", newPath) )
    {
      C2xRemoveToken(packetHandle, "IVIM", newPath);
    }
  }

  snprintf(newPath, elcount(newPath), "%s.%s", oldPath, "validTo");
  if(value.validTo.isValidFlag==1)
  {
    C2xSetTokenInt64(packetHandle, "IVIM", newPath, value.validTo.value);
    result = CheckLastError("IVIM", gkFuncRefGet, result);
  }
  else
  {
    if( C2xIsTokenAvailable(packetHandle, "IVIM", newPath) )
    {
      C2xRemoveToken(packetHandle, "IVIM", newPath);
    }
  }

  snprintf(newPath, elcount(newPath), "%s.%s", oldPath, "connectedIviStructures");
  if(value.connectedIviStructures.isValidFlag==1)
  {
    SetIVIMIVI_IVIManagementContainer_connectedIviStructuresParams(packetHandle, value.connectedIviStructures, newPath);
    result = CheckLastError("IVIM", gkFuncRefGet, result);
  }
  else
  {
    if( C2xIsTokenAvailable(packetHandle, "IVIM", newPath) )
    {
      C2xRemoveToken(packetHandle, "IVIM", newPath);
    }
  }

  snprintf(newPath, elcount(newPath), "%s.%s", oldPath, "iviStatus");
  C2xSetTokenInt(packetHandle, "IVIM", newPath, value.iviStatus);
  result = CheckLastError("IVIM", gkFuncRefGet, result);

  return result;
}

int GetIVIMITS_Container_PosConfidenceEllipseParams(LONG packetHandle, struct IVIMITS_Container_PosConfidenceEllipse value, char oldPath[])
{
  char newPath[300];
  int result;

  result = 0;

  snprintf(newPath, elcount(newPath), "%s.%s", oldPath, "semiMajorConfidence");
  value.semiMajorConfidence = C2xGetTokenInt(packetHandle, "IVIM", newPath);
  result = CheckLastError("IVIM", gkFuncRefGet, result);

  snprintf(newPath, elcount(newPath), "%s.%s", oldPath, "semiMinorConfidence");
  value.semiMinorConfidence = C2xGetTokenInt(packetHandle, "IVIM", newPath);
  result = CheckLastError("IVIM", gkFuncRefGet, result);

  snprintf(newPath, elcount(newPath), "%s.%s", oldPath, "semiMajorOrientation");
  value.semiMajorOrientation = C2xGetTokenInt(packetHandle, "IVIM", newPath);
  result = CheckLastError("IVIM", gkFuncRefGet, result);

  return result;
}

int SetIVIMITS_Container_PosConfidenceEllipseParams(LONG packetHandle, struct IVIMITS_Container_PosConfidenceEllipse value, char oldPath[])
{
  char newPath[300];
  int result;

  result = 0;

  snprintf(newPath, elcount(newPath), "%s.%s", oldPath, "semiMajorConfidence");
  C2xSetTokenInt(packetHandle, "IVIM", newPath, value.semiMajorConfidence);
  result = CheckLastError("IVIM", gkFuncRefGet, result);

  snprintf(newPath, elcount(newPath), "%s.%s", oldPath, "semiMinorConfidence");
  C2xSetTokenInt(packetHandle, "IVIM", newPath, value.semiMinorConfidence);
  result = CheckLastError("IVIM", gkFuncRefGet, result);

  snprintf(newPath, elcount(newPath), "%s.%s", oldPath, "semiMajorOrientation");
  C2xSetTokenInt(packetHandle, "IVIM", newPath, value.semiMajorOrientation);
  result = CheckLastError("IVIM", gkFuncRefGet, result);

  return result;
}

int GetIVIMITS_Container_AltitudeParams(LONG packetHandle, struct IVIMITS_Container_Altitude value, char oldPath[])
{
  char newPath[300];
  int result;

  result = 0;

  snprintf(newPath, elcount(newPath), "%s.%s", oldPath, "altitudeValue");
  value.altitudeValue = C2xGetTokenInt(packetHandle, "IVIM", newPath);
  result = CheckLastError("IVIM", gkFuncRefGet, result);

  snprintf(newPath, elcount(newPath), "%s.%s", oldPath, "altitudeConfidence");
  value.altitudeConfidence = C2xGetTokenInt(packetHandle, "IVIM", newPath);
  result = CheckLastError("IVIM", gkFuncRefGet, result);

  return result;
}

int SetIVIMITS_Container_AltitudeParams(LONG packetHandle, struct IVIMITS_Container_Altitude value, char oldPath[])
{
  char newPath[300];
  int result;

  result = 0;

  snprintf(newPath, elcount(newPath), "%s.%s", oldPath, "altitudeValue");
  C2xSetTokenInt(packetHandle, "IVIM", newPath, value.altitudeValue);
  result = CheckLastError("IVIM", gkFuncRefGet, result);

  snprintf(newPath, elcount(newPath), "%s.%s", oldPath, "altitudeConfidence");
  C2xSetTokenInt(packetHandle, "IVIM", newPath, value.altitudeConfidence);
  result = CheckLastError("IVIM", gkFuncRefGet, result);

  return result;
}

int GetIVIMITS_Container_ReferencePositionParams(LONG packetHandle, struct IVIMITS_Container_ReferencePosition value, char oldPath[])
{
  char newPath[300];
  int result;

  result = 0;

  snprintf(newPath, elcount(newPath), "%s.%s", oldPath, "latitude");
  value.latitude = C2xGetTokenInt(packetHandle, "IVIM", newPath);
  result = CheckLastError("IVIM", gkFuncRefGet, result);

  snprintf(newPath, elcount(newPath), "%s.%s", oldPath, "longitude");
  value.longitude = C2xGetTokenInt(packetHandle, "IVIM", newPath);
  result = CheckLastError("IVIM", gkFuncRefGet, result);

  snprintf(newPath, elcount(newPath), "%s.%s", oldPath, "positionConfidenceEllipse");
  GetIVIMITS_Container_PosConfidenceEllipseParams(packetHandle, value.positionConfidenceEllipse, newPath);
  result = CheckLastError("IVIM", gkFuncRefGet, result);

  snprintf(newPath, elcount(newPath), "%s.%s", oldPath, "altitude");
  GetIVIMITS_Container_AltitudeParams(packetHandle, value.altitude, newPath);
  result = CheckLastError("IVIM", gkFuncRefGet, result);

  return result;
}

int SetIVIMITS_Container_ReferencePositionParams(LONG packetHandle, struct IVIMITS_Container_ReferencePosition value, char oldPath[])
{
  char newPath[300];
  int result;

  result = 0;

  snprintf(newPath, elcount(newPath), "%s.%s", oldPath, "latitude");
  C2xSetTokenInt(packetHandle, "IVIM", newPath, value.latitude);
  result = CheckLastError("IVIM", gkFuncRefGet, result);

  snprintf(newPath, elcount(newPath), "%s.%s", oldPath, "longitude");
  C2xSetTokenInt(packetHandle, "IVIM", newPath, value.longitude);
  result = CheckLastError("IVIM", gkFuncRefGet, result);

  snprintf(newPath, elcount(newPath), "%s.%s", oldPath, "positionConfidenceEllipse");
  SetIVIMITS_Container_PosConfidenceEllipseParams(packetHandle, value.positionConfidenceEllipse, newPath);
  result = CheckLastError("IVIM", gkFuncRefGet, result);

  snprintf(newPath, elcount(newPath), "%s.%s", oldPath, "altitude");
  SetIVIMITS_Container_AltitudeParams(packetHandle, value.altitude, newPath);
  result = CheckLastError("IVIM", gkFuncRefGet, result);

  return result;
}

int GetIVIMITS_Container_HeadingParams(LONG packetHandle, struct IVIMITS_Container_Heading value, char oldPath[])
{
  char newPath[300];
  int result;

  result = 0;

  snprintf(newPath, elcount(newPath), "%s.%s", oldPath, "headingValue");
  value.headingValue = C2xGetTokenInt(packetHandle, "IVIM", newPath);
  result = CheckLastError("IVIM", gkFuncRefGet, result);

  snprintf(newPath, elcount(newPath), "%s.%s", oldPath, "headingConfidence");
  value.headingConfidence = C2xGetTokenInt(packetHandle, "IVIM", newPath);
  result = CheckLastError("IVIM", gkFuncRefGet, result);

  return result;
}

int SetIVIMITS_Container_HeadingParams(LONG packetHandle, struct IVIMITS_Container_Heading value, char oldPath[])
{
  char newPath[300];
  int result;

  result = 0;

  snprintf(newPath, elcount(newPath), "%s.%s", oldPath, "headingValue");
  C2xSetTokenInt(packetHandle, "IVIM", newPath, value.headingValue);
  result = CheckLastError("IVIM", gkFuncRefGet, result);

  snprintf(newPath, elcount(newPath), "%s.%s", oldPath, "headingConfidence");
  C2xSetTokenInt(packetHandle, "IVIM", newPath, value.headingConfidence);
  result = CheckLastError("IVIM", gkFuncRefGet, result);

  return result;
}

int GetIVIMITS_Container_SpeedParams(LONG packetHandle, struct IVIMITS_Container_Speed value, char oldPath[])
{
  char newPath[300];
  int result;

  result = 0;

  snprintf(newPath, elcount(newPath), "%s.%s", oldPath, "speedValue");
  value.speedValue = C2xGetTokenInt(packetHandle, "IVIM", newPath);
  result = CheckLastError("IVIM", gkFuncRefGet, result);

  snprintf(newPath, elcount(newPath), "%s.%s", oldPath, "speedConfidence");
  value.speedConfidence = C2xGetTokenInt(packetHandle, "IVIM", newPath);
  result = CheckLastError("IVIM", gkFuncRefGet, result);

  return result;
}

int SetIVIMITS_Container_SpeedParams(LONG packetHandle, struct IVIMITS_Container_Speed value, char oldPath[])
{
  char newPath[300];
  int result;

  result = 0;

  snprintf(newPath, elcount(newPath), "%s.%s", oldPath, "speedValue");
  C2xSetTokenInt(packetHandle, "IVIM", newPath, value.speedValue);
  result = CheckLastError("IVIM", gkFuncRefGet, result);

  snprintf(newPath, elcount(newPath), "%s.%s", oldPath, "speedConfidence");
  C2xSetTokenInt(packetHandle, "IVIM", newPath, value.speedConfidence);
  result = CheckLastError("IVIM", gkFuncRefGet, result);

  return result;
}

int GetIVIMIVI_DeltaPositionParams(LONG packetHandle, struct IVIMIVI_DeltaPosition value, char oldPath[])
{
  char newPath[300];
  int result;

  result = 0;

  snprintf(newPath, elcount(newPath), "%s.%s", oldPath, "deltaLatitude");
  value.deltaLatitude = C2xGetTokenInt(packetHandle, "IVIM", newPath);
  result = CheckLastError("IVIM", gkFuncRefGet, result);

  snprintf(newPath, elcount(newPath), "%s.%s", oldPath, "deltaLongitude");
  value.deltaLongitude = C2xGetTokenInt(packetHandle, "IVIM", newPath);
  result = CheckLastError("IVIM", gkFuncRefGet, result);

  return result;
}

int SetIVIMIVI_DeltaPositionParams(LONG packetHandle, struct IVIMIVI_DeltaPosition value, char oldPath[])
{
  char newPath[300];
  int result;

  result = 0;

  snprintf(newPath, elcount(newPath), "%s.%s", oldPath, "deltaLatitude");
  C2xSetTokenInt(packetHandle, "IVIM", newPath, value.deltaLatitude);
  result = CheckLastError("IVIM", gkFuncRefGet, result);

  snprintf(newPath, elcount(newPath), "%s.%s", oldPath, "deltaLongitude");
  C2xSetTokenInt(packetHandle, "IVIM", newPath, value.deltaLongitude);
  result = CheckLastError("IVIM", gkFuncRefGet, result);

  return result;
}

int GetIVIMIVI_PolygonalLine_deltaPositionsParams(LONG packetHandle, struct IVIMIVI_PolygonalLine_deltaPositions value, char oldPath[])
{
  char newPath[300]; 
  int i;
  int result;

  result = 0;

  value.length = C2xGetTokenInt(packetHandle, "IVIM", oldPath);
  if((result = CheckLastError("IVIM", gkFuncRefGet, result))==0)
  {
    for(i=0; i<value.length; i++)
    {
      snprintf(newPath, elcount(newPath), "%s[%d]", oldPath, i);
      GetIVIMIVI_DeltaPositionParams(packetHandle, value.arrayValue[i], newPath);
      result = CheckLastError("IVIM", gkFuncRefGet, result);
    }
  }
  return result;
}

int SetIVIMIVI_PolygonalLine_deltaPositionsParams(LONG packetHandle, struct IVIMIVI_PolygonalLine_deltaPositions value, char oldPath[])
{
  char newPath[300]; 
  int i;
  int result;

  result = 0;

  C2xRemoveToken(packetHandle, "IVIM", oldPath);
  for(i=0; i<value.length; i++)
  {
    snprintf(newPath, elcount(newPath), "%s[%d]", oldPath, i);
    SetIVIMIVI_DeltaPositionParams(packetHandle, value.arrayValue[i], newPath);
    result = CheckLastError("IVIM", gkFuncRefGet, result);
  }
  return result;
}

int GetIVIMITS_Container_DeltaReferencePositionParams(LONG packetHandle, struct IVIMITS_Container_DeltaReferencePosition value, char oldPath[])
{
  char newPath[300];
  int result;

  result = 0;

  snprintf(newPath, elcount(newPath), "%s.%s", oldPath, "deltaLatitude");
  value.deltaLatitude = C2xGetTokenInt(packetHandle, "IVIM", newPath);
  result = CheckLastError("IVIM", gkFuncRefGet, result);

  snprintf(newPath, elcount(newPath), "%s.%s", oldPath, "deltaLongitude");
  value.deltaLongitude = C2xGetTokenInt(packetHandle, "IVIM", newPath);
  result = CheckLastError("IVIM", gkFuncRefGet, result);

  snprintf(newPath, elcount(newPath), "%s.%s", oldPath, "deltaAltitude");
  value.deltaAltitude = C2xGetTokenInt(packetHandle, "IVIM", newPath);
  result = CheckLastError("IVIM", gkFuncRefGet, result);

  return result;
}

int SetIVIMITS_Container_DeltaReferencePositionParams(LONG packetHandle, struct IVIMITS_Container_DeltaReferencePosition value, char oldPath[])
{
  char newPath[300];
  int result;

  result = 0;

  snprintf(newPath, elcount(newPath), "%s.%s", oldPath, "deltaLatitude");
  C2xSetTokenInt(packetHandle, "IVIM", newPath, value.deltaLatitude);
  result = CheckLastError("IVIM", gkFuncRefGet, result);

  snprintf(newPath, elcount(newPath), "%s.%s", oldPath, "deltaLongitude");
  C2xSetTokenInt(packetHandle, "IVIM", newPath, value.deltaLongitude);
  result = CheckLastError("IVIM", gkFuncRefGet, result);

  snprintf(newPath, elcount(newPath), "%s.%s", oldPath, "deltaAltitude");
  C2xSetTokenInt(packetHandle, "IVIM", newPath, value.deltaAltitude);
  result = CheckLastError("IVIM", gkFuncRefGet, result);

  return result;
}

int GetIVIMIVI_PolygonalLine_deltaPositionsWithAltitudeParams(LONG packetHandle, struct IVIMIVI_PolygonalLine_deltaPositionsWithAltitude value, char oldPath[])
{
  char newPath[300]; 
  int i;
  int result;

  result = 0;

  value.length = C2xGetTokenInt(packetHandle, "IVIM", oldPath);
  if((result = CheckLastError("IVIM", gkFuncRefGet, result))==0)
  {
    for(i=0; i<value.length; i++)
    {
      snprintf(newPath, elcount(newPath), "%s[%d]", oldPath, i);
      GetIVIMITS_Container_DeltaReferencePositionParams(packetHandle, value.arrayValue[i], newPath);
      result = CheckLastError("IVIM", gkFuncRefGet, result);
    }
  }
  return result;
}

int SetIVIMIVI_PolygonalLine_deltaPositionsWithAltitudeParams(LONG packetHandle, struct IVIMIVI_PolygonalLine_deltaPositionsWithAltitude value, char oldPath[])
{
  char newPath[300]; 
  int i;
  int result;

  result = 0;

  C2xRemoveToken(packetHandle, "IVIM", oldPath);
  for(i=0; i<value.length; i++)
  {
    snprintf(newPath, elcount(newPath), "%s[%d]", oldPath, i);
    SetIVIMITS_Container_DeltaReferencePositionParams(packetHandle, value.arrayValue[i], newPath);
    result = CheckLastError("IVIM", gkFuncRefGet, result);
  }
  return result;
}

int GetIVIMIVI_AbsolutePositionParams(LONG packetHandle, struct IVIMIVI_AbsolutePosition value, char oldPath[])
{
  char newPath[300];
  int result;

  result = 0;

  snprintf(newPath, elcount(newPath), "%s.%s", oldPath, "latitude");
  value.latitude = C2xGetTokenInt(packetHandle, "IVIM", newPath);
  result = CheckLastError("IVIM", gkFuncRefGet, result);

  snprintf(newPath, elcount(newPath), "%s.%s", oldPath, "longitude");
  value.longitude = C2xGetTokenInt(packetHandle, "IVIM", newPath);
  result = CheckLastError("IVIM", gkFuncRefGet, result);

  return result;
}

int SetIVIMIVI_AbsolutePositionParams(LONG packetHandle, struct IVIMIVI_AbsolutePosition value, char oldPath[])
{
  char newPath[300];
  int result;

  result = 0;

  snprintf(newPath, elcount(newPath), "%s.%s", oldPath, "latitude");
  C2xSetTokenInt(packetHandle, "IVIM", newPath, value.latitude);
  result = CheckLastError("IVIM", gkFuncRefGet, result);

  snprintf(newPath, elcount(newPath), "%s.%s", oldPath, "longitude");
  C2xSetTokenInt(packetHandle, "IVIM", newPath, value.longitude);
  result = CheckLastError("IVIM", gkFuncRefGet, result);

  return result;
}

int GetIVIMIVI_PolygonalLine_absolutePositionsParams(LONG packetHandle, struct IVIMIVI_PolygonalLine_absolutePositions value, char oldPath[])
{
  char newPath[300]; 
  int i;
  int result;

  result = 0;

  value.length = C2xGetTokenInt(packetHandle, "IVIM", oldPath);
  if((result = CheckLastError("IVIM", gkFuncRefGet, result))==0)
  {
    for(i=0; i<value.length; i++)
    {
      snprintf(newPath, elcount(newPath), "%s[%d]", oldPath, i);
      GetIVIMIVI_AbsolutePositionParams(packetHandle, value.arrayValue[i], newPath);
      result = CheckLastError("IVIM", gkFuncRefGet, result);
    }
  }
  return result;
}

int SetIVIMIVI_PolygonalLine_absolutePositionsParams(LONG packetHandle, struct IVIMIVI_PolygonalLine_absolutePositions value, char oldPath[])
{
  char newPath[300]; 
  int i;
  int result;

  result = 0;

  C2xRemoveToken(packetHandle, "IVIM", oldPath);
  for(i=0; i<value.length; i++)
  {
    snprintf(newPath, elcount(newPath), "%s[%d]", oldPath, i);
    SetIVIMIVI_AbsolutePositionParams(packetHandle, value.arrayValue[i], newPath);
    result = CheckLastError("IVIM", gkFuncRefGet, result);
  }
  return result;
}

int GetIVIMIVI_AbsolutePositionWAltitudeParams(LONG packetHandle, struct IVIMIVI_AbsolutePositionWAltitude value, char oldPath[])
{
  char newPath[300];
  int result;

  result = 0;

  snprintf(newPath, elcount(newPath), "%s.%s", oldPath, "latitude");
  value.latitude = C2xGetTokenInt(packetHandle, "IVIM", newPath);
  result = CheckLastError("IVIM", gkFuncRefGet, result);

  snprintf(newPath, elcount(newPath), "%s.%s", oldPath, "longitude");
  value.longitude = C2xGetTokenInt(packetHandle, "IVIM", newPath);
  result = CheckLastError("IVIM", gkFuncRefGet, result);

  snprintf(newPath, elcount(newPath), "%s.%s", oldPath, "altitude");
  GetIVIMITS_Container_AltitudeParams(packetHandle, value.altitude, newPath);
  result = CheckLastError("IVIM", gkFuncRefGet, result);

  return result;
}

int SetIVIMIVI_AbsolutePositionWAltitudeParams(LONG packetHandle, struct IVIMIVI_AbsolutePositionWAltitude value, char oldPath[])
{
  char newPath[300];
  int result;

  result = 0;

  snprintf(newPath, elcount(newPath), "%s.%s", oldPath, "latitude");
  C2xSetTokenInt(packetHandle, "IVIM", newPath, value.latitude);
  result = CheckLastError("IVIM", gkFuncRefGet, result);

  snprintf(newPath, elcount(newPath), "%s.%s", oldPath, "longitude");
  C2xSetTokenInt(packetHandle, "IVIM", newPath, value.longitude);
  result = CheckLastError("IVIM", gkFuncRefGet, result);

  snprintf(newPath, elcount(newPath), "%s.%s", oldPath, "altitude");
  SetIVIMITS_Container_AltitudeParams(packetHandle, value.altitude, newPath);
  result = CheckLastError("IVIM", gkFuncRefGet, result);

  return result;
}

int GetIVIMIVI_PolygonalLine_absolutePositionsWithAltitudeParams(LONG packetHandle, struct IVIMIVI_PolygonalLine_absolutePositionsWithAltitude value, char oldPath[])
{
  char newPath[300]; 
  int i;
  int result;

  result = 0;

  value.length = C2xGetTokenInt(packetHandle, "IVIM", oldPath);
  if((result = CheckLastError("IVIM", gkFuncRefGet, result))==0)
  {
    for(i=0; i<value.length; i++)
    {
      snprintf(newPath, elcount(newPath), "%s[%d]", oldPath, i);
      GetIVIMIVI_AbsolutePositionWAltitudeParams(packetHandle, value.arrayValue[i], newPath);
      result = CheckLastError("IVIM", gkFuncRefGet, result);
    }
  }
  return result;
}

int SetIVIMIVI_PolygonalLine_absolutePositionsWithAltitudeParams(LONG packetHandle, struct IVIMIVI_PolygonalLine_absolutePositionsWithAltitude value, char oldPath[])
{
  char newPath[300]; 
  int i;
  int result;

  result = 0;

  C2xRemoveToken(packetHandle, "IVIM", oldPath);
  for(i=0; i<value.length; i++)
  {
    snprintf(newPath, elcount(newPath), "%s[%d]", oldPath, i);
    SetIVIMIVI_AbsolutePositionWAltitudeParams(packetHandle, value.arrayValue[i], newPath);
    result = CheckLastError("IVIM", gkFuncRefGet, result);
  }
  return result;
}

int GetIVIMIVI_PolygonalLineParams(LONG packetHandle, struct IVIMIVI_PolygonalLine value, char oldPath[])
{
  char newPath[300];
  int result;

  result = 0;

  value.choice = C2xGetTokenInt(packetHandle, "IVIM", oldPath);

  switch(value.choice)
  {
    case 0:
    {
      snprintf(newPath, elcount(newPath), "%s.%s", oldPath, "deltaPositions");
      GetIVIMIVI_PolygonalLine_deltaPositionsParams(packetHandle, value.deltaPositions, newPath);
      result = CheckLastError("IVIM", gkFuncRefGet, result);
    }
    break;
    case 1:
    {
      snprintf(newPath, elcount(newPath), "%s.%s", oldPath, "deltaPositionsWithAltitude");
      GetIVIMIVI_PolygonalLine_deltaPositionsWithAltitudeParams(packetHandle, value.deltaPositionsWithAltitude, newPath);
      result = CheckLastError("IVIM", gkFuncRefGet, result);
    }
    break;
    case 2:
    {
      snprintf(newPath, elcount(newPath), "%s.%s", oldPath, "absolutePositions");
      GetIVIMIVI_PolygonalLine_absolutePositionsParams(packetHandle, value.absolutePositions, newPath);
      result = CheckLastError("IVIM", gkFuncRefGet, result);
    }
    break;
    case 3:
    {
      snprintf(newPath, elcount(newPath), "%s.%s", oldPath, "absolutePositionsWithAltitude");
      GetIVIMIVI_PolygonalLine_absolutePositionsWithAltitudeParams(packetHandle, value.absolutePositionsWithAltitude, newPath);
      result = CheckLastError("IVIM", gkFuncRefGet, result);
    }
    break;
  }
  return result;
}

int SetIVIMIVI_PolygonalLineParams(LONG packetHandle, struct IVIMIVI_PolygonalLine value, char oldPath[])
{
  char newPath[300];
  int result;

  result = 0;

  switch(value.choice)
  {
    case 0:
    {
      snprintf(newPath, elcount(newPath), "%s.%s", oldPath, "deltaPositions");
      SetIVIMIVI_PolygonalLine_deltaPositionsParams(packetHandle, value.deltaPositions, newPath);
      result = CheckLastError("IVIM", gkFuncRefGet, result);
    }
    break;
    case 1:
    {
      snprintf(newPath, elcount(newPath), "%s.%s", oldPath, "deltaPositionsWithAltitude");
      SetIVIMIVI_PolygonalLine_deltaPositionsWithAltitudeParams(packetHandle, value.deltaPositionsWithAltitude, newPath);
      result = CheckLastError("IVIM", gkFuncRefGet, result);
    }
    break;
    case 2:
    {
      snprintf(newPath, elcount(newPath), "%s.%s", oldPath, "absolutePositions");
      SetIVIMIVI_PolygonalLine_absolutePositionsParams(packetHandle, value.absolutePositions, newPath);
      result = CheckLastError("IVIM", gkFuncRefGet, result);
    }
    break;
    case 3:
    {
      snprintf(newPath, elcount(newPath), "%s.%s", oldPath, "absolutePositionsWithAltitude");
      SetIVIMIVI_PolygonalLine_absolutePositionsWithAltitudeParams(packetHandle, value.absolutePositionsWithAltitude, newPath);
      result = CheckLastError("IVIM", gkFuncRefGet, result);
    }
    break;
  }
  return result;
}

int GetIVIMIVI_SegmentParams(LONG packetHandle, struct IVIMIVI_Segment value, char oldPath[])
{
  char newPath[300];
  int result;

  result = 0;

  snprintf(newPath, elcount(newPath), "%s.%s", oldPath, "line");
  GetIVIMIVI_PolygonalLineParams(packetHandle, value.line, newPath);
  result = CheckLastError("IVIM", gkFuncRefGet, result);

  snprintf(newPath, elcount(newPath), "%s.%s", oldPath, "laneWidth");
  value.laneWidth.isValidFlag = C2xIsTokenAvailable(packetHandle, "IVIM", newPath);
  if(value.laneWidth.isValidFlag==1)
  {
    value.laneWidth.value = C2xGetTokenInt(packetHandle, "IVIM", newPath);
    result = CheckLastError("IVIM", gkFuncRefGet, result);
  }
  return result;
}

int SetIVIMIVI_SegmentParams(LONG packetHandle, struct IVIMIVI_Segment value, char oldPath[])
{
  char newPath[300];
  int result;

  result = 0;

  snprintf(newPath, elcount(newPath), "%s.%s", oldPath, "line");
  SetIVIMIVI_PolygonalLineParams(packetHandle, value.line, newPath);
  result = CheckLastError("IVIM", gkFuncRefGet, result);

  snprintf(newPath, elcount(newPath), "%s.%s", oldPath, "laneWidth");
  if(value.laneWidth.isValidFlag==1)
  {
    C2xSetTokenInt(packetHandle, "IVIM", newPath, value.laneWidth.value);
    result = CheckLastError("IVIM", gkFuncRefGet, result);
  }
  else
  {
    if( C2xIsTokenAvailable(packetHandle, "IVIM", newPath) )
    {
      C2xRemoveToken(packetHandle, "IVIM", newPath);
    }
  }

  return result;
}

int GetIVIMIVI_ComputedSegmentParams(LONG packetHandle, struct IVIMIVI_ComputedSegment value, char oldPath[])
{
  char newPath[300];
  int result;

  result = 0;

  snprintf(newPath, elcount(newPath), "%s.%s", oldPath, "zoneId");
  value.zoneId = C2xGetTokenInt(packetHandle, "IVIM", newPath);
  result = CheckLastError("IVIM", gkFuncRefGet, result);

  snprintf(newPath, elcount(newPath), "%s.%s", oldPath, "laneNumber");
  value.laneNumber = C2xGetTokenInt(packetHandle, "IVIM", newPath);
  result = CheckLastError("IVIM", gkFuncRefGet, result);

  snprintf(newPath, elcount(newPath), "%s.%s", oldPath, "laneWidth");
  value.laneWidth = C2xGetTokenInt(packetHandle, "IVIM", newPath);
  result = CheckLastError("IVIM", gkFuncRefGet, result);

  snprintf(newPath, elcount(newPath), "%s.%s", oldPath, "offsetDistance");
  value.offsetDistance.isValidFlag = C2xIsTokenAvailable(packetHandle, "IVIM", newPath);
  if(value.offsetDistance.isValidFlag==1)
  {
    value.offsetDistance.value = C2xGetTokenInt(packetHandle, "IVIM", newPath);
    result = CheckLastError("IVIM", gkFuncRefGet, result);
  }
  snprintf(newPath, elcount(newPath), "%s.%s", oldPath, "offsetPosition");
  value.offsetPosition.isValidFlag = C2xIsTokenAvailable(packetHandle, "IVIM", newPath);
  if(value.offsetPosition.isValidFlag==1)
  {
    GetIVIMITS_Container_DeltaReferencePositionParams(packetHandle, value.offsetPosition, newPath);
    result = CheckLastError("IVIM", gkFuncRefGet, result);
  }
  return result;
}

int SetIVIMIVI_ComputedSegmentParams(LONG packetHandle, struct IVIMIVI_ComputedSegment value, char oldPath[])
{
  char newPath[300];
  int result;

  result = 0;

  snprintf(newPath, elcount(newPath), "%s.%s", oldPath, "zoneId");
  C2xSetTokenInt(packetHandle, "IVIM", newPath, value.zoneId);
  result = CheckLastError("IVIM", gkFuncRefGet, result);

  snprintf(newPath, elcount(newPath), "%s.%s", oldPath, "laneNumber");
  C2xSetTokenInt(packetHandle, "IVIM", newPath, value.laneNumber);
  result = CheckLastError("IVIM", gkFuncRefGet, result);

  snprintf(newPath, elcount(newPath), "%s.%s", oldPath, "laneWidth");
  C2xSetTokenInt(packetHandle, "IVIM", newPath, value.laneWidth);
  result = CheckLastError("IVIM", gkFuncRefGet, result);

  snprintf(newPath, elcount(newPath), "%s.%s", oldPath, "offsetDistance");
  if(value.offsetDistance.isValidFlag==1)
  {
    C2xSetTokenInt(packetHandle, "IVIM", newPath, value.offsetDistance.value);
    result = CheckLastError("IVIM", gkFuncRefGet, result);
  }
  else
  {
    if( C2xIsTokenAvailable(packetHandle, "IVIM", newPath) )
    {
      C2xRemoveToken(packetHandle, "IVIM", newPath);
    }
  }

  snprintf(newPath, elcount(newPath), "%s.%s", oldPath, "offsetPosition");
  if(value.offsetPosition.isValidFlag==1)
  {
    SetIVIMITS_Container_DeltaReferencePositionParams(packetHandle, value.offsetPosition, newPath);
    result = CheckLastError("IVIM", gkFuncRefGet, result);
  }
  else
  {
    if( C2xIsTokenAvailable(packetHandle, "IVIM", newPath) )
    {
      C2xRemoveToken(packetHandle, "IVIM", newPath);
    }
  }

  return result;
}

int GetIVIMIVI_ZoneParams(LONG packetHandle, struct IVIMIVI_Zone value, char oldPath[])
{
  char newPath[300];
  int result;

  result = 0;

  value.choice = C2xGetTokenInt(packetHandle, "IVIM", oldPath);

  switch(value.choice)
  {
    case 0:
    {
      snprintf(newPath, elcount(newPath), "%s.%s", oldPath, "segment");
      GetIVIMIVI_SegmentParams(packetHandle, value.segment, newPath);
      result = CheckLastError("IVIM", gkFuncRefGet, result);
    }
    break;
    case 1:
    {
      snprintf(newPath, elcount(newPath), "%s.%s", oldPath, "area");
      GetIVIMIVI_PolygonalLineParams(packetHandle, value.area, newPath);
      result = CheckLastError("IVIM", gkFuncRefGet, result);
    }
    break;
    case 2:
    {
      snprintf(newPath, elcount(newPath), "%s.%s", oldPath, "computedSegment");
      GetIVIMIVI_ComputedSegmentParams(packetHandle, value.computedSegment, newPath);
      result = CheckLastError("IVIM", gkFuncRefGet, result);
    }
    break;
  }
  return result;
}

int SetIVIMIVI_ZoneParams(LONG packetHandle, struct IVIMIVI_Zone value, char oldPath[])
{
  char newPath[300];
  int result;

  result = 0;

  switch(value.choice)
  {
    case 0:
    {
      snprintf(newPath, elcount(newPath), "%s.%s", oldPath, "segment");
      SetIVIMIVI_SegmentParams(packetHandle, value.segment, newPath);
      result = CheckLastError("IVIM", gkFuncRefGet, result);
    }
    break;
    case 1:
    {
      snprintf(newPath, elcount(newPath), "%s.%s", oldPath, "area");
      SetIVIMIVI_PolygonalLineParams(packetHandle, value.area, newPath);
      result = CheckLastError("IVIM", gkFuncRefGet, result);
    }
    break;
    case 2:
    {
      snprintf(newPath, elcount(newPath), "%s.%s", oldPath, "computedSegment");
      SetIVIMIVI_ComputedSegmentParams(packetHandle, value.computedSegment, newPath);
      result = CheckLastError("IVIM", gkFuncRefGet, result);
    }
    break;
  }
  return result;
}

int GetIVIMIVI_GlcPartParams(LONG packetHandle, struct IVIMIVI_GlcPart value, char oldPath[])
{
  char newPath[300];
  int result;

  result = 0;

  snprintf(newPath, elcount(newPath), "%s.%s", oldPath, "zoneId");
  value.zoneId = C2xGetTokenInt(packetHandle, "IVIM", newPath);
  result = CheckLastError("IVIM", gkFuncRefGet, result);

  snprintf(newPath, elcount(newPath), "%s.%s", oldPath, "laneNumber");
  value.laneNumber.isValidFlag = C2xIsTokenAvailable(packetHandle, "IVIM", newPath);
  if(value.laneNumber.isValidFlag==1)
  {
    value.laneNumber.value = C2xGetTokenInt(packetHandle, "IVIM", newPath);
    result = CheckLastError("IVIM", gkFuncRefGet, result);
  }
  snprintf(newPath, elcount(newPath), "%s.%s", oldPath, "zoneExtension");
  value.zoneExtension.isValidFlag = C2xIsTokenAvailable(packetHandle, "IVIM", newPath);
  if(value.zoneExtension.isValidFlag==1)
  {
    value.zoneExtension.value = C2xGetTokenInt(packetHandle, "IVIM", newPath);
    result = CheckLastError("IVIM", gkFuncRefGet, result);
  }
  snprintf(newPath, elcount(newPath), "%s.%s", oldPath, "zoneHeading");
  value.zoneHeading.isValidFlag = C2xIsTokenAvailable(packetHandle, "IVIM", newPath);
  if(value.zoneHeading.isValidFlag==1)
  {
    value.zoneHeading.value = C2xGetTokenInt(packetHandle, "IVIM", newPath);
    result = CheckLastError("IVIM", gkFuncRefGet, result);
  }
  snprintf(newPath, elcount(newPath), "%s.%s", oldPath, "zone");
  value.zone.isValidFlag = C2xIsTokenAvailable(packetHandle, "IVIM", newPath);
  if(value.zone.isValidFlag==1)
  {
    GetIVIMIVI_ZoneParams(packetHandle, value.zone, newPath);
    result = CheckLastError("IVIM", gkFuncRefGet, result);
  }
  return result;
}

int SetIVIMIVI_GlcPartParams(LONG packetHandle, struct IVIMIVI_GlcPart value, char oldPath[])
{
  char newPath[300];
  int result;

  result = 0;

  snprintf(newPath, elcount(newPath), "%s.%s", oldPath, "zoneId");
  C2xSetTokenInt(packetHandle, "IVIM", newPath, value.zoneId);
  result = CheckLastError("IVIM", gkFuncRefGet, result);

  snprintf(newPath, elcount(newPath), "%s.%s", oldPath, "laneNumber");
  if(value.laneNumber.isValidFlag==1)
  {
    C2xSetTokenInt(packetHandle, "IVIM", newPath, value.laneNumber.value);
    result = CheckLastError("IVIM", gkFuncRefGet, result);
  }
  else
  {
    if( C2xIsTokenAvailable(packetHandle, "IVIM", newPath) )
    {
      C2xRemoveToken(packetHandle, "IVIM", newPath);
    }
  }

  snprintf(newPath, elcount(newPath), "%s.%s", oldPath, "zoneExtension");
  if(value.zoneExtension.isValidFlag==1)
  {
    C2xSetTokenInt(packetHandle, "IVIM", newPath, value.zoneExtension.value);
    result = CheckLastError("IVIM", gkFuncRefGet, result);
  }
  else
  {
    if( C2xIsTokenAvailable(packetHandle, "IVIM", newPath) )
    {
      C2xRemoveToken(packetHandle, "IVIM", newPath);
    }
  }

  snprintf(newPath, elcount(newPath), "%s.%s", oldPath, "zoneHeading");
  if(value.zoneHeading.isValidFlag==1)
  {
    C2xSetTokenInt(packetHandle, "IVIM", newPath, value.zoneHeading.value);
    result = CheckLastError("IVIM", gkFuncRefGet, result);
  }
  else
  {
    if( C2xIsTokenAvailable(packetHandle, "IVIM", newPath) )
    {
      C2xRemoveToken(packetHandle, "IVIM", newPath);
    }
  }

  snprintf(newPath, elcount(newPath), "%s.%s", oldPath, "zone");
  if(value.zone.isValidFlag==1)
  {
    SetIVIMIVI_ZoneParams(packetHandle, value.zone, newPath);
    result = CheckLastError("IVIM", gkFuncRefGet, result);
  }
  else
  {
    if( C2xIsTokenAvailable(packetHandle, "IVIM", newPath) )
    {
      C2xRemoveToken(packetHandle, "IVIM", newPath);
    }
  }

  return result;
}

int GetIVIMIVI_GeographicLocationContainer_partsParams(LONG packetHandle, struct IVIMIVI_GeographicLocationContainer_parts value, char oldPath[])
{
  char newPath[300]; 
  int i;
  int result;

  result = 0;

  value.length = C2xGetTokenInt(packetHandle, "IVIM", oldPath);
  if((result = CheckLastError("IVIM", gkFuncRefGet, result))==0)
  {
    for(i=0; i<value.length; i++)
    {
      snprintf(newPath, elcount(newPath), "%s[%d]", oldPath, i);
      GetIVIMIVI_GlcPartParams(packetHandle, value.arrayValue[i], newPath);
      result = CheckLastError("IVIM", gkFuncRefGet, result);
    }
  }
  return result;
}

int SetIVIMIVI_GeographicLocationContainer_partsParams(LONG packetHandle, struct IVIMIVI_GeographicLocationContainer_parts value, char oldPath[])
{
  char newPath[300]; 
  int i;
  int result;

  result = 0;

  C2xRemoveToken(packetHandle, "IVIM", oldPath);
  for(i=0; i<value.length; i++)
  {
    snprintf(newPath, elcount(newPath), "%s[%d]", oldPath, i);
    SetIVIMIVI_GlcPartParams(packetHandle, value.arrayValue[i], newPath);
    result = CheckLastError("IVIM", gkFuncRefGet, result);
  }
  return result;
}

int GetIVIMIVI_GeographicLocationContainerParams(LONG packetHandle, struct IVIMIVI_GeographicLocationContainer value, char oldPath[])
{
  char newPath[300];
  int result;

  result = 0;

  snprintf(newPath, elcount(newPath), "%s.%s", oldPath, "referencePosition");
  GetIVIMITS_Container_ReferencePositionParams(packetHandle, value.referencePosition, newPath);
  result = CheckLastError("IVIM", gkFuncRefGet, result);

  snprintf(newPath, elcount(newPath), "%s.%s", oldPath, "referencePositionTime");
  value.referencePositionTime.isValidFlag = C2xIsTokenAvailable(packetHandle, "IVIM", newPath);
  if(value.referencePositionTime.isValidFlag==1)
  {
    value.referencePositionTime.value = C2xGetTokenInt64(packetHandle, "IVIM", newPath);
    result = CheckLastError("IVIM", gkFuncRefGet, result);
  }
  snprintf(newPath, elcount(newPath), "%s.%s", oldPath, "referencePositionHeading");
  value.referencePositionHeading.isValidFlag = C2xIsTokenAvailable(packetHandle, "IVIM", newPath);
  if(value.referencePositionHeading.isValidFlag==1)
  {
    GetIVIMITS_Container_HeadingParams(packetHandle, value.referencePositionHeading, newPath);
    result = CheckLastError("IVIM", gkFuncRefGet, result);
  }
  snprintf(newPath, elcount(newPath), "%s.%s", oldPath, "referencePositionSpeed");
  value.referencePositionSpeed.isValidFlag = C2xIsTokenAvailable(packetHandle, "IVIM", newPath);
  if(value.referencePositionSpeed.isValidFlag==1)
  {
    GetIVIMITS_Container_SpeedParams(packetHandle, value.referencePositionSpeed, newPath);
    result = CheckLastError("IVIM", gkFuncRefGet, result);
  }
  snprintf(newPath, elcount(newPath), "%s.%s", oldPath, "parts");
  GetIVIMIVI_GeographicLocationContainer_partsParams(packetHandle, value.parts, newPath);
  result = CheckLastError("IVIM", gkFuncRefGet, result);

  return result;
}

int SetIVIMIVI_GeographicLocationContainerParams(LONG packetHandle, struct IVIMIVI_GeographicLocationContainer value, char oldPath[])
{
  char newPath[300];
  int result;

  result = 0;

  snprintf(newPath, elcount(newPath), "%s.%s", oldPath, "referencePosition");
  SetIVIMITS_Container_ReferencePositionParams(packetHandle, value.referencePosition, newPath);
  result = CheckLastError("IVIM", gkFuncRefGet, result);

  snprintf(newPath, elcount(newPath), "%s.%s", oldPath, "referencePositionTime");
  if(value.referencePositionTime.isValidFlag==1)
  {
    C2xSetTokenInt64(packetHandle, "IVIM", newPath, value.referencePositionTime.value);
    result = CheckLastError("IVIM", gkFuncRefGet, result);
  }
  else
  {
    if( C2xIsTokenAvailable(packetHandle, "IVIM", newPath) )
    {
      C2xRemoveToken(packetHandle, "IVIM", newPath);
    }
  }

  snprintf(newPath, elcount(newPath), "%s.%s", oldPath, "referencePositionHeading");
  if(value.referencePositionHeading.isValidFlag==1)
  {
    SetIVIMITS_Container_HeadingParams(packetHandle, value.referencePositionHeading, newPath);
    result = CheckLastError("IVIM", gkFuncRefGet, result);
  }
  else
  {
    if( C2xIsTokenAvailable(packetHandle, "IVIM", newPath) )
    {
      C2xRemoveToken(packetHandle, "IVIM", newPath);
    }
  }

  snprintf(newPath, elcount(newPath), "%s.%s", oldPath, "referencePositionSpeed");
  if(value.referencePositionSpeed.isValidFlag==1)
  {
    SetIVIMITS_Container_SpeedParams(packetHandle, value.referencePositionSpeed, newPath);
    result = CheckLastError("IVIM", gkFuncRefGet, result);
  }
  else
  {
    if( C2xIsTokenAvailable(packetHandle, "IVIM", newPath) )
    {
      C2xRemoveToken(packetHandle, "IVIM", newPath);
    }
  }

  snprintf(newPath, elcount(newPath), "%s.%s", oldPath, "parts");
  SetIVIMIVI_GeographicLocationContainer_partsParams(packetHandle, value.parts, newPath);
  result = CheckLastError("IVIM", gkFuncRefGet, result);

  return result;
}

int GetIVIMIVI_GicPart_detectionZoneIdsParams(LONG packetHandle, struct IVIMIVI_GicPart_detectionZoneIds value, char oldPath[])
{
  char newPath[300]; 
  int i;
  int result;

  result = 0;

  value.length = C2xGetTokenInt(packetHandle, "IVIM", oldPath);
  if((result = CheckLastError("IVIM", gkFuncRefGet, result))==0)
  {
    for(i=0; i<value.length; i++)
    {
      snprintf(newPath, elcount(newPath), "%s[%d]", oldPath, i);
      value.arrayValue[i] = C2xGetTokenInt64(packetHandle, "IVIM", newPath);
      result = CheckLastError("IVIM", gkFuncRefGet, result);
    }
  }
  return result;
}

int SetIVIMIVI_GicPart_detectionZoneIdsParams(LONG packetHandle, struct IVIMIVI_GicPart_detectionZoneIds value, char oldPath[])
{
  char newPath[300]; 
  int i;
  int result;

  result = 0;

  C2xRemoveToken(packetHandle, "IVIM", oldPath);
  for(i=0; i<value.length; i++)
  {
    snprintf(newPath, elcount(newPath), "%s[%d]", oldPath, i);
    C2xSetTokenInt64(packetHandle, "IVIM", newPath, value.arrayValue[i]);
    result = CheckLastError("IVIM", gkFuncRefGet, result);
  }
  return result;
}

int GetIVIMCITSapplMgmtIDs_Ext2Params(LONG packetHandle, struct IVIMCITSapplMgmtIDs_Ext2 value, char oldPath[])
{
  char newPath[300];
  int result;

  result = 0;

  value.choice = C2xGetTokenInt(packetHandle, "IVIM", oldPath);

  switch(value.choice)
  {
    case 0:
    {
      snprintf(newPath, elcount(newPath), "%s.%s", oldPath, "content");
      value.content = C2xGetTokenInt(packetHandle, "IVIM", newPath);
      result = CheckLastError("IVIM", gkFuncRefGet, result);
    }
    break;
    case 1:
    {
      snprintf(newPath, elcount(newPath), "%s.%s", oldPath, "extension");
      value.extension = C2xGetTokenInt(packetHandle, "IVIM", newPath);
      result = CheckLastError("IVIM", gkFuncRefGet, result);
    }
    break;
  }
  return result;
}

int SetIVIMCITSapplMgmtIDs_Ext2Params(LONG packetHandle, struct IVIMCITSapplMgmtIDs_Ext2 value, char oldPath[])
{
  char newPath[300];
  int result;

  result = 0;

  switch(value.choice)
  {
    case 0:
    {
      snprintf(newPath, elcount(newPath), "%s.%s", oldPath, "content");
      C2xSetTokenInt(packetHandle, "IVIM", newPath, value.content);
      result = CheckLastError("IVIM", gkFuncRefGet, result);
    }
    break;
    case 1:
    {
      snprintf(newPath, elcount(newPath), "%s.%s", oldPath, "extension");
      C2xSetTokenInt(packetHandle, "IVIM", newPath, value.extension);
      result = CheckLastError("IVIM", gkFuncRefGet, result);
    }
    break;
  }
  return result;
}

int GetIVIMCITSapplMgmtIDs_Ext1Params(LONG packetHandle, struct IVIMCITSapplMgmtIDs_Ext1 value, char oldPath[])
{
  char newPath[300];
  int result;

  result = 0;

  value.choice = C2xGetTokenInt(packetHandle, "IVIM", oldPath);

  switch(value.choice)
  {
    case 0:
    {
      snprintf(newPath, elcount(newPath), "%s.%s", oldPath, "content");
      value.content = C2xGetTokenInt(packetHandle, "IVIM", newPath);
      result = CheckLastError("IVIM", gkFuncRefGet, result);
    }
    break;
    case 1:
    {
      snprintf(newPath, elcount(newPath), "%s.%s", oldPath, "extension");
      GetIVIMCITSapplMgmtIDs_Ext2Params(packetHandle, value.extension, newPath);
      result = CheckLastError("IVIM", gkFuncRefGet, result);
    }
    break;
  }
  return result;
}

int SetIVIMCITSapplMgmtIDs_Ext1Params(LONG packetHandle, struct IVIMCITSapplMgmtIDs_Ext1 value, char oldPath[])
{
  char newPath[300];
  int result;

  result = 0;

  switch(value.choice)
  {
    case 0:
    {
      snprintf(newPath, elcount(newPath), "%s.%s", oldPath, "content");
      C2xSetTokenInt(packetHandle, "IVIM", newPath, value.content);
      result = CheckLastError("IVIM", gkFuncRefGet, result);
    }
    break;
    case 1:
    {
      snprintf(newPath, elcount(newPath), "%s.%s", oldPath, "extension");
      SetIVIMCITSapplMgmtIDs_Ext2Params(packetHandle, value.extension, newPath);
      result = CheckLastError("IVIM", gkFuncRefGet, result);
    }
    break;
  }
  return result;
}

int GetIVIMCITSapplMgmtIDs_VarLengthNumberParams(LONG packetHandle, struct IVIMCITSapplMgmtIDs_VarLengthNumber value, char oldPath[])
{
  char newPath[300];
  int result;

  result = 0;

  value.choice = C2xGetTokenInt(packetHandle, "IVIM", oldPath);

  switch(value.choice)
  {
    case 0:
    {
      snprintf(newPath, elcount(newPath), "%s.%s", oldPath, "content");
      value.content = C2xGetTokenInt(packetHandle, "IVIM", newPath);
      result = CheckLastError("IVIM", gkFuncRefGet, result);
    }
    break;
    case 1:
    {
      snprintf(newPath, elcount(newPath), "%s.%s", oldPath, "extension");
      GetIVIMCITSapplMgmtIDs_Ext1Params(packetHandle, value.extension, newPath);
      result = CheckLastError("IVIM", gkFuncRefGet, result);
    }
    break;
  }
  return result;
}

int SetIVIMCITSapplMgmtIDs_VarLengthNumberParams(LONG packetHandle, struct IVIMCITSapplMgmtIDs_VarLengthNumber value, char oldPath[])
{
  char newPath[300];
  int result;

  result = 0;

  switch(value.choice)
  {
    case 0:
    {
      snprintf(newPath, elcount(newPath), "%s.%s", oldPath, "content");
      C2xSetTokenInt(packetHandle, "IVIM", newPath, value.content);
      result = CheckLastError("IVIM", gkFuncRefGet, result);
    }
    break;
    case 1:
    {
      snprintf(newPath, elcount(newPath), "%s.%s", oldPath, "extension");
      SetIVIMCITSapplMgmtIDs_Ext1Params(packetHandle, value.extension, newPath);
      result = CheckLastError("IVIM", gkFuncRefGet, result);
    }
    break;
  }
  return result;
}

int GetIVIMIVI_GicPart_relevanceZoneIdsParams(LONG packetHandle, struct IVIMIVI_GicPart_relevanceZoneIds value, char oldPath[])
{
  char newPath[300]; 
  int i;
  int result;

  result = 0;

  value.length = C2xGetTokenInt(packetHandle, "IVIM", oldPath);
  if((result = CheckLastError("IVIM", gkFuncRefGet, result))==0)
  {
    for(i=0; i<value.length; i++)
    {
      snprintf(newPath, elcount(newPath), "%s[%d]", oldPath, i);
      value.arrayValue[i] = C2xGetTokenInt64(packetHandle, "IVIM", newPath);
      result = CheckLastError("IVIM", gkFuncRefGet, result);
    }
  }
  return result;
}

int SetIVIMIVI_GicPart_relevanceZoneIdsParams(LONG packetHandle, struct IVIMIVI_GicPart_relevanceZoneIds value, char oldPath[])
{
  char newPath[300]; 
  int i;
  int result;

  result = 0;

  C2xRemoveToken(packetHandle, "IVIM", oldPath);
  for(i=0; i<value.length; i++)
  {
    snprintf(newPath, elcount(newPath), "%s[%d]", oldPath, i);
    C2xSetTokenInt64(packetHandle, "IVIM", newPath, value.arrayValue[i]);
    result = CheckLastError("IVIM", gkFuncRefGet, result);
  }
  return result;
}

int GetIVIMIVI_GicPart_driverAwarenessZoneIdsParams(LONG packetHandle, struct IVIMIVI_GicPart_driverAwarenessZoneIds value, char oldPath[])
{
  char newPath[300]; 
  int i;
  int result;

  result = 0;

  value.length = C2xGetTokenInt(packetHandle, "IVIM", oldPath);
  if((result = CheckLastError("IVIM", gkFuncRefGet, result))==0)
  {
    for(i=0; i<value.length; i++)
    {
      snprintf(newPath, elcount(newPath), "%s[%d]", oldPath, i);
      value.arrayValue[i] = C2xGetTokenInt64(packetHandle, "IVIM", newPath);
      result = CheckLastError("IVIM", gkFuncRefGet, result);
    }
  }
  return result;
}

int SetIVIMIVI_GicPart_driverAwarenessZoneIdsParams(LONG packetHandle, struct IVIMIVI_GicPart_driverAwarenessZoneIds value, char oldPath[])
{
  char newPath[300]; 
  int i;
  int result;

  result = 0;

  C2xRemoveToken(packetHandle, "IVIM", oldPath);
  for(i=0; i<value.length; i++)
  {
    snprintf(newPath, elcount(newPath), "%s[%d]", oldPath, i);
    C2xSetTokenInt64(packetHandle, "IVIM", newPath, value.arrayValue[i]);
    result = CheckLastError("IVIM", gkFuncRefGet, result);
  }
  return result;
}

int GetIVIMIVI_GicPart_applicableLanesParams(LONG packetHandle, struct IVIMIVI_GicPart_applicableLanes value, char oldPath[])
{
  char newPath[300]; 
  int i;
  int result;

  result = 0;

  value.length = C2xGetTokenInt(packetHandle, "IVIM", oldPath);
  if((result = CheckLastError("IVIM", gkFuncRefGet, result))==0)
  {
    for(i=0; i<value.length; i++)
    {
      snprintf(newPath, elcount(newPath), "%s[%d]", oldPath, i);
      value.arrayValue[i] = C2xGetTokenInt64(packetHandle, "IVIM", newPath);
      result = CheckLastError("IVIM", gkFuncRefGet, result);
    }
  }
  return result;
}

int SetIVIMIVI_GicPart_applicableLanesParams(LONG packetHandle, struct IVIMIVI_GicPart_applicableLanes value, char oldPath[])
{
  char newPath[300]; 
  int i;
  int result;

  result = 0;

  C2xRemoveToken(packetHandle, "IVIM", oldPath);
  for(i=0; i<value.length; i++)
  {
    snprintf(newPath, elcount(newPath), "%s[%d]", oldPath, i);
    C2xSetTokenInt64(packetHandle, "IVIM", newPath, value.arrayValue[i]);
    result = CheckLastError("IVIM", gkFuncRefGet, result);
  }
  return result;
}

int GetIVIMElectronicRegistrationIdentificationVehicleDataModule_EuVehicleCategoryCodeParams(LONG packetHandle, struct IVIMElectronicRegistrationIdentificationVehicleDataModule_EuVehicleCategoryCode value, char oldPath[])
{
  char newPath[300];
  int result;

  result = 0;

  value.choice = C2xGetTokenInt(packetHandle, "IVIM", oldPath);

  switch(value.choice)
  {
    case 0:
    {
      snprintf(newPath, elcount(newPath), "%s.%s", oldPath, "euVehicleCategoryL");
      value.euVehicleCategoryL = C2xGetTokenInt(packetHandle, "IVIM", newPath);
      result = CheckLastError("IVIM", gkFuncRefGet, result);
    }
    break;
    case 1:
    {
      snprintf(newPath, elcount(newPath), "%s.%s", oldPath, "euVehicleCategoryM");
      value.euVehicleCategoryM = C2xGetTokenInt(packetHandle, "IVIM", newPath);
      result = CheckLastError("IVIM", gkFuncRefGet, result);
    }
    break;
    case 2:
    {
      snprintf(newPath, elcount(newPath), "%s.%s", oldPath, "euVehicleCategoryN");
      value.euVehicleCategoryN = C2xGetTokenInt(packetHandle, "IVIM", newPath);
      result = CheckLastError("IVIM", gkFuncRefGet, result);
    }
    break;
    case 3:
    {
      snprintf(newPath, elcount(newPath), "%s.%s", oldPath, "euVehicleCategoryO");
      value.euVehicleCategoryO = C2xGetTokenInt(packetHandle, "IVIM", newPath);
      result = CheckLastError("IVIM", gkFuncRefGet, result);
    }
    break;
  }
  return result;
}

int SetIVIMElectronicRegistrationIdentificationVehicleDataModule_EuVehicleCategoryCodeParams(LONG packetHandle, struct IVIMElectronicRegistrationIdentificationVehicleDataModule_EuVehicleCategoryCode value, char oldPath[])
{
  char newPath[300];
  int result;

  result = 0;

  switch(value.choice)
  {
    case 0:
    {
      snprintf(newPath, elcount(newPath), "%s.%s", oldPath, "euVehicleCategoryL");
      C2xSetTokenInt(packetHandle, "IVIM", newPath, value.euVehicleCategoryL);
      result = CheckLastError("IVIM", gkFuncRefGet, result);
    }
    break;
    case 1:
    {
      snprintf(newPath, elcount(newPath), "%s.%s", oldPath, "euVehicleCategoryM");
      C2xSetTokenInt(packetHandle, "IVIM", newPath, value.euVehicleCategoryM);
      result = CheckLastError("IVIM", gkFuncRefGet, result);
    }
    break;
    case 2:
    {
      snprintf(newPath, elcount(newPath), "%s.%s", oldPath, "euVehicleCategoryN");
      C2xSetTokenInt(packetHandle, "IVIM", newPath, value.euVehicleCategoryN);
      result = CheckLastError("IVIM", gkFuncRefGet, result);
    }
    break;
    case 3:
    {
      snprintf(newPath, elcount(newPath), "%s.%s", oldPath, "euVehicleCategoryO");
      C2xSetTokenInt(packetHandle, "IVIM", newPath, value.euVehicleCategoryO);
      result = CheckLastError("IVIM", gkFuncRefGet, result);
    }
    break;
  }
  return result;
}

int GetIVIMEfcDsrcApplication_EnvironmentalCharacteristicsParams(LONG packetHandle, struct IVIMEfcDsrcApplication_EnvironmentalCharacteristics value, char oldPath[])
{
  char newPath[300];
  int result;

  result = 0;

  snprintf(newPath, elcount(newPath), "%s.%s", oldPath, "euroValue");
  value.euroValue = C2xGetTokenInt(packetHandle, "IVIM", newPath);
  result = CheckLastError("IVIM", gkFuncRefGet, result);

  snprintf(newPath, elcount(newPath), "%s.%s", oldPath, "copValue");
  value.copValue = C2xGetTokenInt(packetHandle, "IVIM", newPath);
  result = CheckLastError("IVIM", gkFuncRefGet, result);

  return result;
}

int SetIVIMEfcDsrcApplication_EnvironmentalCharacteristicsParams(LONG packetHandle, struct IVIMEfcDsrcApplication_EnvironmentalCharacteristics value, char oldPath[])
{
  char newPath[300];
  int result;

  result = 0;

  snprintf(newPath, elcount(newPath), "%s.%s", oldPath, "euroValue");
  C2xSetTokenInt(packetHandle, "IVIM", newPath, value.euroValue);
  result = CheckLastError("IVIM", gkFuncRefGet, result);

  snprintf(newPath, elcount(newPath), "%s.%s", oldPath, "copValue");
  C2xSetTokenInt(packetHandle, "IVIM", newPath, value.copValue);
  result = CheckLastError("IVIM", gkFuncRefGet, result);

  return result;
}

int GetIVIMIVI_LoadTypeParams(LONG packetHandle, struct IVIMIVI_LoadType value, char oldPath[])
{
  char newPath[300]; 
  int j; 
  int k;
  int result;

  result = 0;

  snprintf(newPath, elcount(newPath), "%s.%s", oldPath, "goodsType");
  value.goodsType = C2xGetTokenInt(packetHandle, "IVIM", newPath);
  result = CheckLastError("IVIM", gkFuncRefGet, result);

  snprintf(newPath, elcount(newPath), "%s.%s", oldPath, "dangerousGoodsType");
  value.dangerousGoodsType = C2xGetTokenInt(packetHandle, "IVIM", newPath);
  result = CheckLastError("IVIM", gkFuncRefGet, result);

  snprintf(newPath, elcount(newPath), "%s.%s", oldPath, "specialTransportType");
  value.specialTransportType.isValidFlag = 1;
  value.specialTransportType.stringLength = C2xGetTokenLengthBit(packetHandle, "IVIM", newPath);
  if ((result = CheckLastError("IVIM", gkFuncRefGet, result))==0)
  {
    if(value.specialTransportType.stringLength > 0)
    {
      for(j=0; j<value.specialTransportType.stringLength; j++)
      {
        if(C2xGetTokenBitOfBitString(packetHandle, "IVIM", newPath, j) == 0)
        {
          value.specialTransportType.string[j] = '0';
        }
        else if(C2xGetTokenBitOfBitString(packetHandle, "IVIM", newPath, j) == 1)
        {
          value.specialTransportType.string[j] = '1';
        }

        if(value.specialTransportType.stringLength == 1)
        {
          value.specialTransportType.string[1] = '0';
        }
        result = CheckLastError("IVIM", gkFuncRefGet, result);
      }
    }
    else
    {
      for(k = value.specialTransportType.stringLength+1; k > -1; k--)
      {
        if(value.specialTransportType.string[k] == '1')
        {
          value.specialTransportType.string[k] = '0';
        }
      }
    }
  }

  return result;
}

int SetIVIMIVI_LoadTypeParams(LONG packetHandle, struct IVIMIVI_LoadType value, char oldPath[])
{
  char newPath[300]; 
  int j;
  int result;

  result = 0;

  snprintf(newPath, elcount(newPath), "%s.%s", oldPath, "goodsType");
  C2xSetTokenInt(packetHandle, "IVIM", newPath, value.goodsType);
  result = CheckLastError("IVIM", gkFuncRefGet, result);

  snprintf(newPath, elcount(newPath), "%s.%s", oldPath, "dangerousGoodsType");
  C2xSetTokenInt(packetHandle, "IVIM", newPath, value.dangerousGoodsType);
  result = CheckLastError("IVIM", gkFuncRefGet, result);

  snprintf(newPath, elcount(newPath), "%s.%s", oldPath, "specialTransportType");
    for(j=0; j<value.specialTransportType.stringLength; j++)
    {
      if(value.specialTransportType.string[j] == '0')
      {
        C2xSetTokenBitOfBitString(packetHandle, "IVIM", newPath, j, 0);
      }
      else
      {
        C2xSetTokenBitOfBitString(packetHandle, "IVIM", newPath, j, 1);
      }
      result = CheckLastError("IVIM", gkFuncRefGet, result);
    }

  return result;
}

int GetIVIMIVI_VehicleCharacteristicsFixValuesParams(LONG packetHandle, struct IVIMIVI_VehicleCharacteristicsFixValues value, char oldPath[])
{
  char newPath[300];
  int result;

  result = 0;

  value.choice = C2xGetTokenInt(packetHandle, "IVIM", oldPath);

  switch(value.choice)
  {
    case 0:
    {
      snprintf(newPath, elcount(newPath), "%s.%s", oldPath, "simpleVehicleType");
      value.simpleVehicleType = C2xGetTokenInt(packetHandle, "IVIM", newPath);
      result = CheckLastError("IVIM", gkFuncRefGet, result);
    }
    break;
    case 1:
    {
      snprintf(newPath, elcount(newPath), "%s.%s", oldPath, "euVehicleCategoryCode");
      GetIVIMElectronicRegistrationIdentificationVehicleDataModule_EuVehicleCategoryCodeParams(packetHandle, value.euVehicleCategoryCode, newPath);
      result = CheckLastError("IVIM", gkFuncRefGet, result);
    }
    break;
    case 2:
    {
      snprintf(newPath, elcount(newPath), "%s.%s", oldPath, "iso3833VehicleType");
      value.iso3833VehicleType = C2xGetTokenInt(packetHandle, "IVIM", newPath);
      result = CheckLastError("IVIM", gkFuncRefGet, result);
    }
    break;
    case 3:
    {
      snprintf(newPath, elcount(newPath), "%s.%s", oldPath, "euroAndCo2value");
      GetIVIMEfcDsrcApplication_EnvironmentalCharacteristicsParams(packetHandle, value.euroAndCo2value, newPath);
      result = CheckLastError("IVIM", gkFuncRefGet, result);
    }
    break;
    case 4:
    {
      snprintf(newPath, elcount(newPath), "%s.%s", oldPath, "engineCharacteristics");
      value.engineCharacteristics = C2xGetTokenInt(packetHandle, "IVIM", newPath);
      result = CheckLastError("IVIM", gkFuncRefGet, result);
    }
    break;
    case 5:
    {
      snprintf(newPath, elcount(newPath), "%s.%s", oldPath, "loadType");
      GetIVIMIVI_LoadTypeParams(packetHandle, value.loadType, newPath);
      result = CheckLastError("IVIM", gkFuncRefGet, result);
    }
    break;
    case 6:
    {
      snprintf(newPath, elcount(newPath), "%s.%s", oldPath, "usage");
      value.usage = C2xGetTokenInt(packetHandle, "IVIM", newPath);
      result = CheckLastError("IVIM", gkFuncRefGet, result);
    }
    break;
  }
  return result;
}

int SetIVIMIVI_VehicleCharacteristicsFixValuesParams(LONG packetHandle, struct IVIMIVI_VehicleCharacteristicsFixValues value, char oldPath[])
{
  char newPath[300];
  int result;

  result = 0;

  switch(value.choice)
  {
    case 0:
    {
      snprintf(newPath, elcount(newPath), "%s.%s", oldPath, "simpleVehicleType");
      C2xSetTokenInt(packetHandle, "IVIM", newPath, value.simpleVehicleType);
      result = CheckLastError("IVIM", gkFuncRefGet, result);
    }
    break;
    case 1:
    {
      snprintf(newPath, elcount(newPath), "%s.%s", oldPath, "euVehicleCategoryCode");
      SetIVIMElectronicRegistrationIdentificationVehicleDataModule_EuVehicleCategoryCodeParams(packetHandle, value.euVehicleCategoryCode, newPath);
      result = CheckLastError("IVIM", gkFuncRefGet, result);
    }
    break;
    case 2:
    {
      snprintf(newPath, elcount(newPath), "%s.%s", oldPath, "iso3833VehicleType");
      C2xSetTokenInt(packetHandle, "IVIM", newPath, value.iso3833VehicleType);
      result = CheckLastError("IVIM", gkFuncRefGet, result);
    }
    break;
    case 3:
    {
      snprintf(newPath, elcount(newPath), "%s.%s", oldPath, "euroAndCo2value");
      SetIVIMEfcDsrcApplication_EnvironmentalCharacteristicsParams(packetHandle, value.euroAndCo2value, newPath);
      result = CheckLastError("IVIM", gkFuncRefGet, result);
    }
    break;
    case 4:
    {
      snprintf(newPath, elcount(newPath), "%s.%s", oldPath, "engineCharacteristics");
      C2xSetTokenInt(packetHandle, "IVIM", newPath, value.engineCharacteristics);
      result = CheckLastError("IVIM", gkFuncRefGet, result);
    }
    break;
    case 5:
    {
      snprintf(newPath, elcount(newPath), "%s.%s", oldPath, "loadType");
      SetIVIMIVI_LoadTypeParams(packetHandle, value.loadType, newPath);
      result = CheckLastError("IVIM", gkFuncRefGet, result);
    }
    break;
    case 6:
    {
      snprintf(newPath, elcount(newPath), "%s.%s", oldPath, "usage");
      C2xSetTokenInt(packetHandle, "IVIM", newPath, value.usage);
      result = CheckLastError("IVIM", gkFuncRefGet, result);
    }
    break;
  }
  return result;
}

int GetIVIMIVI_TractorCharacteristics_equalToParams(LONG packetHandle, struct IVIMIVI_TractorCharacteristics_equalTo value, char oldPath[])
{
  char newPath[300]; 
  int i;
  int result;

  result = 0;

  value.length = C2xGetTokenInt(packetHandle, "IVIM", oldPath);
  if((result = CheckLastError("IVIM", gkFuncRefGet, result))==0)
  {
    for(i=0; i<value.length; i++)
    {
      snprintf(newPath, elcount(newPath), "%s[%d]", oldPath, i);
      GetIVIMIVI_VehicleCharacteristicsFixValuesParams(packetHandle, value.arrayValue[i], newPath);
      result = CheckLastError("IVIM", gkFuncRefGet, result);
    }
  }
  return result;
}

int SetIVIMIVI_TractorCharacteristics_equalToParams(LONG packetHandle, struct IVIMIVI_TractorCharacteristics_equalTo value, char oldPath[])
{
  char newPath[300]; 
  int i;
  int result;

  result = 0;

  C2xRemoveToken(packetHandle, "IVIM", oldPath);
  for(i=0; i<value.length; i++)
  {
    snprintf(newPath, elcount(newPath), "%s[%d]", oldPath, i);
    SetIVIMIVI_VehicleCharacteristicsFixValuesParams(packetHandle, value.arrayValue[i], newPath);
    result = CheckLastError("IVIM", gkFuncRefGet, result);
  }
  return result;
}

int GetIVIMIVI_TractorCharacteristics_notEqualToParams(LONG packetHandle, struct IVIMIVI_TractorCharacteristics_notEqualTo value, char oldPath[])
{
  char newPath[300]; 
  int i;
  int result;

  result = 0;

  value.length = C2xGetTokenInt(packetHandle, "IVIM", oldPath);
  if((result = CheckLastError("IVIM", gkFuncRefGet, result))==0)
  {
    for(i=0; i<value.length; i++)
    {
      snprintf(newPath, elcount(newPath), "%s[%d]", oldPath, i);
      GetIVIMIVI_VehicleCharacteristicsFixValuesParams(packetHandle, value.arrayValue[i], newPath);
      result = CheckLastError("IVIM", gkFuncRefGet, result);
    }
  }
  return result;
}

int SetIVIMIVI_TractorCharacteristics_notEqualToParams(LONG packetHandle, struct IVIMIVI_TractorCharacteristics_notEqualTo value, char oldPath[])
{
  char newPath[300]; 
  int i;
  int result;

  result = 0;

  C2xRemoveToken(packetHandle, "IVIM", oldPath);
  for(i=0; i<value.length; i++)
  {
    snprintf(newPath, elcount(newPath), "%s[%d]", oldPath, i);
    SetIVIMIVI_VehicleCharacteristicsFixValuesParams(packetHandle, value.arrayValue[i], newPath);
    result = CheckLastError("IVIM", gkFuncRefGet, result);
  }
  return result;
}

int GetIVIMEfcDsrcApplication_VehicleDimensionsParams(LONG packetHandle, struct IVIMEfcDsrcApplication_VehicleDimensions value, char oldPath[])
{
  char newPath[300];
  int result;

  result = 0;

  snprintf(newPath, elcount(newPath), "%s.%s", oldPath, "vehicleLengthOverall");
  value.vehicleLengthOverall = C2xGetTokenInt(packetHandle, "IVIM", newPath);
  result = CheckLastError("IVIM", gkFuncRefGet, result);

  snprintf(newPath, elcount(newPath), "%s.%s", oldPath, "vehicleHeigthOverall");
  value.vehicleHeigthOverall = C2xGetTokenInt(packetHandle, "IVIM", newPath);
  result = CheckLastError("IVIM", gkFuncRefGet, result);

  snprintf(newPath, elcount(newPath), "%s.%s", oldPath, "vehicleWidthOverall");
  value.vehicleWidthOverall = C2xGetTokenInt(packetHandle, "IVIM", newPath);
  result = CheckLastError("IVIM", gkFuncRefGet, result);

  return result;
}

int SetIVIMEfcDsrcApplication_VehicleDimensionsParams(LONG packetHandle, struct IVIMEfcDsrcApplication_VehicleDimensions value, char oldPath[])
{
  char newPath[300];
  int result;

  result = 0;

  snprintf(newPath, elcount(newPath), "%s.%s", oldPath, "vehicleLengthOverall");
  C2xSetTokenInt(packetHandle, "IVIM", newPath, value.vehicleLengthOverall);
  result = CheckLastError("IVIM", gkFuncRefGet, result);

  snprintf(newPath, elcount(newPath), "%s.%s", oldPath, "vehicleHeigthOverall");
  C2xSetTokenInt(packetHandle, "IVIM", newPath, value.vehicleHeigthOverall);
  result = CheckLastError("IVIM", gkFuncRefGet, result);

  snprintf(newPath, elcount(newPath), "%s.%s", oldPath, "vehicleWidthOverall");
  C2xSetTokenInt(packetHandle, "IVIM", newPath, value.vehicleWidthOverall);
  result = CheckLastError("IVIM", gkFuncRefGet, result);

  return result;
}

int GetIVIMEfcDsrcApplication_VehicleWeightLimitsParams(LONG packetHandle, struct IVIMEfcDsrcApplication_VehicleWeightLimits value, char oldPath[])
{
  char newPath[300];
  int result;

  result = 0;

  snprintf(newPath, elcount(newPath), "%s.%s", oldPath, "vehicleMaxLadenWeight");
  value.vehicleMaxLadenWeight = C2xGetTokenInt(packetHandle, "IVIM", newPath);
  result = CheckLastError("IVIM", gkFuncRefGet, result);

  snprintf(newPath, elcount(newPath), "%s.%s", oldPath, "vehicleTrainMaximumWeight");
  value.vehicleTrainMaximumWeight = C2xGetTokenInt(packetHandle, "IVIM", newPath);
  result = CheckLastError("IVIM", gkFuncRefGet, result);

  snprintf(newPath, elcount(newPath), "%s.%s", oldPath, "vehicleWeightUnladen");
  value.vehicleWeightUnladen = C2xGetTokenInt(packetHandle, "IVIM", newPath);
  result = CheckLastError("IVIM", gkFuncRefGet, result);

  return result;
}

int SetIVIMEfcDsrcApplication_VehicleWeightLimitsParams(LONG packetHandle, struct IVIMEfcDsrcApplication_VehicleWeightLimits value, char oldPath[])
{
  char newPath[300];
  int result;

  result = 0;

  snprintf(newPath, elcount(newPath), "%s.%s", oldPath, "vehicleMaxLadenWeight");
  C2xSetTokenInt(packetHandle, "IVIM", newPath, value.vehicleMaxLadenWeight);
  result = CheckLastError("IVIM", gkFuncRefGet, result);

  snprintf(newPath, elcount(newPath), "%s.%s", oldPath, "vehicleTrainMaximumWeight");
  C2xSetTokenInt(packetHandle, "IVIM", newPath, value.vehicleTrainMaximumWeight);
  result = CheckLastError("IVIM", gkFuncRefGet, result);

  snprintf(newPath, elcount(newPath), "%s.%s", oldPath, "vehicleWeightUnladen");
  C2xSetTokenInt(packetHandle, "IVIM", newPath, value.vehicleWeightUnladen);
  result = CheckLastError("IVIM", gkFuncRefGet, result);

  return result;
}

int GetIVIMEfcDsrcApplication_AxleWeightLimitsParams(LONG packetHandle, struct IVIMEfcDsrcApplication_AxleWeightLimits value, char oldPath[])
{
  char newPath[300];
  int result;

  result = 0;

  snprintf(newPath, elcount(newPath), "%s.%s", oldPath, "maxLadenweightOnAxle1");
  value.maxLadenweightOnAxle1 = C2xGetTokenInt(packetHandle, "IVIM", newPath);
  result = CheckLastError("IVIM", gkFuncRefGet, result);

  snprintf(newPath, elcount(newPath), "%s.%s", oldPath, "maxLadenweightOnAxle2");
  value.maxLadenweightOnAxle2 = C2xGetTokenInt(packetHandle, "IVIM", newPath);
  result = CheckLastError("IVIM", gkFuncRefGet, result);

  snprintf(newPath, elcount(newPath), "%s.%s", oldPath, "maxLadenweightOnAxle3");
  value.maxLadenweightOnAxle3 = C2xGetTokenInt(packetHandle, "IVIM", newPath);
  result = CheckLastError("IVIM", gkFuncRefGet, result);

  snprintf(newPath, elcount(newPath), "%s.%s", oldPath, "maxLadenweightOnAxle4");
  value.maxLadenweightOnAxle4 = C2xGetTokenInt(packetHandle, "IVIM", newPath);
  result = CheckLastError("IVIM", gkFuncRefGet, result);

  snprintf(newPath, elcount(newPath), "%s.%s", oldPath, "maxLadenweightOnAxle5");
  value.maxLadenweightOnAxle5 = C2xGetTokenInt(packetHandle, "IVIM", newPath);
  result = CheckLastError("IVIM", gkFuncRefGet, result);

  return result;
}

int SetIVIMEfcDsrcApplication_AxleWeightLimitsParams(LONG packetHandle, struct IVIMEfcDsrcApplication_AxleWeightLimits value, char oldPath[])
{
  char newPath[300];
  int result;

  result = 0;

  snprintf(newPath, elcount(newPath), "%s.%s", oldPath, "maxLadenweightOnAxle1");
  C2xSetTokenInt(packetHandle, "IVIM", newPath, value.maxLadenweightOnAxle1);
  result = CheckLastError("IVIM", gkFuncRefGet, result);

  snprintf(newPath, elcount(newPath), "%s.%s", oldPath, "maxLadenweightOnAxle2");
  C2xSetTokenInt(packetHandle, "IVIM", newPath, value.maxLadenweightOnAxle2);
  result = CheckLastError("IVIM", gkFuncRefGet, result);

  snprintf(newPath, elcount(newPath), "%s.%s", oldPath, "maxLadenweightOnAxle3");
  C2xSetTokenInt(packetHandle, "IVIM", newPath, value.maxLadenweightOnAxle3);
  result = CheckLastError("IVIM", gkFuncRefGet, result);

  snprintf(newPath, elcount(newPath), "%s.%s", oldPath, "maxLadenweightOnAxle4");
  C2xSetTokenInt(packetHandle, "IVIM", newPath, value.maxLadenweightOnAxle4);
  result = CheckLastError("IVIM", gkFuncRefGet, result);

  snprintf(newPath, elcount(newPath), "%s.%s", oldPath, "maxLadenweightOnAxle5");
  C2xSetTokenInt(packetHandle, "IVIM", newPath, value.maxLadenweightOnAxle5);
  result = CheckLastError("IVIM", gkFuncRefGet, result);

  return result;
}

int GetIVIMEfcDsrcApplication_PassengerCapacityParams(LONG packetHandle, struct IVIMEfcDsrcApplication_PassengerCapacity value, char oldPath[])
{
  char newPath[300];
  int result;

  result = 0;

  snprintf(newPath, elcount(newPath), "%s.%s", oldPath, "numberOfSeats");
  value.numberOfSeats = C2xGetTokenInt(packetHandle, "IVIM", newPath);
  result = CheckLastError("IVIM", gkFuncRefGet, result);

  snprintf(newPath, elcount(newPath), "%s.%s", oldPath, "numberOfStandingPlaces");
  value.numberOfStandingPlaces = C2xGetTokenInt(packetHandle, "IVIM", newPath);
  result = CheckLastError("IVIM", gkFuncRefGet, result);

  return result;
}

int SetIVIMEfcDsrcApplication_PassengerCapacityParams(LONG packetHandle, struct IVIMEfcDsrcApplication_PassengerCapacity value, char oldPath[])
{
  char newPath[300];
  int result;

  result = 0;

  snprintf(newPath, elcount(newPath), "%s.%s", oldPath, "numberOfSeats");
  C2xSetTokenInt(packetHandle, "IVIM", newPath, value.numberOfSeats);
  result = CheckLastError("IVIM", gkFuncRefGet, result);

  snprintf(newPath, elcount(newPath), "%s.%s", oldPath, "numberOfStandingPlaces");
  C2xSetTokenInt(packetHandle, "IVIM", newPath, value.numberOfStandingPlaces);
  result = CheckLastError("IVIM", gkFuncRefGet, result);

  return result;
}

int GetIVIMEfcDsrcApplication_ExhaustEmissionValuesParams(LONG packetHandle, struct IVIMEfcDsrcApplication_ExhaustEmissionValues value, char oldPath[])
{
  char newPath[300];
  int result;

  result = 0;

  snprintf(newPath, elcount(newPath), "%s.%s", oldPath, "unitType");
  value.unitType = C2xGetTokenInt(packetHandle, "IVIM", newPath);
  result = CheckLastError("IVIM", gkFuncRefGet, result);

  snprintf(newPath, elcount(newPath), "%s.%s", oldPath, "emissionCO");
  value.emissionCO = C2xGetTokenInt(packetHandle, "IVIM", newPath);
  result = CheckLastError("IVIM", gkFuncRefGet, result);

  snprintf(newPath, elcount(newPath), "%s.%s", oldPath, "emissionHC");
  value.emissionHC = C2xGetTokenInt(packetHandle, "IVIM", newPath);
  result = CheckLastError("IVIM", gkFuncRefGet, result);

  snprintf(newPath, elcount(newPath), "%s.%s", oldPath, "emissionNOX");
  value.emissionNOX = C2xGetTokenInt(packetHandle, "IVIM", newPath);
  result = CheckLastError("IVIM", gkFuncRefGet, result);

  snprintf(newPath, elcount(newPath), "%s.%s", oldPath, "emissionHCNOX");
  value.emissionHCNOX = C2xGetTokenInt(packetHandle, "IVIM", newPath);
  result = CheckLastError("IVIM", gkFuncRefGet, result);

  return result;
}

int SetIVIMEfcDsrcApplication_ExhaustEmissionValuesParams(LONG packetHandle, struct IVIMEfcDsrcApplication_ExhaustEmissionValues value, char oldPath[])
{
  char newPath[300];
  int result;

  result = 0;

  snprintf(newPath, elcount(newPath), "%s.%s", oldPath, "unitType");
  C2xSetTokenInt(packetHandle, "IVIM", newPath, value.unitType);
  result = CheckLastError("IVIM", gkFuncRefGet, result);

  snprintf(newPath, elcount(newPath), "%s.%s", oldPath, "emissionCO");
  C2xSetTokenInt(packetHandle, "IVIM", newPath, value.emissionCO);
  result = CheckLastError("IVIM", gkFuncRefGet, result);

  snprintf(newPath, elcount(newPath), "%s.%s", oldPath, "emissionHC");
  C2xSetTokenInt(packetHandle, "IVIM", newPath, value.emissionHC);
  result = CheckLastError("IVIM", gkFuncRefGet, result);

  snprintf(newPath, elcount(newPath), "%s.%s", oldPath, "emissionNOX");
  C2xSetTokenInt(packetHandle, "IVIM", newPath, value.emissionNOX);
  result = CheckLastError("IVIM", gkFuncRefGet, result);

  snprintf(newPath, elcount(newPath), "%s.%s", oldPath, "emissionHCNOX");
  C2xSetTokenInt(packetHandle, "IVIM", newPath, value.emissionHCNOX);
  result = CheckLastError("IVIM", gkFuncRefGet, result);

  return result;
}

int GetIVIMEfcDsrcApplication_DieselEmissionValues_particulateParams(LONG packetHandle, struct IVIMEfcDsrcApplication_DieselEmissionValues_particulate value, char oldPath[])
{
  char newPath[300];
  int result;

  result = 0;

  snprintf(newPath, elcount(newPath), "%s.%s", oldPath, "unitType");
  value.unitType = C2xGetTokenInt(packetHandle, "IVIM", newPath);
  result = CheckLastError("IVIM", gkFuncRefGet, result);

  snprintf(newPath, elcount(newPath), "%s.%s", oldPath, "value");
  value.value = C2xGetTokenInt(packetHandle, "IVIM", newPath);
  result = CheckLastError("IVIM", gkFuncRefGet, result);

  return result;
}

int SetIVIMEfcDsrcApplication_DieselEmissionValues_particulateParams(LONG packetHandle, struct IVIMEfcDsrcApplication_DieselEmissionValues_particulate value, char oldPath[])
{
  char newPath[300];
  int result;

  result = 0;

  snprintf(newPath, elcount(newPath), "%s.%s", oldPath, "unitType");
  C2xSetTokenInt(packetHandle, "IVIM", newPath, value.unitType);
  result = CheckLastError("IVIM", gkFuncRefGet, result);

  snprintf(newPath, elcount(newPath), "%s.%s", oldPath, "value");
  C2xSetTokenInt(packetHandle, "IVIM", newPath, value.value);
  result = CheckLastError("IVIM", gkFuncRefGet, result);

  return result;
}

int GetIVIMEfcDsrcApplication_DieselEmissionValuesParams(LONG packetHandle, struct IVIMEfcDsrcApplication_DieselEmissionValues value, char oldPath[])
{
  char newPath[300];
  int result;

  result = 0;

  snprintf(newPath, elcount(newPath), "%s.%s", oldPath, "particulate");
  GetIVIMEfcDsrcApplication_DieselEmissionValues_particulateParams(packetHandle, value.particulate, newPath);
  result = CheckLastError("IVIM", gkFuncRefGet, result);

  snprintf(newPath, elcount(newPath), "%s.%s", oldPath, "absorptionCoeff");
  value.absorptionCoeff = C2xGetTokenInt(packetHandle, "IVIM", newPath);
  result = CheckLastError("IVIM", gkFuncRefGet, result);

  return result;
}

int SetIVIMEfcDsrcApplication_DieselEmissionValuesParams(LONG packetHandle, struct IVIMEfcDsrcApplication_DieselEmissionValues value, char oldPath[])
{
  char newPath[300];
  int result;

  result = 0;

  snprintf(newPath, elcount(newPath), "%s.%s", oldPath, "particulate");
  SetIVIMEfcDsrcApplication_DieselEmissionValues_particulateParams(packetHandle, value.particulate, newPath);
  result = CheckLastError("IVIM", gkFuncRefGet, result);

  snprintf(newPath, elcount(newPath), "%s.%s", oldPath, "absorptionCoeff");
  C2xSetTokenInt(packetHandle, "IVIM", newPath, value.absorptionCoeff);
  result = CheckLastError("IVIM", gkFuncRefGet, result);

  return result;
}

int GetIVIMEfcDsrcApplication_SoundLevelParams(LONG packetHandle, struct IVIMEfcDsrcApplication_SoundLevel value, char oldPath[])
{
  char newPath[300];
  int result;

  result = 0;

  snprintf(newPath, elcount(newPath), "%s.%s", oldPath, "soundstationary");
  value.soundstationary = C2xGetTokenInt(packetHandle, "IVIM", newPath);
  result = CheckLastError("IVIM", gkFuncRefGet, result);

  snprintf(newPath, elcount(newPath), "%s.%s", oldPath, "sounddriveby");
  value.sounddriveby = C2xGetTokenInt(packetHandle, "IVIM", newPath);
  result = CheckLastError("IVIM", gkFuncRefGet, result);

  return result;
}

int SetIVIMEfcDsrcApplication_SoundLevelParams(LONG packetHandle, struct IVIMEfcDsrcApplication_SoundLevel value, char oldPath[])
{
  char newPath[300];
  int result;

  result = 0;

  snprintf(newPath, elcount(newPath), "%s.%s", oldPath, "soundstationary");
  C2xSetTokenInt(packetHandle, "IVIM", newPath, value.soundstationary);
  result = CheckLastError("IVIM", gkFuncRefGet, result);

  snprintf(newPath, elcount(newPath), "%s.%s", oldPath, "sounddriveby");
  C2xSetTokenInt(packetHandle, "IVIM", newPath, value.sounddriveby);
  result = CheckLastError("IVIM", gkFuncRefGet, result);

  return result;
}

int GetIVIMIVI_VehicleCharacteristicsRanges_limitsParams(LONG packetHandle, struct IVIMIVI_VehicleCharacteristicsRanges_limits value, char oldPath[])
{
  char newPath[300];
  int result;

  result = 0;

  value.choice = C2xGetTokenInt(packetHandle, "IVIM", oldPath);

  switch(value.choice)
  {
    case 0:
    {
      snprintf(newPath, elcount(newPath), "%s.%s", oldPath, "numberOfAxles");
      value.numberOfAxles = C2xGetTokenInt(packetHandle, "IVIM", newPath);
      result = CheckLastError("IVIM", gkFuncRefGet, result);
    }
    break;
    case 1:
    {
      snprintf(newPath, elcount(newPath), "%s.%s", oldPath, "vehicleDimensions");
      GetIVIMEfcDsrcApplication_VehicleDimensionsParams(packetHandle, value.vehicleDimensions, newPath);
      result = CheckLastError("IVIM", gkFuncRefGet, result);
    }
    break;
    case 2:
    {
      snprintf(newPath, elcount(newPath), "%s.%s", oldPath, "vehicleWeightLimits");
      GetIVIMEfcDsrcApplication_VehicleWeightLimitsParams(packetHandle, value.vehicleWeightLimits, newPath);
      result = CheckLastError("IVIM", gkFuncRefGet, result);
    }
    break;
    case 3:
    {
      snprintf(newPath, elcount(newPath), "%s.%s", oldPath, "axleWeightLimits");
      GetIVIMEfcDsrcApplication_AxleWeightLimitsParams(packetHandle, value.axleWeightLimits, newPath);
      result = CheckLastError("IVIM", gkFuncRefGet, result);
    }
    break;
    case 4:
    {
      snprintf(newPath, elcount(newPath), "%s.%s", oldPath, "passengerCapacity");
      GetIVIMEfcDsrcApplication_PassengerCapacityParams(packetHandle, value.passengerCapacity, newPath);
      result = CheckLastError("IVIM", gkFuncRefGet, result);
    }
    break;
    case 5:
    {
      snprintf(newPath, elcount(newPath), "%s.%s", oldPath, "exhaustEmissionValues");
      GetIVIMEfcDsrcApplication_ExhaustEmissionValuesParams(packetHandle, value.exhaustEmissionValues, newPath);
      result = CheckLastError("IVIM", gkFuncRefGet, result);
    }
    break;
    case 6:
    {
      snprintf(newPath, elcount(newPath), "%s.%s", oldPath, "dieselEmissionValues");
      GetIVIMEfcDsrcApplication_DieselEmissionValuesParams(packetHandle, value.dieselEmissionValues, newPath);
      result = CheckLastError("IVIM", gkFuncRefGet, result);
    }
    break;
    case 7:
    {
      snprintf(newPath, elcount(newPath), "%s.%s", oldPath, "soundLevel");
      GetIVIMEfcDsrcApplication_SoundLevelParams(packetHandle, value.soundLevel, newPath);
      result = CheckLastError("IVIM", gkFuncRefGet, result);
    }
    break;
  }
  return result;
}

int SetIVIMIVI_VehicleCharacteristicsRanges_limitsParams(LONG packetHandle, struct IVIMIVI_VehicleCharacteristicsRanges_limits value, char oldPath[])
{
  char newPath[300];
  int result;

  result = 0;

  switch(value.choice)
  {
    case 0:
    {
      snprintf(newPath, elcount(newPath), "%s.%s", oldPath, "numberOfAxles");
      C2xSetTokenInt(packetHandle, "IVIM", newPath, value.numberOfAxles);
      result = CheckLastError("IVIM", gkFuncRefGet, result);
    }
    break;
    case 1:
    {
      snprintf(newPath, elcount(newPath), "%s.%s", oldPath, "vehicleDimensions");
      SetIVIMEfcDsrcApplication_VehicleDimensionsParams(packetHandle, value.vehicleDimensions, newPath);
      result = CheckLastError("IVIM", gkFuncRefGet, result);
    }
    break;
    case 2:
    {
      snprintf(newPath, elcount(newPath), "%s.%s", oldPath, "vehicleWeightLimits");
      SetIVIMEfcDsrcApplication_VehicleWeightLimitsParams(packetHandle, value.vehicleWeightLimits, newPath);
      result = CheckLastError("IVIM", gkFuncRefGet, result);
    }
    break;
    case 3:
    {
      snprintf(newPath, elcount(newPath), "%s.%s", oldPath, "axleWeightLimits");
      SetIVIMEfcDsrcApplication_AxleWeightLimitsParams(packetHandle, value.axleWeightLimits, newPath);
      result = CheckLastError("IVIM", gkFuncRefGet, result);
    }
    break;
    case 4:
    {
      snprintf(newPath, elcount(newPath), "%s.%s", oldPath, "passengerCapacity");
      SetIVIMEfcDsrcApplication_PassengerCapacityParams(packetHandle, value.passengerCapacity, newPath);
      result = CheckLastError("IVIM", gkFuncRefGet, result);
    }
    break;
    case 5:
    {
      snprintf(newPath, elcount(newPath), "%s.%s", oldPath, "exhaustEmissionValues");
      SetIVIMEfcDsrcApplication_ExhaustEmissionValuesParams(packetHandle, value.exhaustEmissionValues, newPath);
      result = CheckLastError("IVIM", gkFuncRefGet, result);
    }
    break;
    case 6:
    {
      snprintf(newPath, elcount(newPath), "%s.%s", oldPath, "dieselEmissionValues");
      SetIVIMEfcDsrcApplication_DieselEmissionValuesParams(packetHandle, value.dieselEmissionValues, newPath);
      result = CheckLastError("IVIM", gkFuncRefGet, result);
    }
    break;
    case 7:
    {
      snprintf(newPath, elcount(newPath), "%s.%s", oldPath, "soundLevel");
      SetIVIMEfcDsrcApplication_SoundLevelParams(packetHandle, value.soundLevel, newPath);
      result = CheckLastError("IVIM", gkFuncRefGet, result);
    }
    break;
  }
  return result;
}

int GetIVIMIVI_VehicleCharacteristicsRangesParams(LONG packetHandle, struct IVIMIVI_VehicleCharacteristicsRanges value, char oldPath[])
{
  char newPath[300];
  int result;

  result = 0;

  snprintf(newPath, elcount(newPath), "%s.%s", oldPath, "comparisonOperator");
  value.comparisonOperator = C2xGetTokenInt(packetHandle, "IVIM", newPath);
  result = CheckLastError("IVIM", gkFuncRefGet, result);

  snprintf(newPath, elcount(newPath), "%s.%s", oldPath, "limits");
  GetIVIMIVI_VehicleCharacteristicsRanges_limitsParams(packetHandle, value.limits, newPath);
  result = CheckLastError("IVIM", gkFuncRefGet, result);

  return result;
}

int SetIVIMIVI_VehicleCharacteristicsRangesParams(LONG packetHandle, struct IVIMIVI_VehicleCharacteristicsRanges value, char oldPath[])
{
  char newPath[300];
  int result;

  result = 0;

  snprintf(newPath, elcount(newPath), "%s.%s", oldPath, "comparisonOperator");
  C2xSetTokenInt(packetHandle, "IVIM", newPath, value.comparisonOperator);
  result = CheckLastError("IVIM", gkFuncRefGet, result);

  snprintf(newPath, elcount(newPath), "%s.%s", oldPath, "limits");
  SetIVIMIVI_VehicleCharacteristicsRanges_limitsParams(packetHandle, value.limits, newPath);
  result = CheckLastError("IVIM", gkFuncRefGet, result);

  return result;
}

int GetIVIMIVI_TractorCharacteristics_rangesParams(LONG packetHandle, struct IVIMIVI_TractorCharacteristics_ranges value, char oldPath[])
{
  char newPath[300]; 
  int i;
  int result;

  result = 0;

  value.length = C2xGetTokenInt(packetHandle, "IVIM", oldPath);
  if((result = CheckLastError("IVIM", gkFuncRefGet, result))==0)
  {
    for(i=0; i<value.length; i++)
    {
      snprintf(newPath, elcount(newPath), "%s[%d]", oldPath, i);
      GetIVIMIVI_VehicleCharacteristicsRangesParams(packetHandle, value.arrayValue[i], newPath);
      result = CheckLastError("IVIM", gkFuncRefGet, result);
    }
  }
  return result;
}

int SetIVIMIVI_TractorCharacteristics_rangesParams(LONG packetHandle, struct IVIMIVI_TractorCharacteristics_ranges value, char oldPath[])
{
  char newPath[300]; 
  int i;
  int result;

  result = 0;

  C2xRemoveToken(packetHandle, "IVIM", oldPath);
  for(i=0; i<value.length; i++)
  {
    snprintf(newPath, elcount(newPath), "%s[%d]", oldPath, i);
    SetIVIMIVI_VehicleCharacteristicsRangesParams(packetHandle, value.arrayValue[i], newPath);
    result = CheckLastError("IVIM", gkFuncRefGet, result);
  }
  return result;
}

int GetIVIMIVI_TractorCharacteristicsParams(LONG packetHandle, struct IVIMIVI_TractorCharacteristics value, char oldPath[])
{
  char newPath[300];
  int result;

  result = 0;

  snprintf(newPath, elcount(newPath), "%s.%s", oldPath, "equalTo");
  value.equalTo.isValidFlag = C2xIsTokenAvailable(packetHandle, "IVIM", newPath);
  if(value.equalTo.isValidFlag==1)
  {
    GetIVIMIVI_TractorCharacteristics_equalToParams(packetHandle, value.equalTo, newPath);
    result = CheckLastError("IVIM", gkFuncRefGet, result);
  }
  snprintf(newPath, elcount(newPath), "%s.%s", oldPath, "notEqualTo");
  value.notEqualTo.isValidFlag = C2xIsTokenAvailable(packetHandle, "IVIM", newPath);
  if(value.notEqualTo.isValidFlag==1)
  {
    GetIVIMIVI_TractorCharacteristics_notEqualToParams(packetHandle, value.notEqualTo, newPath);
    result = CheckLastError("IVIM", gkFuncRefGet, result);
  }
  snprintf(newPath, elcount(newPath), "%s.%s", oldPath, "ranges");
  value.ranges.isValidFlag = C2xIsTokenAvailable(packetHandle, "IVIM", newPath);
  if(value.ranges.isValidFlag==1)
  {
    GetIVIMIVI_TractorCharacteristics_rangesParams(packetHandle, value.ranges, newPath);
    result = CheckLastError("IVIM", gkFuncRefGet, result);
  }
  return result;
}

int SetIVIMIVI_TractorCharacteristicsParams(LONG packetHandle, struct IVIMIVI_TractorCharacteristics value, char oldPath[])
{
  char newPath[300];
  int result;

  result = 0;

  snprintf(newPath, elcount(newPath), "%s.%s", oldPath, "equalTo");
  if(value.equalTo.isValidFlag==1)
  {
    SetIVIMIVI_TractorCharacteristics_equalToParams(packetHandle, value.equalTo, newPath);
    result = CheckLastError("IVIM", gkFuncRefGet, result);
  }
  else
  {
    if( C2xIsTokenAvailable(packetHandle, "IVIM", newPath) )
    {
      C2xRemoveToken(packetHandle, "IVIM", newPath);
    }
  }

  snprintf(newPath, elcount(newPath), "%s.%s", oldPath, "notEqualTo");
  if(value.notEqualTo.isValidFlag==1)
  {
    SetIVIMIVI_TractorCharacteristics_notEqualToParams(packetHandle, value.notEqualTo, newPath);
    result = CheckLastError("IVIM", gkFuncRefGet, result);
  }
  else
  {
    if( C2xIsTokenAvailable(packetHandle, "IVIM", newPath) )
    {
      C2xRemoveToken(packetHandle, "IVIM", newPath);
    }
  }

  snprintf(newPath, elcount(newPath), "%s.%s", oldPath, "ranges");
  if(value.ranges.isValidFlag==1)
  {
    SetIVIMIVI_TractorCharacteristics_rangesParams(packetHandle, value.ranges, newPath);
    result = CheckLastError("IVIM", gkFuncRefGet, result);
  }
  else
  {
    if( C2xIsTokenAvailable(packetHandle, "IVIM", newPath) )
    {
      C2xRemoveToken(packetHandle, "IVIM", newPath);
    }
  }

  return result;
}

int GetIVIMIVI_TrailerCharacteristics_equalToParams(LONG packetHandle, struct IVIMIVI_TrailerCharacteristics_equalTo value, char oldPath[])
{
  char newPath[300]; 
  int i;
  int result;

  result = 0;

  value.length = C2xGetTokenInt(packetHandle, "IVIM", oldPath);
  if((result = CheckLastError("IVIM", gkFuncRefGet, result))==0)
  {
    for(i=0; i<value.length; i++)
    {
      snprintf(newPath, elcount(newPath), "%s[%d]", oldPath, i);
      GetIVIMIVI_VehicleCharacteristicsFixValuesParams(packetHandle, value.arrayValue[i], newPath);
      result = CheckLastError("IVIM", gkFuncRefGet, result);
    }
  }
  return result;
}

int SetIVIMIVI_TrailerCharacteristics_equalToParams(LONG packetHandle, struct IVIMIVI_TrailerCharacteristics_equalTo value, char oldPath[])
{
  char newPath[300]; 
  int i;
  int result;

  result = 0;

  C2xRemoveToken(packetHandle, "IVIM", oldPath);
  for(i=0; i<value.length; i++)
  {
    snprintf(newPath, elcount(newPath), "%s[%d]", oldPath, i);
    SetIVIMIVI_VehicleCharacteristicsFixValuesParams(packetHandle, value.arrayValue[i], newPath);
    result = CheckLastError("IVIM", gkFuncRefGet, result);
  }
  return result;
}

int GetIVIMIVI_TrailerCharacteristics_notEqualToParams(LONG packetHandle, struct IVIMIVI_TrailerCharacteristics_notEqualTo value, char oldPath[])
{
  char newPath[300]; 
  int i;
  int result;

  result = 0;

  value.length = C2xGetTokenInt(packetHandle, "IVIM", oldPath);
  if((result = CheckLastError("IVIM", gkFuncRefGet, result))==0)
  {
    for(i=0; i<value.length; i++)
    {
      snprintf(newPath, elcount(newPath), "%s[%d]", oldPath, i);
      GetIVIMIVI_VehicleCharacteristicsFixValuesParams(packetHandle, value.arrayValue[i], newPath);
      result = CheckLastError("IVIM", gkFuncRefGet, result);
    }
  }
  return result;
}

int SetIVIMIVI_TrailerCharacteristics_notEqualToParams(LONG packetHandle, struct IVIMIVI_TrailerCharacteristics_notEqualTo value, char oldPath[])
{
  char newPath[300]; 
  int i;
  int result;

  result = 0;

  C2xRemoveToken(packetHandle, "IVIM", oldPath);
  for(i=0; i<value.length; i++)
  {
    snprintf(newPath, elcount(newPath), "%s[%d]", oldPath, i);
    SetIVIMIVI_VehicleCharacteristicsFixValuesParams(packetHandle, value.arrayValue[i], newPath);
    result = CheckLastError("IVIM", gkFuncRefGet, result);
  }
  return result;
}

int GetIVIMIVI_TrailerCharacteristics_rangesParams(LONG packetHandle, struct IVIMIVI_TrailerCharacteristics_ranges value, char oldPath[])
{
  char newPath[300]; 
  int i;
  int result;

  result = 0;

  value.length = C2xGetTokenInt(packetHandle, "IVIM", oldPath);
  if((result = CheckLastError("IVIM", gkFuncRefGet, result))==0)
  {
    for(i=0; i<value.length; i++)
    {
      snprintf(newPath, elcount(newPath), "%s[%d]", oldPath, i);
      GetIVIMIVI_VehicleCharacteristicsRangesParams(packetHandle, value.arrayValue[i], newPath);
      result = CheckLastError("IVIM", gkFuncRefGet, result);
    }
  }
  return result;
}

int SetIVIMIVI_TrailerCharacteristics_rangesParams(LONG packetHandle, struct IVIMIVI_TrailerCharacteristics_ranges value, char oldPath[])
{
  char newPath[300]; 
  int i;
  int result;

  result = 0;

  C2xRemoveToken(packetHandle, "IVIM", oldPath);
  for(i=0; i<value.length; i++)
  {
    snprintf(newPath, elcount(newPath), "%s[%d]", oldPath, i);
    SetIVIMIVI_VehicleCharacteristicsRangesParams(packetHandle, value.arrayValue[i], newPath);
    result = CheckLastError("IVIM", gkFuncRefGet, result);
  }
  return result;
}

int GetIVIMIVI_TrailerCharacteristicsParams(LONG packetHandle, struct IVIMIVI_TrailerCharacteristics value, char oldPath[])
{
  char newPath[300];
  int result;

  result = 0;

  snprintf(newPath, elcount(newPath), "%s.%s", oldPath, "equalTo");
  value.equalTo.isValidFlag = C2xIsTokenAvailable(packetHandle, "IVIM", newPath);
  if(value.equalTo.isValidFlag==1)
  {
    GetIVIMIVI_TrailerCharacteristics_equalToParams(packetHandle, value.equalTo, newPath);
    result = CheckLastError("IVIM", gkFuncRefGet, result);
  }
  snprintf(newPath, elcount(newPath), "%s.%s", oldPath, "notEqualTo");
  value.notEqualTo.isValidFlag = C2xIsTokenAvailable(packetHandle, "IVIM", newPath);
  if(value.notEqualTo.isValidFlag==1)
  {
    GetIVIMIVI_TrailerCharacteristics_notEqualToParams(packetHandle, value.notEqualTo, newPath);
    result = CheckLastError("IVIM", gkFuncRefGet, result);
  }
  snprintf(newPath, elcount(newPath), "%s.%s", oldPath, "ranges");
  value.ranges.isValidFlag = C2xIsTokenAvailable(packetHandle, "IVIM", newPath);
  if(value.ranges.isValidFlag==1)
  {
    GetIVIMIVI_TrailerCharacteristics_rangesParams(packetHandle, value.ranges, newPath);
    result = CheckLastError("IVIM", gkFuncRefGet, result);
  }
  return result;
}

int SetIVIMIVI_TrailerCharacteristicsParams(LONG packetHandle, struct IVIMIVI_TrailerCharacteristics value, char oldPath[])
{
  char newPath[300];
  int result;

  result = 0;

  snprintf(newPath, elcount(newPath), "%s.%s", oldPath, "equalTo");
  if(value.equalTo.isValidFlag==1)
  {
    SetIVIMIVI_TrailerCharacteristics_equalToParams(packetHandle, value.equalTo, newPath);
    result = CheckLastError("IVIM", gkFuncRefGet, result);
  }
  else
  {
    if( C2xIsTokenAvailable(packetHandle, "IVIM", newPath) )
    {
      C2xRemoveToken(packetHandle, "IVIM", newPath);
    }
  }

  snprintf(newPath, elcount(newPath), "%s.%s", oldPath, "notEqualTo");
  if(value.notEqualTo.isValidFlag==1)
  {
    SetIVIMIVI_TrailerCharacteristics_notEqualToParams(packetHandle, value.notEqualTo, newPath);
    result = CheckLastError("IVIM", gkFuncRefGet, result);
  }
  else
  {
    if( C2xIsTokenAvailable(packetHandle, "IVIM", newPath) )
    {
      C2xRemoveToken(packetHandle, "IVIM", newPath);
    }
  }

  snprintf(newPath, elcount(newPath), "%s.%s", oldPath, "ranges");
  if(value.ranges.isValidFlag==1)
  {
    SetIVIMIVI_TrailerCharacteristics_rangesParams(packetHandle, value.ranges, newPath);
    result = CheckLastError("IVIM", gkFuncRefGet, result);
  }
  else
  {
    if( C2xIsTokenAvailable(packetHandle, "IVIM", newPath) )
    {
      C2xRemoveToken(packetHandle, "IVIM", newPath);
    }
  }

  return result;
}

int GetIVIMIVI_CompleteVehicleCharacteristics_trailerParams(LONG packetHandle, struct IVIMIVI_CompleteVehicleCharacteristics_trailer value, char oldPath[])
{
  char newPath[300]; 
  int i;
  int result;

  result = 0;

  value.length = C2xGetTokenInt(packetHandle, "IVIM", oldPath);
  if((result = CheckLastError("IVIM", gkFuncRefGet, result))==0)
  {
    for(i=0; i<value.length; i++)
    {
      snprintf(newPath, elcount(newPath), "%s[%d]", oldPath, i);
      GetIVIMIVI_TrailerCharacteristicsParams(packetHandle, value.arrayValue[i], newPath);
      result = CheckLastError("IVIM", gkFuncRefGet, result);
    }
  }
  return result;
}

int SetIVIMIVI_CompleteVehicleCharacteristics_trailerParams(LONG packetHandle, struct IVIMIVI_CompleteVehicleCharacteristics_trailer value, char oldPath[])
{
  char newPath[300]; 
  int i;
  int result;

  result = 0;

  C2xRemoveToken(packetHandle, "IVIM", oldPath);
  for(i=0; i<value.length; i++)
  {
    snprintf(newPath, elcount(newPath), "%s[%d]", oldPath, i);
    SetIVIMIVI_TrailerCharacteristicsParams(packetHandle, value.arrayValue[i], newPath);
    result = CheckLastError("IVIM", gkFuncRefGet, result);
  }
  return result;
}

int GetIVIMIVI_CompleteVehicleCharacteristicsParams(LONG packetHandle, struct IVIMIVI_CompleteVehicleCharacteristics value, char oldPath[])
{
  char newPath[300];
  int result;

  result = 0;

  snprintf(newPath, elcount(newPath), "%s.%s", oldPath, "tractor");
  value.tractor.isValidFlag = C2xIsTokenAvailable(packetHandle, "IVIM", newPath);
  if(value.tractor.isValidFlag==1)
  {
    GetIVIMIVI_TractorCharacteristicsParams(packetHandle, value.tractor, newPath);
    result = CheckLastError("IVIM", gkFuncRefGet, result);
  }
  snprintf(newPath, elcount(newPath), "%s.%s", oldPath, "trailer");
  value.trailer.isValidFlag = C2xIsTokenAvailable(packetHandle, "IVIM", newPath);
  if(value.trailer.isValidFlag==1)
  {
    GetIVIMIVI_CompleteVehicleCharacteristics_trailerParams(packetHandle, value.trailer, newPath);
    result = CheckLastError("IVIM", gkFuncRefGet, result);
  }
  snprintf(newPath, elcount(newPath), "%s.%s", oldPath, "train");
  value.train.isValidFlag = C2xIsTokenAvailable(packetHandle, "IVIM", newPath);
  if(value.train.isValidFlag==1)
  {
    GetIVIMIVI_TractorCharacteristicsParams(packetHandle, value.train, newPath);
    result = CheckLastError("IVIM", gkFuncRefGet, result);
  }
  return result;
}

int SetIVIMIVI_CompleteVehicleCharacteristicsParams(LONG packetHandle, struct IVIMIVI_CompleteVehicleCharacteristics value, char oldPath[])
{
  char newPath[300];
  int result;

  result = 0;

  snprintf(newPath, elcount(newPath), "%s.%s", oldPath, "tractor");
  if(value.tractor.isValidFlag==1)
  {
    SetIVIMIVI_TractorCharacteristicsParams(packetHandle, value.tractor, newPath);
    result = CheckLastError("IVIM", gkFuncRefGet, result);
  }
  else
  {
    if( C2xIsTokenAvailable(packetHandle, "IVIM", newPath) )
    {
      C2xRemoveToken(packetHandle, "IVIM", newPath);
    }
  }

  snprintf(newPath, elcount(newPath), "%s.%s", oldPath, "trailer");
  if(value.trailer.isValidFlag==1)
  {
    SetIVIMIVI_CompleteVehicleCharacteristics_trailerParams(packetHandle, value.trailer, newPath);
    result = CheckLastError("IVIM", gkFuncRefGet, result);
  }
  else
  {
    if( C2xIsTokenAvailable(packetHandle, "IVIM", newPath) )
    {
      C2xRemoveToken(packetHandle, "IVIM", newPath);
    }
  }

  snprintf(newPath, elcount(newPath), "%s.%s", oldPath, "train");
  if(value.train.isValidFlag==1)
  {
    SetIVIMIVI_TractorCharacteristicsParams(packetHandle, value.train, newPath);
    result = CheckLastError("IVIM", gkFuncRefGet, result);
  }
  else
  {
    if( C2xIsTokenAvailable(packetHandle, "IVIM", newPath) )
    {
      C2xRemoveToken(packetHandle, "IVIM", newPath);
    }
  }

  return result;
}

int GetIVIMIVI_GicPart_vehicleCharacteristicsParams(LONG packetHandle, struct IVIMIVI_GicPart_vehicleCharacteristics value, char oldPath[])
{
  char newPath[300]; 
  int i;
  int result;

  result = 0;

  value.length = C2xGetTokenInt(packetHandle, "IVIM", oldPath);
  if((result = CheckLastError("IVIM", gkFuncRefGet, result))==0)
  {
    for(i=0; i<value.length; i++)
    {
      snprintf(newPath, elcount(newPath), "%s[%d]", oldPath, i);
      GetIVIMIVI_CompleteVehicleCharacteristicsParams(packetHandle, value.arrayValue[i], newPath);
      result = CheckLastError("IVIM", gkFuncRefGet, result);
    }
  }
  return result;
}

int SetIVIMIVI_GicPart_vehicleCharacteristicsParams(LONG packetHandle, struct IVIMIVI_GicPart_vehicleCharacteristics value, char oldPath[])
{
  char newPath[300]; 
  int i;
  int result;

  result = 0;

  C2xRemoveToken(packetHandle, "IVIM", oldPath);
  for(i=0; i<value.length; i++)
  {
    snprintf(newPath, elcount(newPath), "%s[%d]", oldPath, i);
    SetIVIMIVI_CompleteVehicleCharacteristicsParams(packetHandle, value.arrayValue[i], newPath);
    result = CheckLastError("IVIM", gkFuncRefGet, result);
  }
  return result;
}

int GetIVIMIVI_DTM_yearParams(LONG packetHandle, struct IVIMIVI_DTM_year value, char oldPath[])
{
  char newPath[300];
  int result;

  result = 0;

  snprintf(newPath, elcount(newPath), "%s.%s", oldPath, "syr");
  value.syr = C2xGetTokenInt(packetHandle, "IVIM", newPath);
  result = CheckLastError("IVIM", gkFuncRefGet, result);

  snprintf(newPath, elcount(newPath), "%s.%s", oldPath, "eyr");
  value.eyr = C2xGetTokenInt(packetHandle, "IVIM", newPath);
  result = CheckLastError("IVIM", gkFuncRefGet, result);

  return result;
}

int SetIVIMIVI_DTM_yearParams(LONG packetHandle, struct IVIMIVI_DTM_year value, char oldPath[])
{
  char newPath[300];
  int result;

  result = 0;

  snprintf(newPath, elcount(newPath), "%s.%s", oldPath, "syr");
  C2xSetTokenInt(packetHandle, "IVIM", newPath, value.syr);
  result = CheckLastError("IVIM", gkFuncRefGet, result);

  snprintf(newPath, elcount(newPath), "%s.%s", oldPath, "eyr");
  C2xSetTokenInt(packetHandle, "IVIM", newPath, value.eyr);
  result = CheckLastError("IVIM", gkFuncRefGet, result);

  return result;
}

int GetIVIMIVI_MonthDayParams(LONG packetHandle, struct IVIMIVI_MonthDay value, char oldPath[])
{
  char newPath[300];
  int result;

  result = 0;

  snprintf(newPath, elcount(newPath), "%s.%s", oldPath, "month");
  value.month = C2xGetTokenInt(packetHandle, "IVIM", newPath);
  result = CheckLastError("IVIM", gkFuncRefGet, result);

  snprintf(newPath, elcount(newPath), "%s.%s", oldPath, "day");
  value.day = C2xGetTokenInt(packetHandle, "IVIM", newPath);
  result = CheckLastError("IVIM", gkFuncRefGet, result);

  return result;
}

int SetIVIMIVI_MonthDayParams(LONG packetHandle, struct IVIMIVI_MonthDay value, char oldPath[])
{
  char newPath[300];
  int result;

  result = 0;

  snprintf(newPath, elcount(newPath), "%s.%s", oldPath, "month");
  C2xSetTokenInt(packetHandle, "IVIM", newPath, value.month);
  result = CheckLastError("IVIM", gkFuncRefGet, result);

  snprintf(newPath, elcount(newPath), "%s.%s", oldPath, "day");
  C2xSetTokenInt(packetHandle, "IVIM", newPath, value.day);
  result = CheckLastError("IVIM", gkFuncRefGet, result);

  return result;
}

int GetIVIMIVI_DTM_month_dayParams(LONG packetHandle, struct IVIMIVI_DTM_month_day value, char oldPath[])
{
  char newPath[300];
  int result;

  result = 0;

  snprintf(newPath, elcount(newPath), "%s.%s", oldPath, "smd");
  GetIVIMIVI_MonthDayParams(packetHandle, value.smd, newPath);
  result = CheckLastError("IVIM", gkFuncRefGet, result);

  snprintf(newPath, elcount(newPath), "%s.%s", oldPath, "emd");
  GetIVIMIVI_MonthDayParams(packetHandle, value.emd, newPath);
  result = CheckLastError("IVIM", gkFuncRefGet, result);

  return result;
}

int SetIVIMIVI_DTM_month_dayParams(LONG packetHandle, struct IVIMIVI_DTM_month_day value, char oldPath[])
{
  char newPath[300];
  int result;

  result = 0;

  snprintf(newPath, elcount(newPath), "%s.%s", oldPath, "smd");
  SetIVIMIVI_MonthDayParams(packetHandle, value.smd, newPath);
  result = CheckLastError("IVIM", gkFuncRefGet, result);

  snprintf(newPath, elcount(newPath), "%s.%s", oldPath, "emd");
  SetIVIMIVI_MonthDayParams(packetHandle, value.emd, newPath);
  result = CheckLastError("IVIM", gkFuncRefGet, result);

  return result;
}

int GetIVIMIVI_HoursMinutesParams(LONG packetHandle, struct IVIMIVI_HoursMinutes value, char oldPath[])
{
  char newPath[300];
  int result;

  result = 0;

  snprintf(newPath, elcount(newPath), "%s.%s", oldPath, "hours");
  value.hours = C2xGetTokenInt(packetHandle, "IVIM", newPath);
  result = CheckLastError("IVIM", gkFuncRefGet, result);

  snprintf(newPath, elcount(newPath), "%s.%s", oldPath, "mins");
  value.mins = C2xGetTokenInt(packetHandle, "IVIM", newPath);
  result = CheckLastError("IVIM", gkFuncRefGet, result);

  return result;
}

int SetIVIMIVI_HoursMinutesParams(LONG packetHandle, struct IVIMIVI_HoursMinutes value, char oldPath[])
{
  char newPath[300];
  int result;

  result = 0;

  snprintf(newPath, elcount(newPath), "%s.%s", oldPath, "hours");
  C2xSetTokenInt(packetHandle, "IVIM", newPath, value.hours);
  result = CheckLastError("IVIM", gkFuncRefGet, result);

  snprintf(newPath, elcount(newPath), "%s.%s", oldPath, "mins");
  C2xSetTokenInt(packetHandle, "IVIM", newPath, value.mins);
  result = CheckLastError("IVIM", gkFuncRefGet, result);

  return result;
}

int GetIVIMIVI_DTM_hourMinutesParams(LONG packetHandle, struct IVIMIVI_DTM_hourMinutes value, char oldPath[])
{
  char newPath[300];
  int result;

  result = 0;

  snprintf(newPath, elcount(newPath), "%s.%s", oldPath, "shm");
  GetIVIMIVI_HoursMinutesParams(packetHandle, value.shm, newPath);
  result = CheckLastError("IVIM", gkFuncRefGet, result);

  snprintf(newPath, elcount(newPath), "%s.%s", oldPath, "ehm");
  GetIVIMIVI_HoursMinutesParams(packetHandle, value.ehm, newPath);
  result = CheckLastError("IVIM", gkFuncRefGet, result);

  return result;
}

int SetIVIMIVI_DTM_hourMinutesParams(LONG packetHandle, struct IVIMIVI_DTM_hourMinutes value, char oldPath[])
{
  char newPath[300];
  int result;

  result = 0;

  snprintf(newPath, elcount(newPath), "%s.%s", oldPath, "shm");
  SetIVIMIVI_HoursMinutesParams(packetHandle, value.shm, newPath);
  result = CheckLastError("IVIM", gkFuncRefGet, result);

  snprintf(newPath, elcount(newPath), "%s.%s", oldPath, "ehm");
  SetIVIMIVI_HoursMinutesParams(packetHandle, value.ehm, newPath);
  result = CheckLastError("IVIM", gkFuncRefGet, result);

  return result;
}

int GetIVIMIVI_DTMParams(LONG packetHandle, struct IVIMIVI_DTM value, char oldPath[])
{
  char newPath[300]; 
  int j; 
  int k;
  int result;

  result = 0;

  snprintf(newPath, elcount(newPath), "%s.%s", oldPath, "year");
  value.year.isValidFlag = C2xIsTokenAvailable(packetHandle, "IVIM", newPath);
  if(value.year.isValidFlag==1)
  {
    GetIVIMIVI_DTM_yearParams(packetHandle, value.year, newPath);
    result = CheckLastError("IVIM", gkFuncRefGet, result);
  }
  snprintf(newPath, elcount(newPath), "%s.%s", oldPath, "month_day");
  value.month_day.isValidFlag = C2xIsTokenAvailable(packetHandle, "IVIM", newPath);
  if(value.month_day.isValidFlag==1)
  {
    GetIVIMIVI_DTM_month_dayParams(packetHandle, value.month_day, newPath);
    result = CheckLastError("IVIM", gkFuncRefGet, result);
  }
  snprintf(newPath, elcount(newPath), "%s.%s", oldPath, "pmd");
  value.pmd.isValidFlag = C2xIsTokenAvailable(packetHandle, "IVIM", newPath);
  if(value.pmd.isValidFlag==1)
  {
    value.pmd.isValidFlag = 1;
    value.pmd.stringLength = C2xGetTokenLengthBit(packetHandle, "IVIM", newPath);
    if ((result = CheckLastError("IVIM", gkFuncRefGet, result))==0)
    {
      if(value.pmd.stringLength > 0)
      {
        for(j=0; j<value.pmd.stringLength; j++)
        {
          if(C2xGetTokenBitOfBitString(packetHandle, "IVIM", newPath, j) == 0)
          {
            value.pmd.string[j] = '0';
          }
          else if(C2xGetTokenBitOfBitString(packetHandle, "IVIM", newPath, j) == 1)
          {
            value.pmd.string[j] = '1';
          }

          if(value.pmd.stringLength == 1)
          {
            value.pmd.string[1] = '0';
          }
          result = CheckLastError("IVIM", gkFuncRefGet, result);
        }
      }
      else
      {
        for(k = value.pmd.stringLength+1; k > -1; k--)
        {
          if(value.pmd.string[k] == '1')
          {
            value.pmd.string[k] = '0';
          }
        }
      }
    }

  }
  snprintf(newPath, elcount(newPath), "%s.%s", oldPath, "hourMinutes");
  value.hourMinutes.isValidFlag = C2xIsTokenAvailable(packetHandle, "IVIM", newPath);
  if(value.hourMinutes.isValidFlag==1)
  {
    GetIVIMIVI_DTM_hourMinutesParams(packetHandle, value.hourMinutes, newPath);
    result = CheckLastError("IVIM", gkFuncRefGet, result);
  }
  snprintf(newPath, elcount(newPath), "%s.%s", oldPath, "dayOfWeek");
  value.dayOfWeek.isValidFlag = C2xIsTokenAvailable(packetHandle, "IVIM", newPath);
  if(value.dayOfWeek.isValidFlag==1)
  {
    value.dayOfWeek.isValidFlag = 1;
    value.dayOfWeek.stringLength = C2xGetTokenLengthBit(packetHandle, "IVIM", newPath);
    if ((result = CheckLastError("IVIM", gkFuncRefGet, result))==0)
    {
      if(value.dayOfWeek.stringLength > 0)
      {
        for(j=0; j<value.dayOfWeek.stringLength; j++)
        {
          if(C2xGetTokenBitOfBitString(packetHandle, "IVIM", newPath, j) == 0)
          {
            value.dayOfWeek.string[j] = '0';
          }
          else if(C2xGetTokenBitOfBitString(packetHandle, "IVIM", newPath, j) == 1)
          {
            value.dayOfWeek.string[j] = '1';
          }

          if(value.dayOfWeek.stringLength == 1)
          {
            value.dayOfWeek.string[1] = '0';
          }
          result = CheckLastError("IVIM", gkFuncRefGet, result);
        }
      }
      else
      {
        for(k = value.dayOfWeek.stringLength+1; k > -1; k--)
        {
          if(value.dayOfWeek.string[k] == '1')
          {
            value.dayOfWeek.string[k] = '0';
          }
        }
      }
    }

  }
  snprintf(newPath, elcount(newPath), "%s.%s", oldPath, "period");
  value.period.isValidFlag = C2xIsTokenAvailable(packetHandle, "IVIM", newPath);
  if(value.period.isValidFlag==1)
  {
    GetIVIMIVI_HoursMinutesParams(packetHandle, value.period, newPath);
    result = CheckLastError("IVIM", gkFuncRefGet, result);
  }
  return result;
}

int SetIVIMIVI_DTMParams(LONG packetHandle, struct IVIMIVI_DTM value, char oldPath[])
{
  char newPath[300]; 
  int j;
  int result;

  result = 0;

  snprintf(newPath, elcount(newPath), "%s.%s", oldPath, "year");
  if(value.year.isValidFlag==1)
  {
    SetIVIMIVI_DTM_yearParams(packetHandle, value.year, newPath);
    result = CheckLastError("IVIM", gkFuncRefGet, result);
  }
  else
  {
    if( C2xIsTokenAvailable(packetHandle, "IVIM", newPath) )
    {
      C2xRemoveToken(packetHandle, "IVIM", newPath);
    }
  }

  snprintf(newPath, elcount(newPath), "%s.%s", oldPath, "month_day");
  if(value.month_day.isValidFlag==1)
  {
    SetIVIMIVI_DTM_month_dayParams(packetHandle, value.month_day, newPath);
    result = CheckLastError("IVIM", gkFuncRefGet, result);
  }
  else
  {
    if( C2xIsTokenAvailable(packetHandle, "IVIM", newPath) )
    {
      C2xRemoveToken(packetHandle, "IVIM", newPath);
    }
  }

  snprintf(newPath, elcount(newPath), "%s.%s", oldPath, "pmd");
  if(value.pmd.isValidFlag==1)
  {
      for(j=0; j<value.pmd.stringLength; j++)
      {
        if(value.pmd.string[j] == '0')
        {
          C2xSetTokenBitOfBitString(packetHandle, "IVIM", newPath, j, 0);
        }
        else
        {
          C2xSetTokenBitOfBitString(packetHandle, "IVIM", newPath, j, 1);
        }
        result = CheckLastError("IVIM", gkFuncRefGet, result);
      }
  }
  else
  {
    if( C2xIsTokenAvailable(packetHandle, "IVIM", newPath) )
    {
      C2xRemoveToken(packetHandle, "IVIM", newPath);
    }
  }

  snprintf(newPath, elcount(newPath), "%s.%s", oldPath, "hourMinutes");
  if(value.hourMinutes.isValidFlag==1)
  {
    SetIVIMIVI_DTM_hourMinutesParams(packetHandle, value.hourMinutes, newPath);
    result = CheckLastError("IVIM", gkFuncRefGet, result);
  }
  else
  {
    if( C2xIsTokenAvailable(packetHandle, "IVIM", newPath) )
    {
      C2xRemoveToken(packetHandle, "IVIM", newPath);
    }
  }

  snprintf(newPath, elcount(newPath), "%s.%s", oldPath, "dayOfWeek");
  if(value.dayOfWeek.isValidFlag==1)
  {
      for(j=0; j<value.dayOfWeek.stringLength; j++)
      {
        if(value.dayOfWeek.string[j] == '0')
        {
          C2xSetTokenBitOfBitString(packetHandle, "IVIM", newPath, j, 0);
        }
        else
        {
          C2xSetTokenBitOfBitString(packetHandle, "IVIM", newPath, j, 1);
        }
        result = CheckLastError("IVIM", gkFuncRefGet, result);
      }
  }
  else
  {
    if( C2xIsTokenAvailable(packetHandle, "IVIM", newPath) )
    {
      C2xRemoveToken(packetHandle, "IVIM", newPath);
    }
  }

  snprintf(newPath, elcount(newPath), "%s.%s", oldPath, "period");
  if(value.period.isValidFlag==1)
  {
    SetIVIMIVI_HoursMinutesParams(packetHandle, value.period, newPath);
    result = CheckLastError("IVIM", gkFuncRefGet, result);
  }
  else
  {
    if( C2xIsTokenAvailable(packetHandle, "IVIM", newPath) )
    {
      C2xRemoveToken(packetHandle, "IVIM", newPath);
    }
  }

  return result;
}

int GetIVIMIVI_VcCode_validityParams(LONG packetHandle, struct IVIMIVI_VcCode_validity value, char oldPath[])
{
  char newPath[300]; 
  int i;
  int result;

  result = 0;

  value.length = C2xGetTokenInt(packetHandle, "IVIM", oldPath);
  if((result = CheckLastError("IVIM", gkFuncRefGet, result))==0)
  {
    for(i=0; i<value.length; i++)
    {
      snprintf(newPath, elcount(newPath), "%s[%d]", oldPath, i);
      GetIVIMIVI_DTMParams(packetHandle, value.arrayValue[i], newPath);
      result = CheckLastError("IVIM", gkFuncRefGet, result);
    }
  }
  return result;
}

int SetIVIMIVI_VcCode_validityParams(LONG packetHandle, struct IVIMIVI_VcCode_validity value, char oldPath[])
{
  char newPath[300]; 
  int i;
  int result;

  result = 0;

  C2xRemoveToken(packetHandle, "IVIM", oldPath);
  for(i=0; i<value.length; i++)
  {
    snprintf(newPath, elcount(newPath), "%s[%d]", oldPath, i);
    SetIVIMIVI_DTMParams(packetHandle, value.arrayValue[i], newPath);
    result = CheckLastError("IVIM", gkFuncRefGet, result);
  }
  return result;
}

int GetIVIMIVI_VcCodeParams(LONG packetHandle, struct IVIMIVI_VcCode value, char oldPath[])
{
  char newPath[300];
  int result;

  result = 0;

  snprintf(newPath, elcount(newPath), "%s.%s", oldPath, "roadSignClass");
  value.roadSignClass = C2xGetTokenInt(packetHandle, "IVIM", newPath);
  result = CheckLastError("IVIM", gkFuncRefGet, result);

  snprintf(newPath, elcount(newPath), "%s.%s", oldPath, "roadSignCode");
  value.roadSignCode = C2xGetTokenInt(packetHandle, "IVIM", newPath);
  result = CheckLastError("IVIM", gkFuncRefGet, result);

  snprintf(newPath, elcount(newPath), "%s.%s", oldPath, "vcOption");
  value.vcOption = C2xGetTokenInt(packetHandle, "IVIM", newPath);
  result = CheckLastError("IVIM", gkFuncRefGet, result);

  snprintf(newPath, elcount(newPath), "%s.%s", oldPath, "validity");
  value.validity.isValidFlag = C2xIsTokenAvailable(packetHandle, "IVIM", newPath);
  if(value.validity.isValidFlag==1)
  {
    GetIVIMIVI_VcCode_validityParams(packetHandle, value.validity, newPath);
    result = CheckLastError("IVIM", gkFuncRefGet, result);
  }
  snprintf(newPath, elcount(newPath), "%s.%s", oldPath, "value");
  value.value.isValidFlag = C2xIsTokenAvailable(packetHandle, "IVIM", newPath);
  if(value.value.isValidFlag==1)
  {
    value.value.value = C2xGetTokenInt(packetHandle, "IVIM", newPath);
    result = CheckLastError("IVIM", gkFuncRefGet, result);
  }
  snprintf(newPath, elcount(newPath), "%s.%s", oldPath, "unit");
  value.unit.isValidFlag = C2xIsTokenAvailable(packetHandle, "IVIM", newPath);
  if(value.unit.isValidFlag==1)
  {
    value.unit.value = C2xGetTokenInt(packetHandle, "IVIM", newPath);
    result = CheckLastError("IVIM", gkFuncRefGet, result);
  }
  return result;
}

int SetIVIMIVI_VcCodeParams(LONG packetHandle, struct IVIMIVI_VcCode value, char oldPath[])
{
  char newPath[300];
  int result;

  result = 0;

  snprintf(newPath, elcount(newPath), "%s.%s", oldPath, "roadSignClass");
  C2xSetTokenInt(packetHandle, "IVIM", newPath, value.roadSignClass);
  result = CheckLastError("IVIM", gkFuncRefGet, result);

  snprintf(newPath, elcount(newPath), "%s.%s", oldPath, "roadSignCode");
  C2xSetTokenInt(packetHandle, "IVIM", newPath, value.roadSignCode);
  result = CheckLastError("IVIM", gkFuncRefGet, result);

  snprintf(newPath, elcount(newPath), "%s.%s", oldPath, "vcOption");
  C2xSetTokenInt(packetHandle, "IVIM", newPath, value.vcOption);
  result = CheckLastError("IVIM", gkFuncRefGet, result);

  snprintf(newPath, elcount(newPath), "%s.%s", oldPath, "validity");
  if(value.validity.isValidFlag==1)
  {
    SetIVIMIVI_VcCode_validityParams(packetHandle, value.validity, newPath);
    result = CheckLastError("IVIM", gkFuncRefGet, result);
  }
  else
  {
    if( C2xIsTokenAvailable(packetHandle, "IVIM", newPath) )
    {
      C2xRemoveToken(packetHandle, "IVIM", newPath);
    }
  }

  snprintf(newPath, elcount(newPath), "%s.%s", oldPath, "value");
  if(value.value.isValidFlag==1)
  {
    C2xSetTokenInt(packetHandle, "IVIM", newPath, value.value.value);
    result = CheckLastError("IVIM", gkFuncRefGet, result);
  }
  else
  {
    if( C2xIsTokenAvailable(packetHandle, "IVIM", newPath) )
    {
      C2xRemoveToken(packetHandle, "IVIM", newPath);
    }
  }

  snprintf(newPath, elcount(newPath), "%s.%s", oldPath, "unit");
  if(value.unit.isValidFlag==1)
  {
    C2xSetTokenInt(packetHandle, "IVIM", newPath, value.unit.value);
    result = CheckLastError("IVIM", gkFuncRefGet, result);
  }
  else
  {
    if( C2xIsTokenAvailable(packetHandle, "IVIM", newPath) )
    {
      C2xRemoveToken(packetHandle, "IVIM", newPath);
    }
  }

  return result;
}

int GetIVIMIVI_ISO14823Code_pictogramCode_serviceCategoryCodeParams(LONG packetHandle, struct IVIMIVI_ISO14823Code_pictogramCode_serviceCategoryCode value, char oldPath[])
{
  char newPath[300];
  int result;

  result = 0;

  value.choice = C2xGetTokenInt(packetHandle, "IVIM", oldPath);

  switch(value.choice)
  {
    case 0:
    {
      snprintf(newPath, elcount(newPath), "%s.%s", oldPath, "trafficSignPictogram");
      value.trafficSignPictogram = C2xGetTokenInt(packetHandle, "IVIM", newPath);
      result = CheckLastError("IVIM", gkFuncRefGet, result);
    }
    break;
    case 1:
    {
      snprintf(newPath, elcount(newPath), "%s.%s", oldPath, "publicFacilitiesPictogram");
      value.publicFacilitiesPictogram = C2xGetTokenInt(packetHandle, "IVIM", newPath);
      result = CheckLastError("IVIM", gkFuncRefGet, result);
    }
    break;
    case 2:
    {
      snprintf(newPath, elcount(newPath), "%s.%s", oldPath, "ambientOrRoadConditionPictogram");
      value.ambientOrRoadConditionPictogram = C2xGetTokenInt(packetHandle, "IVIM", newPath);
      result = CheckLastError("IVIM", gkFuncRefGet, result);
    }
    break;
  }
  return result;
}

int SetIVIMIVI_ISO14823Code_pictogramCode_serviceCategoryCodeParams(LONG packetHandle, struct IVIMIVI_ISO14823Code_pictogramCode_serviceCategoryCode value, char oldPath[])
{
  char newPath[300];
  int result;

  result = 0;

  switch(value.choice)
  {
    case 0:
    {
      snprintf(newPath, elcount(newPath), "%s.%s", oldPath, "trafficSignPictogram");
      C2xSetTokenInt(packetHandle, "IVIM", newPath, value.trafficSignPictogram);
      result = CheckLastError("IVIM", gkFuncRefGet, result);
    }
    break;
    case 1:
    {
      snprintf(newPath, elcount(newPath), "%s.%s", oldPath, "publicFacilitiesPictogram");
      C2xSetTokenInt(packetHandle, "IVIM", newPath, value.publicFacilitiesPictogram);
      result = CheckLastError("IVIM", gkFuncRefGet, result);
    }
    break;
    case 2:
    {
      snprintf(newPath, elcount(newPath), "%s.%s", oldPath, "ambientOrRoadConditionPictogram");
      C2xSetTokenInt(packetHandle, "IVIM", newPath, value.ambientOrRoadConditionPictogram);
      result = CheckLastError("IVIM", gkFuncRefGet, result);
    }
    break;
  }
  return result;
}

int GetIVIMIVI_ISO14823Code_pictogramCode_pictogramCategoryCodeParams(LONG packetHandle, struct IVIMIVI_ISO14823Code_pictogramCode_pictogramCategoryCode value, char oldPath[])
{
  char newPath[300];
  int result;

  result = 0;

  snprintf(newPath, elcount(newPath), "%s.%s", oldPath, "nature");
  value.nature = C2xGetTokenInt(packetHandle, "IVIM", newPath);
  result = CheckLastError("IVIM", gkFuncRefGet, result);

  snprintf(newPath, elcount(newPath), "%s.%s", oldPath, "serialNumber");
  value.serialNumber = C2xGetTokenInt(packetHandle, "IVIM", newPath);
  result = CheckLastError("IVIM", gkFuncRefGet, result);

  return result;
}

int SetIVIMIVI_ISO14823Code_pictogramCode_pictogramCategoryCodeParams(LONG packetHandle, struct IVIMIVI_ISO14823Code_pictogramCode_pictogramCategoryCode value, char oldPath[])
{
  char newPath[300];
  int result;

  result = 0;

  snprintf(newPath, elcount(newPath), "%s.%s", oldPath, "nature");
  C2xSetTokenInt(packetHandle, "IVIM", newPath, value.nature);
  result = CheckLastError("IVIM", gkFuncRefGet, result);

  snprintf(newPath, elcount(newPath), "%s.%s", oldPath, "serialNumber");
  C2xSetTokenInt(packetHandle, "IVIM", newPath, value.serialNumber);
  result = CheckLastError("IVIM", gkFuncRefGet, result);

  return result;
}

int GetIVIMIVI_ISO14823Code_pictogramCodeParams(LONG packetHandle, struct IVIMIVI_ISO14823Code_pictogramCode value, char oldPath[])
{
  char newPath[300];
  char buffer[300];
  int result;

  result = 0;

  snprintf(newPath, elcount(newPath), "%s.%s", oldPath, "countryCode");
  value.countryCode.isValidFlag = C2xIsTokenAvailable(packetHandle, "IVIM", newPath);
  if(value.countryCode.isValidFlag==1)
  {
    value.countryCode.isValidFlag = 1;
    value.countryCode.stringLength = C2xGetTokenData(packetHandle, "IVIM", newPath, elcount(value.countryCode.string), value.countryCode.string);
  }
  snprintf(newPath, elcount(newPath), "%s.%s", oldPath, "serviceCategoryCode");
  GetIVIMIVI_ISO14823Code_pictogramCode_serviceCategoryCodeParams(packetHandle, value.serviceCategoryCode, newPath);
  result = CheckLastError("IVIM", gkFuncRefGet, result);

  snprintf(newPath, elcount(newPath), "%s.%s", oldPath, "pictogramCategoryCode");
  GetIVIMIVI_ISO14823Code_pictogramCode_pictogramCategoryCodeParams(packetHandle, value.pictogramCategoryCode, newPath);
  result = CheckLastError("IVIM", gkFuncRefGet, result);

  return result;
}

int SetIVIMIVI_ISO14823Code_pictogramCodeParams(LONG packetHandle, struct IVIMIVI_ISO14823Code_pictogramCode value, char oldPath[])
{
  char newPath[300];
  char buffer[300];
  int result;

  result = 0;

  snprintf(newPath, elcount(newPath), "%s.%s", oldPath, "countryCode");
  if(value.countryCode.isValidFlag==1)
  {
    C2xSetTokenData(packetHandle, "IVIM", newPath, value.countryCode.stringLength, value.countryCode.string);
  }
  else
  {
    if( C2xIsTokenAvailable(packetHandle, "IVIM", newPath) )
    {
      C2xRemoveToken(packetHandle, "IVIM", newPath);
    }
  }

  snprintf(newPath, elcount(newPath), "%s.%s", oldPath, "serviceCategoryCode");
  SetIVIMIVI_ISO14823Code_pictogramCode_serviceCategoryCodeParams(packetHandle, value.serviceCategoryCode, newPath);
  result = CheckLastError("IVIM", gkFuncRefGet, result);

  snprintf(newPath, elcount(newPath), "%s.%s", oldPath, "pictogramCategoryCode");
  SetIVIMIVI_ISO14823Code_pictogramCode_pictogramCategoryCodeParams(packetHandle, value.pictogramCategoryCode, newPath);
  result = CheckLastError("IVIM", gkFuncRefGet, result);

  return result;
}

int GetIVIMIVI_DistanceParams(LONG packetHandle, struct IVIMIVI_Distance value, char oldPath[])
{
  char newPath[300];
  int result;

  result = 0;

  snprintf(newPath, elcount(newPath), "%s.%s", oldPath, "value");
  value.value = C2xGetTokenInt(packetHandle, "IVIM", newPath);
  result = CheckLastError("IVIM", gkFuncRefGet, result);

  snprintf(newPath, elcount(newPath), "%s.%s", oldPath, "unit");
  value.unit = C2xGetTokenInt(packetHandle, "IVIM", newPath);
  result = CheckLastError("IVIM", gkFuncRefGet, result);

  return result;
}

int SetIVIMIVI_DistanceParams(LONG packetHandle, struct IVIMIVI_Distance value, char oldPath[])
{
  char newPath[300];
  int result;

  result = 0;

  snprintf(newPath, elcount(newPath), "%s.%s", oldPath, "value");
  C2xSetTokenInt(packetHandle, "IVIM", newPath, value.value);
  result = CheckLastError("IVIM", gkFuncRefGet, result);

  snprintf(newPath, elcount(newPath), "%s.%s", oldPath, "unit");
  C2xSetTokenInt(packetHandle, "IVIM", newPath, value.unit);
  result = CheckLastError("IVIM", gkFuncRefGet, result);

  return result;
}

int GetIVIMIVI_WeightParams(LONG packetHandle, struct IVIMIVI_Weight value, char oldPath[])
{
  char newPath[300];
  int result;

  result = 0;

  snprintf(newPath, elcount(newPath), "%s.%s", oldPath, "value");
  value.value = C2xGetTokenInt(packetHandle, "IVIM", newPath);
  result = CheckLastError("IVIM", gkFuncRefGet, result);

  snprintf(newPath, elcount(newPath), "%s.%s", oldPath, "unit");
  value.unit = C2xGetTokenInt(packetHandle, "IVIM", newPath);
  result = CheckLastError("IVIM", gkFuncRefGet, result);

  return result;
}

int SetIVIMIVI_WeightParams(LONG packetHandle, struct IVIMIVI_Weight value, char oldPath[])
{
  char newPath[300];
  int result;

  result = 0;

  snprintf(newPath, elcount(newPath), "%s.%s", oldPath, "value");
  C2xSetTokenInt(packetHandle, "IVIM", newPath, value.value);
  result = CheckLastError("IVIM", gkFuncRefGet, result);

  snprintf(newPath, elcount(newPath), "%s.%s", oldPath, "unit");
  C2xSetTokenInt(packetHandle, "IVIM", newPath, value.unit);
  result = CheckLastError("IVIM", gkFuncRefGet, result);

  return result;
}

int GetIVIMIVI_VEDParams(LONG packetHandle, struct IVIMIVI_VED value, char oldPath[])
{
  char newPath[300];
  int result;

  result = 0;

  snprintf(newPath, elcount(newPath), "%s.%s", oldPath, "hei");
  value.hei.isValidFlag = C2xIsTokenAvailable(packetHandle, "IVIM", newPath);
  if(value.hei.isValidFlag==1)
  {
    GetIVIMIVI_DistanceParams(packetHandle, value.hei, newPath);
    result = CheckLastError("IVIM", gkFuncRefGet, result);
  }
  snprintf(newPath, elcount(newPath), "%s.%s", oldPath, "wid");
  value.wid.isValidFlag = C2xIsTokenAvailable(packetHandle, "IVIM", newPath);
  if(value.wid.isValidFlag==1)
  {
    GetIVIMIVI_DistanceParams(packetHandle, value.wid, newPath);
    result = CheckLastError("IVIM", gkFuncRefGet, result);
  }
  snprintf(newPath, elcount(newPath), "%s.%s", oldPath, "vln");
  value.vln.isValidFlag = C2xIsTokenAvailable(packetHandle, "IVIM", newPath);
  if(value.vln.isValidFlag==1)
  {
    GetIVIMIVI_DistanceParams(packetHandle, value.vln, newPath);
    result = CheckLastError("IVIM", gkFuncRefGet, result);
  }
  snprintf(newPath, elcount(newPath), "%s.%s", oldPath, "wei");
  value.wei.isValidFlag = C2xIsTokenAvailable(packetHandle, "IVIM", newPath);
  if(value.wei.isValidFlag==1)
  {
    GetIVIMIVI_WeightParams(packetHandle, value.wei, newPath);
    result = CheckLastError("IVIM", gkFuncRefGet, result);
  }
  return result;
}

int SetIVIMIVI_VEDParams(LONG packetHandle, struct IVIMIVI_VED value, char oldPath[])
{
  char newPath[300];
  int result;

  result = 0;

  snprintf(newPath, elcount(newPath), "%s.%s", oldPath, "hei");
  if(value.hei.isValidFlag==1)
  {
    SetIVIMIVI_DistanceParams(packetHandle, value.hei, newPath);
    result = CheckLastError("IVIM", gkFuncRefGet, result);
  }
  else
  {
    if( C2xIsTokenAvailable(packetHandle, "IVIM", newPath) )
    {
      C2xRemoveToken(packetHandle, "IVIM", newPath);
    }
  }

  snprintf(newPath, elcount(newPath), "%s.%s", oldPath, "wid");
  if(value.wid.isValidFlag==1)
  {
    SetIVIMIVI_DistanceParams(packetHandle, value.wid, newPath);
    result = CheckLastError("IVIM", gkFuncRefGet, result);
  }
  else
  {
    if( C2xIsTokenAvailable(packetHandle, "IVIM", newPath) )
    {
      C2xRemoveToken(packetHandle, "IVIM", newPath);
    }
  }

  snprintf(newPath, elcount(newPath), "%s.%s", oldPath, "vln");
  if(value.vln.isValidFlag==1)
  {
    SetIVIMIVI_DistanceParams(packetHandle, value.vln, newPath);
    result = CheckLastError("IVIM", gkFuncRefGet, result);
  }
  else
  {
    if( C2xIsTokenAvailable(packetHandle, "IVIM", newPath) )
    {
      C2xRemoveToken(packetHandle, "IVIM", newPath);
    }
  }

  snprintf(newPath, elcount(newPath), "%s.%s", oldPath, "wei");
  if(value.wei.isValidFlag==1)
  {
    SetIVIMIVI_WeightParams(packetHandle, value.wei, newPath);
    result = CheckLastError("IVIM", gkFuncRefGet, result);
  }
  else
  {
    if( C2xIsTokenAvailable(packetHandle, "IVIM", newPath) )
    {
      C2xRemoveToken(packetHandle, "IVIM", newPath);
    }
  }

  return result;
}

int GetIVIMIVI_SPEParams(LONG packetHandle, struct IVIMIVI_SPE value, char oldPath[])
{
  char newPath[300];
  int result;

  result = 0;

  snprintf(newPath, elcount(newPath), "%s.%s", oldPath, "spm");
  value.spm.isValidFlag = C2xIsTokenAvailable(packetHandle, "IVIM", newPath);
  if(value.spm.isValidFlag==1)
  {
    value.spm.value = C2xGetTokenInt(packetHandle, "IVIM", newPath);
    result = CheckLastError("IVIM", gkFuncRefGet, result);
  }
  snprintf(newPath, elcount(newPath), "%s.%s", oldPath, "mns");
  value.mns.isValidFlag = C2xIsTokenAvailable(packetHandle, "IVIM", newPath);
  if(value.mns.isValidFlag==1)
  {
    value.mns.value = C2xGetTokenInt(packetHandle, "IVIM", newPath);
    result = CheckLastError("IVIM", gkFuncRefGet, result);
  }
  snprintf(newPath, elcount(newPath), "%s.%s", oldPath, "unit");
  value.unit = C2xGetTokenInt(packetHandle, "IVIM", newPath);
  result = CheckLastError("IVIM", gkFuncRefGet, result);

  return result;
}

int SetIVIMIVI_SPEParams(LONG packetHandle, struct IVIMIVI_SPE value, char oldPath[])
{
  char newPath[300];
  int result;

  result = 0;

  snprintf(newPath, elcount(newPath), "%s.%s", oldPath, "spm");
  if(value.spm.isValidFlag==1)
  {
    C2xSetTokenInt(packetHandle, "IVIM", newPath, value.spm.value);
    result = CheckLastError("IVIM", gkFuncRefGet, result);
  }
  else
  {
    if( C2xIsTokenAvailable(packetHandle, "IVIM", newPath) )
    {
      C2xRemoveToken(packetHandle, "IVIM", newPath);
    }
  }

  snprintf(newPath, elcount(newPath), "%s.%s", oldPath, "mns");
  if(value.mns.isValidFlag==1)
  {
    C2xSetTokenInt(packetHandle, "IVIM", newPath, value.mns.value);
    result = CheckLastError("IVIM", gkFuncRefGet, result);
  }
  else
  {
    if( C2xIsTokenAvailable(packetHandle, "IVIM", newPath) )
    {
      C2xRemoveToken(packetHandle, "IVIM", newPath);
    }
  }

  snprintf(newPath, elcount(newPath), "%s.%s", oldPath, "unit");
  C2xSetTokenInt(packetHandle, "IVIM", newPath, value.unit);
  result = CheckLastError("IVIM", gkFuncRefGet, result);

  return result;
}

int GetIVIMIVI_ISO14823CodeParams(LONG packetHandle, struct IVIMIVI_ISO14823Code value, char oldPath[])
{
  char newPath[300];
  int result;

  result = 0;

  snprintf(newPath, elcount(newPath), "%s.%s", oldPath, "pictogramCode");
  GetIVIMIVI_ISO14823Code_pictogramCodeParams(packetHandle, value.pictogramCode, newPath);
  result = CheckLastError("IVIM", gkFuncRefGet, result);

// ****** Loop, not supported ******* //
  
//  snprintf(newPath, elcount(newPath), "%s.%s", oldPath, "attributes");
//  value.attributes.isValidFlag = C2xIsTokenAvailable(packetHandle, "IVIM", newPath);
//  if(value.attributes.isValidFlag==1)
//  {
//    GetIVIMIVI_ISO14823AttributesParams(packetHandle, value.attributes, newPath);
//    result = CheckLastError("IVIM", gkFuncRefGet, result);
//  }
  return result;
}

int SetIVIMIVI_ISO14823CodeParams(LONG packetHandle, struct IVIMIVI_ISO14823Code value, char oldPath[])
{
  char newPath[300];
  int result;

  result = 0;

  snprintf(newPath, elcount(newPath), "%s.%s", oldPath, "pictogramCode");
  SetIVIMIVI_ISO14823Code_pictogramCodeParams(packetHandle, value.pictogramCode, newPath);
  result = CheckLastError("IVIM", gkFuncRefGet, result);

  snprintf(newPath, elcount(newPath), "%s.%s", oldPath, "attributes");
  
// ****** Loop, not supported ******* //
  
//  if(value.attributes.isValidFlag==1)
//  {
//    SetIVIMIVI_ISO14823AttributesParams(packetHandle, value.attributes, newPath);
//    result = CheckLastError("IVIM", gkFuncRefGet, result);
//  }
//  else
//  {
//    if( C2xIsTokenAvailable(packetHandle, "IVIM", newPath) )
//    {
//      C2xRemoveToken(packetHandle, "IVIM", newPath);
//    }
//  }

  return result;
}

int GetIVIMIVI_DestinationPlaceParams(LONG packetHandle, struct IVIMIVI_DestinationPlace value, char oldPath[])
{
  char newPath[300];
  int result;

  result = 0;

  snprintf(newPath, elcount(newPath), "%s.%s", oldPath, "depType");
  value.depType = C2xGetTokenInt(packetHandle, "IVIM", newPath);
  result = CheckLastError("IVIM", gkFuncRefGet, result);

  snprintf(newPath, elcount(newPath), "%s.%s", oldPath, "depRSCode");
  value.depRSCode.isValidFlag = C2xIsTokenAvailable(packetHandle, "IVIM", newPath);
  if(value.depRSCode.isValidFlag==1)
  {
    GetIVIMIVI_ISO14823CodeParams(packetHandle, value.depRSCode, newPath);
    result = CheckLastError("IVIM", gkFuncRefGet, result);
  }
  snprintf(newPath, elcount(newPath), "%s.%s", oldPath, "depBlob");
  value.depBlob.isValidFlag = C2xIsTokenAvailable(packetHandle, "IVIM", newPath);
  if(value.depBlob.isValidFlag==1)
  {
    value.depBlob.isValidFlag = 1;
    value.depBlob.stringLength = C2xGetTokenData(packetHandle, "IVIM", newPath, elcount(value.depBlob.string), value.depBlob.string);
  }
  snprintf(newPath, elcount(newPath), "%s.%s", oldPath, "plnId");
  value.plnId.isValidFlag = C2xIsTokenAvailable(packetHandle, "IVIM", newPath);
  if(value.plnId.isValidFlag==1)
  {
    value.plnId.value = C2xGetTokenInt(packetHandle, "IVIM", newPath);
    result = CheckLastError("IVIM", gkFuncRefGet, result);
  }
  snprintf(newPath, elcount(newPath), "%s.%s", oldPath, "plnText");
  value.plnText.isValidFlag = C2xIsTokenAvailable(packetHandle, "IVIM", newPath);
  if(value.plnText.isValidFlag==1)
  {
    value.plnText.stringLength = C2xGetTokenData(packetHandle, "IVIM", newPath, elcount(value.plnText.string), value.plnText.string);
    result = CheckLastError("IVIM", gkFuncRefGet, result);
  }
  return result;
}

int SetIVIMIVI_DestinationPlaceParams(LONG packetHandle, struct IVIMIVI_DestinationPlace value, char oldPath[])
{
  char newPath[300];
  int result;

  result = 0;

  snprintf(newPath, elcount(newPath), "%s.%s", oldPath, "depType");
  C2xSetTokenInt(packetHandle, "IVIM", newPath, value.depType);
  result = CheckLastError("IVIM", gkFuncRefGet, result);

  snprintf(newPath, elcount(newPath), "%s.%s", oldPath, "depRSCode");
  if(value.depRSCode.isValidFlag==1)
  {
    SetIVIMIVI_ISO14823CodeParams(packetHandle, value.depRSCode, newPath);
    result = CheckLastError("IVIM", gkFuncRefGet, result);
  }
  else
  {
    if( C2xIsTokenAvailable(packetHandle, "IVIM", newPath) )
    {
      C2xRemoveToken(packetHandle, "IVIM", newPath);
    }
  }

  snprintf(newPath, elcount(newPath), "%s.%s", oldPath, "depBlob");
  if(value.depBlob.isValidFlag==1)
  {
    C2xSetTokenData(packetHandle, "IVIM", newPath, value.depBlob.stringLength, value.depBlob.string);
  }
  else
  {
    if( C2xIsTokenAvailable(packetHandle, "IVIM", newPath) )
    {
      C2xRemoveToken(packetHandle, "IVIM", newPath);
    }
  }

  snprintf(newPath, elcount(newPath), "%s.%s", oldPath, "plnId");
  if(value.plnId.isValidFlag==1)
  {
    C2xSetTokenInt(packetHandle, "IVIM", newPath, value.plnId.value);
    result = CheckLastError("IVIM", gkFuncRefGet, result);
  }
  else
  {
    if( C2xIsTokenAvailable(packetHandle, "IVIM", newPath) )
    {
      C2xRemoveToken(packetHandle, "IVIM", newPath);
    }
  }

  snprintf(newPath, elcount(newPath), "%s.%s", oldPath, "plnText");
  if(value.plnText.isValidFlag==1)
  {
    C2xSetTokenData(packetHandle, "IVIM", newPath, value.plnText.stringLength, value.plnText.string);
    result = CheckLastError("IVIM", gkFuncRefGet, result);
  }
  else
  {
    if( C2xIsTokenAvailable(packetHandle, "IVIM", newPath) )
    {
      C2xRemoveToken(packetHandle, "IVIM", newPath);
    }
  }

  return result;
}

int GetIVIMIVI_DDD_IO_dpParams(LONG packetHandle, struct IVIMIVI_DDD_IO_dp value, char oldPath[])
{
  char newPath[300]; 
  int i;
  int result;

  result = 0;

  value.length = C2xGetTokenInt(packetHandle, "IVIM", oldPath);
  if((result = CheckLastError("IVIM", gkFuncRefGet, result))==0)
  {
    for(i=0; i<value.length; i++)
    {
      snprintf(newPath, elcount(newPath), "%s[%d]", oldPath, i);
      GetIVIMIVI_DestinationPlaceParams(packetHandle, value.arrayValue[i], newPath);
      result = CheckLastError("IVIM", gkFuncRefGet, result);
    }
  }
  return result;
}

int SetIVIMIVI_DDD_IO_dpParams(LONG packetHandle, struct IVIMIVI_DDD_IO_dp value, char oldPath[])
{
  char newPath[300]; 
  int i;
  int result;

  result = 0;

  C2xRemoveToken(packetHandle, "IVIM", oldPath);
  for(i=0; i<value.length; i++)
  {
    snprintf(newPath, elcount(newPath), "%s[%d]", oldPath, i);
    SetIVIMIVI_DestinationPlaceParams(packetHandle, value.arrayValue[i], newPath);
    result = CheckLastError("IVIM", gkFuncRefGet, result);
  }
  return result;
}

int GetIVIMIVI_DestinationRoadParams(LONG packetHandle, struct IVIMIVI_DestinationRoad value, char oldPath[])
{
  char newPath[300];
  int result;

  result = 0;

  snprintf(newPath, elcount(newPath), "%s.%s", oldPath, "derType");
  value.derType = C2xGetTokenInt(packetHandle, "IVIM", newPath);
  result = CheckLastError("IVIM", gkFuncRefGet, result);

  snprintf(newPath, elcount(newPath), "%s.%s", oldPath, "ronId");
  value.ronId.isValidFlag = C2xIsTokenAvailable(packetHandle, "IVIM", newPath);
  if(value.ronId.isValidFlag==1)
  {
    value.ronId.value = C2xGetTokenInt(packetHandle, "IVIM", newPath);
    result = CheckLastError("IVIM", gkFuncRefGet, result);
  }
  snprintf(newPath, elcount(newPath), "%s.%s", oldPath, "ronText");
  value.ronText.isValidFlag = C2xIsTokenAvailable(packetHandle, "IVIM", newPath);
  if(value.ronText.isValidFlag==1)
  {
    value.ronText.stringLength = C2xGetTokenData(packetHandle, "IVIM", newPath, elcount(value.ronText.string), value.ronText.string);
    result = CheckLastError("IVIM", gkFuncRefGet, result);
  }
  return result;
}

int SetIVIMIVI_DestinationRoadParams(LONG packetHandle, struct IVIMIVI_DestinationRoad value, char oldPath[])
{
  char newPath[300];
  int result;

  result = 0;

  snprintf(newPath, elcount(newPath), "%s.%s", oldPath, "derType");
  C2xSetTokenInt(packetHandle, "IVIM", newPath, value.derType);
  result = CheckLastError("IVIM", gkFuncRefGet, result);

  snprintf(newPath, elcount(newPath), "%s.%s", oldPath, "ronId");
  if(value.ronId.isValidFlag==1)
  {
    C2xSetTokenInt(packetHandle, "IVIM", newPath, value.ronId.value);
    result = CheckLastError("IVIM", gkFuncRefGet, result);
  }
  else
  {
    if( C2xIsTokenAvailable(packetHandle, "IVIM", newPath) )
    {
      C2xRemoveToken(packetHandle, "IVIM", newPath);
    }
  }

  snprintf(newPath, elcount(newPath), "%s.%s", oldPath, "ronText");
  if(value.ronText.isValidFlag==1)
  {
    C2xSetTokenData(packetHandle, "IVIM", newPath, value.ronText.stringLength, value.ronText.string);
    result = CheckLastError("IVIM", gkFuncRefGet, result);
  }
  else
  {
    if( C2xIsTokenAvailable(packetHandle, "IVIM", newPath) )
    {
      C2xRemoveToken(packetHandle, "IVIM", newPath);
    }
  }

  return result;
}

int GetIVIMIVI_DDD_IO_drParams(LONG packetHandle, struct IVIMIVI_DDD_IO_dr value, char oldPath[])
{
  char newPath[300]; 
  int i;
  int result;

  result = 0;

  value.length = C2xGetTokenInt(packetHandle, "IVIM", oldPath);
  if((result = CheckLastError("IVIM", gkFuncRefGet, result))==0)
  {
    for(i=0; i<value.length; i++)
    {
      snprintf(newPath, elcount(newPath), "%s[%d]", oldPath, i);
      GetIVIMIVI_DestinationRoadParams(packetHandle, value.arrayValue[i], newPath);
      result = CheckLastError("IVIM", gkFuncRefGet, result);
    }
  }
  return result;
}

int SetIVIMIVI_DDD_IO_drParams(LONG packetHandle, struct IVIMIVI_DDD_IO_dr value, char oldPath[])
{
  char newPath[300]; 
  int i;
  int result;

  result = 0;

  C2xRemoveToken(packetHandle, "IVIM", oldPath);
  for(i=0; i<value.length; i++)
  {
    snprintf(newPath, elcount(newPath), "%s[%d]", oldPath, i);
    SetIVIMIVI_DestinationRoadParams(packetHandle, value.arrayValue[i], newPath);
    result = CheckLastError("IVIM", gkFuncRefGet, result);
  }
  return result;
}

int GetIVIMIVI_DistanceOrDurationParams(LONG packetHandle, struct IVIMIVI_DistanceOrDuration value, char oldPath[])
{
  char newPath[300];
  int result;

  result = 0;

  snprintf(newPath, elcount(newPath), "%s.%s", oldPath, "value");
  value.value = C2xGetTokenInt(packetHandle, "IVIM", newPath);
  result = CheckLastError("IVIM", gkFuncRefGet, result);

  snprintf(newPath, elcount(newPath), "%s.%s", oldPath, "unit");
  value.unit = C2xGetTokenInt(packetHandle, "IVIM", newPath);
  result = CheckLastError("IVIM", gkFuncRefGet, result);

  return result;
}

int SetIVIMIVI_DistanceOrDurationParams(LONG packetHandle, struct IVIMIVI_DistanceOrDuration value, char oldPath[])
{
  char newPath[300];
  int result;

  result = 0;

  snprintf(newPath, elcount(newPath), "%s.%s", oldPath, "value");
  C2xSetTokenInt(packetHandle, "IVIM", newPath, value.value);
  result = CheckLastError("IVIM", gkFuncRefGet, result);

  snprintf(newPath, elcount(newPath), "%s.%s", oldPath, "unit");
  C2xSetTokenInt(packetHandle, "IVIM", newPath, value.unit);
  result = CheckLastError("IVIM", gkFuncRefGet, result);

  return result;
}

int GetIVIMIVI_DDD_IOParams(LONG packetHandle, struct IVIMIVI_DDD_IO value, char oldPath[])
{
  char newPath[300];
  int result;

  result = 0;

  snprintf(newPath, elcount(newPath), "%s.%s", oldPath, "drn");
  value.drn = C2xGetTokenInt(packetHandle, "IVIM", newPath);
  result = CheckLastError("IVIM", gkFuncRefGet, result);

  snprintf(newPath, elcount(newPath), "%s.%s", oldPath, "dp");
  value.dp.isValidFlag = C2xIsTokenAvailable(packetHandle, "IVIM", newPath);
  if(value.dp.isValidFlag==1)
  {
    GetIVIMIVI_DDD_IO_dpParams(packetHandle, value.dp, newPath);
    result = CheckLastError("IVIM", gkFuncRefGet, result);
  }
  snprintf(newPath, elcount(newPath), "%s.%s", oldPath, "dr");
  value.dr.isValidFlag = C2xIsTokenAvailable(packetHandle, "IVIM", newPath);
  if(value.dr.isValidFlag==1)
  {
    GetIVIMIVI_DDD_IO_drParams(packetHandle, value.dr, newPath);
    result = CheckLastError("IVIM", gkFuncRefGet, result);
  }
  snprintf(newPath, elcount(newPath), "%s.%s", oldPath, "rne");
  value.rne.isValidFlag = C2xIsTokenAvailable(packetHandle, "IVIM", newPath);
  if(value.rne.isValidFlag==1)
  {
    value.rne.value = C2xGetTokenInt(packetHandle, "IVIM", newPath);
    result = CheckLastError("IVIM", gkFuncRefGet, result);
  }
  snprintf(newPath, elcount(newPath), "%s.%s", oldPath, "stnId");
  value.stnId.isValidFlag = C2xIsTokenAvailable(packetHandle, "IVIM", newPath);
  if(value.stnId.isValidFlag==1)
  {
    value.stnId.value = C2xGetTokenInt(packetHandle, "IVIM", newPath);
    result = CheckLastError("IVIM", gkFuncRefGet, result);
  }
  snprintf(newPath, elcount(newPath), "%s.%s", oldPath, "stnText");
  value.stnText.isValidFlag = C2xIsTokenAvailable(packetHandle, "IVIM", newPath);
  if(value.stnText.isValidFlag==1)
  {
    value.stnText.stringLength = C2xGetTokenData(packetHandle, "IVIM", newPath, elcount(value.stnText.string), value.stnText.string);
    result = CheckLastError("IVIM", gkFuncRefGet, result);
  }
  snprintf(newPath, elcount(newPath), "%s.%s", oldPath, "dcp");
  value.dcp.isValidFlag = C2xIsTokenAvailable(packetHandle, "IVIM", newPath);
  if(value.dcp.isValidFlag==1)
  {
    GetIVIMIVI_DistanceOrDurationParams(packetHandle, value.dcp, newPath);
    result = CheckLastError("IVIM", gkFuncRefGet, result);
  }
  snprintf(newPath, elcount(newPath), "%s.%s", oldPath, "ddp");
  value.ddp.isValidFlag = C2xIsTokenAvailable(packetHandle, "IVIM", newPath);
  if(value.ddp.isValidFlag==1)
  {
    GetIVIMIVI_DistanceOrDurationParams(packetHandle, value.ddp, newPath);
    result = CheckLastError("IVIM", gkFuncRefGet, result);
  }
  return result;
}

int SetIVIMIVI_DDD_IOParams(LONG packetHandle, struct IVIMIVI_DDD_IO value, char oldPath[])
{
  char newPath[300];
  int result;

  result = 0;

  snprintf(newPath, elcount(newPath), "%s.%s", oldPath, "drn");
  C2xSetTokenInt(packetHandle, "IVIM", newPath, value.drn);
  result = CheckLastError("IVIM", gkFuncRefGet, result);

  snprintf(newPath, elcount(newPath), "%s.%s", oldPath, "dp");
  if(value.dp.isValidFlag==1)
  {
    SetIVIMIVI_DDD_IO_dpParams(packetHandle, value.dp, newPath);
    result = CheckLastError("IVIM", gkFuncRefGet, result);
  }
  else
  {
    if( C2xIsTokenAvailable(packetHandle, "IVIM", newPath) )
    {
      C2xRemoveToken(packetHandle, "IVIM", newPath);
    }
  }

  snprintf(newPath, elcount(newPath), "%s.%s", oldPath, "dr");
  if(value.dr.isValidFlag==1)
  {
    SetIVIMIVI_DDD_IO_drParams(packetHandle, value.dr, newPath);
    result = CheckLastError("IVIM", gkFuncRefGet, result);
  }
  else
  {
    if( C2xIsTokenAvailable(packetHandle, "IVIM", newPath) )
    {
      C2xRemoveToken(packetHandle, "IVIM", newPath);
    }
  }

  snprintf(newPath, elcount(newPath), "%s.%s", oldPath, "rne");
  if(value.rne.isValidFlag==1)
  {
    C2xSetTokenInt(packetHandle, "IVIM", newPath, value.rne.value);
    result = CheckLastError("IVIM", gkFuncRefGet, result);
  }
  else
  {
    if( C2xIsTokenAvailable(packetHandle, "IVIM", newPath) )
    {
      C2xRemoveToken(packetHandle, "IVIM", newPath);
    }
  }

  snprintf(newPath, elcount(newPath), "%s.%s", oldPath, "stnId");
  if(value.stnId.isValidFlag==1)
  {
    C2xSetTokenInt(packetHandle, "IVIM", newPath, value.stnId.value);
    result = CheckLastError("IVIM", gkFuncRefGet, result);
  }
  else
  {
    if( C2xIsTokenAvailable(packetHandle, "IVIM", newPath) )
    {
      C2xRemoveToken(packetHandle, "IVIM", newPath);
    }
  }

  snprintf(newPath, elcount(newPath), "%s.%s", oldPath, "stnText");
  if(value.stnText.isValidFlag==1)
  {
    C2xSetTokenData(packetHandle, "IVIM", newPath, value.stnText.stringLength, value.stnText.string);
    result = CheckLastError("IVIM", gkFuncRefGet, result);
  }
  else
  {
    if( C2xIsTokenAvailable(packetHandle, "IVIM", newPath) )
    {
      C2xRemoveToken(packetHandle, "IVIM", newPath);
    }
  }

  snprintf(newPath, elcount(newPath), "%s.%s", oldPath, "dcp");
  if(value.dcp.isValidFlag==1)
  {
    SetIVIMIVI_DistanceOrDurationParams(packetHandle, value.dcp, newPath);
    result = CheckLastError("IVIM", gkFuncRefGet, result);
  }
  else
  {
    if( C2xIsTokenAvailable(packetHandle, "IVIM", newPath) )
    {
      C2xRemoveToken(packetHandle, "IVIM", newPath);
    }
  }

  snprintf(newPath, elcount(newPath), "%s.%s", oldPath, "ddp");
  if(value.ddp.isValidFlag==1)
  {
    SetIVIMIVI_DistanceOrDurationParams(packetHandle, value.ddp, newPath);
    result = CheckLastError("IVIM", gkFuncRefGet, result);
  }
  else
  {
    if( C2xIsTokenAvailable(packetHandle, "IVIM", newPath) )
    {
      C2xRemoveToken(packetHandle, "IVIM", newPath);
    }
  }

  return result;
}

int GetIVIMIVI_DDD_ioListParams(LONG packetHandle, struct IVIMIVI_DDD_ioList value, char oldPath[])
{
  char newPath[300]; 
  int i;
  int result;

  result = 0;

  value.length = C2xGetTokenInt(packetHandle, "IVIM", oldPath);
  if((result = CheckLastError("IVIM", gkFuncRefGet, result))==0)
  {
    for(i=0; i<value.length; i++)
    {
      snprintf(newPath, elcount(newPath), "%s[%d]", oldPath, i);
      GetIVIMIVI_DDD_IOParams(packetHandle, value.arrayValue[i], newPath);
      result = CheckLastError("IVIM", gkFuncRefGet, result);
    }
  }
  return result;
}

int SetIVIMIVI_DDD_ioListParams(LONG packetHandle, struct IVIMIVI_DDD_ioList value, char oldPath[])
{
  char newPath[300]; 
  int i;
  int result;

  result = 0;

  C2xRemoveToken(packetHandle, "IVIM", oldPath);
  for(i=0; i<value.length; i++)
  {
    snprintf(newPath, elcount(newPath), "%s[%d]", oldPath, i);
    SetIVIMIVI_DDD_IOParams(packetHandle, value.arrayValue[i], newPath);
    result = CheckLastError("IVIM", gkFuncRefGet, result);
  }
  return result;
}

int GetIVIMIVI_DDDParams(LONG packetHandle, struct IVIMIVI_DDD value, char oldPath[])
{
  char newPath[300];
  int result;

  result = 0;

  snprintf(newPath, elcount(newPath), "%s.%s", oldPath, "dcj");
  value.dcj.isValidFlag = C2xIsTokenAvailable(packetHandle, "IVIM", newPath);
  if(value.dcj.isValidFlag==1)
  {
    value.dcj.value = C2xGetTokenInt(packetHandle, "IVIM", newPath);
    result = CheckLastError("IVIM", gkFuncRefGet, result);
  }
  snprintf(newPath, elcount(newPath), "%s.%s", oldPath, "dcr");
  value.dcr.isValidFlag = C2xIsTokenAvailable(packetHandle, "IVIM", newPath);
  if(value.dcr.isValidFlag==1)
  {
    value.dcr.value = C2xGetTokenInt(packetHandle, "IVIM", newPath);
    result = CheckLastError("IVIM", gkFuncRefGet, result);
  }
  snprintf(newPath, elcount(newPath), "%s.%s", oldPath, "tpl");
  value.tpl.isValidFlag = C2xIsTokenAvailable(packetHandle, "IVIM", newPath);
  if(value.tpl.isValidFlag==1)
  {
    value.tpl.value = C2xGetTokenInt(packetHandle, "IVIM", newPath);
    result = CheckLastError("IVIM", gkFuncRefGet, result);
  }
  snprintf(newPath, elcount(newPath), "%s.%s", oldPath, "ioList");
  GetIVIMIVI_DDD_ioListParams(packetHandle, value.ioList, newPath);
  result = CheckLastError("IVIM", gkFuncRefGet, result);

  return result;
}

int SetIVIMIVI_DDDParams(LONG packetHandle, struct IVIMIVI_DDD value, char oldPath[])
{
  char newPath[300];
  int result;

  result = 0;

  snprintf(newPath, elcount(newPath), "%s.%s", oldPath, "dcj");
  if(value.dcj.isValidFlag==1)
  {
    C2xSetTokenInt(packetHandle, "IVIM", newPath, value.dcj.value);
    result = CheckLastError("IVIM", gkFuncRefGet, result);
  }
  else
  {
    if( C2xIsTokenAvailable(packetHandle, "IVIM", newPath) )
    {
      C2xRemoveToken(packetHandle, "IVIM", newPath);
    }
  }

  snprintf(newPath, elcount(newPath), "%s.%s", oldPath, "dcr");
  if(value.dcr.isValidFlag==1)
  {
    C2xSetTokenInt(packetHandle, "IVIM", newPath, value.dcr.value);
    result = CheckLastError("IVIM", gkFuncRefGet, result);
  }
  else
  {
    if( C2xIsTokenAvailable(packetHandle, "IVIM", newPath) )
    {
      C2xRemoveToken(packetHandle, "IVIM", newPath);
    }
  }

  snprintf(newPath, elcount(newPath), "%s.%s", oldPath, "tpl");
  if(value.tpl.isValidFlag==1)
  {
    C2xSetTokenInt(packetHandle, "IVIM", newPath, value.tpl.value);
    result = CheckLastError("IVIM", gkFuncRefGet, result);
  }
  else
  {
    if( C2xIsTokenAvailable(packetHandle, "IVIM", newPath) )
    {
      C2xRemoveToken(packetHandle, "IVIM", newPath);
    }
  }

  snprintf(newPath, elcount(newPath), "%s.%s", oldPath, "ioList");
  SetIVIMIVI_DDD_ioListParams(packetHandle, value.ioList, newPath);
  result = CheckLastError("IVIM", gkFuncRefGet, result);

  return result;
}

int GetIVIMIVI_ISO14823Attributes_Params(LONG packetHandle, struct IVIMIVI_ISO14823Attributes_ value, char oldPath[])
{
  char newPath[300];
  int result;

  result = 0;

  value.choice = C2xGetTokenInt(packetHandle, "IVIM", oldPath);

  switch(value.choice)
  {
    case 0:
    {
      snprintf(newPath, elcount(newPath), "%s.%s", oldPath, "dtm");
      GetIVIMIVI_DTMParams(packetHandle, value.dtm, newPath);
      result = CheckLastError("IVIM", gkFuncRefGet, result);
    }
    break;
    case 1:
    {
      snprintf(newPath, elcount(newPath), "%s.%s", oldPath, "edt");
      GetIVIMIVI_DTMParams(packetHandle, value.edt, newPath);
      result = CheckLastError("IVIM", gkFuncRefGet, result);
    }
    break;
    case 2:
    {
      snprintf(newPath, elcount(newPath), "%s.%s", oldPath, "dfl");
      value.dfl = C2xGetTokenInt(packetHandle, "IVIM", newPath);
      result = CheckLastError("IVIM", gkFuncRefGet, result);
    }
    break;
    case 3:
    {
      snprintf(newPath, elcount(newPath), "%s.%s", oldPath, "ved");
      GetIVIMIVI_VEDParams(packetHandle, value.ved, newPath);
      result = CheckLastError("IVIM", gkFuncRefGet, result);
    }
    break;
    case 4:
    {
      snprintf(newPath, elcount(newPath), "%s.%s", oldPath, "spe");
      GetIVIMIVI_SPEParams(packetHandle, value.spe, newPath);
      result = CheckLastError("IVIM", gkFuncRefGet, result);
    }
    break;
    case 5:
    {
      snprintf(newPath, elcount(newPath), "%s.%s", oldPath, "roi");
      value.roi = C2xGetTokenInt(packetHandle, "IVIM", newPath);
      result = CheckLastError("IVIM", gkFuncRefGet, result);
    }
    break;
    case 6:
    {
      snprintf(newPath, elcount(newPath), "%s.%s", oldPath, "dbv");
      GetIVIMIVI_DistanceParams(packetHandle, value.dbv, newPath);
      result = CheckLastError("IVIM", gkFuncRefGet, result);
    }
    break;
    case 7:
    {
      snprintf(newPath, elcount(newPath), "%s.%s", oldPath, "ddd");
      GetIVIMIVI_DDDParams(packetHandle, value.ddd, newPath);
      result = CheckLastError("IVIM", gkFuncRefGet, result);
    }
    break;
  }
  return result;
}

int SetIVIMIVI_ISO14823Attributes_Params(LONG packetHandle, struct IVIMIVI_ISO14823Attributes_ value, char oldPath[])
{
  char newPath[300];
  int result;

  result = 0;

  switch(value.choice)
  {
    case 0:
    {
      snprintf(newPath, elcount(newPath), "%s.%s", oldPath, "dtm");
      SetIVIMIVI_DTMParams(packetHandle, value.dtm, newPath);
      result = CheckLastError("IVIM", gkFuncRefGet, result);
    }
    break;
    case 1:
    {
      snprintf(newPath, elcount(newPath), "%s.%s", oldPath, "edt");
      SetIVIMIVI_DTMParams(packetHandle, value.edt, newPath);
      result = CheckLastError("IVIM", gkFuncRefGet, result);
    }
    break;
    case 2:
    {
      snprintf(newPath, elcount(newPath), "%s.%s", oldPath, "dfl");
      C2xSetTokenInt(packetHandle, "IVIM", newPath, value.dfl);
      result = CheckLastError("IVIM", gkFuncRefGet, result);
    }
    break;
    case 3:
    {
      snprintf(newPath, elcount(newPath), "%s.%s", oldPath, "ved");
      SetIVIMIVI_VEDParams(packetHandle, value.ved, newPath);
      result = CheckLastError("IVIM", gkFuncRefGet, result);
    }
    break;
    case 4:
    {
      snprintf(newPath, elcount(newPath), "%s.%s", oldPath, "spe");
      SetIVIMIVI_SPEParams(packetHandle, value.spe, newPath);
      result = CheckLastError("IVIM", gkFuncRefGet, result);
    }
    break;
    case 5:
    {
      snprintf(newPath, elcount(newPath), "%s.%s", oldPath, "roi");
      C2xSetTokenInt(packetHandle, "IVIM", newPath, value.roi);
      result = CheckLastError("IVIM", gkFuncRefGet, result);
    }
    break;
    case 6:
    {
      snprintf(newPath, elcount(newPath), "%s.%s", oldPath, "dbv");
      SetIVIMIVI_DistanceParams(packetHandle, value.dbv, newPath);
      result = CheckLastError("IVIM", gkFuncRefGet, result);
    }
    break;
    case 7:
    {
      snprintf(newPath, elcount(newPath), "%s.%s", oldPath, "ddd");
      SetIVIMIVI_DDDParams(packetHandle, value.ddd, newPath);
      result = CheckLastError("IVIM", gkFuncRefGet, result);
    }
    break;
  }
  return result;
}

int GetIVIMIVI_ISO14823AttributesParams(LONG packetHandle, struct IVIMIVI_ISO14823Attributes value, char oldPath[])
{
  char newPath[300]; 
  int i;
  int result;

  result = 0;

  value.length = C2xGetTokenInt(packetHandle, "IVIM", oldPath);
  if((result = CheckLastError("IVIM", gkFuncRefGet, result))==0)
  {
    for(i=0; i<value.length; i++)
    {
      snprintf(newPath, elcount(newPath), "%s[%d]", oldPath, i);
      GetIVIMIVI_ISO14823Attributes_Params(packetHandle, value.arrayValue[i], newPath);
      result = CheckLastError("IVIM", gkFuncRefGet, result);
    }
  }
  return result;
}

int SetIVIMIVI_ISO14823AttributesParams(LONG packetHandle, struct IVIMIVI_ISO14823Attributes value, char oldPath[])
{
  char newPath[300]; 
  int i;
  int result;

  result = 0;

  C2xRemoveToken(packetHandle, "IVIM", oldPath);
  for(i=0; i<value.length; i++)
  {
    snprintf(newPath, elcount(newPath), "%s[%d]", oldPath, i);
    SetIVIMIVI_ISO14823Attributes_Params(packetHandle, value.arrayValue[i], newPath);
    result = CheckLastError("IVIM", gkFuncRefGet, result);
  }
  return result;
}

int GetIVIMIVI_AnyCatalogueParams(LONG packetHandle, struct IVIMIVI_AnyCatalogue value, char oldPath[])
{
  char newPath[300];
  int result;

  result = 0;

  snprintf(newPath, elcount(newPath), "%s.%s", oldPath, "owner");
  GetIVIMEfcDsrcApplication_ProviderParams(packetHandle, value.owner, newPath);
  result = CheckLastError("IVIM", gkFuncRefGet, result);

  snprintf(newPath, elcount(newPath), "%s.%s", oldPath, "version");
  value.version = C2xGetTokenInt(packetHandle, "IVIM", newPath);
  result = CheckLastError("IVIM", gkFuncRefGet, result);

  snprintf(newPath, elcount(newPath), "%s.%s", oldPath, "pictogramCode");
  value.pictogramCode = C2xGetTokenInt(packetHandle, "IVIM", newPath);
  result = CheckLastError("IVIM", gkFuncRefGet, result);

  snprintf(newPath, elcount(newPath), "%s.%s", oldPath, "value");
  value.value.isValidFlag = C2xIsTokenAvailable(packetHandle, "IVIM", newPath);
  if(value.value.isValidFlag==1)
  {
    value.value.value = C2xGetTokenInt(packetHandle, "IVIM", newPath);
    result = CheckLastError("IVIM", gkFuncRefGet, result);
  }
  snprintf(newPath, elcount(newPath), "%s.%s", oldPath, "unit");
  value.unit.isValidFlag = C2xIsTokenAvailable(packetHandle, "IVIM", newPath);
  if(value.unit.isValidFlag==1)
  {
    value.unit.value = C2xGetTokenInt(packetHandle, "IVIM", newPath);
    result = CheckLastError("IVIM", gkFuncRefGet, result);
  }
  snprintf(newPath, elcount(newPath), "%s.%s", oldPath, "attributes");
  value.attributes.isValidFlag = C2xIsTokenAvailable(packetHandle, "IVIM", newPath);
  if(value.attributes.isValidFlag==1)
  {
    GetIVIMIVI_ISO14823AttributesParams(packetHandle, value.attributes, newPath);
    result = CheckLastError("IVIM", gkFuncRefGet, result);
  }
  return result;
}

int SetIVIMIVI_AnyCatalogueParams(LONG packetHandle, struct IVIMIVI_AnyCatalogue value, char oldPath[])
{
  char newPath[300];
  int result;

  result = 0;

  snprintf(newPath, elcount(newPath), "%s.%s", oldPath, "owner");
  SetIVIMEfcDsrcApplication_ProviderParams(packetHandle, value.owner, newPath);
  result = CheckLastError("IVIM", gkFuncRefGet, result);

  snprintf(newPath, elcount(newPath), "%s.%s", oldPath, "version");
  C2xSetTokenInt(packetHandle, "IVIM", newPath, value.version);
  result = CheckLastError("IVIM", gkFuncRefGet, result);

  snprintf(newPath, elcount(newPath), "%s.%s", oldPath, "pictogramCode");
  C2xSetTokenInt(packetHandle, "IVIM", newPath, value.pictogramCode);
  result = CheckLastError("IVIM", gkFuncRefGet, result);

  snprintf(newPath, elcount(newPath), "%s.%s", oldPath, "value");
  if(value.value.isValidFlag==1)
  {
    C2xSetTokenInt(packetHandle, "IVIM", newPath, value.value.value);
    result = CheckLastError("IVIM", gkFuncRefGet, result);
  }
  else
  {
    if( C2xIsTokenAvailable(packetHandle, "IVIM", newPath) )
    {
      C2xRemoveToken(packetHandle, "IVIM", newPath);
    }
  }

  snprintf(newPath, elcount(newPath), "%s.%s", oldPath, "unit");
  if(value.unit.isValidFlag==1)
  {
    C2xSetTokenInt(packetHandle, "IVIM", newPath, value.unit.value);
    result = CheckLastError("IVIM", gkFuncRefGet, result);
  }
  else
  {
    if( C2xIsTokenAvailable(packetHandle, "IVIM", newPath) )
    {
      C2xRemoveToken(packetHandle, "IVIM", newPath);
    }
  }

  snprintf(newPath, elcount(newPath), "%s.%s", oldPath, "attributes");
  if(value.attributes.isValidFlag==1)
  {
    SetIVIMIVI_ISO14823AttributesParams(packetHandle, value.attributes, newPath);
    result = CheckLastError("IVIM", gkFuncRefGet, result);
  }
  else
  {
    if( C2xIsTokenAvailable(packetHandle, "IVIM", newPath) )
    {
      C2xRemoveToken(packetHandle, "IVIM", newPath);
    }
  }

  return result;
}

int GetIVIMIVI_RSCode_codeParams(LONG packetHandle, struct IVIMIVI_RSCode_code value, char oldPath[])
{
  char newPath[300];
  int result;

  result = 0;

  value.choice = C2xGetTokenInt(packetHandle, "IVIM", oldPath);

  switch(value.choice)
  {
    case 0:
    {
      snprintf(newPath, elcount(newPath), "%s.%s", oldPath, "viennaConvention");
      GetIVIMIVI_VcCodeParams(packetHandle, value.viennaConvention, newPath);
      result = CheckLastError("IVIM", gkFuncRefGet, result);
    }
    break;
    case 1:
    {
      snprintf(newPath, elcount(newPath), "%s.%s", oldPath, "iso14823");
      GetIVIMIVI_ISO14823CodeParams(packetHandle, value.iso14823, newPath);
      result = CheckLastError("IVIM", gkFuncRefGet, result);
    }
    break;
    case 2:
    {
      snprintf(newPath, elcount(newPath), "%s.%s", oldPath, "itisCodes");
      value.itisCodes = C2xGetTokenInt(packetHandle, "IVIM", newPath);
      result = CheckLastError("IVIM", gkFuncRefGet, result);
    }
    break;
    case 3:
    {
      snprintf(newPath, elcount(newPath), "%s.%s", oldPath, "anyCatalogue");
      GetIVIMIVI_AnyCatalogueParams(packetHandle, value.anyCatalogue, newPath);
      result = CheckLastError("IVIM", gkFuncRefGet, result);
    }
    break;
  }
  return result;
}

int SetIVIMIVI_RSCode_codeParams(LONG packetHandle, struct IVIMIVI_RSCode_code value, char oldPath[])
{
  char newPath[300];
  int result;

  result = 0;

  switch(value.choice)
  {
    case 0:
    {
      snprintf(newPath, elcount(newPath), "%s.%s", oldPath, "viennaConvention");
      SetIVIMIVI_VcCodeParams(packetHandle, value.viennaConvention, newPath);
      result = CheckLastError("IVIM", gkFuncRefGet, result);
    }
    break;
    case 1:
    {
      snprintf(newPath, elcount(newPath), "%s.%s", oldPath, "iso14823");
      SetIVIMIVI_ISO14823CodeParams(packetHandle, value.iso14823, newPath);
      result = CheckLastError("IVIM", gkFuncRefGet, result);
    }
    break;
    case 2:
    {
      snprintf(newPath, elcount(newPath), "%s.%s", oldPath, "itisCodes");
      C2xSetTokenInt(packetHandle, "IVIM", newPath, value.itisCodes);
      result = CheckLastError("IVIM", gkFuncRefGet, result);
    }
    break;
    case 3:
    {
      snprintf(newPath, elcount(newPath), "%s.%s", oldPath, "anyCatalogue");
      SetIVIMIVI_AnyCatalogueParams(packetHandle, value.anyCatalogue, newPath);
      result = CheckLastError("IVIM", gkFuncRefGet, result);
    }
    break;
  }
  return result;
}

int GetIVIMIVI_RSCodeParams(LONG packetHandle, struct IVIMIVI_RSCode value, char oldPath[])
{
  char newPath[300];
  int result;

  result = 0;

  snprintf(newPath, elcount(newPath), "%s.%s", oldPath, "layoutComponentId");
  value.layoutComponentId.isValidFlag = C2xIsTokenAvailable(packetHandle, "IVIM", newPath);
  if(value.layoutComponentId.isValidFlag==1)
  {
    value.layoutComponentId.value = C2xGetTokenInt(packetHandle, "IVIM", newPath);
    result = CheckLastError("IVIM", gkFuncRefGet, result);
  }
  snprintf(newPath, elcount(newPath), "%s.%s", oldPath, "code");
  GetIVIMIVI_RSCode_codeParams(packetHandle, value.code, newPath);
  result = CheckLastError("IVIM", gkFuncRefGet, result);

  return result;
}

int SetIVIMIVI_RSCodeParams(LONG packetHandle, struct IVIMIVI_RSCode value, char oldPath[])
{
  char newPath[300];
  int result;

  result = 0;

  snprintf(newPath, elcount(newPath), "%s.%s", oldPath, "layoutComponentId");
  if(value.layoutComponentId.isValidFlag==1)
  {
    C2xSetTokenInt(packetHandle, "IVIM", newPath, value.layoutComponentId.value);
    result = CheckLastError("IVIM", gkFuncRefGet, result);
  }
  else
  {
    if( C2xIsTokenAvailable(packetHandle, "IVIM", newPath) )
    {
      C2xRemoveToken(packetHandle, "IVIM", newPath);
    }
  }

  snprintf(newPath, elcount(newPath), "%s.%s", oldPath, "code");
  SetIVIMIVI_RSCode_codeParams(packetHandle, value.code, newPath);
  result = CheckLastError("IVIM", gkFuncRefGet, result);

  return result;
}

int GetIVIMIVI_GicPart_roadSignCodesParams(LONG packetHandle, struct IVIMIVI_GicPart_roadSignCodes value, char oldPath[])
{
  char newPath[300]; 
  int i;
  int result;

  result = 0;

  value.length = C2xGetTokenInt(packetHandle, "IVIM", oldPath);
  if((result = CheckLastError("IVIM", gkFuncRefGet, result))==0)
  {
    for(i=0; i<value.length; i++)
    {
      snprintf(newPath, elcount(newPath), "%s[%d]", oldPath, i);
      GetIVIMIVI_RSCodeParams(packetHandle, value.arrayValue[i], newPath);
      result = CheckLastError("IVIM", gkFuncRefGet, result);
    }
  }
  return result;
}

int SetIVIMIVI_GicPart_roadSignCodesParams(LONG packetHandle, struct IVIMIVI_GicPart_roadSignCodes value, char oldPath[])
{
  char newPath[300]; 
  int i;
  int result;

  result = 0;

  C2xRemoveToken(packetHandle, "IVIM", oldPath);
  for(i=0; i<value.length; i++)
  {
    snprintf(newPath, elcount(newPath), "%s[%d]", oldPath, i);
    SetIVIMIVI_RSCodeParams(packetHandle, value.arrayValue[i], newPath);
    result = CheckLastError("IVIM", gkFuncRefGet, result);
  }
  return result;
}

int GetIVIMIVI_TextParams(LONG packetHandle, struct IVIMIVI_Text value, char oldPath[])
{
  char newPath[300]; 
  int j; 
  int k;
  int result;

  result = 0;

  snprintf(newPath, elcount(newPath), "%s.%s", oldPath, "layoutComponentId");
  value.layoutComponentId.isValidFlag = C2xIsTokenAvailable(packetHandle, "IVIM", newPath);
  if(value.layoutComponentId.isValidFlag==1)
  {
    value.layoutComponentId.value = C2xGetTokenInt(packetHandle, "IVIM", newPath);
    result = CheckLastError("IVIM", gkFuncRefGet, result);
  }
  snprintf(newPath, elcount(newPath), "%s.%s", oldPath, "language");
  value.language.isValidFlag = 1;
  value.language.stringLength = C2xGetTokenLengthBit(packetHandle, "IVIM", newPath);
  if ((result = CheckLastError("IVIM", gkFuncRefGet, result))==0)
  {
    if(value.language.stringLength > 0)
    {
      for(j=0; j<value.language.stringLength; j++)
      {
        if(C2xGetTokenBitOfBitString(packetHandle, "IVIM", newPath, j) == 0)
        {
          value.language.string[j] = '0';
        }
        else if(C2xGetTokenBitOfBitString(packetHandle, "IVIM", newPath, j) == 1)
        {
          value.language.string[j] = '1';
        }

        if(value.language.stringLength == 1)
        {
          value.language.string[1] = '0';
        }
        result = CheckLastError("IVIM", gkFuncRefGet, result);
      }
    }
    else
    {
      for(k = value.language.stringLength+1; k > -1; k--)
      {
        if(value.language.string[k] == '1')
        {
          value.language.string[k] = '0';
        }
      }
    }
  }

  snprintf(newPath, elcount(newPath), "%s.%s", oldPath, "textContent");
  value.textContent.stringLength = C2xGetTokenData(packetHandle, "IVIM", newPath, elcount(value.textContent.string), value.textContent.string);
  result = CheckLastError("IVIM", gkFuncRefGet, result);
  return result;
}

int SetIVIMIVI_TextParams(LONG packetHandle, struct IVIMIVI_Text value, char oldPath[])
{
  char newPath[300]; 
  int j;
  int result;

  result = 0;

  snprintf(newPath, elcount(newPath), "%s.%s", oldPath, "layoutComponentId");
  if(value.layoutComponentId.isValidFlag==1)
  {
    C2xSetTokenInt(packetHandle, "IVIM", newPath, value.layoutComponentId.value);
    result = CheckLastError("IVIM", gkFuncRefGet, result);
  }
  else
  {
    if( C2xIsTokenAvailable(packetHandle, "IVIM", newPath) )
    {
      C2xRemoveToken(packetHandle, "IVIM", newPath);
    }
  }

  snprintf(newPath, elcount(newPath), "%s.%s", oldPath, "language");
    for(j=0; j<value.language.stringLength; j++)
    {
      if(value.language.string[j] == '0')
      {
        C2xSetTokenBitOfBitString(packetHandle, "IVIM", newPath, j, 0);
      }
      else
      {
        C2xSetTokenBitOfBitString(packetHandle, "IVIM", newPath, j, 1);
      }
      result = CheckLastError("IVIM", gkFuncRefGet, result);
    }

  snprintf(newPath, elcount(newPath), "%s.%s", oldPath, "textContent");
  C2xSetTokenData(packetHandle, "IVIM", newPath, value.textContent.stringLength, value.textContent.string);
  result = CheckLastError("IVIM", gkFuncRefGet, result);

  return result;
}

int GetIVIMIVI_GicPart_extraTextParams(LONG packetHandle, struct IVIMIVI_GicPart_extraText value, char oldPath[])
{
  char newPath[300]; 
  int i;
  int result;

  result = 0;

  value.length = C2xGetTokenInt(packetHandle, "IVIM", oldPath);
  if((result = CheckLastError("IVIM", gkFuncRefGet, result))==0)
  {
    for(i=0; i<value.length; i++)
    {
      snprintf(newPath, elcount(newPath), "%s[%d]", oldPath, i);
      GetIVIMIVI_TextParams(packetHandle, value.arrayValue[i], newPath);
      result = CheckLastError("IVIM", gkFuncRefGet, result);
    }
  }
  return result;
}

int SetIVIMIVI_GicPart_extraTextParams(LONG packetHandle, struct IVIMIVI_GicPart_extraText value, char oldPath[])
{
  char newPath[300]; 
  int i;
  int result;

  result = 0;

  C2xRemoveToken(packetHandle, "IVIM", oldPath);
  for(i=0; i<value.length; i++)
  {
    snprintf(newPath, elcount(newPath), "%s[%d]", oldPath, i);
    SetIVIMIVI_TextParams(packetHandle, value.arrayValue[i], newPath);
    result = CheckLastError("IVIM", gkFuncRefGet, result);
  }
  return result;
}

int GetIVIMIVI_GicPartParams(LONG packetHandle, struct IVIMIVI_GicPart value, char oldPath[])
{
  char newPath[300];
  int result;

  result = 0;

  snprintf(newPath, elcount(newPath), "%s.%s", oldPath, "detectionZoneIds");
  value.detectionZoneIds.isValidFlag = C2xIsTokenAvailable(packetHandle, "IVIM", newPath);
  if(value.detectionZoneIds.isValidFlag==1)
  {
    GetIVIMIVI_GicPart_detectionZoneIdsParams(packetHandle, value.detectionZoneIds, newPath);
    result = CheckLastError("IVIM", gkFuncRefGet, result);
  }
  snprintf(newPath, elcount(newPath), "%s.%s", oldPath, "its_Rrid");
  value.its_Rrid.isValidFlag = C2xIsTokenAvailable(packetHandle, "IVIM", newPath);
  if(value.its_Rrid.isValidFlag==1)
  {
    GetIVIMCITSapplMgmtIDs_VarLengthNumberParams(packetHandle, value.its_Rrid, newPath);
    result = CheckLastError("IVIM", gkFuncRefGet, result);
  }
  snprintf(newPath, elcount(newPath), "%s.%s", oldPath, "relevanceZoneIds");
  value.relevanceZoneIds.isValidFlag = C2xIsTokenAvailable(packetHandle, "IVIM", newPath);
  if(value.relevanceZoneIds.isValidFlag==1)
  {
    GetIVIMIVI_GicPart_relevanceZoneIdsParams(packetHandle, value.relevanceZoneIds, newPath);
    result = CheckLastError("IVIM", gkFuncRefGet, result);
  }
  snprintf(newPath, elcount(newPath), "%s.%s", oldPath, "direction");
  value.direction.isValidFlag = C2xIsTokenAvailable(packetHandle, "IVIM", newPath);
  if(value.direction.isValidFlag==1)
  {
    value.direction.value = C2xGetTokenInt(packetHandle, "IVIM", newPath);
    result = CheckLastError("IVIM", gkFuncRefGet, result);
  }
  snprintf(newPath, elcount(newPath), "%s.%s", oldPath, "driverAwarenessZoneIds");
  value.driverAwarenessZoneIds.isValidFlag = C2xIsTokenAvailable(packetHandle, "IVIM", newPath);
  if(value.driverAwarenessZoneIds.isValidFlag==1)
  {
    GetIVIMIVI_GicPart_driverAwarenessZoneIdsParams(packetHandle, value.driverAwarenessZoneIds, newPath);
    result = CheckLastError("IVIM", gkFuncRefGet, result);
  }
  snprintf(newPath, elcount(newPath), "%s.%s", oldPath, "minimumAwarenessTime");
  value.minimumAwarenessTime.isValidFlag = C2xIsTokenAvailable(packetHandle, "IVIM", newPath);
  if(value.minimumAwarenessTime.isValidFlag==1)
  {
    value.minimumAwarenessTime.value = C2xGetTokenInt(packetHandle, "IVIM", newPath);
    result = CheckLastError("IVIM", gkFuncRefGet, result);
  }
  snprintf(newPath, elcount(newPath), "%s.%s", oldPath, "applicableLanes");
  value.applicableLanes.isValidFlag = C2xIsTokenAvailable(packetHandle, "IVIM", newPath);
  if(value.applicableLanes.isValidFlag==1)
  {
    GetIVIMIVI_GicPart_applicableLanesParams(packetHandle, value.applicableLanes, newPath);
    result = CheckLastError("IVIM", gkFuncRefGet, result);
  }
  snprintf(newPath, elcount(newPath), "%s.%s", oldPath, "iviType");
  value.iviType = C2xGetTokenInt(packetHandle, "IVIM", newPath);
  result = CheckLastError("IVIM", gkFuncRefGet, result);

  snprintf(newPath, elcount(newPath), "%s.%s", oldPath, "iviPurpose");
  value.iviPurpose.isValidFlag = C2xIsTokenAvailable(packetHandle, "IVIM", newPath);
  if(value.iviPurpose.isValidFlag==1)
  {
    value.iviPurpose.value = C2xGetTokenInt(packetHandle, "IVIM", newPath);
    result = CheckLastError("IVIM", gkFuncRefGet, result);
  }
  snprintf(newPath, elcount(newPath), "%s.%s", oldPath, "laneStatus");
  value.laneStatus.isValidFlag = C2xIsTokenAvailable(packetHandle, "IVIM", newPath);
  if(value.laneStatus.isValidFlag==1)
  {
    value.laneStatus.value = C2xGetTokenInt(packetHandle, "IVIM", newPath);
    result = CheckLastError("IVIM", gkFuncRefGet, result);
  }
  snprintf(newPath, elcount(newPath), "%s.%s", oldPath, "vehicleCharacteristics");
  value.vehicleCharacteristics.isValidFlag = C2xIsTokenAvailable(packetHandle, "IVIM", newPath);
  if(value.vehicleCharacteristics.isValidFlag==1)
  {
    GetIVIMIVI_GicPart_vehicleCharacteristicsParams(packetHandle, value.vehicleCharacteristics, newPath);
    result = CheckLastError("IVIM", gkFuncRefGet, result);
  }
  snprintf(newPath, elcount(newPath), "%s.%s", oldPath, "driverCharacteristics");
  value.driverCharacteristics.isValidFlag = C2xIsTokenAvailable(packetHandle, "IVIM", newPath);
  if(value.driverCharacteristics.isValidFlag==1)
  {
    value.driverCharacteristics.value = C2xGetTokenInt(packetHandle, "IVIM", newPath);
    result = CheckLastError("IVIM", gkFuncRefGet, result);
  }
  snprintf(newPath, elcount(newPath), "%s.%s", oldPath, "layoutId");
  value.layoutId.isValidFlag = C2xIsTokenAvailable(packetHandle, "IVIM", newPath);
  if(value.layoutId.isValidFlag==1)
  {
    value.layoutId.value = C2xGetTokenInt(packetHandle, "IVIM", newPath);
    result = CheckLastError("IVIM", gkFuncRefGet, result);
  }
  snprintf(newPath, elcount(newPath), "%s.%s", oldPath, "preStoredlayoutId");
  value.preStoredlayoutId.isValidFlag = C2xIsTokenAvailable(packetHandle, "IVIM", newPath);
  if(value.preStoredlayoutId.isValidFlag==1)
  {
    value.preStoredlayoutId.value = C2xGetTokenInt(packetHandle, "IVIM", newPath);
    result = CheckLastError("IVIM", gkFuncRefGet, result);
  }
  snprintf(newPath, elcount(newPath), "%s.%s", oldPath, "roadSignCodes");
  GetIVIMIVI_GicPart_roadSignCodesParams(packetHandle, value.roadSignCodes, newPath);
  result = CheckLastError("IVIM", gkFuncRefGet, result);

  snprintf(newPath, elcount(newPath), "%s.%s", oldPath, "extraText");
  value.extraText.isValidFlag = C2xIsTokenAvailable(packetHandle, "IVIM", newPath);
  if(value.extraText.isValidFlag==1)
  {
    GetIVIMIVI_GicPart_extraTextParams(packetHandle, value.extraText, newPath);
    result = CheckLastError("IVIM", gkFuncRefGet, result);
  }
  return result;
}

int SetIVIMIVI_GicPartParams(LONG packetHandle, struct IVIMIVI_GicPart value, char oldPath[])
{
  char newPath[300];
  int result;

  result = 0;

  snprintf(newPath, elcount(newPath), "%s.%s", oldPath, "detectionZoneIds");
  if(value.detectionZoneIds.isValidFlag==1)
  {
    SetIVIMIVI_GicPart_detectionZoneIdsParams(packetHandle, value.detectionZoneIds, newPath);
    result = CheckLastError("IVIM", gkFuncRefGet, result);
  }
  else
  {
    if( C2xIsTokenAvailable(packetHandle, "IVIM", newPath) )
    {
      C2xRemoveToken(packetHandle, "IVIM", newPath);
    }
  }

  snprintf(newPath, elcount(newPath), "%s.%s", oldPath, "its_Rrid");
  if(value.its_Rrid.isValidFlag==1)
  {
    SetIVIMCITSapplMgmtIDs_VarLengthNumberParams(packetHandle, value.its_Rrid, newPath);
    result = CheckLastError("IVIM", gkFuncRefGet, result);
  }
  else
  {
    if( C2xIsTokenAvailable(packetHandle, "IVIM", newPath) )
    {
      C2xRemoveToken(packetHandle, "IVIM", newPath);
    }
  }

  snprintf(newPath, elcount(newPath), "%s.%s", oldPath, "relevanceZoneIds");
  if(value.relevanceZoneIds.isValidFlag==1)
  {
    SetIVIMIVI_GicPart_relevanceZoneIdsParams(packetHandle, value.relevanceZoneIds, newPath);
    result = CheckLastError("IVIM", gkFuncRefGet, result);
  }
  else
  {
    if( C2xIsTokenAvailable(packetHandle, "IVIM", newPath) )
    {
      C2xRemoveToken(packetHandle, "IVIM", newPath);
    }
  }

  snprintf(newPath, elcount(newPath), "%s.%s", oldPath, "direction");
  if(value.direction.isValidFlag==1)
  {
    C2xSetTokenInt(packetHandle, "IVIM", newPath, value.direction.value);
    result = CheckLastError("IVIM", gkFuncRefGet, result);
  }
  else
  {
    if( C2xIsTokenAvailable(packetHandle, "IVIM", newPath) )
    {
      C2xRemoveToken(packetHandle, "IVIM", newPath);
    }
  }

  snprintf(newPath, elcount(newPath), "%s.%s", oldPath, "driverAwarenessZoneIds");
  if(value.driverAwarenessZoneIds.isValidFlag==1)
  {
    SetIVIMIVI_GicPart_driverAwarenessZoneIdsParams(packetHandle, value.driverAwarenessZoneIds, newPath);
    result = CheckLastError("IVIM", gkFuncRefGet, result);
  }
  else
  {
    if( C2xIsTokenAvailable(packetHandle, "IVIM", newPath) )
    {
      C2xRemoveToken(packetHandle, "IVIM", newPath);
    }
  }

  snprintf(newPath, elcount(newPath), "%s.%s", oldPath, "minimumAwarenessTime");
  if(value.minimumAwarenessTime.isValidFlag==1)
  {
    C2xSetTokenInt(packetHandle, "IVIM", newPath, value.minimumAwarenessTime.value);
    result = CheckLastError("IVIM", gkFuncRefGet, result);
  }
  else
  {
    if( C2xIsTokenAvailable(packetHandle, "IVIM", newPath) )
    {
      C2xRemoveToken(packetHandle, "IVIM", newPath);
    }
  }

  snprintf(newPath, elcount(newPath), "%s.%s", oldPath, "applicableLanes");
  if(value.applicableLanes.isValidFlag==1)
  {
    SetIVIMIVI_GicPart_applicableLanesParams(packetHandle, value.applicableLanes, newPath);
    result = CheckLastError("IVIM", gkFuncRefGet, result);
  }
  else
  {
    if( C2xIsTokenAvailable(packetHandle, "IVIM", newPath) )
    {
      C2xRemoveToken(packetHandle, "IVIM", newPath);
    }
  }

  snprintf(newPath, elcount(newPath), "%s.%s", oldPath, "iviType");
  C2xSetTokenInt(packetHandle, "IVIM", newPath, value.iviType);
  result = CheckLastError("IVIM", gkFuncRefGet, result);

  snprintf(newPath, elcount(newPath), "%s.%s", oldPath, "iviPurpose");
  if(value.iviPurpose.isValidFlag==1)
  {
    C2xSetTokenInt(packetHandle, "IVIM", newPath, value.iviPurpose.value);
    result = CheckLastError("IVIM", gkFuncRefGet, result);
  }
  else
  {
    if( C2xIsTokenAvailable(packetHandle, "IVIM", newPath) )
    {
      C2xRemoveToken(packetHandle, "IVIM", newPath);
    }
  }

  snprintf(newPath, elcount(newPath), "%s.%s", oldPath, "laneStatus");
  if(value.laneStatus.isValidFlag==1)
  {
    C2xSetTokenInt(packetHandle, "IVIM", newPath, value.laneStatus.value);
    result = CheckLastError("IVIM", gkFuncRefGet, result);
  }
  else
  {
    if( C2xIsTokenAvailable(packetHandle, "IVIM", newPath) )
    {
      C2xRemoveToken(packetHandle, "IVIM", newPath);
    }
  }

  snprintf(newPath, elcount(newPath), "%s.%s", oldPath, "vehicleCharacteristics");
  if(value.vehicleCharacteristics.isValidFlag==1)
  {
    SetIVIMIVI_GicPart_vehicleCharacteristicsParams(packetHandle, value.vehicleCharacteristics, newPath);
    result = CheckLastError("IVIM", gkFuncRefGet, result);
  }
  else
  {
    if( C2xIsTokenAvailable(packetHandle, "IVIM", newPath) )
    {
      C2xRemoveToken(packetHandle, "IVIM", newPath);
    }
  }

  snprintf(newPath, elcount(newPath), "%s.%s", oldPath, "driverCharacteristics");
  if(value.driverCharacteristics.isValidFlag==1)
  {
    C2xSetTokenInt(packetHandle, "IVIM", newPath, value.driverCharacteristics.value);
    result = CheckLastError("IVIM", gkFuncRefGet, result);
  }
  else
  {
    if( C2xIsTokenAvailable(packetHandle, "IVIM", newPath) )
    {
      C2xRemoveToken(packetHandle, "IVIM", newPath);
    }
  }

  snprintf(newPath, elcount(newPath), "%s.%s", oldPath, "layoutId");
  if(value.layoutId.isValidFlag==1)
  {
    C2xSetTokenInt(packetHandle, "IVIM", newPath, value.layoutId.value);
    result = CheckLastError("IVIM", gkFuncRefGet, result);
  }
  else
  {
    if( C2xIsTokenAvailable(packetHandle, "IVIM", newPath) )
    {
      C2xRemoveToken(packetHandle, "IVIM", newPath);
    }
  }

  snprintf(newPath, elcount(newPath), "%s.%s", oldPath, "preStoredlayoutId");
  if(value.preStoredlayoutId.isValidFlag==1)
  {
    C2xSetTokenInt(packetHandle, "IVIM", newPath, value.preStoredlayoutId.value);
    result = CheckLastError("IVIM", gkFuncRefGet, result);
  }
  else
  {
    if( C2xIsTokenAvailable(packetHandle, "IVIM", newPath) )
    {
      C2xRemoveToken(packetHandle, "IVIM", newPath);
    }
  }

  snprintf(newPath, elcount(newPath), "%s.%s", oldPath, "roadSignCodes");
  SetIVIMIVI_GicPart_roadSignCodesParams(packetHandle, value.roadSignCodes, newPath);
  result = CheckLastError("IVIM", gkFuncRefGet, result);

  snprintf(newPath, elcount(newPath), "%s.%s", oldPath, "extraText");
  if(value.extraText.isValidFlag==1)
  {
    SetIVIMIVI_GicPart_extraTextParams(packetHandle, value.extraText, newPath);
    result = CheckLastError("IVIM", gkFuncRefGet, result);
  }
  else
  {
    if( C2xIsTokenAvailable(packetHandle, "IVIM", newPath) )
    {
      C2xRemoveToken(packetHandle, "IVIM", newPath);
    }
  }

  return result;
}

int GetIVIMIVI_GeneralIviContainerParams(LONG packetHandle, struct IVIMIVI_GeneralIviContainer value, char oldPath[])
{
  char newPath[300]; 
  int i;
  int result;

  result = 0;

  value.length = C2xGetTokenInt(packetHandle, "IVIM", oldPath);
  if((result = CheckLastError("IVIM", gkFuncRefGet, result))==0)
  {
    for(i=0; i<value.length; i++)
    {
      snprintf(newPath, elcount(newPath), "%s[%d]", oldPath, i);
      GetIVIMIVI_GicPartParams(packetHandle, value.arrayValue[i], newPath);
      result = CheckLastError("IVIM", gkFuncRefGet, result);
    }
  }
  return result;
}

int SetIVIMIVI_GeneralIviContainerParams(LONG packetHandle, struct IVIMIVI_GeneralIviContainer value, char oldPath[])
{
  char newPath[300]; 
  int i;
  int result;

  result = 0;

  C2xRemoveToken(packetHandle, "IVIM", oldPath);
  for(i=0; i<value.length; i++)
  {
    snprintf(newPath, elcount(newPath), "%s[%d]", oldPath, i);
    SetIVIMIVI_GicPartParams(packetHandle, value.arrayValue[i], newPath);
    result = CheckLastError("IVIM", gkFuncRefGet, result);
  }
  return result;
}

int GetIVIMIVI_RccPart_zoneIdsParams(LONG packetHandle, struct IVIMIVI_RccPart_zoneIds value, char oldPath[])
{
  char newPath[300]; 
  int i;
  int result;

  result = 0;

  value.length = C2xGetTokenInt(packetHandle, "IVIM", oldPath);
  if((result = CheckLastError("IVIM", gkFuncRefGet, result))==0)
  {
    for(i=0; i<value.length; i++)
    {
      snprintf(newPath, elcount(newPath), "%s[%d]", oldPath, i);
      value.arrayValue[i] = C2xGetTokenInt64(packetHandle, "IVIM", newPath);
      result = CheckLastError("IVIM", gkFuncRefGet, result);
    }
  }
  return result;
}

int SetIVIMIVI_RccPart_zoneIdsParams(LONG packetHandle, struct IVIMIVI_RccPart_zoneIds value, char oldPath[])
{
  char newPath[300]; 
  int i;
  int result;

  result = 0;

  C2xRemoveToken(packetHandle, "IVIM", oldPath);
  for(i=0; i<value.length; i++)
  {
    snprintf(newPath, elcount(newPath), "%s[%d]", oldPath, i);
    C2xSetTokenInt64(packetHandle, "IVIM", newPath, value.arrayValue[i]);
    result = CheckLastError("IVIM", gkFuncRefGet, result);
  }
  return result;
}

int GetIVIMIVI_LaneInformationParams(LONG packetHandle, struct IVIMIVI_LaneInformation value, char oldPath[])
{
  char newPath[300];
  int result;

  result = 0;

  snprintf(newPath, elcount(newPath), "%s.%s", oldPath, "laneNumber");
  value.laneNumber = C2xGetTokenInt(packetHandle, "IVIM", newPath);
  result = CheckLastError("IVIM", gkFuncRefGet, result);

  snprintf(newPath, elcount(newPath), "%s.%s", oldPath, "direction");
  value.direction = C2xGetTokenInt(packetHandle, "IVIM", newPath);
  result = CheckLastError("IVIM", gkFuncRefGet, result);

  snprintf(newPath, elcount(newPath), "%s.%s", oldPath, "validity");
  value.validity.isValidFlag = C2xIsTokenAvailable(packetHandle, "IVIM", newPath);
  if(value.validity.isValidFlag==1)
  {
    GetIVIMIVI_DTMParams(packetHandle, value.validity, newPath);
    result = CheckLastError("IVIM", gkFuncRefGet, result);
  }
  snprintf(newPath, elcount(newPath), "%s.%s", oldPath, "laneType");
  value.laneType = C2xGetTokenInt(packetHandle, "IVIM", newPath);
  result = CheckLastError("IVIM", gkFuncRefGet, result);

  snprintf(newPath, elcount(newPath), "%s.%s", oldPath, "laneTypeQualifier");
  value.laneTypeQualifier.isValidFlag = C2xIsTokenAvailable(packetHandle, "IVIM", newPath);
  if(value.laneTypeQualifier.isValidFlag==1)
  {
    GetIVIMIVI_CompleteVehicleCharacteristicsParams(packetHandle, value.laneTypeQualifier, newPath);
    result = CheckLastError("IVIM", gkFuncRefGet, result);
  }
  snprintf(newPath, elcount(newPath), "%s.%s", oldPath, "laneStatus");
  value.laneStatus = C2xGetTokenInt(packetHandle, "IVIM", newPath);
  result = CheckLastError("IVIM", gkFuncRefGet, result);

  snprintf(newPath, elcount(newPath), "%s.%s", oldPath, "laneWidth");
  value.laneWidth.isValidFlag = C2xIsTokenAvailable(packetHandle, "IVIM", newPath);
  if(value.laneWidth.isValidFlag==1)
  {
    value.laneWidth.value = C2xGetTokenInt(packetHandle, "IVIM", newPath);
    result = CheckLastError("IVIM", gkFuncRefGet, result);
  }
  return result;
}

int SetIVIMIVI_LaneInformationParams(LONG packetHandle, struct IVIMIVI_LaneInformation value, char oldPath[])
{
  char newPath[300];
  int result;

  result = 0;

  snprintf(newPath, elcount(newPath), "%s.%s", oldPath, "laneNumber");
  C2xSetTokenInt(packetHandle, "IVIM", newPath, value.laneNumber);
  result = CheckLastError("IVIM", gkFuncRefGet, result);

  snprintf(newPath, elcount(newPath), "%s.%s", oldPath, "direction");
  C2xSetTokenInt(packetHandle, "IVIM", newPath, value.direction);
  result = CheckLastError("IVIM", gkFuncRefGet, result);

  snprintf(newPath, elcount(newPath), "%s.%s", oldPath, "validity");
  if(value.validity.isValidFlag==1)
  {
    SetIVIMIVI_DTMParams(packetHandle, value.validity, newPath);
    result = CheckLastError("IVIM", gkFuncRefGet, result);
  }
  else
  {
    if( C2xIsTokenAvailable(packetHandle, "IVIM", newPath) )
    {
      C2xRemoveToken(packetHandle, "IVIM", newPath);
    }
  }

  snprintf(newPath, elcount(newPath), "%s.%s", oldPath, "laneType");
  C2xSetTokenInt(packetHandle, "IVIM", newPath, value.laneType);
  result = CheckLastError("IVIM", gkFuncRefGet, result);

  snprintf(newPath, elcount(newPath), "%s.%s", oldPath, "laneTypeQualifier");
  if(value.laneTypeQualifier.isValidFlag==1)
  {
    SetIVIMIVI_CompleteVehicleCharacteristicsParams(packetHandle, value.laneTypeQualifier, newPath);
    result = CheckLastError("IVIM", gkFuncRefGet, result);
  }
  else
  {
    if( C2xIsTokenAvailable(packetHandle, "IVIM", newPath) )
    {
      C2xRemoveToken(packetHandle, "IVIM", newPath);
    }
  }

  snprintf(newPath, elcount(newPath), "%s.%s", oldPath, "laneStatus");
  C2xSetTokenInt(packetHandle, "IVIM", newPath, value.laneStatus);
  result = CheckLastError("IVIM", gkFuncRefGet, result);

  snprintf(newPath, elcount(newPath), "%s.%s", oldPath, "laneWidth");
  if(value.laneWidth.isValidFlag==1)
  {
    C2xSetTokenInt(packetHandle, "IVIM", newPath, value.laneWidth.value);
    result = CheckLastError("IVIM", gkFuncRefGet, result);
  }
  else
  {
    if( C2xIsTokenAvailable(packetHandle, "IVIM", newPath) )
    {
      C2xRemoveToken(packetHandle, "IVIM", newPath);
    }
  }

  return result;
}

int GetIVIMIVI_RccPart_laneConfigurationParams(LONG packetHandle, struct IVIMIVI_RccPart_laneConfiguration value, char oldPath[])
{
  char newPath[300]; 
  int i;
  int result;

  result = 0;

  value.length = C2xGetTokenInt(packetHandle, "IVIM", oldPath);
  if((result = CheckLastError("IVIM", gkFuncRefGet, result))==0)
  {
    for(i=0; i<value.length; i++)
    {
      snprintf(newPath, elcount(newPath), "%s[%d]", oldPath, i);
      GetIVIMIVI_LaneInformationParams(packetHandle, value.arrayValue[i], newPath);
      result = CheckLastError("IVIM", gkFuncRefGet, result);
    }
  }
  return result;
}

int SetIVIMIVI_RccPart_laneConfigurationParams(LONG packetHandle, struct IVIMIVI_RccPart_laneConfiguration value, char oldPath[])
{
  char newPath[300]; 
  int i;
  int result;

  result = 0;

  C2xRemoveToken(packetHandle, "IVIM", oldPath);
  for(i=0; i<value.length; i++)
  {
    snprintf(newPath, elcount(newPath), "%s[%d]", oldPath, i);
    SetIVIMIVI_LaneInformationParams(packetHandle, value.arrayValue[i], newPath);
    result = CheckLastError("IVIM", gkFuncRefGet, result);
  }
  return result;
}

int GetIVIMIVI_RccPartParams(LONG packetHandle, struct IVIMIVI_RccPart value, char oldPath[])
{
  char newPath[300];
  int result;

  result = 0;

  snprintf(newPath, elcount(newPath), "%s.%s", oldPath, "zoneIds");
  GetIVIMIVI_RccPart_zoneIdsParams(packetHandle, value.zoneIds, newPath);
  result = CheckLastError("IVIM", gkFuncRefGet, result);

  snprintf(newPath, elcount(newPath), "%s.%s", oldPath, "roadType");
  value.roadType = C2xGetTokenInt(packetHandle, "IVIM", newPath);
  result = CheckLastError("IVIM", gkFuncRefGet, result);

  snprintf(newPath, elcount(newPath), "%s.%s", oldPath, "laneConfiguration");
  GetIVIMIVI_RccPart_laneConfigurationParams(packetHandle, value.laneConfiguration, newPath);
  result = CheckLastError("IVIM", gkFuncRefGet, result);

  return result;
}

int SetIVIMIVI_RccPartParams(LONG packetHandle, struct IVIMIVI_RccPart value, char oldPath[])
{
  char newPath[300];
  int result;

  result = 0;

  snprintf(newPath, elcount(newPath), "%s.%s", oldPath, "zoneIds");
  SetIVIMIVI_RccPart_zoneIdsParams(packetHandle, value.zoneIds, newPath);
  result = CheckLastError("IVIM", gkFuncRefGet, result);

  snprintf(newPath, elcount(newPath), "%s.%s", oldPath, "roadType");
  C2xSetTokenInt(packetHandle, "IVIM", newPath, value.roadType);
  result = CheckLastError("IVIM", gkFuncRefGet, result);

  snprintf(newPath, elcount(newPath), "%s.%s", oldPath, "laneConfiguration");
  SetIVIMIVI_RccPart_laneConfigurationParams(packetHandle, value.laneConfiguration, newPath);
  result = CheckLastError("IVIM", gkFuncRefGet, result);

  return result;
}

int GetIVIMIVI_RoadConfigurationContainerParams(LONG packetHandle, struct IVIMIVI_RoadConfigurationContainer value, char oldPath[])
{
  char newPath[300]; 
  int i;
  int result;

  result = 0;

  value.length = C2xGetTokenInt(packetHandle, "IVIM", oldPath);
  if((result = CheckLastError("IVIM", gkFuncRefGet, result))==0)
  {
    for(i=0; i<value.length; i++)
    {
      snprintf(newPath, elcount(newPath), "%s[%d]", oldPath, i);
      GetIVIMIVI_RccPartParams(packetHandle, value.arrayValue[i], newPath);
      result = CheckLastError("IVIM", gkFuncRefGet, result);
    }
  }
  return result;
}

int SetIVIMIVI_RoadConfigurationContainerParams(LONG packetHandle, struct IVIMIVI_RoadConfigurationContainer value, char oldPath[])
{
  char newPath[300]; 
  int i;
  int result;

  result = 0;

  C2xRemoveToken(packetHandle, "IVIM", oldPath);
  for(i=0; i<value.length; i++)
  {
    snprintf(newPath, elcount(newPath), "%s[%d]", oldPath, i);
    SetIVIMIVI_RccPartParams(packetHandle, value.arrayValue[i], newPath);
    result = CheckLastError("IVIM", gkFuncRefGet, result);
  }
  return result;
}

int GetIVIMIVI_TcPart_detectionZoneIdsParams(LONG packetHandle, struct IVIMIVI_TcPart_detectionZoneIds value, char oldPath[])
{
  char newPath[300]; 
  int i;
  int result;

  result = 0;

  value.length = C2xGetTokenInt(packetHandle, "IVIM", oldPath);
  if((result = CheckLastError("IVIM", gkFuncRefGet, result))==0)
  {
    for(i=0; i<value.length; i++)
    {
      snprintf(newPath, elcount(newPath), "%s[%d]", oldPath, i);
      value.arrayValue[i] = C2xGetTokenInt64(packetHandle, "IVIM", newPath);
      result = CheckLastError("IVIM", gkFuncRefGet, result);
    }
  }
  return result;
}

int SetIVIMIVI_TcPart_detectionZoneIdsParams(LONG packetHandle, struct IVIMIVI_TcPart_detectionZoneIds value, char oldPath[])
{
  char newPath[300]; 
  int i;
  int result;

  result = 0;

  C2xRemoveToken(packetHandle, "IVIM", oldPath);
  for(i=0; i<value.length; i++)
  {
    snprintf(newPath, elcount(newPath), "%s[%d]", oldPath, i);
    C2xSetTokenInt64(packetHandle, "IVIM", newPath, value.arrayValue[i]);
    result = CheckLastError("IVIM", gkFuncRefGet, result);
  }
  return result;
}

int GetIVIMIVI_TcPart_relevanceZoneIdsParams(LONG packetHandle, struct IVIMIVI_TcPart_relevanceZoneIds value, char oldPath[])
{
  char newPath[300]; 
  int i;
  int result;

  result = 0;

  value.length = C2xGetTokenInt(packetHandle, "IVIM", oldPath);
  if((result = CheckLastError("IVIM", gkFuncRefGet, result))==0)
  {
    for(i=0; i<value.length; i++)
    {
      snprintf(newPath, elcount(newPath), "%s[%d]", oldPath, i);
      value.arrayValue[i] = C2xGetTokenInt64(packetHandle, "IVIM", newPath);
      result = CheckLastError("IVIM", gkFuncRefGet, result);
    }
  }
  return result;
}

int SetIVIMIVI_TcPart_relevanceZoneIdsParams(LONG packetHandle, struct IVIMIVI_TcPart_relevanceZoneIds value, char oldPath[])
{
  char newPath[300]; 
  int i;
  int result;

  result = 0;

  C2xRemoveToken(packetHandle, "IVIM", oldPath);
  for(i=0; i<value.length; i++)
  {
    snprintf(newPath, elcount(newPath), "%s[%d]", oldPath, i);
    C2xSetTokenInt64(packetHandle, "IVIM", newPath, value.arrayValue[i]);
    result = CheckLastError("IVIM", gkFuncRefGet, result);
  }
  return result;
}

int GetIVIMIVI_TcPart_driverAwarenessZoneIdsParams(LONG packetHandle, struct IVIMIVI_TcPart_driverAwarenessZoneIds value, char oldPath[])
{
  char newPath[300]; 
  int i;
  int result;

  result = 0;

  value.length = C2xGetTokenInt(packetHandle, "IVIM", oldPath);
  if((result = CheckLastError("IVIM", gkFuncRefGet, result))==0)
  {
    for(i=0; i<value.length; i++)
    {
      snprintf(newPath, elcount(newPath), "%s[%d]", oldPath, i);
      value.arrayValue[i] = C2xGetTokenInt64(packetHandle, "IVIM", newPath);
      result = CheckLastError("IVIM", gkFuncRefGet, result);
    }
  }
  return result;
}

int SetIVIMIVI_TcPart_driverAwarenessZoneIdsParams(LONG packetHandle, struct IVIMIVI_TcPart_driverAwarenessZoneIds value, char oldPath[])
{
  char newPath[300]; 
  int i;
  int result;

  result = 0;

  C2xRemoveToken(packetHandle, "IVIM", oldPath);
  for(i=0; i<value.length; i++)
  {
    snprintf(newPath, elcount(newPath), "%s[%d]", oldPath, i);
    C2xSetTokenInt64(packetHandle, "IVIM", newPath, value.arrayValue[i]);
    result = CheckLastError("IVIM", gkFuncRefGet, result);
  }
  return result;
}

int GetIVIMIVI_TcPart_applicableLanesParams(LONG packetHandle, struct IVIMIVI_TcPart_applicableLanes value, char oldPath[])
{
  char newPath[300]; 
  int i;
  int result;

  result = 0;

  value.length = C2xGetTokenInt(packetHandle, "IVIM", oldPath);
  if((result = CheckLastError("IVIM", gkFuncRefGet, result))==0)
  {
    for(i=0; i<value.length; i++)
    {
      snprintf(newPath, elcount(newPath), "%s[%d]", oldPath, i);
      value.arrayValue[i] = C2xGetTokenInt64(packetHandle, "IVIM", newPath);
      result = CheckLastError("IVIM", gkFuncRefGet, result);
    }
  }
  return result;
}

int SetIVIMIVI_TcPart_applicableLanesParams(LONG packetHandle, struct IVIMIVI_TcPart_applicableLanes value, char oldPath[])
{
  char newPath[300]; 
  int i;
  int result;

  result = 0;

  C2xRemoveToken(packetHandle, "IVIM", oldPath);
  for(i=0; i<value.length; i++)
  {
    snprintf(newPath, elcount(newPath), "%s[%d]", oldPath, i);
    C2xSetTokenInt64(packetHandle, "IVIM", newPath, value.arrayValue[i]);
    result = CheckLastError("IVIM", gkFuncRefGet, result);
  }
  return result;
}

int GetIVIMIVI_TcPart_textParams(LONG packetHandle, struct IVIMIVI_TcPart_text value, char oldPath[])
{
  char newPath[300]; 
  int i;
  int result;

  result = 0;

  value.length = C2xGetTokenInt(packetHandle, "IVIM", oldPath);
  if((result = CheckLastError("IVIM", gkFuncRefGet, result))==0)
  {
    for(i=0; i<value.length; i++)
    {
      snprintf(newPath, elcount(newPath), "%s[%d]", oldPath, i);
      GetIVIMIVI_TextParams(packetHandle, value.arrayValue[i], newPath);
      result = CheckLastError("IVIM", gkFuncRefGet, result);
    }
  }
  return result;
}

int SetIVIMIVI_TcPart_textParams(LONG packetHandle, struct IVIMIVI_TcPart_text value, char oldPath[])
{
  char newPath[300]; 
  int i;
  int result;

  result = 0;

  C2xRemoveToken(packetHandle, "IVIM", oldPath);
  for(i=0; i<value.length; i++)
  {
    snprintf(newPath, elcount(newPath), "%s[%d]", oldPath, i);
    SetIVIMIVI_TextParams(packetHandle, value.arrayValue[i], newPath);
    result = CheckLastError("IVIM", gkFuncRefGet, result);
  }
  return result;
}

int GetIVIMIVI_TcPartParams(LONG packetHandle, struct IVIMIVI_TcPart value, char oldPath[])
{
  char newPath[300];
  int result;

  result = 0;

  snprintf(newPath, elcount(newPath), "%s.%s", oldPath, "detectionZoneIds");
  value.detectionZoneIds.isValidFlag = C2xIsTokenAvailable(packetHandle, "IVIM", newPath);
  if(value.detectionZoneIds.isValidFlag==1)
  {
    GetIVIMIVI_TcPart_detectionZoneIdsParams(packetHandle, value.detectionZoneIds, newPath);
    result = CheckLastError("IVIM", gkFuncRefGet, result);
  }
  snprintf(newPath, elcount(newPath), "%s.%s", oldPath, "relevanceZoneIds");
  GetIVIMIVI_TcPart_relevanceZoneIdsParams(packetHandle, value.relevanceZoneIds, newPath);
  result = CheckLastError("IVIM", gkFuncRefGet, result);

  snprintf(newPath, elcount(newPath), "%s.%s", oldPath, "direction");
  value.direction.isValidFlag = C2xIsTokenAvailable(packetHandle, "IVIM", newPath);
  if(value.direction.isValidFlag==1)
  {
    value.direction.value = C2xGetTokenInt(packetHandle, "IVIM", newPath);
    result = CheckLastError("IVIM", gkFuncRefGet, result);
  }
  snprintf(newPath, elcount(newPath), "%s.%s", oldPath, "driverAwarenessZoneIds");
  value.driverAwarenessZoneIds.isValidFlag = C2xIsTokenAvailable(packetHandle, "IVIM", newPath);
  if(value.driverAwarenessZoneIds.isValidFlag==1)
  {
    GetIVIMIVI_TcPart_driverAwarenessZoneIdsParams(packetHandle, value.driverAwarenessZoneIds, newPath);
    result = CheckLastError("IVIM", gkFuncRefGet, result);
  }
  snprintf(newPath, elcount(newPath), "%s.%s", oldPath, "minimumAwarenessTime");
  value.minimumAwarenessTime.isValidFlag = C2xIsTokenAvailable(packetHandle, "IVIM", newPath);
  if(value.minimumAwarenessTime.isValidFlag==1)
  {
    value.minimumAwarenessTime.value = C2xGetTokenInt(packetHandle, "IVIM", newPath);
    result = CheckLastError("IVIM", gkFuncRefGet, result);
  }
  snprintf(newPath, elcount(newPath), "%s.%s", oldPath, "applicableLanes");
  value.applicableLanes.isValidFlag = C2xIsTokenAvailable(packetHandle, "IVIM", newPath);
  if(value.applicableLanes.isValidFlag==1)
  {
    GetIVIMIVI_TcPart_applicableLanesParams(packetHandle, value.applicableLanes, newPath);
    result = CheckLastError("IVIM", gkFuncRefGet, result);
  }
  snprintf(newPath, elcount(newPath), "%s.%s", oldPath, "layoutId");
  value.layoutId.isValidFlag = C2xIsTokenAvailable(packetHandle, "IVIM", newPath);
  if(value.layoutId.isValidFlag==1)
  {
    value.layoutId.value = C2xGetTokenInt(packetHandle, "IVIM", newPath);
    result = CheckLastError("IVIM", gkFuncRefGet, result);
  }
  snprintf(newPath, elcount(newPath), "%s.%s", oldPath, "preStoredlayoutId");
  value.preStoredlayoutId.isValidFlag = C2xIsTokenAvailable(packetHandle, "IVIM", newPath);
  if(value.preStoredlayoutId.isValidFlag==1)
  {
    value.preStoredlayoutId.value = C2xGetTokenInt(packetHandle, "IVIM", newPath);
    result = CheckLastError("IVIM", gkFuncRefGet, result);
  }
  snprintf(newPath, elcount(newPath), "%s.%s", oldPath, "text");
  value.text.isValidFlag = C2xIsTokenAvailable(packetHandle, "IVIM", newPath);
  if(value.text.isValidFlag==1)
  {
    GetIVIMIVI_TcPart_textParams(packetHandle, value.text, newPath);
    result = CheckLastError("IVIM", gkFuncRefGet, result);
  }
  snprintf(newPath, elcount(newPath), "%s.%s", oldPath, "data");
  value.data.stringLength = C2xGetTokenData(packetHandle, "IVIM", newPath, elcount(value.data.string), value.data.string);
  return result;
}

int SetIVIMIVI_TcPartParams(LONG packetHandle, struct IVIMIVI_TcPart value, char oldPath[])
{
  char newPath[300];
  int result;

  result = 0;

  snprintf(newPath, elcount(newPath), "%s.%s", oldPath, "detectionZoneIds");
  if(value.detectionZoneIds.isValidFlag==1)
  {
    SetIVIMIVI_TcPart_detectionZoneIdsParams(packetHandle, value.detectionZoneIds, newPath);
    result = CheckLastError("IVIM", gkFuncRefGet, result);
  }
  else
  {
    if( C2xIsTokenAvailable(packetHandle, "IVIM", newPath) )
    {
      C2xRemoveToken(packetHandle, "IVIM", newPath);
    }
  }

  snprintf(newPath, elcount(newPath), "%s.%s", oldPath, "relevanceZoneIds");
  SetIVIMIVI_TcPart_relevanceZoneIdsParams(packetHandle, value.relevanceZoneIds, newPath);
  result = CheckLastError("IVIM", gkFuncRefGet, result);

  snprintf(newPath, elcount(newPath), "%s.%s", oldPath, "direction");
  if(value.direction.isValidFlag==1)
  {
    C2xSetTokenInt(packetHandle, "IVIM", newPath, value.direction.value);
    result = CheckLastError("IVIM", gkFuncRefGet, result);
  }
  else
  {
    if( C2xIsTokenAvailable(packetHandle, "IVIM", newPath) )
    {
      C2xRemoveToken(packetHandle, "IVIM", newPath);
    }
  }

  snprintf(newPath, elcount(newPath), "%s.%s", oldPath, "driverAwarenessZoneIds");
  if(value.driverAwarenessZoneIds.isValidFlag==1)
  {
    SetIVIMIVI_TcPart_driverAwarenessZoneIdsParams(packetHandle, value.driverAwarenessZoneIds, newPath);
    result = CheckLastError("IVIM", gkFuncRefGet, result);
  }
  else
  {
    if( C2xIsTokenAvailable(packetHandle, "IVIM", newPath) )
    {
      C2xRemoveToken(packetHandle, "IVIM", newPath);
    }
  }

  snprintf(newPath, elcount(newPath), "%s.%s", oldPath, "minimumAwarenessTime");
  if(value.minimumAwarenessTime.isValidFlag==1)
  {
    C2xSetTokenInt(packetHandle, "IVIM", newPath, value.minimumAwarenessTime.value);
    result = CheckLastError("IVIM", gkFuncRefGet, result);
  }
  else
  {
    if( C2xIsTokenAvailable(packetHandle, "IVIM", newPath) )
    {
      C2xRemoveToken(packetHandle, "IVIM", newPath);
    }
  }

  snprintf(newPath, elcount(newPath), "%s.%s", oldPath, "applicableLanes");
  if(value.applicableLanes.isValidFlag==1)
  {
    SetIVIMIVI_TcPart_applicableLanesParams(packetHandle, value.applicableLanes, newPath);
    result = CheckLastError("IVIM", gkFuncRefGet, result);
  }
  else
  {
    if( C2xIsTokenAvailable(packetHandle, "IVIM", newPath) )
    {
      C2xRemoveToken(packetHandle, "IVIM", newPath);
    }
  }

  snprintf(newPath, elcount(newPath), "%s.%s", oldPath, "layoutId");
  if(value.layoutId.isValidFlag==1)
  {
    C2xSetTokenInt(packetHandle, "IVIM", newPath, value.layoutId.value);
    result = CheckLastError("IVIM", gkFuncRefGet, result);
  }
  else
  {
    if( C2xIsTokenAvailable(packetHandle, "IVIM", newPath) )
    {
      C2xRemoveToken(packetHandle, "IVIM", newPath);
    }
  }

  snprintf(newPath, elcount(newPath), "%s.%s", oldPath, "preStoredlayoutId");
  if(value.preStoredlayoutId.isValidFlag==1)
  {
    C2xSetTokenInt(packetHandle, "IVIM", newPath, value.preStoredlayoutId.value);
    result = CheckLastError("IVIM", gkFuncRefGet, result);
  }
  else
  {
    if( C2xIsTokenAvailable(packetHandle, "IVIM", newPath) )
    {
      C2xRemoveToken(packetHandle, "IVIM", newPath);
    }
  }

  snprintf(newPath, elcount(newPath), "%s.%s", oldPath, "text");
  if(value.text.isValidFlag==1)
  {
    SetIVIMIVI_TcPart_textParams(packetHandle, value.text, newPath);
    result = CheckLastError("IVIM", gkFuncRefGet, result);
  }
  else
  {
    if( C2xIsTokenAvailable(packetHandle, "IVIM", newPath) )
    {
      C2xRemoveToken(packetHandle, "IVIM", newPath);
    }
  }

  snprintf(newPath, elcount(newPath), "%s.%s", oldPath, "data");
  C2xSetTokenData(packetHandle, "IVIM", newPath, value.data.stringLength, value.data.string);

  return result;
}

int GetIVIMIVI_TextContainerParams(LONG packetHandle, struct IVIMIVI_TextContainer value, char oldPath[])
{
  char newPath[300]; 
  int i;
  int result;

  result = 0;

  value.length = C2xGetTokenInt(packetHandle, "IVIM", oldPath);
  if((result = CheckLastError("IVIM", gkFuncRefGet, result))==0)
  {
    for(i=0; i<value.length; i++)
    {
      snprintf(newPath, elcount(newPath), "%s[%d]", oldPath, i);
      GetIVIMIVI_TcPartParams(packetHandle, value.arrayValue[i], newPath);
      result = CheckLastError("IVIM", gkFuncRefGet, result);
    }
  }
  return result;
}

int SetIVIMIVI_TextContainerParams(LONG packetHandle, struct IVIMIVI_TextContainer value, char oldPath[])
{
  char newPath[300]; 
  int i;
  int result;

  result = 0;

  C2xRemoveToken(packetHandle, "IVIM", oldPath);
  for(i=0; i<value.length; i++)
  {
    snprintf(newPath, elcount(newPath), "%s[%d]", oldPath, i);
    SetIVIMIVI_TcPartParams(packetHandle, value.arrayValue[i], newPath);
    result = CheckLastError("IVIM", gkFuncRefGet, result);
  }
  return result;
}

int GetIVIMIVI_LayoutComponentParams(LONG packetHandle, struct IVIMIVI_LayoutComponent value, char oldPath[])
{
  char newPath[300];
  int result;

  result = 0;

  snprintf(newPath, elcount(newPath), "%s.%s", oldPath, "layoutComponentId");
  value.layoutComponentId = C2xGetTokenInt(packetHandle, "IVIM", newPath);
  result = CheckLastError("IVIM", gkFuncRefGet, result);

  snprintf(newPath, elcount(newPath), "%s.%s", oldPath, "height");
  value.height = C2xGetTokenInt(packetHandle, "IVIM", newPath);
  result = CheckLastError("IVIM", gkFuncRefGet, result);

  snprintf(newPath, elcount(newPath), "%s.%s", oldPath, "width");
  value.width = C2xGetTokenInt(packetHandle, "IVIM", newPath);
  result = CheckLastError("IVIM", gkFuncRefGet, result);

  snprintf(newPath, elcount(newPath), "%s.%s", oldPath, "x");
  value.x = C2xGetTokenInt(packetHandle, "IVIM", newPath);
  result = CheckLastError("IVIM", gkFuncRefGet, result);

  snprintf(newPath, elcount(newPath), "%s.%s", oldPath, "y");
  value.y = C2xGetTokenInt(packetHandle, "IVIM", newPath);
  result = CheckLastError("IVIM", gkFuncRefGet, result);

  snprintf(newPath, elcount(newPath), "%s.%s", oldPath, "textScripting");
  value.textScripting = C2xGetTokenInt(packetHandle, "IVIM", newPath);
  result = CheckLastError("IVIM", gkFuncRefGet, result);

  return result;
}

int SetIVIMIVI_LayoutComponentParams(LONG packetHandle, struct IVIMIVI_LayoutComponent value, char oldPath[])
{
  char newPath[300];
  int result;

  result = 0;

  snprintf(newPath, elcount(newPath), "%s.%s", oldPath, "layoutComponentId");
  C2xSetTokenInt(packetHandle, "IVIM", newPath, value.layoutComponentId);
  result = CheckLastError("IVIM", gkFuncRefGet, result);

  snprintf(newPath, elcount(newPath), "%s.%s", oldPath, "height");
  C2xSetTokenInt(packetHandle, "IVIM", newPath, value.height);
  result = CheckLastError("IVIM", gkFuncRefGet, result);

  snprintf(newPath, elcount(newPath), "%s.%s", oldPath, "width");
  C2xSetTokenInt(packetHandle, "IVIM", newPath, value.width);
  result = CheckLastError("IVIM", gkFuncRefGet, result);

  snprintf(newPath, elcount(newPath), "%s.%s", oldPath, "x");
  C2xSetTokenInt(packetHandle, "IVIM", newPath, value.x);
  result = CheckLastError("IVIM", gkFuncRefGet, result);

  snprintf(newPath, elcount(newPath), "%s.%s", oldPath, "y");
  C2xSetTokenInt(packetHandle, "IVIM", newPath, value.y);
  result = CheckLastError("IVIM", gkFuncRefGet, result);

  snprintf(newPath, elcount(newPath), "%s.%s", oldPath, "textScripting");
  C2xSetTokenInt(packetHandle, "IVIM", newPath, value.textScripting);
  result = CheckLastError("IVIM", gkFuncRefGet, result);

  return result;
}

int GetIVIMIVI_LayoutContainer_layoutComponentsParams(LONG packetHandle, struct IVIMIVI_LayoutContainer_layoutComponents value, char oldPath[])
{
  char newPath[300]; 
  int i;
  int result;

  result = 0;

  value.length = C2xGetTokenInt(packetHandle, "IVIM", oldPath);
  if((result = CheckLastError("IVIM", gkFuncRefGet, result))==0)
  {
    for(i=0; i<value.length; i++)
    {
      snprintf(newPath, elcount(newPath), "%s[%d]", oldPath, i);
      GetIVIMIVI_LayoutComponentParams(packetHandle, value.arrayValue[i], newPath);
      result = CheckLastError("IVIM", gkFuncRefGet, result);
    }
  }
  return result;
}

int SetIVIMIVI_LayoutContainer_layoutComponentsParams(LONG packetHandle, struct IVIMIVI_LayoutContainer_layoutComponents value, char oldPath[])
{
  char newPath[300]; 
  int i;
  int result;

  result = 0;

  C2xRemoveToken(packetHandle, "IVIM", oldPath);
  for(i=0; i<value.length; i++)
  {
    snprintf(newPath, elcount(newPath), "%s[%d]", oldPath, i);
    SetIVIMIVI_LayoutComponentParams(packetHandle, value.arrayValue[i], newPath);
    result = CheckLastError("IVIM", gkFuncRefGet, result);
  }
  return result;
}

int GetIVIMIVI_LayoutContainerParams(LONG packetHandle, struct IVIMIVI_LayoutContainer value, char oldPath[])
{
  char newPath[300];
  int result;

  result = 0;

  snprintf(newPath, elcount(newPath), "%s.%s", oldPath, "layoutId");
  value.layoutId = C2xGetTokenInt(packetHandle, "IVIM", newPath);
  result = CheckLastError("IVIM", gkFuncRefGet, result);

  snprintf(newPath, elcount(newPath), "%s.%s", oldPath, "height");
  value.height.isValidFlag = C2xIsTokenAvailable(packetHandle, "IVIM", newPath);
  if(value.height.isValidFlag==1)
  {
    value.height.value = C2xGetTokenInt(packetHandle, "IVIM", newPath);
    result = CheckLastError("IVIM", gkFuncRefGet, result);
  }
  snprintf(newPath, elcount(newPath), "%s.%s", oldPath, "width");
  value.width.isValidFlag = C2xIsTokenAvailable(packetHandle, "IVIM", newPath);
  if(value.width.isValidFlag==1)
  {
    value.width.value = C2xGetTokenInt(packetHandle, "IVIM", newPath);
    result = CheckLastError("IVIM", gkFuncRefGet, result);
  }
  snprintf(newPath, elcount(newPath), "%s.%s", oldPath, "layoutComponents");
  GetIVIMIVI_LayoutContainer_layoutComponentsParams(packetHandle, value.layoutComponents, newPath);
  result = CheckLastError("IVIM", gkFuncRefGet, result);

  return result;
}

int SetIVIMIVI_LayoutContainerParams(LONG packetHandle, struct IVIMIVI_LayoutContainer value, char oldPath[])
{
  char newPath[300];
  int result;

  result = 0;

  snprintf(newPath, elcount(newPath), "%s.%s", oldPath, "layoutId");
  C2xSetTokenInt(packetHandle, "IVIM", newPath, value.layoutId);
  result = CheckLastError("IVIM", gkFuncRefGet, result);

  snprintf(newPath, elcount(newPath), "%s.%s", oldPath, "height");
  if(value.height.isValidFlag==1)
  {
    C2xSetTokenInt(packetHandle, "IVIM", newPath, value.height.value);
    result = CheckLastError("IVIM", gkFuncRefGet, result);
  }
  else
  {
    if( C2xIsTokenAvailable(packetHandle, "IVIM", newPath) )
    {
      C2xRemoveToken(packetHandle, "IVIM", newPath);
    }
  }

  snprintf(newPath, elcount(newPath), "%s.%s", oldPath, "width");
  if(value.width.isValidFlag==1)
  {
    C2xSetTokenInt(packetHandle, "IVIM", newPath, value.width.value);
    result = CheckLastError("IVIM", gkFuncRefGet, result);
  }
  else
  {
    if( C2xIsTokenAvailable(packetHandle, "IVIM", newPath) )
    {
      C2xRemoveToken(packetHandle, "IVIM", newPath);
    }
  }

  snprintf(newPath, elcount(newPath), "%s.%s", oldPath, "layoutComponents");
  SetIVIMIVI_LayoutContainer_layoutComponentsParams(packetHandle, value.layoutComponents, newPath);
  result = CheckLastError("IVIM", gkFuncRefGet, result);

  return result;
}

int GetIVIMIVI_IviContainerParams(LONG packetHandle, struct IVIMIVI_IviContainer value, char oldPath[])
{
  char newPath[300];
  int result;

  result = 0;

  value.choice = C2xGetTokenInt(packetHandle, "IVIM", oldPath);

  switch(value.choice)
  {
    case 0:
    {
      snprintf(newPath, elcount(newPath), "%s.%s", oldPath, "glc");
      GetIVIMIVI_GeographicLocationContainerParams(packetHandle, value.glc, newPath);
      result = CheckLastError("IVIM", gkFuncRefGet, result);
    }
    break;
    case 1:
    {
      snprintf(newPath, elcount(newPath), "%s.%s", oldPath, "giv");
      GetIVIMIVI_GeneralIviContainerParams(packetHandle, value.giv, newPath);
      result = CheckLastError("IVIM", gkFuncRefGet, result);
    }
    break;
    case 2:
    {
      snprintf(newPath, elcount(newPath), "%s.%s", oldPath, "rcc");
      GetIVIMIVI_RoadConfigurationContainerParams(packetHandle, value.rcc, newPath);
      result = CheckLastError("IVIM", gkFuncRefGet, result);
    }
    break;
    case 3:
    {
      snprintf(newPath, elcount(newPath), "%s.%s", oldPath, "tc");
      GetIVIMIVI_TextContainerParams(packetHandle, value.tc, newPath);
      result = CheckLastError("IVIM", gkFuncRefGet, result);
    }
    break;
    case 4:
    {
      snprintf(newPath, elcount(newPath), "%s.%s", oldPath, "lac");
      GetIVIMIVI_LayoutContainerParams(packetHandle, value.lac, newPath);
      result = CheckLastError("IVIM", gkFuncRefGet, result);
    }
    break;
  }
  return result;
}

int SetIVIMIVI_IviContainerParams(LONG packetHandle, struct IVIMIVI_IviContainer value, char oldPath[])
{
  char newPath[300];
  int result;

  result = 0;

  switch(value.choice)
  {
    case 0:
    {
      snprintf(newPath, elcount(newPath), "%s.%s", oldPath, "glc");
      SetIVIMIVI_GeographicLocationContainerParams(packetHandle, value.glc, newPath);
      result = CheckLastError("IVIM", gkFuncRefGet, result);
    }
    break;
    case 1:
    {
      snprintf(newPath, elcount(newPath), "%s.%s", oldPath, "giv");
      SetIVIMIVI_GeneralIviContainerParams(packetHandle, value.giv, newPath);
      result = CheckLastError("IVIM", gkFuncRefGet, result);
    }
    break;
    case 2:
    {
      snprintf(newPath, elcount(newPath), "%s.%s", oldPath, "rcc");
      SetIVIMIVI_RoadConfigurationContainerParams(packetHandle, value.rcc, newPath);
      result = CheckLastError("IVIM", gkFuncRefGet, result);
    }
    break;
    case 3:
    {
      snprintf(newPath, elcount(newPath), "%s.%s", oldPath, "tc");
      SetIVIMIVI_TextContainerParams(packetHandle, value.tc, newPath);
      result = CheckLastError("IVIM", gkFuncRefGet, result);
    }
    break;
    case 4:
    {
      snprintf(newPath, elcount(newPath), "%s.%s", oldPath, "lac");
      SetIVIMIVI_LayoutContainerParams(packetHandle, value.lac, newPath);
      result = CheckLastError("IVIM", gkFuncRefGet, result);
    }
    break;
  }
  return result;
}

int GetIVIMIVI_IviStructure_optionalParams(LONG packetHandle, struct IVIMIVI_IviStructure_optional value, char oldPath[])
{
  char newPath[300]; 
  int i;
  int result;

  result = 0;

  value.length = C2xGetTokenInt(packetHandle, "IVIM", oldPath);
  if((result = CheckLastError("IVIM", gkFuncRefGet, result))==0)
  {
    for(i=0; i<value.length; i++)
    {
      snprintf(newPath, elcount(newPath), "%s[%d]", oldPath, i);
      GetIVIMIVI_IviContainerParams(packetHandle, value.arrayValue[i], newPath);
      result = CheckLastError("IVIM", gkFuncRefGet, result);
    }
  }
  return result;
}

int SetIVIMIVI_IviStructure_optionalParams(LONG packetHandle, struct IVIMIVI_IviStructure_optional value, char oldPath[])
{
  char newPath[300]; 
  int i;
  int result;

  result = 0;

  C2xRemoveToken(packetHandle, "IVIM", oldPath);
  for(i=0; i<value.length; i++)
  {
    snprintf(newPath, elcount(newPath), "%s[%d]", oldPath, i);
    SetIVIMIVI_IviContainerParams(packetHandle, value.arrayValue[i], newPath);
    result = CheckLastError("IVIM", gkFuncRefGet, result);
  }
  return result;
}

int GetIVIMIVI_IviStructureParams(LONG packetHandle, struct IVIMIVI_IviStructure value, char oldPath[])
{
  char newPath[300];
  int result;

  result = 0;

  snprintf(newPath, elcount(newPath), "%s.%s", oldPath, "mandatory");
  GetIVIMIVI_IVIManagementContainerParams(packetHandle, value.mandatory, newPath);
  result = CheckLastError("IVIM", gkFuncRefGet, result);

  snprintf(newPath, elcount(newPath), "%s.%s", oldPath, "optional");
  value.optional.isValidFlag = C2xIsTokenAvailable(packetHandle, "IVIM", newPath);
  if(value.optional.isValidFlag==1)
  {
    GetIVIMIVI_IviStructure_optionalParams(packetHandle, value.optional, newPath);
    result = CheckLastError("IVIM", gkFuncRefGet, result);
  }
  return result;
}

int SetIVIMIVI_IviStructureParams(LONG packetHandle, struct IVIMIVI_IviStructure value, char oldPath[])
{
  char newPath[300];
  int result;

  result = 0;

  snprintf(newPath, elcount(newPath), "%s.%s", oldPath, "mandatory");
  SetIVIMIVI_IVIManagementContainerParams(packetHandle, value.mandatory, newPath);
  result = CheckLastError("IVIM", gkFuncRefGet, result);

  snprintf(newPath, elcount(newPath), "%s.%s", oldPath, "optional");
  if(value.optional.isValidFlag==1)
  {
    SetIVIMIVI_IviStructure_optionalParams(packetHandle, value.optional, newPath);
    result = CheckLastError("IVIM", gkFuncRefGet, result);
  }
  else
  {
    if( C2xIsTokenAvailable(packetHandle, "IVIM", newPath) )
    {
      C2xRemoveToken(packetHandle, "IVIM", newPath);
    }
  }

  return result;
}

int API_GetIVIMParams(LONG packetHandle, struct IVIM value)
{
  int result;
  result = 0;

  value.header.isValidFlag = 1;
  GetIVIMITS_Container_ItsPduHeaderParams(packetHandle, value.header, "header");
  result = CheckLastError("IVIM", gkFuncRefGet, result);

  value.ivi.isValidFlag = 1;
  GetIVIMIVI_IviStructureParams(packetHandle, value.ivi, "ivi");
  result = CheckLastError("IVIM", gkFuncRefGet, result);

  return result;
}

int API_SetIVIMParams(LONG packetHandle, struct IVIM value)
{
  int result;
  result = 0;

  SetIVIMITS_Container_ItsPduHeaderParams(packetHandle, value.header, "header");
  result = CheckLastError("IVIM", gkFuncRefGet, result);

  SetIVIMIVI_IviStructureParams(packetHandle, value.ivi, "ivi");
  result = CheckLastError("IVIM", gkFuncRefGet, result);

  return result;
}

