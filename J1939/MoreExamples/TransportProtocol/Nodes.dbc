VERSION ""

NS_ :

BS_:

BU_: Node2 Node1

BO_ 2565800194 ProprietaryA_Node2: 8 Node2
 SG_ N2PropA_Counter : 0|8@1+ (1,0) [0|255] "" Vector__XXX

BO_ 2565800449 ProprietaryA_Node1: 8 Node1
 SG_ N1PropA_Counter : 0|8@1+ (1,0) [0|255] "" Vector__XXX

BO_ 2566849026 ProprietaryB_Node2: 8 Node2
 SG_ N2PropB_Counter : 0|8@1+ (1,0) [0|255] "" Vector__XXX

BO_ 2566848769 ProprietaryB_Node1: 8 Node1
 SG_ N1PropB_Counter : 0|8@1+ (1,0) [0|255] "" Vector__XXX

EV_ EvNode2_RX_CMDT_DLC: 0 [0|1785] "" 0 1 DUMMY_NODE_VECTOR0 Vector__XXX;

EV_ EvNode2_RX_BAM_DLC: 0 [0|1785] "" 0 2 DUMMY_NODE_VECTOR0 Vector__XXX;

EV_ EvNode1_RX_CMDT_DLC: 0 [0|1785] "" 0 3 DUMMY_NODE_VECTOR0 Vector__XXX;

EV_ EvNode1_RX_BAM_DLC: 0 [0|1785] "" 0 4 DUMMY_NODE_VECTOR0 Vector__XXX;

EV_ EvNode2_TX_CMDT: 0 [0|1] "" 0 5 DUMMY_NODE_VECTOR0 Vector__XXX;

EV_ EvNode2_TX_CMDT_DLC: 0 [0|1785] "" 21 6 DUMMY_NODE_VECTOR0 Vector__XXX;

EV_ EvNode2_TX_BAM: 0 [0|1] "" 0 7 DUMMY_NODE_VECTOR0 Vector__XXX;

EV_ EvNode2_TX_BAM_DLC: 0 [0|1785] "" 21 8 DUMMY_NODE_VECTOR0 Vector__XXX;

EV_ EvNode1_TX_CMDT: 0 [0|1] "" 0 9 DUMMY_NODE_VECTOR0 Vector__XXX;

EV_ EvNode1_TX_CMDT_DLC: 0 [0|1785] "" 21 10 DUMMY_NODE_VECTOR0 Vector__XXX;

EV_ EvNode1_TX_BAM: 0 [0|1] "" 0 11 DUMMY_NODE_VECTOR0 Vector__XXX;

EV_ EvNode1_TX_BAM_DLC: 0 [0|1785] "" 21 12 DUMMY_NODE_VECTOR0 Vector__XXX;

BA_DEF_ BO_  "VFrameFormat" ENUM  "StandardCAN","ExtendedCAN","reserved","J1939PG";
BA_DEF_ BO_  "GenMsgSendType" ENUM  "cyclic","reserved","cyclicIfActive","reserved","reserved","reserved","reserved","reserved","noMsgSendType","vector_leerstring";
BA_DEF_ BO_  "GenMsgRequestable" INT 0 1;
BA_DEF_ BU_  "NmStationAddress" INT 0 255;
BA_DEF_ BU_  "NmJ1939AAC" INT 0 1;
BA_DEF_ BU_  "NmJ1939IndustryGroup" INT 0 7;
BA_DEF_ BU_  "NmJ1939System" INT 0 127;
BA_DEF_ BU_  "NmJ1939SystemInstance" INT 0 15;
BA_DEF_ BU_  "NmJ1939Function" INT 0 255;
BA_DEF_ BU_  "NmJ1939FunctionInstance" INT 0 7;
BA_DEF_ BU_  "NmJ1939ECUInstance" INT 0 7;
BA_DEF_ BU_  "NmJ1939ManufacturerCode" INT 0 2047;
BA_DEF_ BU_  "NmJ1939IdentityNumber" INT 0 2097151;
BA_DEF_ BU_  "ECU" STRING ;
BA_DEF_  "ProtocolType" STRING ;
BA_DEF_  "BusType" STRING ;
BA_DEF_DEF_  "VFrameFormat" "J1939PG";
BA_DEF_DEF_  "GenMsgSendType" "noMsgSendType";
BA_DEF_DEF_  "GenMsgRequestable" 1;
BA_DEF_DEF_  "NmStationAddress" 254;
BA_DEF_DEF_  "NmJ1939AAC" 0;
BA_DEF_DEF_  "NmJ1939IndustryGroup" 0;
BA_DEF_DEF_  "NmJ1939System" 0;
BA_DEF_DEF_  "NmJ1939SystemInstance" 0;
BA_DEF_DEF_  "NmJ1939Function" 0;
BA_DEF_DEF_  "NmJ1939FunctionInstance" 0;
BA_DEF_DEF_  "NmJ1939ECUInstance" 0;
BA_DEF_DEF_  "NmJ1939ManufacturerCode" 0;
BA_DEF_DEF_  "NmJ1939IdentityNumber" 0;
BA_DEF_DEF_  "ECU" "";
BA_DEF_DEF_  "ProtocolType" "";
BA_DEF_DEF_  "BusType" "CAN";
BA_ "ProtocolType" "J1939";
BA_ "ECU" BU_ Node2 "Node2";
BA_ "NmJ1939IdentityNumber" BU_ Node2 2;
BA_ "NmJ1939ManufacturerCode" BU_ Node2 1861;
BA_ "NmJ1939Function" BU_ Node2 128;
BA_ "NmStationAddress" BU_ Node2 2;
BA_ "NmStationAddress" BU_ Node1 1;
BA_ "ECU" BU_ Node1 "Node1";
BA_ "NmJ1939IdentityNumber" BU_ Node1 1;
BA_ "NmJ1939ManufacturerCode" BU_ Node1 1861;
BA_ "NmJ1939Function" BU_ Node1 128;
