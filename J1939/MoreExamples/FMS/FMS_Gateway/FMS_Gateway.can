/*@!Encoding:1252*/
/*
 * FMS Gateway ECU                                 Version 1.1
 *
 * Copyright 2005, Vector Informatik GmbH - All right reserved
 *
 * History:
 * 1.0 (Jr) Created 
 * 1.1 (Jr) Minor changes, fixed initialization issue
 */
variables
{
  // Constants
  const int  kNullAddr    = 0xfe;   // Null address
  const int  kGlobalAddr  = 0xff;   // Global address
  const byte kCAN_Channel = 1;
  const byte kFMS_Channel = 2;

  // TX Parameter Groups
  pg ACL   TX_ACL;
  pg EEC1  TX_EEC1;
  pg EEC2  TX_EEC2;
  pg TCO1  TX_TCO1;
  pg CCVS  TX_CCVS;
  pg DD    TX_DD;
  pg ET1   TX_ET1;
  pg HOURS TX_HOURS;
  pg LFC1   TX_LFC;
  pg SERV  TX_SERV;
  pg VDHR  TX_VDHR;
  pg VW    TX_VW;
  pg FMSSI TX_FMSSI;
  pg VI    TX_VI;

  // Timers
  msTimer Timer20ms;
  msTimer Timer50ms;
  msTimer Timer100ms;
  msTimer Timer1000ms;
  msTimer Timer10s;
  msTimer ACLTimer;
}

/*
 * Transmit Parameter Groups with 20ms cycle time.
 */
on timer Timer20ms
{
  output( TX_EEC1 );

  setTimer( Timer20ms, 20 );
}

/*
 * Transmit Parameter Groups with 50ms cycle time.
 */
on timer Timer50ms
{
  output( TX_EEC2 );
  output( TX_TCO1 );

  setTimer( Timer50ms, 50 );
}

/*
 * Transmit Parameter Groups with 100ms cycle time.
 */
on timer Timer100ms
{
  output( TX_CCVS );

  setTimer( Timer100ms, 100 );
}

/*
 * Transmit Parameter Groups with 1000ms cycle time.
 */
on timer Timer1000ms
{
  output( TX_DD );
  output( TX_ET1 );
  output( TX_HOURS );
  output( TX_LFC );
  output( TX_SERV );
  output( TX_LFC );
  output( TX_VDHR );
  output( TX_VW );

  setTimer( Timer1000ms, 1000 );
}

/*
 * Transmit Parameter Groups with 10 seconds cycle time.
 */
on timer Timer10s
{
  output( TX_FMSSI );
  output( TX_VI );

  setTimer( Timer10s, 10000 );
}

/*
 * Start the ECU. 
 * The functions starts the Address Claiming procedure.
 */
void FMS_GatewayStartUp()
{
  TX_ACL.SA                      = FMS_Gateway.NmStationAddress;
  TX_ACL.DA                      = kGlobalAddr;
  TX_ACL.ArbitraryAddressCapable = FMS_Gateway.NmJ1939AAC;
  TX_ACL.IndustryGroup           = FMS_Gateway.NmJ1939IndustryGroup;
  TX_ACL.VehicleSystem           = FMS_Gateway.NmJ1939System;
  TX_ACL.VehicleSystemInstance   = FMS_Gateway.NmJ1939SystemInstance;
  TX_ACL.Function                = FMS_Gateway.NmJ1939Function;
  TX_ACL.FunctionInstance        = FMS_Gateway.NmJ1939FunctionInstance;
  TX_ACL.ECUInstance             = FMS_Gateway.NmJ1939ECUInstance;
  TX_ACL.ManufacturerCode        = FMS_Gateway.NmJ1939ManufacturerCode;
  TX_ACL.IdentityNumber          = FMS_Gateway.NmJ1939IdentityNumber;

  FMS_GatewayInit();

  TX_ACL.CAN = kFMS_Channel;
  output( TX_ACL );
  TX_ACL.CAN = kCAN_Channel;
  output( TX_ACL );

  setTimer( ACLTimer, 250 );
}

/*
 * Shut down the ECU. Stop timers and transmission
 * of the Parameter Groups.
 */
void FMS_GatewayShutDown()
{
  cancelTimer( Timer20ms );
  cancelTimer( Timer50ms );
  cancelTimer( Timer100ms );
  cancelTimer( Timer1000ms );
  cancelTimer( Timer10s );
}

/*
 * Initialize the Parameter Group buffers
 */
void FMS_GatewayInit()
{
  TX_EEC1.CAN  = kFMS_Channel;
  TX_EEC1.SA   = TX_ACL.SA;
  TX_EEC1.dword(0) = TX_EEC1.dword(4) = 0xffffffff;

  TX_EEC2.CAN  = kFMS_Channel;
  TX_EEC2.SA   = TX_ACL.SA;
  TX_EEC2.dword(0) = TX_EEC2.dword(4) = 0xffffffff;

  TX_TCO1.CAN  = kFMS_Channel;
  TX_TCO1.SA   = TX_ACL.SA;
  TX_TCO1.dword(0) = TX_TCO1.dword(4) = 0xffffffff;

  TX_CCVS.CAN  = kFMS_Channel;
  TX_CCVS.SA   = TX_ACL.SA;
  TX_CCVS.dword(0) = TX_CCVS.dword(4) = 0xffffffff;

  TX_DD.CAN    = kFMS_Channel;
  TX_DD.SA     = TX_ACL.SA;
  TX_DD.dword(0) = TX_DD.dword(4) = 0xffffffff;

  TX_ET1.CAN   = kFMS_Channel;
  TX_ET1.SA    = TX_ACL.SA;
  TX_ET1.dword(0) = TX_ET1.dword(4) = 0xffffffff;

  TX_HOURS.CAN = kFMS_Channel;
  TX_HOURS.SA  = TX_ACL.SA;
  TX_HOURS.dword(0) = TX_HOURS.dword(4) = 0xffffffff;

  TX_LFC.CAN   = kFMS_Channel;
  TX_LFC.SA    = TX_ACL.SA;
  TX_LFC.dword(0) = TX_LFC.dword(4) = 0xffffffff;

  TX_SERV.CAN  = kFMS_Channel;
  TX_SERV.SA   = TX_ACL.SA;
  TX_SERV.dword(0) = TX_SERV.dword(4) = 0xffffffff;

  TX_VDHR.CAN  = kFMS_Channel;
  TX_VDHR.SA   = TX_ACL.SA;
  TX_VDHR.dword(0) = TX_VDHR.dword(4) = 0xffffffff;

  TX_VW.CAN    = kFMS_Channel;
  TX_VW.SA     = TX_ACL.SA;
  TX_VW.dword(0) = TX_VW.dword(4) = 0xffffffff;

  TX_FMSSI.CAN = kFMS_Channel;
  TX_FMSSI.SA  = TX_ACL.SA;
  TX_FMSSI.dword(0) = TX_FMSSI.dword(4) = 0xffffffff;
  TX_FMSSI.SoftwareVersion      = ('0' << 24) | ('1' << 16) |  ('0' << 8) | ('0');
  TX_FMSSI.RequestsSupported    = 0;
  TX_FMSSI.DiagnosticsSupported = 0;

  TX_VI.CAN    = kFMS_Channel;
  TX_VI.SA     = TX_ACL.SA;
  TX_VI.dword(0) = TX_VI.dword(4) = 0xffffffff;
}

on start
{
  FMS_GatewayStartUp();
}

on stopMeasurement
{
  FMS_GatewayShutDown();
}

/*
 * The ECU has successfully claimed an address. Start
 * the timers an transmit the Parameter Groups on the
 * FMS-Bus
 */
void FMS_GatewayClaimingComplete()
{
  setTimer( Timer20ms, 20 );
  setTimer( Timer50ms, 50 );
  setTimer( Timer100ms, 100 );
  setTimer( Timer1000ms, 1000 );
  setTimer( Timer10s, 10000 );
}

/*
 * Received Address Claim Parameter Group
 */
on pg ACL
{
  pg ACL acl;
  int    compareResult;

  if (this.DIR != RX) return;
  if ((this.CAN != kFMS_Channel) && (this.CAN != kCAN_Channel)) return;

  if (TX_ACL.SA == this.SA) {
    acl.DWORD(0) = this.DWORD(0);
    acl.DWORD(4) = this.DWORD(4);

    compareResult = utilCompareDeviceName( TX_ACL, acl );
    
    // compare names for priority
    if (compareResult > 0) {
      // send address claiming PG again
      TX_ACL.CAN = kFMS_Channel;
      output( TX_ACL );
      TX_ACL.CAN = kCAN_Channel;
      output( TX_ACL );
    }
    else if (compareResult < 0) {
      // go offline, we have a lower priority
      cancelTimer( ACLTimer );

      TX_ACL.SA  = kNullAddr;
      TX_ACL.CAN = kFMS_Channel;
      output( TX_ACL );
      TX_ACL.CAN = kCAN_Channel;
      output( TX_ACL );

      FMS_GatewayShutDown();
    }
  }
}

/*
 * Compare device names
 *
 * if pg1 has lower priority than pg2, return -1
 * if pg1 has higher priority than pg2, return 1
 * if both names are equal, return 0
 */
int utilCompareDeviceName( pg ACL pg1, pg ACL pg2 )
{
  int i = 0;
  for( i = 7; i >= 0; i-- ) {
    if (pg1.byte(i) > pg2.byte(i)) {
      return -1;
    }
    else if (pg1.byte(i) < pg2.byte(i)) {
      return 1;
    }
  }

  return 0;
}

/*
 * If this timer expires, we have successfully claimed an address.
 */
on timer ACLTimer
{
  FMS_GatewayClaimingComplete();
}

on pg J1939::EEC1
{
  if ((this.dir == RX) && (this.can == kCAN_Channel)) {
    TX_EEC1.EngSpeed = this.EngSpeed;
  }
}

on pg J1939::EEC2
{
  if ((this.dir == RX) && (this.can == kCAN_Channel)) {
    TX_EEC2.AccelPedalPosition1 = this.AccelPedalPos1;
  }
}

on pg J1939::TCO1
{
  if ((this.dir == RX) && (this.can == kCAN_Channel)) {
    TX_TCO1.DirectionIndicator       = this.DirectionIndicator;
    TX_TCO1.Driver1TimeRelatedStates = this.Driver1TimeRelatedStates;
    TX_TCO1.Driver1WorkingState      = this.Driver1WorkingState;
    TX_TCO1.Driver2TimeRelatedStates = this.Driver2TimeRelatedStates;
    TX_TCO1.Driver2WorkingState      = this.Driver2WorkingState;
    TX_TCO1.DriverCardDriver1        = this.DriverCardDriver1;
    TX_TCO1.DriverCardDriver2        = this.DriverCardDriver2;
    TX_TCO1.DriveRecognize           = this.VehicleMotion;
    TX_TCO1.HandlingInformation      = this.HandlingInformation;
    TX_TCO1.SystemEvent              = this.SystemEvent;
    TX_TCO1.TachographPerformance    = this.TachographPerformance;
    TX_TCO1.TachographVehicleSpeed   = this.TachographVehicleSpeed;
  }
}

on pg J1939::CCVS1
{
  if ((this.dir == RX) && (this.can == kCAN_Channel)) {
    TX_CCVS.WheelBasedVehicleSpeed = this.WheelBasedVehicleSpeed;
    TX_CCVS.BrakeSwitch            = this.BrakeSwitch;
    TX_CCVS.ClutchSwitch           = this.ClutchSwitch;
    TX_CCVS.CruiseCtrlActive       = this.CruiseCtrlActive;
    TX_CCVS.PTOState               = this.PTOGovernorState;
  }
}

on pg J1939::ET1
{
  if ((this.dir == RX) && (this.can == kCAN_Channel)) {
    TX_ET1.EngCoolantTemp = this.EngCoolantTemp;
  }
}

on pg J1939::HOURS
{
  if ((this.dir == RX) && (this.can == kCAN_Channel)) {
    TX_HOURS.EngTotalHoursOfOperation = this.EngTotalHoursOfOperation;
  }
}

on pg J1939::LFC1
{
  if ((this.dir == RX) && (this.can == kCAN_Channel)) {
    TX_LFC.EngTotalFuelUsed = this.EngTotalFuelUsed;
  }
}

on pg J1939::SERV
{
  if ((this.dir == RX) && (this.can == kCAN_Channel)) {
    TX_SERV.ServiceDistance = this.ServiceDistance;
  }
}

on pg J1939::VDHR
{
  if ((this.dir == RX) && (this.can == kCAN_Channel)) {
    TX_VDHR.HghRslutionTotalVehicleDistance = this.HghRsolutionTotalVehicleDistance;
  }
}

on pg J1939::VW
{
  if ((this.dir == RX) && (this.can == kCAN_Channel)) {
    TX_VW.AxleLocation = this.AxleLocation;
    TX_VW.AxleWeight   = this.AxleWeight_00;
  }
}

on pg J1939::VI
{
  int i;
  if ((this.dir == RX) && (this.can == kCAN_Channel)) {
    for( i = 0; i < this.DLC; i++ ) {
      TX_VI.byte(i) = this.byte(i);
    }
  }
}

