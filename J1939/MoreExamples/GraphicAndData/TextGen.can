/*@@var:*/
variables
{
  BYTE i, x=1;

  CHAR data[9] = "Signal  ";

  pg VI pg_1;

  LONG sourceAddress = 0x12;

  msTimer textTimer;
}
/*@@end*/

/*@@startStart:Start:*/
on start
{
  setTimer(textTimer, 1500);

  pg_1.sa = sourceAddress;
  pg_1.dlc = 8;
  for (i=0; i<8; i++)
  {
    pg_1.byte(i) = data[i];
  }

  output(pg_1);
}
/*@@end*/

/*@@timer:textTimer:*/
on timer textTimer
{
  setTimer(textTimer, 1500);

  switch(x)
  {
    case(0) :
    {
      strncpy(data, "Signal  ", 9);
      break;
    }
    case(1) :
    {
      strncpy(data, "Analysis", 9);
      break;
    }
    case(2) :
    {
      strncpy(data, "with    ", 9);
      break;
    }
    case(3) :
    {
      strncpy(data, "Option  ", 9);
      break;
    }
    case(4) :
    {
      strncpy(data, ".J1939  ", 9);
      break;
    }
    default :
      break;
  }

  for (i=0; i<8; i++)
  {
    pg_1.byte(i) = data[i];
  }

  output(pg_1);

  if (x++>3) x=0;
}
/*@@end*/

