/*@!Encoding:1252*/
/*
 * CraneController ECU                             Version 1.1
 *
 * Copyright 2005, Vector Informatik GmbH - All right reserved
 *
 * History:
 * 1.0 (Jr) Created 
 * 1.1 (Jr) Renamed some attributes and variables
 */
variables
{
  // some constants
  const BYTE kNullAddr   = 0xfe;
  const BYTE kGlobalAddr = 0xff;
  // ECU states
  const BYTE kNotInitialized = 0;
  const BYTE kInitialized    = 1;
  const BYTE kAddrClaiming   = 2;
  const BYTE kOnline         = 3;
  const BYTE kOffline        = 4;

  // General ECU variables
  char gECULabel[20] = "CraneController"; // Label for output to write window
  BYTE gECUState     = kNotInitialized;   // State of the ECU
  BYTE gECUChannel   = 1;                 // CAN channel

  // Address claiming stuff
  pg AC  TX_ACL = { PRIO=6, DP=0 };
  msTimer TX_ACL_Timer;

  // 
  const int   kSystemTime    = 100;                  // System time in [ms]
  const float kSystemTimeSec = kSystemTime / 1000.0; // System time in [sec]
  msTimer     SystemTimer;                           // System timer

  // transmit PGs
	pg SupportCommand TX_SupportCommand;
	msTimer           TX_SupportCommand_Timer;
	pg WinchCommand   TX_WinchCommand;
	msTimer           TX_WinchCommand_Timer;
	pg BoomCommand     TX_BoomCommand;
	msTimer           TX_BoomCommand_Timer;
	msTimer           DemoTimer;

	// simulation variables
	int   gSupportIsDown = 0;
	float gMaxRopeLoad   = 30000; // in [kg]
	float gMaxRopeSpeed  = 2.0;   // in [m/s]
	float gMaxAngleSpeed = 5.0;   // in [deg/sec]
	float gMaxBoomSpeed   = 5.0;   // in [%/sec]

	float gSupportPosition = 0.0;
	float gBoomAngle        = 0.0;
	float gBoomPosition     = 0.0;
	float gWinchPosition   = 0.0;

  // Definition of debugging constants
  const int kDbgInfo    = 10;
  const int kDbgWarning = 5;
  const int kDbgError   = 1;
  const int kDbgQuiet   = 0;

  // General global variables
  int gDbgLevel         = kDbgWarning; // Set debug level for output to write window
}

on preStart
{
  setWriteDbgLevel( gDbgLevel );
  TX_SupportCommand.DWORD(0) = TX_SupportCommand.DWORD(4) = 0xFFFFFFFF; //init datafield
  TX_WinchCommand.DWORD(0) = TX_WinchCommand.DWORD(4) = 0xFFFFFFFF; //init datafield
  TX_BoomCommand.DWORD(0) = TX_BoomCommand.DWORD(4) = 0xFFFFFFFF; //init datafield
	
}

//
// Initialize the ECU
//
EnterInitialized()
{
  cancelTimer( SystemTimer );

  // init address claiming PG
  TX_ACL.ArbitraryAddressCapable = CraneController.NmJ1939AAC;
  TX_ACL.IndustryGroup           = CraneController.NmJ1939IndustryGroup;
  TX_ACL.VehicleSystem           = CraneController.NmJ1939System;
  TX_ACL.VehicleSystemInstance   = CraneController.NmJ1939SystemInstance;
  TX_ACL.Function                = CraneController.NmJ1939Function;
  TX_ACL.FunctionInstance        = CraneController.NmJ1939FunctionInstance;
  TX_ACL.ECUInstance             = CraneController.NmJ1939ECUInstance;
  TX_ACL.ManufacturerCode        = CraneController.NmJ1939ManufacturerCode;
  TX_ACL.IdentityNumber          = CraneController.NmJ1939IdentityNumber;
  TX_ACL.SA = CraneController.NmStationAddress;
  TX_ACL.DA = kGlobalAddr;
  TX_ACL.CAN = gECUChannel;

  // initialize SupportCommand
  TX_SupportCommand.CmdFrontLeft  = TX_SupportCommand.CmdFrontLeft::Idle;
  TX_SupportCommand.CmdFrontRight = TX_SupportCommand.CmdFrontRight::Idle;
  TX_SupportCommand.CmdRearLeft   = TX_SupportCommand.CmdRearLeft::Idle;
  TX_SupportCommand.CmdRearRight  = TX_SupportCommand.CmdRearRight::Idle;
  TX_SupportCommand.SA            = kNullAddr;

	// initialize WinchCommand
  TX_WinchCommand.MaxRopeLoad.phys  = gMaxRopeLoad;
  TX_WinchCommand.SetRopeSpeed.phys = 0.0;
  TX_WinchCommand.SA                = kNullAddr;

	// initialize BoomCommand
  TX_BoomCommand.CmdBoom   = TX_BoomCommand.CmdBoom::Idle;
  TX_BoomCommand.CmdAngle = TX_BoomCommand.CmdAngle::Idle;
  TX_BoomCommand.SA       = kNullAddr;

  writeDbgLevel( kDbgInfo, "<%s> ECU initialized", gECULabel );
}

//
// Change the state of the ECU
//
EcuChangeState( BYTE newState )
{
  if (newState == kNotInitialized) {
    // stop everthing immediately
    cancelTimer( SystemTimer );
    cancelTimer( TX_ACL_Timer );
    cancelTimer( TX_SupportCommand_Timer );
    cancelTimer( TX_WinchCommand_Timer );
    cancelTimer( TX_BoomCommand_Timer );
    cancelTimer( DemoTimer );
    gECUState = kNotInitialized;
    return;
  }

  switch( gECUState ) {
    case kNotInitialized:
	    if (newState == kInitialized) {
	      EnterInitialized();
        gECUState = newState;
	    }
	    break;
    case kInitialized:
	  case kOffline:
	    if (newState == kAddrClaiming) {
	      EnterClaiming();
        gECUState = newState;
	    }
	    break;
    case kAddrClaiming:
	    if (newState == kOnline) {
	      EnterOnline();
        gECUState = newState;
      }
      else if (newState == kOffline) {
	      EnterOffline();
        gECUState = newState;
	    }
	    break;
    case kOnline:
	    if (newState == kOffline) {
	      EnterOffline();
        gECUState = newState;
	    }
	    else if (newState == kAddrClaiming) {
	      EnterClaiming();
        gECUState = newState;
	    }
	    break;
  }
}

//
// Start address claiming
//
EnterClaiming()
{
  cancelTimer( SystemTimer );
  cancelTimer( TX_ACL_Timer );

  // send address claiming PG and wait 250ms
  output( TX_ACL );
  SetTimer( TX_ACL_Timer, 250 );

  writeDbgLevel( kDbgInfo, "<%s> start address claiming for address %d", gECULabel, TX_ACL.SA );
}

//
// Enter online state
//
EnterOnline()
{
  TX_SupportCommand.SA = TX_ACL.SA;
  TX_WinchCommand.SA   = TX_ACL.SA;
  TX_BoomCommand.SA     = TX_ACL.SA;

  setTimer( SystemTimer, kSystemTime );
  setTimer( TX_SupportCommand_Timer, TX_SupportCommand.GenMsgCycleTime );
  setTimer( TX_WinchCommand_Timer, TX_WinchCommand.GenMsgCycleTime );
  setTimer( TX_BoomCommand_Timer, TX_BoomCommand.GenMsgCycleTime );
  if (getValue( EvDemoMode ) == 1) {
    setTimer( DemoTimer, 200 );
  }

  writeDbgLevel( kDbgInfo, "<%s> online with address %d", gECULabel, TX_ACL.SA );
}

//
// Enter offline state
//
EnterOffline()
{
  cancelTimer( SystemTimer );
  cancelTimer( TX_SupportCommand_Timer );
  cancelTimer( TX_WinchCommand_Timer );
  cancelTimer( TX_BoomCommand_Timer );
	cancelTimer( DemoTimer );

  // send address claiming PG with NULL address
  TX_ACL.SA = kNullAddr;
  output( TX_ACL );

  writeDbgLevel( kDbgInfo, "<%s> offline", gECULabel, TX_ACL.SA );
}

//
// Address claiming timer. 
//
// If no other node sends an address claim PG while this timer is
// running, we can use the address and switch the state to kOnline.
//
on timer TX_ACL_Timer
{
  EcuChangeState( kOnline );
}

//
// Received address claim PG
//
on pg AC
{
  pg AC acl;
  if (this.DIR != RX) return;
  if (this.CAN != gECUChannel) return;

  if (this.SA == TX_ACL.SA) {
    acl.DWORD(0) = this.DWORD(0);
    acl.DWORD(4) = this.DWORD(4);

    // compare names for priority
    if (utilCompareDeviceName( TX_ACL, acl ) > 0) {
      // send address claiming PG again
      output( TX_ACL );
    }
    else {
      // go offline, we have a lower priority
      EcuChangeState( kOffline );
    }

    // stop address claiming timer, if we are in claiming phase
    if (gECUState == kAddrClaiming) {
      cancelTimer( TX_ACL_Timer );
    }
  }
}

//
// Compare device names
//
// if pg1 has lower priority than pg2, return -1
// if pg1 has higher priority than pg2, return 1
// if both names are equal, return 0
//
int utilCompareDeviceName( pg AC pg1, pg AC pg2 )
{
  int i = 0;
  for( i = 7; i >= 0; i-- ) {
    if (pg1.byte(i) < pg2.byte(i)) {
	  return -1;
	}
    else if (pg1.byte(i) > pg2.byte(i)) {
	  return 1;
	}
  }
  return 0;
}

//
// Received a request
//
on pg RQST
{
  if (this.DIR != RX) return;
  if (this.CAN != gECUChannel) return;

  if (gECUState == kOnline) {
    if ((this.DA == kGlobalAddr) || (this.DA == TX_ACL.SA)) {
	  switch(this.ParameterGroupNumber) {
	    case 0xee00: // Address Claim PGN
		  output( TX_ACL );
		  break;
      }
    }
  }
  else if (gECUState == kOnline) {
    if ((this.DA == kGlobalAddr) && (this.ParameterGroupNumber == 0xee00)) {
	  output( TX_ACL );
	}
  }
}

//
//
//
on envVar Ev_ECUPower
{
  if ((getValue( this ) == 1) && (gECUState == kNotInitialized)) {
    EcuChangeState( kInitialized );
    EcuChangeState( kAddrClaiming );
  }
  else if ((getValue( this ) == 0) && (gECUState != kNotInitialized)) {
    EcuChangeState( kNotInitialized );
  }
}

on start
{
  if (getValue( Ev_ECUPower ) == 1) {
    EcuChangeState( kInitialized );
    EcuChangeState( kAddrClaiming );
  }
}

//
// Received commanded address PG
//
on pg CA
{
  int i;
  pg AC nameDummy;

  if (this.DIR != RX) return;
  if (this.CAN != gECUChannel) return;

  // copy name of 'this' PG to name dummy
  for( i = 0; i < 8; i++ ) {
    nameDummy.byte(i) = this.byte(i);
  }
  
  // compare name
  if (utilCompareDeviceName( TX_ACL, nameDummy ) == 0) {
    // claim new address
    TX_ACL.SA = this.AddressAssignment;
    EcuChangeState( kAddrClaiming );
  }
}

//
//
//
on timer SystemTimer
{
  setTimer( SystemTimer, kSystemTime );
}

//
// Flow control for the CMDT transport protocol
//
// Because CANoe is a passive tool we have to transmit
// the CTS and EoMA message for the transport sessions
// which we receive.
//
on pg TPCMxx, TPDT
{
  BYTE  sessionAddress[1]  = { kNullAddr };
  BYTE  sessionsPackets[1] = { 0 };
  BYTE  sessionsBytes[1]   = { 0 };
  DWORD sessionPGN[1]      = { 0x0000 };
  int   i;
  pg    TPCMxx cmPG;

  if (this.DIR != RX) return;
  if (this.CAN != gECUChannel) return;

  cmPG.SA  = TX_ACL.SA;
  cmPG.DA  = this.SA;
  cmPG.CAN = this.CAN;
  cmPG.dword(0) = cmPG.dword(4) = 0xffffffff;

  if (this.PF == 0xec) { // Command
    if (this.byte(0) == 0x10) { // RTS
	  // new session
	  for( i = 0; i < elCount(sessionAddress); i++ ) {
	    if ((sessionAddress[i] == this.SA) || (sessionAddress[i] == kNullAddr)) {
		  sessionAddress[i]  = this.SA;
          sessionsPackets[i] = this.byte(3); 
          sessionsBytes[i]   = this.word(1);
		  sessionPGN[i]      = (this.byte(7)) | (this.byte(6) << 8) | (this.byte(5) << 16);
		  // send CTS
		  cmPG.ControlByte   = cmPG.ControlByte::CTS;
		  cmPG.NumberOfPacketsThatCanBeSent = 1;
		  cmPG.NextPacketNumberToBeSent     = 1;
		  cmPG.PGNumber      = sessionPGN[i];
		  output( cmPG );
		  break;
		}
	  }
	}
  }
  else if (this.PF == 0xeb) { // Data
    // find session
    for( i = 0; i < elCount(sessionAddress); i++ ) {
      if (sessionAddress[i] == this.SA) {
	    if (this.byte(0) < sessionsPackets[i]) {
		  // send CTS
		  cmPG.ControlByte   = cmPG.ControlByte::CTS;
		  cmPG.NumberOfPacketsThatCanBeSent = 1;
		  cmPG.NextPacketNumberToBeSent     = this.byte(0) + 1;
		  cmPG.PGNumber      = sessionPGN[i];
      output( cmPG );
    }
		else { // last packet
		  // send CTS
		  cmPG.ControlByte          = cmPG.ControlByte::EoMA;
		  cmPG.TotalMessageSize     = sessionsBytes[i];
		  cmPG.TotalNumberOfPackets = sessionsPackets[i];
		  cmPG.PGNumber             = sessionPGN[i];
      output( cmPG );
		  sessionAddress[i]  = kNullAddr; // close session
		}
	    break;
      }
    }
  }
}

//
// 
//
on envVar EvSupport_Down
{
  if (getValue(this) == 1) {
    if (getValue( EvSupportLock ) == 0) {
      TX_SupportCommand.CmdFrontLeft  = TX_SupportCommand.CmdFrontLeft::Down;
      TX_SupportCommand.CmdFrontRight = TX_SupportCommand.CmdFrontRight::Down;
      TX_SupportCommand.CmdRearLeft   = TX_SupportCommand.CmdRearLeft::Down;
      TX_SupportCommand.CmdRearRight  = TX_SupportCommand.CmdRearRight::Down;
    }
  }
	else {
    TX_SupportCommand.CmdFrontLeft  = TX_SupportCommand.CmdFrontLeft::Idle;
    TX_SupportCommand.CmdFrontRight = TX_SupportCommand.CmdFrontRight::Idle;
    TX_SupportCommand.CmdRearLeft   = TX_SupportCommand.CmdRearLeft::Idle;
    TX_SupportCommand.CmdRearRight  = TX_SupportCommand.CmdRearRight::Idle;
	}
}

//
// 
//
on envVar EvSupport_Up
{
  if (getValue(this) == 1) {
    if (getValue( EvSupportLock ) == 0) {
      TX_SupportCommand.CmdFrontLeft  = TX_SupportCommand.CmdFrontLeft::Up;
      TX_SupportCommand.CmdFrontRight = TX_SupportCommand.CmdFrontRight::Up;
      TX_SupportCommand.CmdRearLeft   = TX_SupportCommand.CmdRearLeft::Up;
      TX_SupportCommand.CmdRearRight  = TX_SupportCommand.CmdRearRight::Up;
    }
  }
  else {
    TX_SupportCommand.CmdFrontLeft  = TX_SupportCommand.CmdFrontLeft::Idle;
    TX_SupportCommand.CmdFrontRight = TX_SupportCommand.CmdFrontRight::Idle;
    TX_SupportCommand.CmdRearLeft   = TX_SupportCommand.CmdRearLeft::Idle;
    TX_SupportCommand.CmdRearRight  = TX_SupportCommand.CmdRearRight::Idle;
	}
}

//
//
//
on timer TX_SupportCommand_Timer
{
  if (gECUState == kOnline) {
    output( TX_SupportCommand );
    setTimer( TX_SupportCommand_Timer, TX_SupportCommand.GenMsgCycleTime );
  }
}

//
// Position of support received
//
on pg SupportPosition
{
  if ((this.dir == rx) && (this.can == gECUChannel)) {
    gSupportPosition = this.PositionFrontLeft.phys;
    if (this.PositionFrontLeft.phys < 95.0) {
      gSupportIsDown = 1;
			putValue( EvBoomLock, 1 );
    }
    else {
      gSupportIsDown = 0;
			putValue( EvBoomLock, 0 );
    }
  }
}

//
//
//
on envVar EvWinchDown
{
  if (getValue(this) == 1) {
    TX_WinchCommand.SetRopeSpeed.phys = gMaxRopeSpeed;
	}
	else {
    TX_WinchCommand.SetRopeSpeed.phys = 0.0;
	}
}

//
// Transmit winch command
//
on timer TX_WinchCommand_Timer
{
  if (gECUState == kOnline) {
    output( TX_WinchCommand );
    setTimer( TX_WinchCommand_Timer, TX_WinchCommand.GenMsgCycleTime );
  }
}

//
//
//
on envVar EvWinchUp
{
  if (getValue(this) == 1) {
    TX_WinchCommand.SetRopeSpeed.phys = -gMaxRopeSpeed;
  }
  else {
    TX_WinchCommand.SetRopeSpeed.phys = 0.0;
  }
}

//
// Transmit Boom command
//
on timer TX_BoomCommand_Timer
{
  if (gECUState == kOnline) {
    output( TX_BoomCommand );
    setTimer( TX_BoomCommand_Timer, TX_BoomCommand.GenMsgCycleTime );
  }
}

//
// 
//
on envVar EvBoomUp
{
  if (getValue(this) == 1) {
    if (getValue( EvBoomLock ) == 0) {
      TX_BoomCommand.CmdAngle = TX_BoomCommand.CmdAngle::Up;
    }
  }
  else {
    TX_BoomCommand.CmdAngle = TX_BoomCommand.CmdAngle::Idle;
  }
}

//
// 
//
on envVar EvBoomDown
{
  if (getValue(this) == 1) {
    if (getValue( EvBoomLock ) == 0) {
      TX_BoomCommand.CmdAngle = TX_BoomCommand.CmdAngle::Down;
    }
  }
  else {
    TX_BoomCommand.CmdAngle = TX_BoomCommand.CmdAngle::Idle;
  }
}

//
// 
//
on envVar EvBoomPullOut
{
  if (getValue(this) == 1) {
    if (getValue( EvBoomLock ) == 0) {
      TX_BoomCommand.CmdBoom = TX_BoomCommand.CmdBoom::PullOut;
     }
  }
  else {
    TX_BoomCommand.CmdBoom = TX_BoomCommand.CmdBoom::Idle;
  }
}

//
// 
//
on envVar EvBoomPullIn
{
  if (getValue(this) == 1) {
    if (getValue( EvBoomLock ) == 0) {
      TX_BoomCommand.CmdBoom = TX_BoomCommand.CmdBoom::PullIn;
     }
  }
  else {
    TX_BoomCommand.CmdBoom = TX_BoomCommand.CmdBoom::Idle;
  }
}

//
// Received Boom status
//
on pg BoomPosition
{
  if ((this.dir == rx) && (this.can == gECUChannel)) {
	  putValue( EvCC_BoomAngle, this.Angle.phys );
		gBoomPosition = this.Position.phys;
		gBoomAngle    = this.Angle.phys;

    if ((this.Angle.phys > 1) || (this.Position.phys > 1)) {
      putValue( EvSupportLock, 1 );
    }
    else {
      putValue( EvSupportLock, 0 );
    }

  }
}

//
// Received winch status
//
on pg WinchStatus
{
  if ((this.dir == rx) && (this.can == gECUChannel)) {
	  putValue( EvCC_RopeLength, this.RopeLength.phys );
	  putValue( EvCC_HookWeight, this.Weight.phys );
		gWinchPosition = this.RopeLength.phys;
  }
}

//
// This timer controls the crane in demo mode
//
on timer DemoTimer
{
  int demoState = 0;

	switch(demoState) {
	  case 0: // move support to lower position
		  if (gSupportPosition < 98) {
			  putValue( EvSupport_Down, 1 );
			}
			else {
			  putValue( EvSupport_Down, 0 );
				demoState = 1;
			}
		  break;
	  case 1: // increase angle of Boom
		  if (gBoomAngle < 55) {
			  putValue( EvBoomUp, 1 );
			}
			else {
			  putValue( EvBoomUp, 0 );
				demoState = 2;
			}
		  break;
	  case 2: // pull out Boom
		  if (gBoomPosition < 50) {
			  putValue( EvBoomPullOut, 1 );
			}
			else {
			  putValue( EvBoomPullOut, 0 );
				demoState = 3;
			}
		  break;
	  case 3: // hook down
		  if (gWinchPosition < 12) {
			  putValue( EvWinchDown, 1 );
			}
			else {
			  putValue( EvWinchDown, 0 );
			  putValue( EvActualWeight, 5158 );
				demoState = 4;
			}
		  break;
	  case 4: // hook up
		  if (gWinchPosition > 0) {
			  putValue( EvWinchUp, 1 );
			}
			else {
			  putValue( EvWinchUp, 0 );
				demoState = 5;
			}
		  break;
	  case 5: // pull in Boom
		  if (gBoomPosition > 0) {
			  putValue( EvBoomPullIn, 1 );
			}
			else {
			  putValue( EvBoomPullIn, 0 );
				demoState = 6;
			}
		  break;
	  case 6: // decrease angle of Boom
		  if (gBoomAngle > 0) {
			  putValue( EvBoomDown, 1 );
			}
			else {
			  putValue( EvBoomDown, 0 );
				demoState = 7;
			}
		  break;
	  case 7: // move support to upper position
		  if (gSupportPosition > 0.0) {
			  putValue( EvSupport_Up, 1 );
			}
			else {
			  putValue( EvSupport_Up, 0 );
			  putValue( EvActualWeight, 0 );
				demoState = 0;
			}
		  break;
	}

	setTimer( DemoTimer, 200 );
}

//
// Enable/Disable demo mode
//
on envVar EvDemoMode
{
  if (getValue( this ) == 1) {
    setTimer( DemoTimer, 200 );
  }
  else {
    cancelTimer( DemoTimer );
  }
}

