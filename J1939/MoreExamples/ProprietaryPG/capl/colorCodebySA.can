/*@@var:*/
variables
{
}
/*@@end*/

/*@@pg:*:*/
/*
 * This event procedure color codes the Trace Window Parameter Groups based on Source Address.
 *
 */
on pg *
{
    if(this.SA == 0x80)
    {
        traceSetEventColors(this, makeRGB(0x40, 0x00, 0x40), makeRGB(0xFF, 0xFF, 0xFF));
    }
    else if(this.SA == 0x81)
    {
        traceSetEventColors(this, makeRGB(0x00, 0x00, 0xA0), makeRGB(0xFF, 0xFF, 0xFF));
    }
    else if(this.SA == 0x82)
    {
        traceSetEventColors(this, makeRGB(0x00, 0x80, 0x00), makeRGB(0xFF, 0xFF, 0xFF));
    }
    else if(this.SA == 0x83)
    {
        traceSetEventColors(this, makeRGB(0x80, 0x00, 0x00), makeRGB(0xFF, 0xFF, 0xFF));
    }

    output(this);
}
/*@@end*/

