/*@@var:*/
variables
{
}
/*@@end*/

/*@@pg:*:*/
/*
 * This event procedure color codes the Trace Window Parameter Groups based on Source Address.
 *
 */
on pg *
{
    if(this.SA == 0x00)
    {
        traceSetEventColors(this, makeRGB(10, 25, 175), makeRGB(0xFF, 0xFF, 0xFF));
    }
    else if(this.SA == 0x0C)
    {
        traceSetEventColors(this, makeRGB(0x00, 0x00, 0xA0), makeRGB(0xFF, 0xFF, 0xFF));
    }
    else if(this.SA == 0x0D)
    {
        traceSetEventColors(this, makeRGB(0x00, 0x80, 0x00), makeRGB(0xFF, 0xFF, 0xFF));
    }
    else if(this.SA == 0x0B)
    {
        traceSetEventColors(this, makeRGB(0x80, 0x00, 0x00), makeRGB(0xFF, 0xFF, 0xFF));
    }

    output(this);
}
/*@@end*/

/*@@startStart:Start:*/
on start
{
    write("Parameter Groups from Source Address 0x00 will be color coded with blue text in Trace Windows");
    write("Parameter Groups from Source Address 0x0B will be color coded with dark red text in Trace Windows");
}
/*@@end*/

