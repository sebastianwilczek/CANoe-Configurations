VERSION ""

NS_ :

BS_:

BU_: EBS EMS
VAL_TABLE_ FMI 31 "Not available" 19 "Received network data in error" 18 "Below normal (moderately severe)" 17 "Below normal (least severe)" 16 "Above normal (moderately severe)" 15 "Above normal (least severe)" 14 "Special intstructions" 13 "Out of calibration" 12 "Bad intelligent device" 11 "Root cause not known" 10 "Abnormal rate of change" 9 "Abnormal update rate" 8 "Abnormal frequency" 7 "Mechanical system not responding" 6 "Current above normal" 5 "Current below normal" 4 "Voltage below normal" 3 "Voltage above normal" 2 "Data erratic" 1 "Below normal (most severe)" 0 "Above normal (most severe)" ;

BO_ 3221225472 VECTOR__INDEPENDENT_SIG_MSG: 0 Vector__XXX
 SG_ FailureModeIdentifier1 : 0|5@1+ (1,0) [0|0] "" Vector__XXX
 SG_ SPN1High : 0|3@1+ (1,0) [0|7] "" Vector__XXX
 SG_ SPN1 : 0|16@1+ (1,0) [0|65536] "" Vector__XXX
 SG_ TextDisplayIndex : 0|8@1+ (1,0) [0|250] "" Vector__XXX
 SG_ TextDisplayInstructions : 0|4@1+ (1,0) [0|15] "" Vector__XXX
 SG_ MovementStatusOfRamp3 : 0|2@1+ (1,0) [0|3] "" Vector__XXX
 SG_ EnableStatusOfRamp3 : 0|2@1+ (1,0) [0|3] "" Vector__XXX
 SG_ RetractStatusOfRamp3 : 0|2@1+ (1,0) [0|3] "" Vector__XXX
 SG_ MovementStatusOfRamp2 : 0|2@1+ (1,0) [0|3] "" Vector__XXX
 SG_ EnableStatusOfRamp2 : 0|2@1+ (1,0) [0|3] "" Vector__XXX
 SG_ RetractStatusOfRamp2 : 0|2@1+ (1,0) [0|3] "" Vector__XXX
 SG_ MovementStatusOfRamp1 : 0|2@1+ (1,0) [0|3] "" Vector__XXX
 SG_ EnableStatusOfRamp1 : 0|2@1+ (1,0) [0|3] "" Vector__XXX
 SG_ RetractStatusOfRamp1 : 0|2@1+ (1,0) [0|3] "" Vector__XXX
 SG_ MaxCrankAttemptsPerStartAttempt : 0|8@1+ (1,0) [0|250] "" Vector__XXX
 SG_ EngExhstGsRcirculationValve2Pos : 0|16@1+ (0.0025,0) [0|160.6375] "%" Vector__XXX
 SG_ EngExhstGsRecirculationValvePos : 0|16@1+ (0.0025,0) [0|160.6375] "%" Vector__XXX
 SG_ EngExhstGsRcrculationValve2Ctrl : 0|16@1+ (0.0025,0) [0|160.6375] "%" Vector__XXX
 SG_ EngIntkVlvActtonOilPressForCyl4 : 0|16@1+ (0.1,0) [0|6425.5] "kPa" Vector__XXX
 SG_ EngIntkVlvActtonOilPressForCyl3 : 0|16@1+ (0.1,0) [0|6425.5] "kPa" Vector__XXX
 SG_ EngIntkVlvActtonOilPressForCyl2 : 0|16@1+ (0.1,0) [0|6425.5] "kPa" Vector__XXX
 SG_ EngIntkVlvActtonOilPressForCyl1 : 0|16@1+ (0.1,0) [0|6425.5] "kPa" Vector__XXX
 SG_ EngIntkVlvActtonOilPressForCyl8 : 0|16@1+ (0.1,0) [0|6425.5] "kPa" Vector__XXX
 SG_ EngIntkVlvActtonOilPressForCyl7 : 0|16@1+ (0.1,0) [0|6425.5] "kPa" Vector__XXX
 SG_ EngIntkVlvActtonOilPressForCyl6 : 0|16@1+ (0.1,0) [0|6425.5] "kPa" Vector__XXX
 SG_ EngIntkVlvActtonOilPressForCyl5 : 0|16@1+ (0.1,0) [0|6425.5] "kPa" Vector__XXX
 SG_ EngIntkVlvActtnOilPressForCyl12 : 0|16@1+ (0.1,0) [0|6425.5] "kPa" Vector__XXX
 SG_ EngIntkVlvActtnOilPressForCyl11 : 0|16@1+ (0.1,0) [0|6425.5] "kPa" Vector__XXX
 SG_ EngIntkVlvActtnOilPressForCyl10 : 0|16@1+ (0.1,0) [0|6425.5] "kPa" Vector__XXX
 SG_ EngIntkVlvActtonOilPressForCyl9 : 0|16@1+ (0.1,0) [0|6425.5] "kPa" Vector__XXX
 SG_ EngIntkVlvActtnOilPressForCyl16 : 0|16@1+ (0.1,0) [0|6425.5] "kPa" Vector__XXX
 SG_ EngIntkVlvActtnOilPressForCyl15 : 0|16@1+ (0.1,0) [0|6425.5] "kPa" Vector__XXX
 SG_ EngIntkVlvActtnOilPressForCyl14 : 0|16@1+ (0.1,0) [0|6425.5] "kPa" Vector__XXX
 SG_ EngIntkVlvActtnOilPressForCyl13 : 0|16@1+ (0.1,0) [0|6425.5] "kPa" Vector__XXX
 SG_ EngIntkVlvActtnOilPressForCyl20 : 0|16@1+ (0.1,0) [0|6425.5] "kPa" Vector__XXX
 SG_ EngIntkVlvActtnOilPressForCyl19 : 0|16@1+ (0.1,0) [0|6425.5] "kPa" Vector__XXX
 SG_ EngIntkVlvActtnOilPressForCyl18 : 0|16@1+ (0.1,0) [0|6425.5] "kPa" Vector__XXX
 SG_ EngIntkVlvActtnOilPressForCyl17 : 0|16@1+ (0.1,0) [0|6425.5] "kPa" Vector__XXX
 SG_ EGRCoolerBypassActuatorPostion : 0|8@1+ (0.4,0) [0|100] "%" Vector__XXX
 SG_ EngSparkPlug4 : 0|16@1+ (1,0) [0|64255] "V" Vector__XXX
 SG_ EngSparkPlug3 : 0|16@1+ (1,0) [0|64255] "V" Vector__XXX
 SG_ EngSparkPlug2 : 0|16@1+ (1,0) [0|64255] "V" Vector__XXX
 SG_ EngSparkPlug1 : 0|16@1+ (1,0) [0|64255] "V" Vector__XXX
 SG_ EngSparkPlug8 : 0|16@1+ (1,0) [0|64255] "V" Vector__XXX
 SG_ EngSparkPlug7 : 0|16@1+ (1,0) [0|64255] "V" Vector__XXX
 SG_ EngSparkPlug6 : 0|16@1+ (1,0) [0|64255] "V" Vector__XXX
 SG_ EngSparkPlug5 : 0|16@1+ (1,0) [0|64255] "V" Vector__XXX
 SG_ EngSparkPlug12 : 0|16@1+ (1,0) [0|64255] "V" Vector__XXX
 SG_ EngSparkPlug11 : 0|16@1+ (1,0) [0|64255] "V" Vector__XXX
 SG_ EngSparkPlug10 : 0|16@1+ (1,0) [0|64255] "V" Vector__XXX
 SG_ EngSparkPlug9 : 0|16@1+ (1,0) [0|64255] "V" Vector__XXX
 SG_ EngSparkPlug16 : 0|16@1+ (1,0) [0|64255] "V" Vector__XXX
 SG_ EngSparkPlug15 : 0|16@1+ (1,0) [0|64255] "V" Vector__XXX
 SG_ EngSparkPlug14 : 0|16@1+ (1,0) [0|64255] "V" Vector__XXX
 SG_ EngSparkPlug13 : 0|16@1+ (1,0) [0|64255] "V" Vector__XXX
 SG_ EngSparkPlug20 : 0|16@1+ (1,0) [0|64255] "V" Vector__XXX
 SG_ EngSparkPlug19 : 0|16@1+ (1,0) [0|64255] "V" Vector__XXX
 SG_ EngSparkPlug18 : 0|16@1+ (1,0) [0|64255] "V" Vector__XXX
 SG_ EngSparkPlug17 : 0|16@1+ (1,0) [0|64255] "V" Vector__XXX
 SG_ EngSparkPlug24 : 0|16@1+ (1,0) [0|64255] "V" Vector__XXX
 SG_ EngSparkPlug23 : 0|16@1+ (1,0) [0|64255] "V" Vector__XXX
 SG_ EngSparkPlug22 : 0|16@1+ (1,0) [0|64255] "V" Vector__XXX
 SG_ EngSparkPlug21 : 0|16@1+ (1,0) [0|64255] "V" Vector__XXX
 SG_ LaneDepartureWarningEnableCmd : 0|2@1+ (1,0) [0|3] "" Vector__XXX
 SG_ J2012DTCOccurrenceCount : 0|7@1+ (1,0) [0|127] "" Vector__XXX
 SG_ J2012DTCStatus : 0|1@1+ (1,0) [0|1] "" Vector__XXX
 SG_ NumberOfJ2012DTCs : 0|8@1+ (1,0) [0|250] "" Vector__XXX
 SG_ PrtcltTrpActvRgnrtnInhbtdDTVhclS : 0|2@1+ (1,0) [0|3] "" Vector__XXX
 SG_ PrtcltTrpActvRgnrtnInhbtdDTOtOfN : 0|2@1+ (1,0) [0|3] "" Vector__XXX
 SG_ PrtcltTrpActvRgnrtnInhbtdDTAcclP : 0|2@1+ (1,0) [0|3] "" Vector__XXX
 SG_ PrtcltTrpActvRgnrtnInhbtdDTPTOAc : 0|2@1+ (1,0) [0|3] "" Vector__XXX
 SG_ PrtcltTrpActvRgnrtnInhbtdDTSrvcB : 0|2@1+ (1,0) [0|3] "" Vector__XXX
 SG_ PrtcltTrpActvRgnrtnInhbtdDTCltch : 0|2@1+ (1,0) [0|3] "" Vector__XXX
 SG_ PrtcltTrpActvRgnrtnInhbtdDTInhbt : 0|2@1+ (1,0) [0|3] "" Vector__XXX
 SG_ PrtcltTrpActvRgnrtnInhbtdStatus : 0|2@1+ (1,0) [0|3] "" Vector__XXX
 SG_ ParticulateTrapStatus : 0|3@1+ (1,0) [0|7] "" Vector__XXX
 SG_ PrtcltTrpActvRegenerationStatus : 0|2@1+ (1,0) [0|3] "" Vector__XXX
 SG_ PrtcltTrpPssvRegenerationStatus : 0|2@1+ (1,0) [0|3] "" Vector__XXX
 SG_ ParticulateTrapLampCmd : 0|3@1+ (1,0) [0|7] "" Vector__XXX
 SG_ MessageChecksum : 0|4@1+ (1,0) [0|15] "" Vector__XXX
 SG_ MessageCounter : 0|4@1+ (1,0) [0|15] "" Vector__XXX
 SG_ SteerAngleSensorCalibrated : 0|2@1+ (1,0) [0|3] "" Vector__XXX
 SG_ SteerAngleSensorActiveMode : 0|2@1+ (1,0) [0|3] "" Vector__XXX
 SG_ SteerWheelAngleRange : 0|16@1+ (0.0009765625,-31.374) [-31.374|31.374] "rad" Vector__XXX
 SG_ SteerWheelAngleRangeCounterType : 0|2@1+ (1,0) [0|3] "" Vector__XXX
 SG_ SteerWheelAngleRangeCounter : 0|6@1+ (1,-32) [-32|29] "ranges" Vector__XXX
 SG_ SteerWheelAngle : 0|16@1+ (0.000976563,-31.374) [-31.374|31.374] "rad" Vector__XXX
 SG_ CmdedCatalystReagentConsumption : 0|16@1+ (0.05,0) [0|3212.75] "L/hr" Vector__XXX
 SG_ AvrgeCatalystReagentConsumption : 0|16@1+ (0.05,0) [0|3212.75] "L/hr" Vector__XXX
 SG_ TransferCaseStatus : 0|3@1+ (1,0) [0|7] "" Vector__XXX
 SG_ TransTorqueConvOilOutlTemp : 0|16@1+ (0.03125,-273) [-273|1785] "°C" Vector__XXX
 SG_ TransmissionOilLifeRemaining : 0|8@1+ (0.4,0) [0|100] "%" Vector__XXX
 SG_ TransOilLevelSwitch : 0|2@1+ (1,0) [0|3] "" Vector__XXX
 SG_ TransOilFilterRestrictionSwitch : 0|2@1+ (1,0) [0|3] "" Vector__XXX
 SG_ VehicleRoll : 0|16@1+ (0.0078125,-200) [-200|301.99] "deg" Vector__XXX
 SG_ TotalEngCruiseTime : 0|32@1+ (0.05,0) [0|210554060.75] "hr" Vector__XXX
 SG_ TotalDriveAverageLoadFactor : 0|8@1+ (0.4,0) [0|100] "%" Vector__XXX
 SG_ TripDriveAverageLoadFactor : 0|8@1+ (0.4,0) [0|100] "%" Vector__XXX
 SG_ TripAverageEngSpeed : 0|16@1+ (0.125,0) [0|8031.875] "RPM" Vector__XXX
 SG_ TripMaxEngSpeed : 0|16@1+ (0.125,0) [0|8031.875] "RPM" Vector__XXX
 SG_ ImplementRearWorkLight : 0|2@1+ (1,0) [0|3] "" Vector__XXX
 SG_ ImplementLeftForwardWorkLight : 0|2@1+ (1,0) [0|3] "" Vector__XXX
 SG_ ImplementRightForwardWorkLight : 0|2@1+ (1,0) [0|3] "" Vector__XXX
 SG_ ImplementLeftFacingWorkLight : 0|2@1+ (1,0) [0|3] "" Vector__XXX
 SG_ ImplementRightFacingWorkLight : 0|2@1+ (1,0) [0|3] "" Vector__XXX
 SG_ ImplementOEMOption1Light : 0|2@1+ (1,0) [0|3] "" Vector__XXX
 SG_ ImplementOEMOption2Light : 0|2@1+ (1,0) [0|3] "" Vector__XXX
 SG_ TrctrFrontHighMountedWorkLights : 0|2@1+ (1,0) [0|3] "" Vector__XXX
 SG_ TrctorFrontLowMountedWorkLights : 0|2@1+ (1,0) [0|3] "" Vector__XXX
 SG_ TrctorSideHighMountedWorkLights : 0|2@1+ (1,0) [0|3] "" Vector__XXX
 SG_ TractorSideLowMountedWorkLights : 0|2@1+ (1,0) [0|3] "" Vector__XXX
 SG_ TrctorRearHighMountedWorkLights : 0|2@1+ (1,0) [0|3] "" Vector__XXX
 SG_ TractorRearLowMountedWorkLights : 0|2@1+ (1,0) [0|3] "" Vector__XXX
 SG_ TrctrUndersideMountedWorkLights : 0|2@1+ (1,0) [0|3] "" Vector__XXX
 SG_ RearFogLights : 0|2@1+ (1,0) [0|3] "" Vector__XXX
 SG_ TractorMarkerLight : 0|2@1+ (1,0) [0|3] "" Vector__XXX
 SG_ ImplementMarkerLight : 0|2@1+ (1,0) [0|3] "" Vector__XXX
 SG_ TractorClearanceLight : 0|2@1+ (1,0) [0|3] "" Vector__XXX
 SG_ ImplementClearanceLight : 0|2@1+ (1,0) [0|3] "" Vector__XXX
 SG_ LeftStopLight : 0|2@1+ (1,0) [0|3] "" Vector__XXX
 SG_ RightStopLight : 0|2@1+ (1,0) [0|3] "" Vector__XXX
 SG_ CenterStopLight : 0|2@1+ (1,0) [0|3] "" Vector__XXX
 SG_ BackUpLightAndAlarmHorn : 0|2@1+ (1,0) [0|3] "" Vector__XXX
 SG_ LeftTurnSignalLights : 0|2@1+ (1,0) [0|3] "" Vector__XXX
 SG_ RightTurnSignalLights : 0|2@1+ (1,0) [0|3] "" Vector__XXX
 SG_ RotatingBeaconLight : 0|2@1+ (1,0) [0|3] "" Vector__XXX
 SG_ TractorFrontFogLights : 0|2@1+ (1,0) [0|3] "" Vector__XXX
 SG_ HighBeamHeadLightData : 0|2@1+ (1,0) [0|3] "" Vector__XXX
 SG_ LowBeamHeadLightData : 0|2@1+ (1,0) [0|3] "" Vector__XXX
 SG_ AltBeamHeadLightData : 0|2@1+ (1,0) [0|3] "" Vector__XXX
 SG_ RunningLight : 0|2@1+ (1,0) [0|3] "" Vector__XXX
 SG_ ImplementRearWorkLightCmd : 0|2@1+ (1,0) [0|3] "" Vector__XXX
 SG_ ImplmentLeftForwardWorkLightCmd : 0|2@1+ (1,0) [0|3] "" Vector__XXX
 SG_ ImplmntRightForwardWorkLightCmd : 0|2@1+ (1,0) [0|3] "" Vector__XXX
 SG_ LightingDataRqCmd : 0|2@1+ (1,0) [0|3] "" Vector__XXX
 SG_ ImplementLeftFacingWorkLightCmd : 0|2@1+ (1,0) [0|3] "" Vector__XXX
 SG_ ImplmentRightFacingWorkLightCmd : 0|2@1+ (1,0) [0|3] "" Vector__XXX
 SG_ ImplementOEMOption1LightCmd : 0|2@1+ (1,0) [0|3] "" Vector__XXX
 SG_ ImplementOEMOption2LightCmd : 0|2@1+ (1,0) [0|3] "" Vector__XXX
 SG_ TrctrFrntHghMuntedWorkLightsCmd : 0|2@1+ (1,0) [0|3] "" Vector__XXX
 SG_ TrctrFrntLwMountedWorkLightsCmd : 0|2@1+ (1,0) [0|3] "" Vector__XXX
 SG_ TrctrSdHighMountedWorkLightsCmd : 0|2@1+ (1,0) [0|3] "" Vector__XXX
 SG_ TrctrSdeLowMountedWorkLightsCmd : 0|2@1+ (1,0) [0|3] "" Vector__XXX
 SG_ TrctrRrHighMountedWorkLightsCmd : 0|2@1+ (1,0) [0|3] "" Vector__XXX
 SG_ TrctrRarLowMountedWorkLightsCmd : 0|2@1+ (1,0) [0|3] "" Vector__XXX
 SG_ TrctrUndrsdMountedWorkLightsCmd : 0|2@1+ (1,0) [0|3] "" Vector__XXX
 SG_ RearFogLightCmd : 0|2@1+ (1,0) [0|3] "" Vector__XXX
 SG_ TractorMarkerLightCmd : 0|2@1+ (1,0) [0|3] "" Vector__XXX
 SG_ ImplementMarkerLightCmd : 0|2@1+ (1,0) [0|3] "" Vector__XXX
 SG_ TractorClearanceLightCmd : 0|2@1+ (1,0) [0|3] "" Vector__XXX
 SG_ ImplementClearanceLightCmd : 0|2@1+ (1,0) [0|3] "" Vector__XXX
 SG_ LeftStopLightCmd : 0|2@1+ (1,0) [0|3] "" Vector__XXX
 SG_ RightStopLightCmd : 0|2@1+ (1,0) [0|3] "" Vector__XXX
 SG_ CenterStopLightCmd : 0|2@1+ (1,0) [0|3] "" Vector__XXX
 SG_ BackUpLightAndAlarmHornCmd : 0|2@1+ (1,0) [0|3] "" Vector__XXX
 SG_ LeftTurnSignalLightsCmd : 0|2@1+ (1,0) [0|3] "" Vector__XXX
 SG_ RightTurnSignalLightsCmd : 0|2@1+ (1,0) [0|3] "" Vector__XXX
 SG_ RotatingBeaconLightCmd : 0|2@1+ (1,0) [0|3] "" Vector__XXX
 SG_ TractorFrontFogLightsCmd : 0|2@1+ (1,0) [0|3] "" Vector__XXX
 SG_ HighBeamHeadLightCmd : 0|2@1+ (1,0) [0|3] "" Vector__XXX
 SG_ LowBeamHeadLightCmd : 0|2@1+ (1,0) [0|3] "" Vector__XXX
 SG_ AltBeamHeadLightCmd : 0|2@1+ (1,0) [0|3] "" Vector__XXX
 SG_ RunningLightCmd : 0|2@1+ (1,0) [0|3] "" Vector__XXX
 SG_ BladeCtrlMode : 0|8@1+ (1,0) [0|255] "" Vector__XXX
 SG_ BladeDurationAndDirection : 0|16@1+ (0.1,-3276.8) [-3276.8|3148.7] "sec" Vector__XXX
 SG_ EngActualIgntTiming : 0|16@1+ (0.0078125,-200) [-200|301.99] "deg" Vector__XXX
 SG_ EngDesiredIgntTiming3 : 0|16@1+ (0.0078125,-200) [-200|301.99] "deg" Vector__XXX
 SG_ EngDesiredIgntTiming2 : 0|16@1+ (0.0078125,-200) [-200|301.99] "deg" Vector__XXX
 SG_ EngDesiredIgntTiming1 : 0|16@1+ (0.0078125,-200) [-200|301.99] "deg" Vector__XXX
 SG_ EngCyl20IgntTiming : 0|16@1+ (0.0078125,-200) [-200|301.99] "deg" Vector__XXX
 SG_ EngCyl19IgntTiming : 0|16@1+ (0.0078125,-200) [-200|301.99] "deg" Vector__XXX
 SG_ EngCyl18IgntTiming : 0|16@1+ (0.0078125,-200) [-200|301.99] "deg" Vector__XXX
 SG_ EngCyl17IgntTiming : 0|16@1+ (0.0078125,-200) [-200|301.99] "deg" Vector__XXX
 SG_ EngCyl16IgntTiming : 0|16@1+ (0.0078125,-200) [-200|301.99] "deg" Vector__XXX
 SG_ EngCyl15IgntTiming : 0|16@1+ (0.0078125,-200) [-200|301.99] "deg" Vector__XXX
 SG_ EngCyl14IgntTiming : 0|16@1+ (0.0078125,-200) [-200|301.99] "deg" Vector__XXX
 SG_ EngCyl13IgntTiming : 0|16@1+ (0.0078125,-200) [-200|301.99] "deg" Vector__XXX
 SG_ EngCyl12IgntTiming : 0|16@1+ (0.0078125,-200) [-200|301.99] "deg" Vector__XXX
 SG_ EngCyl11IgntTiming : 0|16@1+ (0.0078125,-200) [-200|301.99] "deg" Vector__XXX
 SG_ EngCyl10IgntTiming : 0|16@1+ (0.0078125,-200) [-200|301.99] "deg" Vector__XXX
 SG_ EngCyl9IgntTiming : 0|16@1+ (0.0078125,-200) [-200|301.99] "deg" Vector__XXX
 SG_ EngCyl8IgntTiming : 0|16@1+ (0.0078125,-200) [-200|301.99] "deg" Vector__XXX
 SG_ EngCyl7IgntTiming : 0|16@1+ (0.0078125,-200) [-200|301.99] "deg" Vector__XXX
 SG_ EngCyl6IgntTiming : 0|16@1+ (0.0078125,-200) [-200|301.99] "deg" Vector__XXX
 SG_ EngCyl5IgntTiming : 0|16@1+ (0.0078125,-200) [-200|301.99] "deg" Vector__XXX
 SG_ EngCyl4IgntTiming : 0|16@1+ (0.0078125,-200) [-200|301.99] "deg" Vector__XXX
 SG_ EngCyl3IgntTiming : 0|16@1+ (0.0078125,-200) [-200|301.99] "deg" Vector__XXX
 SG_ EngCyl2IgntTiming : 0|16@1+ (0.0078125,-200) [-200|301.99] "deg" Vector__XXX
 SG_ EngCyl1IgntTiming : 0|16@1+ (0.0078125,-200) [-200|301.99] "deg" Vector__XXX
 SG_ EngCyl20IgntTransSecondOutput : 0|8@1+ (1,-125) [-125|125] "%" Vector__XXX
 SG_ EngCyl19IgntTransSecondOutput : 0|8@1+ (1,-125) [-125|125] "%" Vector__XXX
 SG_ EngCyl18IgntTransSecondOutput : 0|8@1+ (1,-125) [-125|125] "%" Vector__XXX
 SG_ EngCyl17IgntTransSecondOutput : 0|8@1+ (1,-125) [-125|125] "%" Vector__XXX
 SG_ EngCyl16IgntTransSecondOutput : 0|8@1+ (1,-125) [-125|125] "%" Vector__XXX
 SG_ EngCyl15IgntTransSecondOutput : 0|8@1+ (1,-125) [-125|125] "%" Vector__XXX
 SG_ EngCyl14IgntTransSecondOutput : 0|8@1+ (1,-125) [-125|125] "%" Vector__XXX
 SG_ EngCyl13IgntTransSecondOutput : 0|8@1+ (1,-125) [-125|125] "%" Vector__XXX
 SG_ EngCyl12IgntTransSecondOutput : 0|8@1+ (1,-125) [-125|125] "%" Vector__XXX
 SG_ EngCyl11IgntTransSecondOutput : 0|8@1+ (1,-125) [-125|125] "%" Vector__XXX
 SG_ EngCyl10IgntTransSecondOutput : 0|8@1+ (1,-125) [-125|125] "%" Vector__XXX
 SG_ EngCyl9IgntTransSecondOutput : 0|8@1+ (1,-125) [-125|125] "%" Vector__XXX
 SG_ EngCyl8IgntTransSecondOutput : 0|8@1+ (1,-125) [-125|125] "%" Vector__XXX
 SG_ EngCyl7IgntTransSecondOutput : 0|8@1+ (1,-125) [-125|125] "%" Vector__XXX
 SG_ EngCyl6IgntTransSecondOutput : 0|8@1+ (1,-125) [-125|125] "%" Vector__XXX
 SG_ EngCyl5IgntTransSecondOutput : 0|8@1+ (1,-125) [-125|125] "%" Vector__XXX
 SG_ EngCyl4IgntTransSecondOutput : 0|8@1+ (1,-125) [-125|125] "%" Vector__XXX
 SG_ EngCyl3IgntTransSecondOutput : 0|8@1+ (1,-125) [-125|125] "%" Vector__XXX
 SG_ EngCyl2IgntTransSecondOutput : 0|8@1+ (1,-125) [-125|125] "%" Vector__XXX
 SG_ EngCyl1IgntTransSecondOutput : 0|8@1+ (1,-125) [-125|125] "%" Vector__XXX
 SG_ EngOprtrPrmryIntrmdtSpdSlctStte : 0|4@1+ (1,0) [0|15] "" Vector__XXX
 SG_ EngOprtrPrmryIntrmdtSpeedSelect : 0|4@1+ (1,0) [0|15] "" Vector__XXX
 SG_ EngTotalIdleHours : 0|32@1+ (0.05,0) [0|210554060.75] "hr" Vector__XXX
 SG_ EngTotalIdleFuelUsed : 0|32@1+ (0.5,0) [0|2105540607.5] "L" Vector__XXX
 SG_ EngIntakeManifold6Temp : 0|8@1+ (1,-40) [-40|210] "°C" Vector__XXX
 SG_ EngIntakeManifold5Temp : 0|8@1+ (1,-40) [-40|210] "°C" Vector__XXX
 SG_ EngIntakeManifold4Temp : 0|8@1+ (1,-40) [-40|210] "°C" Vector__XXX
 SG_ EngIntakeManifold3Temp : 0|8@1+ (1,-40) [-40|210] "°C" Vector__XXX
 SG_ EngIntakeManifold2Temp : 0|8@1+ (1,-40) [-40|210] "°C" Vector__XXX
 SG_ EngTurbo4BoostPress : 0|16@1+ (0.125,0) [0|8031.875] "kPa" Vector__XXX
 SG_ EngTurbo3BoostPress : 0|16@1+ (0.125,0) [0|8031.875] "kPa" Vector__XXX
 SG_ EngTurbo2BoostPress : 0|16@1+ (0.125,0) [0|8031.875] "kPa" Vector__XXX
 SG_ EngTurbo1BoostPress : 0|16@1+ (0.125,0) [0|8031.875] "kPa" Vector__XXX
 SG_ EngAirFilter4DiffPress : 0|8@1+ (0.05,0) [0|12.5] "kPa" Vector__XXX
 SG_ EngAirFilter3DiffPress : 0|8@1+ (0.05,0) [0|12.5] "kPa" Vector__XXX
 SG_ EngAirFilter2DiffPress : 0|8@1+ (0.05,0) [0|12.5] "kPa" Vector__XXX
 SG_ EngIntakeManifold2Press : 0|8@1+ (2,0) [0|500] "kPa" Vector__XXX
 SG_ EngIntakeManifold1AbsPress : 0|8@1+ (2,0) [0|500] "kPa" Vector__XXX
 SG_ CabHeatingZone : 0|2@1+ (1,0) [0|3] "" Vector__XXX
 SG_ EngHeatingZone : 0|2@1+ (1,0) [0|3] "" Vector__XXX
 SG_ CabVentilation : 0|2@1+ (1,0) [0|3] "" Vector__XXX
 SG_ AuxilaryHeaterWaterPumpStatus : 0|2@1+ (1,0) [0|3] "" Vector__XXX
 SG_ AuxHeaterMode : 0|4@1+ (1,0) [0|15] "" Vector__XXX
 SG_ AuxHeaterOutputPowerPercent : 0|8@1+ (0.4,0) [0|100] "%" Vector__XXX
 SG_ AuxHeaterInputAirTemp : 0|8@1+ (1,-40) [-40|210] "°C" Vector__XXX
 SG_ AuxHeaterOutputCoolantTemp : 0|8@1+ (1,-40) [-40|210] "°C" Vector__XXX
 SG_ RearAxleRightWheelSpeed : 0|16@1+ (0.00390625,0) [0|250.996] "km/h" Vector__XXX
 SG_ RearAxleLeftWheelSpeed : 0|16@1+ (0.00390625,0) [0|250.996] "km/h" Vector__XXX
 SG_ FrontAxleRightWheelSpeed : 0|16@1+ (0.00390625,0) [0|250.996] "km/h" Vector__XXX
 SG_ FrontAxleLeftWheelSpeed : 0|16@1+ (0.00390625,0) [0|250.966] "km/h" Vector__XXX
 SG_ FireApparatusPumpEngagement : 0|2@1+ (1,0) [0|3] "" Vector__XXX
 SG_ EngHydPressGovernorSwitch : 0|2@1+ (1,0) [0|3] "" Vector__XXX
 SG_ EngHydPrssGovernorModeIndicator : 0|2@1+ (1,0) [0|3] "" Vector__XXX
 SG_ HydPress : 0|16@1+ (2,0) [0|128510] "kPa" Vector__XXX
 SG_ HydBrakeFluidLevelSwitch : 0|2@1+ (1,0) [0|3] "" Vector__XXX
 SG_ HydBrakeSystemAudibleWarningCmd : 0|2@1+ (1,0) [0|3] "" Vector__XXX
 SG_ HydBrkePressSupplyStateCircuit2 : 0|2@1+ (1,0) [0|3] "" Vector__XXX
 SG_ HydBrkePressSupplyStateCircuit1 : 0|2@1+ (1,0) [0|3] "" Vector__XXX
 SG_ HydBrkPressWarningStateCircuit2 : 0|2@1+ (1,0) [0|3] "" Vector__XXX
 SG_ HydBrkPressWarningStateCircuit1 : 0|2@1+ (1,0) [0|3] "" Vector__XXX
 SG_ HydBrakePressCircuit2 : 0|8@1+ (100,0) [0|25] "MPa" Vector__XXX
 SG_ HydBrakePressCircuit1 : 0|8@1+ (100,0) [0|25] "MPa" Vector__XXX
 SG_ TripDriveFuelEconomy : 0|16@1+ (0.00195313,0) [0|125.5] "km/L" Vector__XXX
 SG_ TripCruiseFuelUsed : 0|32@1+ (0.5,0) [0|2105540607.5] "kg" Vector__XXX
 SG_ TripVehicleIdleFuelUsed : 0|32@1+ (0.5,0) [0|2105540607.5] "kg" Vector__XXX
 SG_ TripPTONonmovingFuelUsed : 0|32@1+ (0.5,0) [0|2105540607.5] "kg" Vector__XXX
 SG_ TripPTOMovingFuelUsed : 0|32@1+ (0.5,0) [0|2105540607.5] "kg" Vector__XXX
 SG_ TripDriveFuelUsed : 0|32@1+ (0.5,0) [0|2105540607.5] "kg" Vector__XXX
 SG_ EngFuelValve1OutletAbsPress : 0|16@1+ (0.1,0) [0|6425.5] "kPa" Vector__XXX
 SG_ EngAirToFuelDiffPress : 0|16@1+ (0.1,0) [0|6425.5] "kPa" Vector__XXX
 SG_ EngFuelValveDiffPress : 0|16@1+ (0.1,0) [0|6425.5] "kPa" Vector__XXX
 SG_ EngFuelValveInletAbsPress : 0|16@1+ (0.1,0) [0|6425.5] "kPa" Vector__XXX
 SG_ EngFuelFlowRate2 : 0|16@1+ (0.1,0) [0|6425.5] "m³/hr" Vector__XXX
 SG_ EngFuelFlowRate1 : 0|16@1+ (0.1,0) [0|6425.5] "m³/hr" Vector__XXX
 SG_ EngRqedFuelValve2Pos : 0|8@1+ (0.4,0) [0|100] "%" Vector__XXX
 SG_ EngRqedFuelValve1Pos : 0|8@1+ (0.4,0) [0|100] "%" Vector__XXX
 SG_ EngFuelValve2Pos : 0|8@1+ (0.4,0) [0|100] "%" Vector__XXX
 SG_ EngFuelValve1Pos : 0|8@1+ (0.4,0) [0|100] "%" Vector__XXX
 SG_ EngFuelSpecificGravity : 0|16@1+ (0.0001,0) [0|6.4255] "" Vector__XXX
 SG_ TripAverageFuelRate : 0|16@1+ (0.05,0) [0|3212.75] "kg/hr" Vector__XXX
 SG_ TotalEngPTOFuelUsed : 0|32@1+ (0.5,0) [0|2105540607.5] "kg" Vector__XXX
 SG_ SpecificHeatRatio : 0|16@1+ (0.001,0) [0|64.255] "" Vector__XXX
 SG_ TotalFuelUsed : 0|32@1+ (0.5,0) [0|2105540607.5] "kg" Vector__XXX
 SG_ TripFuel : 0|32@1+ (0.5,0) [0|2105540607.5] "kg" Vector__XXX
 SG_ SensorSupplyVoltage6 : 0|16@1+ (0.05,0) [0|3212.75] "V" Vector__XXX
 SG_ SensorSupplyVoltage5 : 0|16@1+ (0.05,0) [0|3212.75] "V" Vector__XXX
 SG_ SensorSupplyVoltage4 : 0|16@1+ (0.05,0) [0|3212.75] "V" Vector__XXX
 SG_ SensorSupplyVoltage3 : 0|16@1+ (0.05,0) [0|3212.75] "V" Vector__XXX
 SG_ SensorSupplyVoltage2 : 0|16@1+ (0.05,0) [0|3212.75] "V" Vector__XXX
 SG_ SensorSupplyVoltage1 : 0|16@1+ (0.05,0) [0|3212.75] "V" Vector__XXX
 SG_ EnggmntSttusTransInputShaftPTO1 : 0|2@1+ (1,0) [0|3] "" Vector__XXX
 SG_ EnggmntSttusTransInputShaftPTO2 : 0|2@1+ (1,0) [0|3] "" Vector__XXX
 SG_ EnggmntSttusTransOutputShaftPTO : 0|2@1+ (1,0) [0|3] "" Vector__XXX
 SG_ EnggmntSttsTrnsfrCsOtptShaftPTO : 0|2@1+ (1,0) [0|3] "" Vector__XXX
 SG_ EnggmntCnsntTransInputShaftPTO1 : 0|2@1+ (1,0) [0|3] "" Vector__XXX
 SG_ EnggmntCnsntTransInputShaftPTO2 : 0|2@1+ (1,0) [0|3] "" Vector__XXX
 SG_ EnggmntCnsntTransOutputShaftPTO : 0|2@1+ (1,0) [0|3] "" Vector__XXX
 SG_ EnggmntCnsntTrnsfrCsOtptShftPTO : 0|2@1+ (1,0) [0|3] "" Vector__XXX
 SG_ EnableSwitchTransInputShaftPTO1 : 0|2@1+ (1,0) [0|3] "" Vector__XXX
 SG_ EnableSwitchTransInputShaftPTO2 : 0|2@1+ (1,0) [0|3] "" Vector__XXX
 SG_ EnableSwitchTransOutputShaftPTO : 0|2@1+ (1,0) [0|3] "" Vector__XXX
 SG_ EnblSwtchTrnsfrCsOutputShaftPTO : 0|2@1+ (1,0) [0|3] "" Vector__XXX
 SG_ EngFuelValve2OutletAbsPress : 0|16@1+ (0.1,0) [0|6425.5] "kPa" Vector__XXX
 SG_ EngFuelTemp2 : 0|8@1+ (1,-40) [-40|210] "°C" Vector__XXX
 SG_ EngGasMassFlowRate2 : 0|16@1+ (0.05,0) [0|3212.75] "kg/hr" Vector__XXX
 SG_ EngFuelValve2InletAbsPress : 0|16@1+ (0.1,0) [0|6425.5] "kPa" Vector__XXX
 SG_ EngCentrifugalOilFilterSpeed : 0|16@1+ (4,0) [0|257020] "RPM" Vector__XXX
 SG_ EngCoolantPumpDiffPress : 0|8@1+ (1.64,-7) [-7|403] "kPa" Vector__XXX
 SG_ EngChargeAirCooler2InletPress : 0|8@1+ (2,0) [0|500] "kPa" Vector__XXX
 SG_ EngChargeAirCooler1InletPress : 0|8@1+ (2,0) [0|500] "kPa" Vector__XXX
 SG_ EngIntercoolerCoolantLevel : 0|8@1+ (0.4,0) [0|100] "%" Vector__XXX
 SG_ EngChargeAirCoolerOutletPress : 0|8@1+ (2,0) [0|500] "kPa" Vector__XXX
 SG_ EngAftercoolerCoolantLevel : 0|8@1+ (0.4,0) [0|100] "%" Vector__XXX
 SG_ EngVrableGeometryTurboActuator1 : 0|8@1+ (0.4,0) [0|100] "%" Vector__XXX
 SG_ EngTrbCmprssorBypassActuatorPos : 0|8@1+ (0.4,0) [0|100] "%" Vector__XXX
 SG_ EngTurboCompressorCtrl : 0|16@1+ (0.0025,0) [0|160.6375] "%" Vector__XXX
 SG_ EnableStatusOfDoor10 : 0|2@1+ (1,0) [0|3] "" Vector__XXX
 SG_ OpenStatusOfDoor10 : 0|2@1+ (1,0) [0|3] "" Vector__XXX
 SG_ LockStatusOfDoor10 : 0|2@1+ (1,0) [0|3] "" Vector__XXX
 SG_ EnableStatusOfDoor9 : 0|2@1+ (1,0) [0|3] "" Vector__XXX
 SG_ OpenStatusOfDoor9 : 0|2@1+ (1,0) [0|3] "" Vector__XXX
 SG_ LockStatusOfDoor9 : 0|2@1+ (1,0) [0|3] "" Vector__XXX
 SG_ EnableStatusOfDoor8 : 0|2@1+ (1,0) [0|3] "" Vector__XXX
 SG_ OpenStatusOfDoor8 : 0|2@1+ (1,0) [0|3] "" Vector__XXX
 SG_ LockStatusOfDoor8 : 0|2@1+ (1,0) [0|3] "" Vector__XXX
 SG_ EnableStatusOfDoor7 : 0|2@1+ (1,0) [0|3] "" Vector__XXX
 SG_ OpenStatusOfDoor7 : 0|2@1+ (1,0) [0|3] "" Vector__XXX
 SG_ LockStatusOfDoor7 : 0|2@1+ (1,0) [0|3] "" Vector__XXX
 SG_ EnableStatusOfDoor6 : 0|2@1+ (1,0) [0|3] "" Vector__XXX
 SG_ OpenStatusOfDoor6 : 0|2@1+ (1,0) [0|3] "" Vector__XXX
 SG_ LockStatusOfDoor6 : 0|2@1+ (1,0) [0|3] "" Vector__XXX
 SG_ EnableStatusOfDoor5 : 0|2@1+ (1,0) [0|3] "" Vector__XXX
 SG_ OpenStatusOfDoor5 : 0|2@1+ (1,0) [0|3] "" Vector__XXX
 SG_ LockStatusOfDoor5 : 0|2@1+ (1,0) [0|3] "" Vector__XXX
 SG_ EnableStatusOfDoor4 : 0|2@1+ (1,0) [0|3] "" Vector__XXX
 SG_ OpenStatusOfDoor4 : 0|2@1+ (1,0) [0|3] "" Vector__XXX
 SG_ LockStatusOfDoor4 : 0|2@1+ (1,0) [0|3] "" Vector__XXX
 SG_ EnableStatusOfDoor3 : 0|2@1+ (1,0) [0|3] "" Vector__XXX
 SG_ OpenStatusOfDoor3 : 0|2@1+ (1,0) [0|3] "" Vector__XXX
 SG_ LockStatusOfDoor3 : 0|2@1+ (1,0) [0|3] "" Vector__XXX
 SG_ EnableStatusOfDoor2 : 0|2@1+ (1,0) [0|3] "" Vector__XXX
 SG_ OpenStatusOfDoor2 : 0|2@1+ (1,0) [0|3] "" Vector__XXX
 SG_ LockStatusOfDoor2 : 0|2@1+ (1,0) [0|3] "" Vector__XXX
 SG_ EnableStatusOfDoor1 : 0|2@1+ (1,0) [0|3] "" Vector__XXX
 SG_ OpenStatusOfDoor1 : 0|2@1+ (1,0) [0|3] "" Vector__XXX
 SG_ LockStatusOfDoor1 : 0|2@1+ (1,0) [0|3] "" Vector__XXX
 SG_ CatalystReagentType : 0|4@1+ (1,0) [0|15] "" Vector__XXX
 SG_ CtlystRgntPrprtesPreliminaryFMI : 0|5@1+ (1,0) [0|31] "" Vector__XXX
 SG_ CtlystRagentTemp2PreliminaryFMI : 0|5@1+ (1,0) [0|31] "" Vector__XXX
 SG_ CatalystReagentConductivity : 0|8@1+ (5,0) [0|1250] "microSiemens/mm" Vector__XXX
 SG_ CatalystReagentConcentration : 0|8@1+ (0.25,0) [0|62.5] "%" Vector__XXX
 SG_ CatalystReagentTemp2 : 0|8@1+ (1,-40) [-40|210] "°C" Vector__XXX
 SG_ RqdGnrtrAvrgLneLineACRMSVoltage : 0|32@1+ (0.0078125,0) [0|32899071] "V" Vector__XXX
 SG_ EngThrottleActuator2CtrlCmd : 0|16@1+ (0.0025,0) [0|160.6375] "%" Vector__XXX
 SG_ EngThrottleActuator1CtrlCmd : 0|16@1+ (0.0025,0) [0|160.6375] "%" Vector__XXX
 SG_ EngFuelActuator2CtrlCmd : 0|16@1+ (0.0025,0) [0|160.6375] "%" Vector__XXX
 SG_ EngFuelActuator1CtrlCmd : 0|16@1+ (0.0025,0) [0|160.6375] "%" Vector__XXX
 SG_ EngCyl24KnockLevel : 0|8@1+ (1,0) [0|250] "%" Vector__XXX
 SG_ EngCyl23KnockLevel : 0|8@1+ (1,0) [0|250] "%" Vector__XXX
 SG_ EngCyl22KnockLevel : 0|8@1+ (1,0) [0|250] "%" Vector__XXX
 SG_ EngCyl21KnockLevel : 0|8@1+ (1,0) [0|250] "%" Vector__XXX
 SG_ EngCyl20KnockLevel : 0|8@1+ (1,0) [0|250] "%" Vector__XXX
 SG_ EngCyl19KnockLevel : 0|8@1+ (1,0) [0|250] "%" Vector__XXX
 SG_ EngCyl18KnockLevel : 0|8@1+ (1,0) [0|250] "%" Vector__XXX
 SG_ EngCyl17KnockLevel : 0|8@1+ (1,0) [0|250] "%" Vector__XXX
 SG_ EngCyl15KnockLevel : 0|8@1+ (1,0) [0|250] "%" Vector__XXX
 SG_ EngCyl14KnockLevel : 0|8@1+ (1,0) [0|250] "%" Vector__XXX
 SG_ EngCyl13KnockLevel : 0|8@1+ (1,0) [0|250] "%" Vector__XXX
 SG_ EngCyl12KnockLevel : 0|8@1+ (1,0) [0|250] "%" Vector__XXX
 SG_ EngCyl11KnockLevel : 0|8@1+ (1,0) [0|250] "%" Vector__XXX
 SG_ EngCyl10KnockLevel : 0|8@1+ (1,0) [0|250] "%" Vector__XXX
 SG_ EngCyl9KnockLevel : 0|8@1+ (1,0) [0|250] "%" Vector__XXX
 SG_ EngCyl16KnockLevel : 0|8@1+ (1,0) [0|250] "%" Vector__XXX
 SG_ EngCyl8KnockLevel : 0|8@1+ (1,0) [0|250] "%" Vector__XXX
 SG_ EngCyl7KnockLevel : 0|8@1+ (1,0) [0|250] "%" Vector__XXX
 SG_ EngCyl6KnockLevel : 0|8@1+ (1,0) [0|250] "%" Vector__XXX
 SG_ EngCyl5KnockLevel : 0|8@1+ (1,0) [0|250] "%" Vector__XXX
 SG_ EngCyl4KnockLevel : 0|8@1+ (1,0) [0|250] "%" Vector__XXX
 SG_ EngCyl3KnockLevel : 0|8@1+ (1,0) [0|250] "%" Vector__XXX
 SG_ EngCyl2KnockLevel : 0|8@1+ (1,0) [0|250] "%" Vector__XXX
 SG_ EngCyl1KnockLevel : 0|8@1+ (1,0) [0|250] "%" Vector__XXX
 SG_ EngCyl9CombustionStatus : 0|2@1+ (1,0) [0|3] "" Vector__XXX
 SG_ EngCyl8CombustionStatus : 0|2@1+ (1,0) [0|3] "" Vector__XXX
 SG_ EngCyl7CombustionStatus : 0|2@1+ (1,0) [0|3] "" Vector__XXX
 SG_ EngCyl6CombustionStatus : 0|2@1+ (1,0) [0|3] "" Vector__XXX
 SG_ EngCyl5CombustionStatus : 0|2@1+ (1,0) [0|3] "" Vector__XXX
 SG_ EngCyl4CombustionStatus : 0|2@1+ (1,0) [0|3] "" Vector__XXX
 SG_ EngCyl3CombustionStatus : 0|2@1+ (1,0) [0|3] "" Vector__XXX
 SG_ EngCyl2CombustionStatus : 0|2@1+ (1,0) [0|3] "" Vector__XXX
 SG_ EngCyl24CombustionStatus : 0|2@1+ (1,0) [0|3] "" Vector__XXX
 SG_ EngCyl23CombustionStatus : 0|2@1+ (1,0) [0|3] "" Vector__XXX
 SG_ EngCyl22CombustionStatus : 0|2@1+ (1,0) [0|3] "" Vector__XXX
 SG_ EngCyl21CombustionStatus : 0|2@1+ (1,0) [0|3] "" Vector__XXX
 SG_ EngCyl20CombustionStatus : 0|2@1+ (1,0) [0|3] "" Vector__XXX
 SG_ EngCyl1CombustionStatus : 0|2@1+ (1,0) [0|3] "" Vector__XXX
 SG_ EngCyl19CombustionStatus : 0|2@1+ (1,0) [0|3] "" Vector__XXX
 SG_ EngCyl18CombustionStatus : 0|2@1+ (1,0) [0|3] "" Vector__XXX
 SG_ EngCyl17CombustionStatus : 0|2@1+ (1,0) [0|3] "" Vector__XXX
 SG_ EngCyl16CombustionStatus : 0|2@1+ (1,0) [0|3] "" Vector__XXX
 SG_ EngCyl15CombustionStatus : 0|2@1+ (1,0) [0|3] "" Vector__XXX
 SG_ EngCyl14CombustionStatus : 0|2@1+ (1,0) [0|3] "" Vector__XXX
 SG_ EngCyl13CombustionStatus : 0|2@1+ (1,0) [0|3] "" Vector__XXX
 SG_ EngCyl12CombustionStatus : 0|2@1+ (1,0) [0|3] "" Vector__XXX
 SG_ EngCyl11CombustionStatus : 0|2@1+ (1,0) [0|3] "" Vector__XXX
 SG_ EngCyl10CombustionStatus : 0|2@1+ (1,0) [0|3] "" Vector__XXX
 SG_ RqGenOverallPowerFactorLagging : 0|2@1+ (1,0) [0|4] "" Vector__XXX
 SG_ RqGeneratorOverallPowerFactor : 0|16@1+ (6.103515625E-005,-1) [-1|2.921814] "" Vector__XXX
 SG_ RqGeneratorTotalACReactivePower : 0|32@1+ (1,-2000000000) [-2000000000|2000000000] "VA" Vector__XXX
 SG_ BladeRotationAngleFigureOfMerit : 0|2@1+ (1,0) [0|3] "" Vector__XXX
 SG_ RelBladeHeightFigureOfMerit : 0|2@1+ (1,0) [0|4] "" Vector__XXX
 SG_ RelBladeMeasurementLatency : 0|8@1+ (0.5,0) [0|125] "ms" Vector__XXX
 SG_ BladeRotationAngle : 0|16@1+ (0.0078125,-200) [-200|301.99] "deg" Vector__XXX
 SG_ RelativeBladeHeight : 0|16@1+ (0.1,-3200) [-3200|3225.5] "mm" Vector__XXX
 SG_ RetarderDemandValue : 0|8@1+ (1,-125) [-125|125] "%" Vector__XXX
 SG_ ParkBrakeDemandValue : 0|8@1+ (0.4,0) [0|100] "%" Vector__XXX
 SG_ ServiceBrakeDemandValue : 0|16@1+ (0.01953125,0) [0|1255] "kPa" Vector__XXX
 SG_ VehicleType : 0|2@1+ (1,0) [0|3] "" Vector__XXX
 SG_ BrakeLightSwitch : 0|2@1+ (1,0) [0|3] "" Vector__XXX
 SG_ ASREngineControlActive : 0|2@1+ (1,0) [0|3] "" Vector__XXX
 SG_ ASRBreakControlActive : 0|2@1+ (1,0) [0|3] "" Vector__XXX
 SG_ VehicleRetarderCtrlActive : 0|2@1+ (1,0) [0|3] "" Vector__XXX
 SG_ VehicleABSActive : 0|2@1+ (1,0) [0|1] "" Vector__XXX
 SG_ RoadCurvature : 0|16@1+ (0.0078125,-250) [-250|251.992] "1/km" Vector__XXX
 SG_ PneumaticControlLine : 0|2@1+ (1,0) [0|1] "" Vector__XXX
 SG_ ABSOffroadRequest : 0|2@1+ (1,0) [0|1] "" Vector__XXX
 SG_ TwoElCircuitsBrakeDemand : 0|2@1+ (1,0) [0|1] "" Vector__XXX
 SG_ VehicleRetarderCtrlActive : 0|2@1+ (1,0) [0|3] "" Vector__XXX
 SG_ WheelSpeedDiffMainAxle : 0|16@1+ (0.00390625,-125) [-125|125] "km/h" Vector__XXX
 SG_ ActualRetarderPercTorque : 0|8@1+ (1,-125) [-125|125] "%" Vector__XXX
 SG_ Wheel_BasedVehicleSpeed : 0|16@1+ (0.00390625,0) [0|251] "km/h" Vector__XXX
 SG_ SupplyLineBrakingRequest : 0|2@1+ (1,0) [0|1] "" Vector__XXX
 SG_ VDCActive : 0|2@1+ (1,0) [0|1] "" Vector__XXX
 SG_ AutomTowedVehBreakActive : 0|2@1+ (1,0) [0|1] "" Vector__XXX
 SG_ VehicleServiceBrakeActive : 0|2@1+ (1,0) [0|1] "" Vector__XXX
 SG_ VehicleRetarderCtrlActive : 0|2@1+ (1,0) [0|3] "" Vector__XXX
 SG_ VehicleABSActive : 0|2@1+ (1,0) [0|1] "" Vector__XXX
 SG_ ReferenceRetarderTorque : 0|16@1+ (1,0) [0|64255] "Nm" Vector__XXX
 SG_ AxleLoadSum : 0|16@1+ (2,0) [0|128510] "kg" Vector__XXX
 SG_ SupplyLineBrakingRequest : 0|2@1+ (1,0) [0|1] "" Vector__XXX
 SG_ LoadingRampApproachAssist : 0|2@1+ (1,0) [0|1] "" Vector__XXX
 SG_ SpringBrakeEngaged : 0|2@1+ (1,0) [0|1] "" Vector__XXX
 SG_ ElectrLoadPropFunc : 0|2@1+ (1,0) [0|1] "" Vector__XXX
 SG_ SpringBrakeInstalled : 0|2@1+ (1,0) [0|1] "" Vector__XXX
 SG_ VehicleType : 0|2@1+ (1,0) [0|3] "" Vector__XXX
 SG_ ElecSupplyOfNonBrakingSys : 0|2@1+ (1,0) [0|1] "" Vector__XXX
 SG_ AmberWarningSignalReq : 0|2@1+ (1,0) [0|1] "" Vector__XXX
 SG_ RedWarningSignalRequest : 0|2@1+ (1,0) [0|1] "" Vector__XXX
 SG_ VehicleElectrSupplySuff : 0|2@1+ (1,0) [0|1] "" Vector__XXX
 SG_ AutomTowedVehBreakActive : 0|2@1+ (1,0) [0|1] "" Vector__XXX
 SG_ VehicleServiceBrakeActive : 0|2@1+ (1,0) [0|1] "" Vector__XXX
 SG_ VehicleRetarderCtrlActive : 0|2@1+ (1,0) [0|3] "" Vector__XXX
 SG_ VehicleABSActive : 0|2@1+ (1,0) [0|1] "" Vector__XXX
 SG_ PneumaticSupplyPressure : 0|8@1+ (5,0) [0|1250] "kPa" Vector__XXX
 SG_ BrakeTemperature : 0|8@1+ (10,0) [0|2500] "°C" Vector__XXX
 SG_ BrakeLining : 0|8@1+ (0.4,0) [0|100] "%" Vector__XXX
 SG_ TyrePressure : 0|8@1+ (10,0) [0|2500] "kPa" Vector__XXX
 SG_ TyreWheelIdentTemp2 : 0|4@1+ (1,0) [0|15] "" Vector__XXX
 SG_ TyreWheelIdentTemp1 : 0|4@1+ (1,0) [0|15] "" Vector__XXX
 SG_ TyreWheelIdentPressure2 : 0|4@1+ (1,0) [0|15] "" Vector__XXX
 SG_ TyreWheelIdentPressure1 : 0|4@1+ (1,0) [0|15] "" Vector__XXX
 SG_ TyreWheelIdentLining2 : 0|4@1+ (1,0) [0|15] "" Vector__XXX
 SG_ TyreWheelIdentLining1 : 0|4@1+ (1,0) [0|15] "" Vector__XXX
 SG_ VehiclePneumSupplySuff : 0|2@1+ (1,0) [0|1] "" Vector__XXX
 SG_ BrakeTemperatureStatus : 0|2@1+ (1,0) [0|1] "" Vector__XXX
 SG_ BrakeLiningSufficient : 0|2@1+ (1,0) [0|1] "" Vector__XXX
 SG_ TyrePressureSufficient : 0|2@1+ (1,0) [0|1] "" Vector__XXX
 SG_ ODDRequest : 0|2@1+ (1,0) [0|3] "" Vector__XXX
 SG_ AntiTheftDeviceReq : 0|2@1+ (1,0) [0|3] "" Vector__XXX
 SG_ VehicleType : 0|2@1+ (1,0) [0|3] "" Vector__XXX
 SG_ MaxVehicleSpeedLimit : 0|8@1+ (1,0) [0|250] "km/h" Vector__XXX
 SG_ EngineSpeedUpperLimit : 0|16@1+ (0.125,0) [0|8031.875] "RPM" Vector__XXX
 SG_ EngineSpeedLowerLimit : 0|16@1+ (0.125,0) [0|8191.875] "RPM" Vector__XXX
 SG_ EngineTorqueMode : 0|4@1+ (1,0) [0|15] "" Vector__XXX
 SG_ VehicleSpeed : 0|16@1+ (0.00390625,0) [0|250.996] "km/h" Vector__XXX
 SG_ PercentLoadAtCurrentSpeed : 0|8@1+ (1,0) [0|125] "%" Vector__XXX
 SG_ EngineSpeed : 0|16@1+ (0.125,0) [0|8031.88] "RPM" Vector__XXX
 SG_ ActualEngine_PercTorque : 0|8@1+ (1,-125) [-125|125] "%" Vector__XXX
 SG_ DriversDemandEngine_PercTorque : 0|8@1+ (1,-125) [-125|125] "%" Vector__XXX
 SG_ EngineRunning : 0|2@1+ (1,0) [0|1] "" Vector__XXX
 SG_ EngineControlAllowed : 0|2@1+ (1,0) [0|1] "" Vector__XXX
 SG_ ClutchIndptdPTOFeedback : 0|2@1+ (1,0) [0|1] "" Vector__XXX
 SG_ AccelPedalPosition : 0|8@1+ (0.4,0) [0|100] "%" Vector__XXX
 SG_ AccelPedalLowIdleSwitch : 0|2@1+ (1,0) [0|1] "" Vector__XXX
 SG_ StarterActive : 0|2@1+ (1,0) [0|1] "" Vector__XXX
 SG_ TorqueConvOilTemp : 0|16@1+ (0.03125,-273) [-273|1735] "°C" Vector__XXX
 SG_ TorqueConvtOilTempWarning : 0|3@1+ (1,0) [0|2] "" Vector__XXX
 SG_ PTOControlAllowed : 0|2@1+ (1,0) [0|1] "" Vector__XXX
 SG_ SecEngineMtdPTOFeedback : 0|2@1+ (1,0) [0|1] "" Vector__XXX
 SG_ FirstEngineMtdPTOFeedback : 0|2@1+ (1,0) [0|1] "" Vector__XXX
 SG_ SecClutchDptdPTOFeedback : 0|2@1+ (1,0) [0|1] "" Vector__XXX
 SG_ FirstClutchDpdtPTOFeedback : 0|2@1+ (1,0) [0|1] "" Vector__XXX
 SG_ CurrentGear : 0|8@1+ (1,-125) [-125|125] "" Vector__XXX
 SG_ PercentClutchSlip : 0|8@1+ (0.4,0) [0|100] "%" Vector__XXX
 SG_ ReferenceEngineTorque : 0|16@1+ (1,0) [0|64255] "Nm" Vector__XXX
 SG_ FuelLevelWarning : 0|2@1+ (1,0) [0|1] "" Vector__XXX
 SG_ EngineOilPressureWarning : 0|2@1+ (1,0) [0|1] "" Vector__XXX
 SG_ EngineCoolantTempWarning : 0|3@1+ (1,0) [0|2] "" Vector__XXX
 SG_ EngineOilPressure : 0|8@1+ (4,0) [0|1000] "kPa" Vector__XXX
 SG_ EngineCoolantTemperature : 0|8@1+ (1,-40) [-40|210] "°C" Vector__XXX
 SG_ EngineOilTemperature : 0|16@1+ (0.03125,-273) [-273|1735] "°C" Vector__XXX
 SG_ AmbientAirTemperature : 0|16@1+ (0.03125,-273) [-273|1735] "°C" Vector__XXX
 SG_ VehicleType : 0|2@1+ (1,0) [0|3] "" Vector__XXX
 SG_ BodyPressure : 0|8@1+ (0.1,0) [0|25] "bar" Vector__XXX
 SG_ BodyFluidLevel : 0|16@1+ (2,0) [0|128510] "L" Vector__XXX
 SG_ ThermalBodyTemperature : 0|8@1+ (1,-125) [-125|125] "°C" Vector__XXX
 SG_ RearObstacleDistance : 0|8@1+ (2,0) [0|500] "cm" Vector__XXX
 SG_ AntiTheftDeviceStatus : 0|2@1+ (1,0) [0|1] "" Vector__XXX
 SG_ ODDStatus : 0|2@1+ (1,0) [0|1] "" Vector__XXX
 SG_ ReqEngineSpeedUpperLim : 0|16@1+ (0.125,0) [0|8031.875] "RPM" Vector__XXX
 SG_ ReqEngineSpeedLowerLim : 0|16@1+ (0.125,0) [0|8031.875] "RPM" Vector__XXX
 SG_ ReqEngineTorqueLimit : 0|8@1+ (1,-125) [-125|125] "%" Vector__XXX
 SG_ ReqEngineSpeedLimit : 0|8@1+ (1,0) [0|250] "km/h" Vector__XXX
 SG_ ReqEngineSpeed : 0|16@1+ (0.125,0) [0|8031.875] "RPM" Vector__XXX
 SG_ SecEngineMtdPTOSwitch : 0|2@1+ (1,0) [0|1] "" Vector__XXX
 SG_ SecClutchDpdtPTOSwitch : 0|2@1+ (1,0) [0|1] "" Vector__XXX
 SG_ FirstClutchDpdtPTOSwitch : 0|2@1+ (1,0) [0|1] "" Vector__XXX
 SG_ OperatingPanelActive : 0|2@1+ (1,0) [0|1] "" Vector__XXX
 SG_ RefusePackerStepSwitch : 0|2@1+ (1,0) [0|1] "" Vector__XXX
 SG_ EngineStopSwitch : 0|2@1+ (1,0) [0|1] "" Vector__XXX
 SG_ EngineStartSwitch : 0|2@1+ (1,0) [0|3] "" Vector__XXX
 SG_ StarterLockoutSwitch : 0|2@1+ (1,0) [0|1] "" Vector__XXX
 SG_ RqstedPercentClutchSlip : 0|8@1+ (0.4,0) [0|100] "%" Vector__XXX
 SG_ FirstEngineMtdPTOSwitch : 0|2@1+ (1,0) [0|1] "" Vector__XXX
 SG_ ClutchIndpdtPTOSwitch : 0|2@1+ (1,0) [0|1] "" Vector__XXX
 SG_ TrailerLeftSideMarkerLight : 0|2@1+ (1,0) [0|3] "" Vector__XXX
 SG_ TrailerLeftReversingLight : 0|2@1+ (1,0) [0|3] "" Vector__XXX
 SG_ TrailerLeftRearWidIndLight : 0|2@1+ (1,0) [0|3] "" Vector__XXX
 SG_ TrailerLeftRearRegPltLight : 0|2@1+ (1,0) [0|3] "" Vector__XXX
 SG_ TrailerLeftRearLight : 0|2@1+ (1,0) [0|3] "" Vector__XXX
 SG_ TrailerLeftRearFogLight : 0|2@1+ (1,0) [0|3] "" Vector__XXX
 SG_ TrailerLeftDirIndLight : 0|2@1+ (1,0) [0|3] "" Vector__XXX
 SG_ TrailerLeftCrnMarkerLight : 0|2@1+ (1,0) [0|3] "" Vector__XXX
 SG_ TrailerInteriorLight : 0|2@1+ (1,0) [0|3] "" Vector__XXX
 SG_ TrailerWorkLamp : 0|2@1+ (1,0) [0|3] "" Vector__XXX
 SG_ TrailerRotatingIdentLight : 0|2@1+ (1,0) [0|3] "" Vector__XXX
 SG_ TrailerRightStopLight : 0|2@1+ (1,0) [0|3] "" Vector__XXX
 SG_ TrailerRightSideMrkLight : 0|2@1+ (1,0) [0|3] "" Vector__XXX
 SG_ TrailerRightReversingLight : 0|2@1+ (1,0) [0|3] "" Vector__XXX
 SG_ TrailRightRearWidIndLight : 0|2@1+ (1,0) [0|3] "" Vector__XXX
 SG_ TrailerRightRearRegPltLight : 0|2@1+ (1,0) [0|3] "" Vector__XXX
 SG_ TrailerRightRearLight : 0|2@1+ (1,0) [0|3] "" Vector__XXX
 SG_ TrailerRightRearFogLight : 0|2@1+ (1,0) [0|3] "" Vector__XXX
 SG_ TrailerRightDirIndLight : 0|2@1+ (1,0) [0|3] "" Vector__XXX
 SG_ TrailerRightCrnMarkerLight : 0|2@1+ (1,0) [0|3] "" Vector__XXX
 SG_ TrailerRearWarningLight : 0|2@1+ (1,0) [0|3] "" Vector__XXX
 SG_ TrailerLeftStopLight : 0|2@1+ (1,0) [0|3] "" Vector__XXX
 SG_ SN : 0|4@1+ (1,0) [0|15] "" Vector__XXX
 SG_ SeparationTime : 0|8@1+ (1,0) [0|255] "ms" Vector__XXX
 SG_ BlockSize : 0|8@1+ (1,0) [0|255] "" Vector__XXX
 SG_ FlowStatus : 0|4@1+ (1,0) [0|3] "" Vector__XXX
 SG_ FirstFrameDataLength : 0|12@0+ (1,0) [0|4095] "Byte" Vector__XXX
 SG_ SingleFrameDataLength : 0|4@1+ (1,0) [0|7] "Byte" Vector__XXX
 SG_ ProtocolCtrlInformation : 0|4@1+ (1,0) [0|3] "" Vector__XXX
 SG_ SN : 0|4@1+ (1,0) [0|15] "" Vector__XXX
 SG_ SeparationTime : 0|8@1+ (1,0) [0|255] "ms" Vector__XXX
 SG_ BlockSize : 0|8@1+ (1,0) [0|255] "" Vector__XXX
 SG_ FlowStatus : 0|4@1+ (1,0) [0|3] "" Vector__XXX
 SG_ FirstFrameDataLength : 0|12@0+ (1,0) [0|4095] "Byte" Vector__XXX
 SG_ SingleFrameDataLength : 0|4@1+ (1,0) [0|7] "Byte" Vector__XXX
 SG_ ProtocolCtrlInformation : 0|4@1+ (1,0) [0|3] "" Vector__XXX
 SG_ ControlByte : 0|8@1+ (1,0) [0|255] "" Vector__XXX
 SG_ FilterMode : 0|8@1+ (1,0) [0|255] "" Vector__XXX
 SG_ ToPort : 0|4@1+ (1,0) [0|15] "" Vector__XXX
 SG_ FromPort : 0|4@1+ (1,0) [0|15] "" Vector__XXX
 SG_ ParkingAndTrailerAirPress : 0|8@1+ (8,0) [0|2000] "kPa" Vector__XXX
 SG_ DrivenAxleLoad : 0|16@1+ (2,0) [0|128510] "kg" Vector__XXX
 SG_ AuxEquipSupplyPressure : 0|8@1+ (8,0) [0|2000] "kPa" Vector__XXX
 SG_ StopLevelChangeReq : 0|2@1+ (1,0) [0|3] "" Vector__XXX
 SG_ RampLevelStorageReq : 0|2@1+ (1,0) [0|3] "" Vector__XXX
 SG_ LevelControlReq : 0|2@1+ (1,0) [0|3] "" Vector__XXX
 SG_ RampLevelReq : 0|2@1+ (1,0) [0|3] "" Vector__XXX
 SG_ SteeringAxleLockingReq : 0|2@1+ (1,0) [0|3] "" Vector__XXX
 SG_ LiftAxle2PositionReq : 0|2@1+ (1,0) [0|3] "" Vector__XXX
 SG_ LiftAxle1PositionReq : 0|2@1+ (1,0) [0|3] "" Vector__XXX
 SG_ TractionHelpReq : 0|2@1+ (1,0) [0|3] "" Vector__XXX
 SG_ LevelChangeReqRearAxle : 0|2@1+ (1,0) [0|3] "" Vector__XXX
 SG_ LevelChangeReqFrontAxle : 0|2@1+ (1,0) [0|3] "" Vector__XXX
 SG_ RideHeightRequest : 0|2@1+ (1,0) [0|3] "" Vector__XXX
 SG_ LevelControl : 0|2@1+ (1,0) [0|1] "" Vector__XXX
 SG_ NominalVehBodyLevelRearAxle : 0|16@1+ (1,0) [0|64255] "mm" Vector__XXX
 SG_ NominalVehBodyLevelFrontAxle : 0|16@1+ (1,0) [0|64255] "mm" Vector__XXX
 SG_ RampLevel : 0|2@1+ (1,0) [0|1] "" Vector__XXX
 SG_ NormalLevel : 0|2@1+ (1,0) [0|3] "" Vector__XXX
 SG_ StopLevelChangeAcknowledge : 0|2@1+ (1,0) [0|1] "" Vector__XXX
 SG_ LevelChangeRearAxle : 0|2@1+ (1,0) [0|1] "" Vector__XXX
 SG_ LevelChangeFrontAxle : 0|2@1+ (1,0) [0|1] "" Vector__XXX
 SG_ RampLevelStorage : 0|2@1+ (1,0) [0|1] "" Vector__XXX
 SG_ SteeringAxleLocking : 0|2@1+ (1,0) [0|3] "" Vector__XXX
 SG_ LiftAxle2Pos : 0|2@1+ (1,0) [0|3] "" Vector__XXX
 SG_ LiftAxle1Pos : 0|2@1+ (1,0) [0|3] "" Vector__XXX
 SG_ RampLevelPosition : 0|2@1+ (1,0) [0|3] "" Vector__XXX
 SG_ TractionHelp : 0|2@1+ (1,0) [0|1] "" Vector__XXX
 SG_ LevelCtrlSysRideHeightLevel : 0|2@1+ (1,0) [0|1] "" Vector__XXX
 SG_ RelVehBodyLevelRearAxle : 0|16@1+ (1,0) [0|64255] "mm" Vector__XXX
 SG_ RelVehBodyLevelFrontAxle : 0|16@1+ (1,-32000) [-32000|32255] "mm" Vector__XXX
 SG_ TyrePressThresholdDetect : 0|3@1+ (1,0) [0|7] "" Vector__XXX
 SG_ TyreModulePowerSupply : 0|2@1+ (1,0) [0|1] "" Vector__XXX
 SG_ TyreTemperature : 0|16@1+ (0.03125,-273) [-273|1735] "°C" Vector__XXX
 SG_ AirLeakageDetection : 0|16@1+ (0.1,0) [0|6425.5] "Pa/s" Vector__XXX
 SG_ TyreWheelIdentification2 : 0|4@1+ (1,0) [0|15] "" Vector__XXX
 SG_ TyreWheelIdentification1 : 0|4@1+ (1,0) [0|15] "" Vector__XXX
 SG_ XBRMessageChecksum : 0|4@1+ (1,0) [0|15] "" Vector__XXX
 SG_ XBRMessageCounter : 0|4@1+ (1,0) [0|15] "" Vector__XXX
 SG_ XBRCtrlMode : 0|2@1+ (1,0) [0|3] "" Vector__XXX
 SG_ XBRPriority : 0|2@1+ (1,0) [0|3] "" Vector__XXX
 SG_ XBREBIMode : 0|2@1+ (1,0) [0|3] "" Vector__XXX
 SG_ ExtlAccelerationDemand : 0|16@1+ (0.000488281,-15.687) [-15.687|15.687] "m/s²" Vector__XXX
 SG_ WaterInFuelIndicator : 0|2@1+ (1,0) [0|3] "" Vector__XXX
 SG_ CargoWeight : 0|16@1+ (2,0) [0|128510] "kg" Vector__XXX
 SG_ ReferenceRetarderTorque : 0|16@1+ (1,0) [0|64255] "Nm" Vector__XXX
 SG_ TripDriveFuelEconomy : 0|16@1+ (0.00195313,0) [0|125.5] "km/L" Vector__XXX
 SG_ TripCruiseFuelUsed : 0|32@1+ (0.5,0) [0|2105540607.5] "kg" Vector__XXX
 SG_ TripVehicleIdleFuelUsed : 0|32@1+ (0.5,0) [0|2105540607.5] "kg" Vector__XXX
 SG_ TripPTONonmovingFuelUsed : 0|32@1+ (0.5,0) [0|2105540607.5] "kg" Vector__XXX
 SG_ TripPTOMovingFuelUsed : 0|32@1+ (0.5,0) [0|2105540607.5] "kg" Vector__XXX
 SG_ TripDriveFuelUsed : 0|32@1+ (0.5,0) [0|2105540607.5] "kg" Vector__XXX
 SG_ TripAverageFuelRate : 0|16@1+ (0.05,0) [0|3212.75] "kg/hr" Vector__XXX
 SG_ TotalEngPTOFuelUsed : 0|32@1+ (0.5,0) [0|2105540607.5] "kg" Vector__XXX
 SG_ PercentClutchSlip : 0|8@1+ (0.4,0) [0|100] "%" Vector__XXX
 SG_ MaxVehicleSpeedLimit : 0|8@1+ (1,0) [0|250] "km/h" Vector__XXX
 SG_ FailureModeIdentifier1 : 0|5@1+ (1,0) [0|0] "" Vector__XXX
 SG_ SPN1High : 0|3@1+ (1,0) [0|7] "" Vector__XXX
 SG_ SPN1 : 0|16@1+ (1,0) [0|65536] "" Vector__XXX
 SG_ FailureModeIdentifier1 : 0|5@1+ (1,0) [0|0] "" Vector__XXX
 SG_ SPN1High : 0|3@1+ (1,0) [0|7] "" Vector__XXX
 SG_ SPN1 : 0|16@1+ (1,0) [0|65536] "" Vector__XXX
 SG_ LiftAxle2Pos : 0|2@1+ (1,0) [0|3] "" Vector__XXX
 SG_ LiftAxle1Pos : 0|2@1+ (1,0) [0|3] "" Vector__XXX
 SG_ RoadCurvature : 0|16@1+ (0.0078125,-250) [-250|251.992] "1/km" Vector__XXX

CM_ BU_ EBS "Electronic Brake System";
CM_ BU_ EMS "Engine Management System";
CM_ BO_ 3221225472 "This is a message for not used signals, created by Vector CANdb++ DBC OLE DB Provider.";
CM_ SG_ 3221225472 FailureModeIdentifier1 "The FMI defines the type of failure detected in the subsystem identified by an SPN.The FMI defines the type of failure detected in the subsystem identified by an SPN.The FMI defines the type of failure detected in the subsystem identified by an SPN.";
CM_ SG_ 3221225472 SPN1High "SPN #1 (Conversion Version 4)SPN #1 (Conversion Version 4)SPN #1 (Conversion Version 4)";
CM_ SG_ 3221225472 SPN1 "SPN #1 (Conversion Version 4)SPN #1 (Conversion Version 4)SPN #1 (Conversion Version 4)";
CM_ SG_ 3221225472 TextDisplayInstructions "This parameter describes the status for the display how to show the information.";
CM_ SG_ 3221225472 MaxCrankAttemptsPerStartAttempt "The number of cranking cycles that will be performed before ending the start attempt.";
CM_ SG_ 3221225472 EngExhstGsRcirculationValve2Pos "The position of the second exhaust gas recirculation valve expressed as a percentage of full travel.";
CM_ SG_ 3221225472 EngExhstGsRecirculationValvePos "The position of the exhaust gas recirculation valve expressed as a percentage of full travel.";
CM_ SG_ 3221225472 EngExhstGsRcrculationValve2Ctrl "Desired percentage of maximum Exhaust Gas Recirculation (EGR) valve opening for valve 2.";
CM_ SG_ 3221225472 EngIntkVlvActtonOilPressForCyl4 "The gage pressure of the oil in the hydraulic accumulator that powers the engine intake valve for cylinder #4.";
CM_ SG_ 3221225472 EngIntkVlvActtonOilPressForCyl3 "The gage pressure of the oil in the hydraulic accumulator that powers the engine intake valve for cylinder #3.";
CM_ SG_ 3221225472 EngIntkVlvActtonOilPressForCyl2 "The gage pressure of the oil in the hydraulic accumulator that powers the engine intake valve for cylinder #2.";
CM_ SG_ 3221225472 EngIntkVlvActtonOilPressForCyl1 "The gage pressure of the oil in the hydraulic accumulator that powers the engine intake valve for cylinder #1.";
CM_ SG_ 3221225472 EngIntkVlvActtonOilPressForCyl8 "The gage pressure of the oil in the hydraulic accumulator that powers the engine intake valve for cylinder #8.";
CM_ SG_ 3221225472 EngIntkVlvActtonOilPressForCyl7 "The gage pressure of the oil in the hydraulic accumulator that powers the engine intake valve for cylinder #7.";
CM_ SG_ 3221225472 EngIntkVlvActtonOilPressForCyl6 "The gage pressure of the oil in the hydraulic accumulator that powers the engine intake valve for cylinder #6.";
CM_ SG_ 3221225472 EngIntkVlvActtonOilPressForCyl5 "The gage pressure of the oil in the hydraulic accumulator that powers the engine intake valve for cylinder #5.";
CM_ SG_ 3221225472 EngIntkVlvActtnOilPressForCyl12 "The gage pressure of the oil in the hydraulic accumulator that powers the engine intake valve for cylinder #12.";
CM_ SG_ 3221225472 EngIntkVlvActtnOilPressForCyl11 "The gage pressure of the oil in the hydraulic accumulator that powers the engine intake valve for cylinder #11.";
CM_ SG_ 3221225472 EngIntkVlvActtnOilPressForCyl10 "The gage pressure of the oil in the hydraulic accumulator that powers the engine intake valve for cylinder #10.";
CM_ SG_ 3221225472 EngIntkVlvActtonOilPressForCyl9 "The gage pressure of the oil in the hydraulic accumulator that powers the engine intake valve for cylinder #9.";
CM_ SG_ 3221225472 EngIntkVlvActtnOilPressForCyl16 "The gage pressure of the oil in the hydraulic accumulator that powers the engine intake valve for cylinder #16.";
CM_ SG_ 3221225472 EngIntkVlvActtnOilPressForCyl15 "The gage pressure of the oil in the hydraulic accumulator that powers the engine intake valve for cylinder #15.";
CM_ SG_ 3221225472 EngIntkVlvActtnOilPressForCyl14 "The gage pressure of the oil in the hydraulic accumulator that powers the engine intake valve for cylinder #14.";
CM_ SG_ 3221225472 EngIntkVlvActtnOilPressForCyl13 "The gage pressure of the oil in the hydraulic accumulator that powers the engine intake valve for cylinder #13.";
CM_ SG_ 3221225472 EngIntkVlvActtnOilPressForCyl20 "The gage pressure of the oil in the hydraulic accumulator that powers the engine intake valve for cylinder #20.";
CM_ SG_ 3221225472 EngIntkVlvActtnOilPressForCyl19 "The gage pressure of the oil in the hydraulic accumulator that powers the engine intake valve for cylinder #19.";
CM_ SG_ 3221225472 EngIntkVlvActtnOilPressForCyl18 "The gage pressure of the oil in the hydraulic accumulator that powers the engine intake valve for cylinder #18.";
CM_ SG_ 3221225472 EngIntkVlvActtnOilPressForCyl17 "The gage pressure of the oil in the hydraulic accumulator that powers the engine intake valve for cylinder #17.";
CM_ SG_ 3221225472 J2012DTCOccurrenceCount "Number of occurrences of the respective SAE J2012 DTC being conveyed.";
CM_ SG_ 3221225472 J2012DTCStatus "Indicates if the respective SAE J2012 DTC is active or previously active.";
CM_ SG_ 3221225472 NumberOfJ2012DTCs "The number J2012 DTCs being conveyed in PGN 64906.";
CM_ SG_ 3221225472 PrtcltTrpActvRgnrtnInhbtdDTOtOfN "Indicates the state of particulate trap active regeneration inhibition due to the transmission being out of neutral.";
CM_ SG_ 3221225472 PrtcltTrpActvRgnrtnInhbtdDTAcclP "Indicates the state of particulate trap active regeneration inhibition due to the accelerator pedal being off idle.";
CM_ SG_ 3221225472 PrtcltTrpActvRgnrtnInhbtdDTPTOAc "Indicates the state of particulate trap active regeneration inhibition due to the PTO being active.";
CM_ SG_ 3221225472 PrtcltTrpActvRgnrtnInhbtdDTSrvcB "Indicates the state of particulate trap active regeneration inhibition due to the service brake being active.";
CM_ SG_ 3221225472 PrtcltTrpActvRgnrtnInhbtdDTCltch "Indicates the state of particulate trap active regeneration inhibition due to the clutch being disengaged.";
CM_ SG_ 3221225472 PrtcltTrpActvRgnrtnInhbtdDTInhbt "Indicates the state of particulate trap active regeneration inhibition due to the Particulate Trap Regeneration Inhibit Switch.";
CM_ SG_ 3221225472 PrtcltTrpActvRgnrtnInhbtdStatus "Indicates the state of particulate trap active regeneration inhibition.";
CM_ SG_ 3221225472 ParticulateTrapStatus "Indicates the state of the particulate trap regeneration need and urgency.";
CM_ SG_ 3221225472 PrtcltTrpActvRegenerationStatus "Indicates the state of particulate trap active regeneration.";
CM_ SG_ 3221225472 PrtcltTrpPssvRegenerationStatus "Indicates the state of particulate trap passive regeneration.";
CM_ SG_ 3221225472 ParticulateTrapLampCmd "Command to control the particulate trap lamp.";
CM_ SG_ 3221225472 MessageChecksum "The message checksum is used to verify the signal path from the demanding device to the steering controller .";
CM_ SG_ 3221225472 MessageCounter "The message counter is to verify the signal path from the demanding device to the steering controller.";
CM_ SG_ 3221225472 SteerAngleSensorCalibrated "This signal indicates the calibration status of the steering angle sensor.";
CM_ SG_ 3221225472 SteerAngleSensorActiveMode "This signal indicates the operational mode of the steering angle sensor.";
CM_ SG_ 3221225472 SteerWheelAngleRange "The signal indicates the range of the steering wheel angle the sensor element is capable to measure.";
CM_ SG_ 3221225472 SteerWheelAngle "The main operator`s steering wheel angle (on the steering column, not the actual wheel angle).";
CM_ SG_ 3221225472 TransferCaseStatus "This parameter describes the feedback from the transfer case controller .";
CM_ SG_ 3221225472 TransTorqueConvOilOutlTemp "Temperature of transmission torque converter outlet oil.";
CM_ SG_ 3221225472 TransmissionOilLifeRemaining "Signal which indicates the actual oil life remaining in percent.";
CM_ SG_ 3221225472 TransOilLevelSwitch "This switch indicates whether transmission oil level is full or empty.";
CM_ SG_ 3221225472 TransOilFilterRestrictionSwitch "This switch indicates whether the transmission oil filter is clogged.";
CM_ SG_ 3221225472 VehicleRoll "This parameter indicates the roll in degrees from level.";
CM_ SG_ 3221225472 TotalEngCruiseTime "Total time that the engine has operated in the cruise hold state, excluding time in accelerator override, over the life of the engine.";
CM_ SG_ 3221225472 TripAverageEngSpeed "Average speed of the engine since the last trip reset.";
CM_ SG_ 3221225472 TripMaxEngSpeed "Maximum engine speed achieved since the last trip reset.";
CM_ SG_ 3221225472 ImplementRearWorkLight "This parameter provides measured data from the implement rear work lamps.";
CM_ SG_ 3221225472 ImplementLeftForwardWorkLight "This parameter provides measured data from the forward facing work lights toward the left end of the implement.";
CM_ SG_ 3221225472 ImplementRightForwardWorkLight "This parameter provides measured data from the forward facing work lights toward the right end of the implement.";
CM_ SG_ 3221225472 ImplementOEMOption1Light "This parameter provides measured data from the implement OEM option 1 light.";
CM_ SG_ 3221225472 ImplementOEMOption2Light "This parameter provides measured data from the implement OEM option 2 light.";
CM_ SG_ 3221225472 TrctrFrontHighMountedWorkLights "This parameter provides measured data from the tractor front high mounted work lights.";
CM_ SG_ 3221225472 TrctorFrontLowMountedWorkLights "This parameter provides measured data from the tractor front low mounted work lights.";
CM_ SG_ 3221225472 TrctorSideHighMountedWorkLights "This parameter provides measured data from the tractor side high mounted work lights.";
CM_ SG_ 3221225472 TractorSideLowMountedWorkLights "This parameter provides measured data from the tractor side low mounted work lights.";
CM_ SG_ 3221225472 TrctorRearHighMountedWorkLights "This parameter provides measured data from the tractor rear high mounted work lights.";
CM_ SG_ 3221225472 TractorRearLowMountedWorkLights "This parameter provides measured data from the tractor rear low mounted work lights.";
CM_ SG_ 3221225472 TrctrUndersideMountedWorkLights "This parameter provides measured data from the tractor underside mounted work lights.";
CM_ SG_ 3221225472 RearFogLights "This parameter provides measured data from the tractor and/or implement rear fog lights.";
CM_ SG_ 3221225472 TractorClearanceLight "This parameter provides measured data from the tractor high mounted clearance and center ID lights.";
CM_ SG_ 3221225472 ImplementClearanceLight "This parameter provides measured data from an attached implement high mounted clearance lights.";
CM_ SG_ 3221225472 LeftStopLight "This parameter provides measured data from the tractor and attached implement left stop lights.";
CM_ SG_ 3221225472 RightStopLight "This parameter provides measured data from the tractor and attached implement right stop lights.";
CM_ SG_ 3221225472 CenterStopLight "This parameter provides measured data from the tractor and attached implement center stop lights.";
CM_ SG_ 3221225472 BackUpLightAndAlarmHorn "This parameter provides measured data from the back up lights and/ or associated alarm.";
CM_ SG_ 3221225472 LeftTurnSignalLights "This parameter provides measured data from the tractor and attached implement left turn signal lights.";
CM_ SG_ 3221225472 RightTurnSignalLights "This parameter provides measured data from the tractor and attached implement right turn signal lights.";
CM_ SG_ 3221225472 RotatingBeaconLight "This parameter provides measured data from the beacon light on tractor or attached implements.";
CM_ SG_ 3221225472 TractorFrontFogLights "This parameter provides measured data from the tractor front fog lights.";
CM_ SG_ 3221225472 HighBeamHeadLightData "This parameter provides measured data from the tractor high beam head light lamps.";
CM_ SG_ 3221225472 LowBeamHeadLightData "This parameter provides measured data from the tractor low beam head light lamps.";
CM_ SG_ 3221225472 AltBeamHeadLightData "This parameter provides measured data from the tractor alternate beam head light lamps.";
CM_ SG_ 3221225472 RunningLight "This parameter provides measured data from the vehicle’s running lights.";
CM_ SG_ 3221225472 ImplementRearWorkLightCmd "Command to activate or de-activate implement rear work lights.";
CM_ SG_ 3221225472 ImplmentLeftForwardWorkLightCmd "Command to activate or de-activate the forward facing work lights toward the left end of the implement.";
CM_ SG_ 3221225472 ImplmntRightForwardWorkLightCmd "Command to activate or de-activate the forward facing work lights toward the right end of the implement.";
CM_ SG_ 3221225472 ImplementLeftFacingWorkLightCmd "Command to activate or de-activate work lights mounted on an implement to illuminate beyond left end of the implement.";
CM_ SG_ 3221225472 ImplmentRightFacingWorkLightCmd "Command to activate or de-activate work lights mounted on an implement to illuminate beyond right end of the implement.";
CM_ SG_ 3221225472 ImplementOEMOption1LightCmd "Command to activate or de-activate an implement OEM option 1 light.";
CM_ SG_ 3221225472 ImplementOEMOption2LightCmd "Command to activate or de-activate an implement OEM option 2 light.";
CM_ SG_ 3221225472 TrctrFrntHghMuntedWorkLightsCmd "Command to activate or de-activate the tractor front high mounted work lights.";
CM_ SG_ 3221225472 TrctrFrntLwMountedWorkLightsCmd "Command to activate or de-activate the tractor front low mounted work lights.";
CM_ SG_ 3221225472 TrctrSdHighMountedWorkLightsCmd "Command to activate or de-activate the tractor side high mounted work lights.";
CM_ SG_ 3221225472 TrctrSdeLowMountedWorkLightsCmd "Command to activate or de-activate the tractor side low mounted work lights.";
CM_ SG_ 3221225472 TrctrRrHighMountedWorkLightsCmd "Command to activate or de-activate the tractor rear high mounted work lights.";
CM_ SG_ 3221225472 TrctrRarLowMountedWorkLightsCmd "Command to activate or de-activate the tractor rear low mounted work lights.";
CM_ SG_ 3221225472 TrctrUndrsdMountedWorkLightsCmd "Command to activate or de-activate the tractor underside mounted work lights.";
CM_ SG_ 3221225472 RearFogLightCmd "Command to activate or de-activate tractor or implement rear fog lights.";
CM_ SG_ 3221225472 ImplementClearanceLightCmd "Command to activate or de-activate the implement high mounted clearance and lights.";
CM_ SG_ 3221225472 RotatingBeaconLightCmd "Command to activate or de-activate slow moving vehicle indicator lights on tractor and/or implements.";
CM_ SG_ 3221225472 TractorFrontFogLightsCmd "Command to activate or de-activate tractor front fog lights.";
CM_ SG_ 3221225472 HighBeamHeadLightCmd "Command to activate or de-activate the tractor high beam head light lamps.";
CM_ SG_ 3221225472 LowBeamHeadLightCmd "Command to activate or de-activate the tractor low beam head light lamps.";
CM_ SG_ 3221225472 AltBeamHeadLightCmd "Command to activate or de-activate the tractor alternate head lights (only low beam is available on alternate head lights).";
CM_ SG_ 3221225472 RunningLightCmd "Command to activate or de-activate the tractor or powered vehicle running lights.";
CM_ SG_ 3221225472 BladeCtrlMode "Allows the user to select the type of blade control for the land leveling system.";
CM_ SG_ 3221225472 BladeDurationAndDirection "Used to indicate the duration and direction that the land leveling system blade moves.";
CM_ SG_ 3221225472 EngActualIgntTiming "The actual ignition timing at the current engine conditions.";
CM_ SG_ 3221225472 EngDesiredIgntTiming3 "A programmable timing value specific to the engine’s application.";
CM_ SG_ 3221225472 EngDesiredIgntTiming2 "A programmable timing value specific to the engine’s application.";
CM_ SG_ 3221225472 EngDesiredIgntTiming1 "A programmable timing value specific to the engine’s application.";
CM_ SG_ 3221225472 EngCyl20IgntTiming "The ignition timing of the cylinder.";
CM_ SG_ 3221225472 EngCyl19IgntTiming "The ignition timing of the cylinder.";
CM_ SG_ 3221225472 EngCyl18IgntTiming "The ignition timing of the cylinder.";
CM_ SG_ 3221225472 EngCyl17IgntTiming "The ignition timing of the cylinder.";
CM_ SG_ 3221225472 EngCyl16IgntTiming "The ignition timing of the cylinder.";
CM_ SG_ 3221225472 EngCyl15IgntTiming "The ignition timing of the cylinder.";
CM_ SG_ 3221225472 EngCyl14IgntTiming "The ignition timing of the cylinder.";
CM_ SG_ 3221225472 EngCyl13IgntTiming "The ignition timing of the cylinder.";
CM_ SG_ 3221225472 EngCyl12IgntTiming "The ignition timing of the cylinder.";
CM_ SG_ 3221225472 EngCyl11IgntTiming "The ignition timing of the cylinder.";
CM_ SG_ 3221225472 EngCyl10IgntTiming "The ignition timing of the cylinder.";
CM_ SG_ 3221225472 EngCyl9IgntTiming "The ignition timing of the cylinder.";
CM_ SG_ 3221225472 EngCyl8IgntTiming "The ignition timing of the cylinder.";
CM_ SG_ 3221225472 EngCyl7IgntTiming "The ignition timing of the cylinder.";
CM_ SG_ 3221225472 EngCyl6IgntTiming "The ignition timing of the cylinder.";
CM_ SG_ 3221225472 EngCyl5IgntTiming "The ignition timing of the cylinder.";
CM_ SG_ 3221225472 EngCyl4IgntTiming "The ignition timing of the cylinder.";
CM_ SG_ 3221225472 EngCyl3IgntTiming "The ignition timing of the cylinder.";
CM_ SG_ 3221225472 EngCyl2IgntTiming "The ignition timing of the cylinder.";
CM_ SG_ 3221225472 EngCyl1IgntTiming "The ignition timing of the cylinder.";
CM_ SG_ 3221225472 EngCyl20IgntTransSecondOutput "This parameter indicates the relative intensity of the secondary output voltage of the ignition transformer.";
CM_ SG_ 3221225472 EngCyl19IgntTransSecondOutput "This parameter indicates the relative intensity of the secondary output voltage of the ignition transformer.";
CM_ SG_ 3221225472 EngCyl18IgntTransSecondOutput "This parameter indicates the relative intensity of the secondary output voltage of the ignition transformer.";
CM_ SG_ 3221225472 EngCyl17IgntTransSecondOutput "This parameter indicates the relative intensity of the secondary output voltage of the ignition transformer.";
CM_ SG_ 3221225472 EngCyl16IgntTransSecondOutput "This parameter indicates the relative intensity of the secondary output voltage of the ignition transformer.";
CM_ SG_ 3221225472 EngCyl15IgntTransSecondOutput "This parameter indicates the relative intensity of the secondary output voltage of the ignition transformer.";
CM_ SG_ 3221225472 EngCyl14IgntTransSecondOutput "This parameter indicates the relative intensity of the secondary output voltage of the ignition transformer.";
CM_ SG_ 3221225472 EngCyl13IgntTransSecondOutput "This parameter indicates the relative intensity of the secondary output voltage of the ignition transformer.";
CM_ SG_ 3221225472 EngCyl12IgntTransSecondOutput "This parameter indicates the relative intensity of the secondary output voltage of the ignition transformer.";
CM_ SG_ 3221225472 EngCyl11IgntTransSecondOutput "This parameter indicates the relative intensity of the secondary output voltage of the ignition transformer.";
CM_ SG_ 3221225472 EngCyl10IgntTransSecondOutput "This parameter indicates the relative intensity of the secondary output voltage of the ignition transformer.";
CM_ SG_ 3221225472 EngCyl9IgntTransSecondOutput "This parameter indicates the relative intensity of the secondary output voltage of the ignition transformer.";
CM_ SG_ 3221225472 EngCyl8IgntTransSecondOutput "This parameter indicates the relative intensity of the secondary output voltage of the ignition transformer.";
CM_ SG_ 3221225472 EngCyl7IgntTransSecondOutput "This parameter indicates the relative intensity of the secondary output voltage of the ignition transformer.";
CM_ SG_ 3221225472 EngCyl6IgntTransSecondOutput "This parameter indicates the relative intensity of the secondary output voltage of the ignition transformer.";
CM_ SG_ 3221225472 EngCyl5IgntTransSecondOutput "This parameter indicates the relative intensity of the secondary output voltage of the ignition transformer.";
CM_ SG_ 3221225472 EngCyl4IgntTransSecondOutput "This parameter indicates the relative intensity of the secondary output voltage of the ignition transformer.";
CM_ SG_ 3221225472 EngCyl3IgntTransSecondOutput "This parameter indicates the relative intensity of the secondary output voltage of the ignition transformer.";
CM_ SG_ 3221225472 EngCyl2IgntTransSecondOutput "This parameter indicates the relative intensity of the secondary output voltage of the ignition transformer.";
CM_ SG_ 3221225472 EngCyl1IgntTransSecondOutput "This parameter indicates the relative intensity of the secondary output voltage of the ignition transformer.";
CM_ SG_ 3221225472 EngOprtrPrmryIntrmdtSpdSlctStte "13 preprogrammed intermediate speed control settings are availible for the contolling ECM to select.";
CM_ SG_ 3221225472 EngOprtrPrmryIntrmdtSpeedSelect "Allows the operator to select one of 13 preprogrammed Intermediate Speed Control settings.";
CM_ SG_ 3221225472 EngTotalIdleHours "Accumulated time of operation of the engine while under idle conditions.";
CM_ SG_ 3221225472 EngTotalIdleFuelUsed "Accumulated amount of fuel used during vehicle operation while under idle conditions.";
CM_ SG_ 3221225472 EngIntakeManifold6Temp "Temperature of pre-combustion air found in intake manifold number 6 of engine air supply system.";
CM_ SG_ 3221225472 EngIntakeManifold5Temp "Temperature of pre-combustion air found in intake manifold number 5 of engine air supply system.";
CM_ SG_ 3221225472 EngIntakeManifold4Temp "Temperature of pre-combustion air found in intake manifold of engine air supply system.";
CM_ SG_ 3221225472 EngIntakeManifold3Temp "Temperature of pre-combustion air found in intake manifold of engine air supply system.";
CM_ SG_ 3221225472 EngIntakeManifold2Temp "Temperature of pre-combustion air found in intake manifold of engine air supply system.";
CM_ SG_ 3221225472 EngTurbo4BoostPress "Gage pressure of air measured downstream of the compressor discharge side of the turbocharger.";
CM_ SG_ 3221225472 EngTurbo3BoostPress "Gage pressure of air measured downstream of the compressor discharge side of the turbocharger.";
CM_ SG_ 3221225472 EngTurbo2BoostPress "Gage pressure of air measured downstream of the compressor discharge side of the turbocharger.";
CM_ SG_ 3221225472 EngTurbo1BoostPress "Gage pressure of air measured downstream of the compressor discharge side of the turbocharger.";
CM_ SG_ 3221225472 EngIntakeManifold2Press "The gage pressure measurement of the air intake manifold for bank #2 or the second air intake manifold.";
CM_ SG_ 3221225472 EngIntakeManifold1AbsPress "The absolute pressure measurement of the air intake manifold.";
CM_ SG_ 3221225472 CabHeatingZone "Parameter indicating whether the cab zone is being heated.";
CM_ SG_ 3221225472 EngHeatingZone "Parameter indicating whether the engine zone is being heated.";
CM_ SG_ 3221225472 CabVentilation "Indicates whether the cab is being ventilated or not.";
CM_ SG_ 3221225472 AuxHeaterOutputPowerPercent "Current auxiliary heater output power, relative to the auxiliary heater maximum output power.";
CM_ SG_ 3221225472 AuxHeaterInputAirTemp "Temperature of the input air in an auxiliary heater system.";
CM_ SG_ 3221225472 AuxHeaterOutputCoolantTemp "Temperature of the auxiliary heater output coolant (I.";
CM_ SG_ 3221225472 RearAxleRightWheelSpeed "High resolution measurement of the speed of the right wheel on the rear axle.";
CM_ SG_ 3221225472 RearAxleLeftWheelSpeed "High resolution measurement of the speed of the left wheel on the rear axle.";
CM_ SG_ 3221225472 FrontAxleRightWheelSpeed "High resolution measurement of the speed of the right wheel on the front axle.";
CM_ SG_ 3221225472 FrontAxleLeftWheelSpeed "High resolution measurement of the speed of the left wheel on the front axle.";
CM_ SG_ 3221225472 EngHydPrssGovernorModeIndicator "Mode for governor operation is hydraulic pressure control.";
CM_ SG_ 3221225472 HydPress "Hydraulic pressure measured at the output of the hydraulic pump.";
CM_ SG_ 3221225472 HydBrakeFluidLevelSwitch "Signal which indicates whether the hydraulic fluid level in the reservoir(s) is sufficient.";
CM_ SG_ 3221225472 HydBrakeSystemAudibleWarningCmd "Signal which commands an audible warning by the hydraulic braking system.";
CM_ SG_ 3221225472 TripCruiseFuelUsed "Total fuel consumed while the engine is in the cruise hold state since the last trip reset.Total fuel consumed while the engine is in the cruise hold state since the last trip reset.";
CM_ SG_ 3221225472 EngFuelValve1OutletAbsPress "Absolute Pressure of gas on outlet side of the first or only fuel system control valve.";
CM_ SG_ 3221225472 EngAirToFuelDiffPress "The differential pressure between the gaseous fuel and the air intake manifold.";
CM_ SG_ 3221225472 EngFuelValveDiffPress "The differential pressure between the inlet and the outlet of a gaseous fuel valve.";
CM_ SG_ 3221225472 EngFuelValveInletAbsPress "The absolute pressure at the inlet of the gaseous fuel valve.";
CM_ SG_ 3221225472 EngFuelFlowRate2 "The rate at which the fuel is flowing through a fuel valve.";
CM_ SG_ 3221225472 EngFuelFlowRate1 "The rate at which the fuel is flowing through a fuel valve.";
CM_ SG_ 3221225472 EngRqedFuelValve1Pos "The requested position of a gaseous fuel valve 1 that is metering the fuel flow to the engine.";
CM_ SG_ 3221225472 EngFuelValve2Pos "The position of a gaseous fuel valve that is metering the fuel flow to the engine.";
CM_ SG_ 3221225472 EngFuelValve1Pos "The position of a gaseous fuel valve that is metering the fuel flow to the engine.";
CM_ SG_ 3221225472 EngFuelSpecificGravity "This parameter conveys the specific gravity of the gaseous fuel being used by the engine.";
CM_ SG_ 3221225472 TripAverageFuelRate "Average fuel rate, equal to trip fuel divided by trip time while the engine speed is above zero, since the last trip reset.Average fuel rate, equal to trip fuel divided by trip time while the engine speed is above zero, since the last trip reset.";
CM_ SG_ 3221225472 TotalEngPTOFuelUsed "Total fuel used while the PTO or remote PTO is in the hold state and engine speed is above zero, over the life of the engine.Total fuel used while the PTO or remote PTO is in the hold state and engine speed is above zero, over the life of the engine.";
CM_ SG_ 3221225472 SpecificHeatRatio "The specific heat ratio of the fuel.";
CM_ SG_ 3221225472 TotalFuelUsed "Total fuel consumed (trip drive fuel + trip PTO moving fuel + trip PTO non-moving fuel + trip idle fuel) over the life of the engine.";
CM_ SG_ 3221225472 TripFuel "Total fuel consumed (trip drive fuel + trip PTO moving fuel + trip PTO non-moving fuel + trip idle fuel) since the last trip reset.";
CM_ SG_ 3221225472 EnggmntSttusTransInputShaftPTO1 "Reports if this specific PTO drive is engaged.";
CM_ SG_ 3221225472 EnggmntSttusTransInputShaftPTO2 "Reports if this specific PTO drive is engaged.";
CM_ SG_ 3221225472 EnggmntSttusTransOutputShaftPTO "Reports if this specific PTO drive is engaged.";
CM_ SG_ 3221225472 EnggmntSttsTrnsfrCsOtptShaftPTO "Reports if this specific PTO drive is engaged.";
CM_ SG_ 3221225472 EnggmntCnsntTransInputShaftPTO1 "Status of the transmission controller’s consent to engage the first or sole PTO drive mounted on the transmission case.";
CM_ SG_ 3221225472 EnggmntCnsntTransInputShaftPTO2 "Status of the transmission controller’s consent to engage the second PTO drive mounted on the transmission case.";
CM_ SG_ 3221225472 EnggmntCnsntTransOutputShaftPTO "Status of the transmission controller’s consent to engage the PTO drive connected to the transmission output shaft.";
CM_ SG_ 3221225472 EnggmntCnsntTrnsfrCsOtptShftPTO "Status of the transmission controller’s consent to engage the PTO drive connected to the transfer case output shaft.";
CM_ SG_ 3221225472 EngFuelValve2OutletAbsPress "Absolute pressure of gas on outlet side of the second fuel system control valve.";
CM_ SG_ 3221225472 EngFuelTemp2 "Temperature 2 of fuel (or gas).";
CM_ SG_ 3221225472 EngCentrifugalOilFilterSpeed "The speed of a rotating (centrifugal) engine oil filter.";
CM_ SG_ 3221225472 EngCoolantPumpDiffPress "The differential pressure measured across the input and output of the engine coolant pump.";
CM_ SG_ 3221225472 EngIntercoolerCoolantLevel "Ratio of volume of liquid found in an engine intercooler cooling system to total engine intercooler cooling system volume.";
CM_ SG_ 3221225472 EngAftercoolerCoolantLevel "Ratio of aftercooler coolant system volume of liquid to total cooling system volume.";
CM_ SG_ 3221225472 EngVrableGeometryTurboActuator1 "Actuator that controls the variable geometry turbocharger geometry.";
CM_ SG_ 3221225472 EnableStatusOfDoor10 "Enable status of bus door 10.";
CM_ SG_ 3221225472 EnableStatusOfDoor9 "Enable status of bus door 9.";
CM_ SG_ 3221225472 EnableStatusOfDoor8 "Enable status of bus door 8.";
CM_ SG_ 3221225472 EnableStatusOfDoor7 "Enable status of bus door 7.";
CM_ SG_ 3221225472 EnableStatusOfDoor6 "Enable status of bus door 6.";
CM_ SG_ 3221225472 EnableStatusOfDoor5 "Enable status of bus door 5.";
CM_ SG_ 3221225472 EnableStatusOfDoor4 "Enable status of bus door 4.";
CM_ SG_ 3221225472 EnableStatusOfDoor3 "Enable status of bus door 3.";
CM_ SG_ 3221225472 EnableStatusOfDoor2 "Enable status of bus door 2.";
CM_ SG_ 3221225472 EnableStatusOfDoor1 "Enable status of bus door 1.";
CM_ SG_ 3221225472 CatalystReagentType "This parameter indicates what reagent is in the tank.";
CM_ SG_ 3221225472 CtlystRgntPrprtesPreliminaryFMI "Used to identify the applicable J1939-73 FMI that applies to the most significant failure of the catalyst reagent properties sensor.";
CM_ SG_ 3221225472 CtlystRagentTemp2PreliminaryFMI "Used to identify the applicable J1939-73 FMI that applies to the most significant failure of the catalyst temperature sensor.";
CM_ SG_ 3221225472 CatalystReagentConductivity "A measure of the conductivity of the reagent or fluid at the sensor.";
CM_ SG_ 3221225472 CatalystReagentConcentration "A measure of the concentration of urea in water.";
CM_ SG_ 3221225472 RqdGnrtrAvrgLneLineACRMSVoltage "The requested average AC RMS voltage to be delivered by the generator.";
CM_ SG_ 3221225472 EngCyl24KnockLevel "Used to indicate the level of knock for engine cylinder 24.";
CM_ SG_ 3221225472 EngCyl23KnockLevel "Used to indicate the level of knock for engine cylinder 23.";
CM_ SG_ 3221225472 EngCyl22KnockLevel "Used to indicate the level of knock for engine cylinder 22.";
CM_ SG_ 3221225472 EngCyl21KnockLevel "Used to indicate the level of knock for engine cylinder 21.";
CM_ SG_ 3221225472 EngCyl20KnockLevel "Used to indicate the level of knock for engine cylinder 20.";
CM_ SG_ 3221225472 EngCyl19KnockLevel "Used to indicate the level of knock for engine cylinder 19.";
CM_ SG_ 3221225472 EngCyl18KnockLevel "Used to indicate the level of knock for engine cylinder 18.";
CM_ SG_ 3221225472 EngCyl17KnockLevel "Used to indicate the level of knock for engine cylinder 17.";
CM_ SG_ 3221225472 EngCyl15KnockLevel "Used to indicate the level of knock for engine cylinder 15.";
CM_ SG_ 3221225472 EngCyl14KnockLevel "Used to indicate the level of knock for engine cylinder 14.";
CM_ SG_ 3221225472 EngCyl13KnockLevel "Used to indicate the level of knock for engine cylinder 13.";
CM_ SG_ 3221225472 EngCyl12KnockLevel "Used to indicate the level of knock for engine cylinder 12.";
CM_ SG_ 3221225472 EngCyl11KnockLevel "Used to indicate the level of knock for engine cylinder 11.";
CM_ SG_ 3221225472 EngCyl10KnockLevel "Used to indicate the level of knock for engine cylinder 10.";
CM_ SG_ 3221225472 EngCyl9KnockLevel "Used to indicate the level of knock for engine cylinder 9.";
CM_ SG_ 3221225472 EngCyl16KnockLevel "Used to indicate the level of knock for engine cylinder 16.";
CM_ SG_ 3221225472 EngCyl8KnockLevel "Used to indicate the level of knock for engine cylinder 8.";
CM_ SG_ 3221225472 EngCyl7KnockLevel "Used to indicate the level of knock for engine cylinder 7.";
CM_ SG_ 3221225472 EngCyl6KnockLevel "Used to indicate the level of knock for engine cylinder 6.";
CM_ SG_ 3221225472 EngCyl5KnockLevel "Used to indicate the level of knock for engine cylinder 5.";
CM_ SG_ 3221225472 EngCyl4KnockLevel "Used to indicate the level of knock for engine cylinder 4.";
CM_ SG_ 3221225472 EngCyl3KnockLevel "Used to indicate the level of knock for engine cylinder 3.";
CM_ SG_ 3221225472 EngCyl2KnockLevel "Used to indicate the level of knock for engine cylinder 2.";
CM_ SG_ 3221225472 EngCyl1KnockLevel "Used to indicate the level of knock for engine cylinder 1.";
CM_ SG_ 3221225472 RqGenOverallPowerFactorLagging "The requested lead/lag status for the generator average AC power factor";
CM_ SG_ 3221225472 RqGeneratorOverallPowerFactor "The requested average power factor of the generator.";
CM_ SG_ 3221225472 RqGeneratorTotalACReactivePower "The total reactive power requested to be delivered by the generator";
CM_ SG_ 3221225472 BladeRotationAngleFigureOfMerit "Figure of merit for blade rotation measurement.";
CM_ SG_ 3221225472 RelBladeHeightFigureOfMerit "Figure of merit for blade height measurement.";
CM_ SG_ 3221225472 RelBladeMeasurementLatency "The estimated measurement latency of the measurement.";
CM_ SG_ 3221225472 BladeRotationAngle "The blade rotation angle measurement around the yaw (z-axis).";
CM_ SG_ 3221225472 RelativeBladeHeight "The measured vertical distance from a fixed location on the machine blade to a ground-based reference.";
CM_ SG_ 3221225472 RetarderDemandValue "The demanded value of the retarder on the towed vehicle(s) as a percentage of the absolute peak torque of retarder.";
CM_ SG_ 3221225472 ParkBrakeDemandValue "The requested brake pressure value of the parking brake as a percentage of maximum.";
CM_ SG_ 3221225472 ServiceBrakeDemandValue "The requested brake pressure value of the service brake demanded by the driver.";
CM_ SG_ 3221225472 VehicleType "Information to identify a dolly axle within the road train.Information to identify a dolly axle within the road train.Information to identify a dolly axle within the road train.Information to identify a dolly axle within the road train.";
CM_ SG_ 3221225472 BrakeLightSwitch "Signal which indicates that the brake pedal is being pressed.";
CM_ SG_ 3221225472 ASREngineControlActive "Signal which indicates that ASR engine control is active/passive.";
CM_ SG_ 3221225472 ASRBreakControlActive "Signal which indicates that ASR brake control is active/passive.";
CM_ SG_ 3221225472 VehicleRetarderCtrlActive "This signal indicates the active/passive state in all cases when the installed retarder is applied by the driver’s demand or by other systems (brakes).This signal indicates the active/passive state in all cases when the installed retarder is applied by the driver’s demand or by other systems (brakes).This signal indicates the active/passive state in all cases when the installed retarder is applied by the driver’s demand or by other systems (brakes).This signal indicates the active/passive state in all cases when the installed retarder is applied by the driver’s demand or by other systems (brakes).";
CM_ SG_ 3221225472 VehicleABSActive "Signal indicating the ABS is active/passive.Signal indicating the ABS is active/passive.Signal indicating the ABS is active/passive.";
CM_ SG_ 3221225472 RoadCurvature "Estimated value of the current road curvature for use by the adaptive cruise control system.Estimated value of the current road curvature for use by the adaptive cruise control system.";
CM_ SG_ 3221225472 PneumaticControlLine "Signal which indicates that the towing vehicle has a pneumatic control line for the towed vehicle service braking system";
CM_ SG_ 3221225472 ABSOffroadRequest "Request to activate the ABS off-road function. The switch signal is independent of an actual ABS control situation.";
CM_ SG_ 3221225472 TwoElCircuitsBrakeDemand "Signal which indicates that the service brake demand value sent by the towing vehicle can be generated by one or two independent electrical braking circuit(s).";
CM_ SG_ 3221225472 WheelSpeedDiffMainAxle "Difference between the wheel speed at the right side and and the left side of the main axle.";
CM_ SG_ 3221225472 ActualRetarderPercTorque "Actual torque of the retarder as negative percentage of maximum.";
CM_ SG_ 3221225472 Wheel_BasedVehicleSpeed "Actual speed of the vehicle (positive value for forward and backward speed) calculated as the average of the wheel speeds of one axle influenced by slip and filtered by a frequency range of 5 Hz to 20 Hz.";
CM_ SG_ 3221225472 SupplyLineBrakingRequest "Signal indicating the trailer is requesting to be braked by the commercial vehicle by means of bleeding the pneumatic supply line.Signal indicating the trailer is requesting to be braked by the commercial vehicle by means of bleeding the pneumatic supply line.";
CM_ SG_ 3221225472 VDCActive "Signal which indicates that Vehicle Dynamic Control (VDC) is active/passive.";
CM_ SG_ 3221225472 AutomTowedVehBreakActive "Signal indicating the automatic towed vehicle braking is active/passive.Signal indicating the automatic towed vehicle braking is active/passive.";
CM_ SG_ 3221225472 VehicleServiceBrakeActive "Signal indicating the service brake of the towed vehicle is active/passive, by observing the brake pressure.Signal indicating the service brake of the towed vehicle is active/passive, by observing the brake pressure.";
CM_ SG_ 3221225472 ReferenceRetarderTorque "This parameter is the 100% reference value for all defined indicated retarder torque parameters.This parameter is the 100% reference value for all defined indicated retarder torque parameters.";
CM_ SG_ 3221225472 AxleLoadSum "Sum of the static vertical loads of the vehicle axles.";
CM_ SG_ 3221225472 LoadingRampApproachAssist "The parameter indicates whether the loading ramp approach assistance is activated.";
CM_ SG_ 3221225472 SpringBrakeEngaged "Signal indicating the vehicle spring brake is engaged.";
CM_ SG_ 3221225472 ElectrLoadPropFunc "Signal indicating the vehicle is equipped with an electrical load proportional function.";
CM_ SG_ 3221225472 SpringBrakeInstalled "Signal indicating the vehicle has one or more axle(s) fitted with spring brakes.";
CM_ SG_ 3221225472 ElecSupplyOfNonBrakingSys "Signal which indicates the status of the supply of non-braking systems.";
CM_ SG_ 3221225472 AmberWarningSignalReq "Request from the towed vehicle to the commercial vehicle to activate the amber warning signal on the commercial vehicle.";
CM_ SG_ 3221225472 RedWarningSignalRequest "Request from the towed vehicle to the commercial vehicle to activate the red warning signal on the commercial vehicle, which indicates certain specified failures within the braking equipment of the towed vehicles.";
CM_ SG_ 3221225472 VehicleElectrSupplySuff "Signal indicating the actual supply voltage is sufficient/insufficient for proper brake function (including over voltage).";
CM_ SG_ 3221225472 PneumaticSupplyPressure "Actual supply pressure of the reservoir of the braking system.";
CM_ SG_ 3221225472 BrakeTemperature "Actual brake temperature.";
CM_ SG_ 3221225472 BrakeLining "Actual relative value of brake lining of a specific brake.";
CM_ SG_ 3221225472 TyrePressure "Actual tyre pressure without corrections.";
CM_ SG_ 3221225472 TyreWheelIdentTemp2 "Second part of identification number of the tyre or wheel (the number of axles).";
CM_ SG_ 3221225472 TyreWheelIdentTemp1 "First part of identification number of the tyre or wheel (position on each axle).";
CM_ SG_ 3221225472 TyreWheelIdentPressure2 "Second part of identification number of the tyre or wheel (the number of axles).";
CM_ SG_ 3221225472 TyreWheelIdentPressure1 "First part of identification number of the tyre or wheel (position on each axle).";
CM_ SG_ 3221225472 TyreWheelIdentLining2 "Second part of identification number of the tyre or wheel (the number of axles).";
CM_ SG_ 3221225472 TyreWheelIdentLining1 "First part of identification number of the tyre or wheel (position on each axle).";
CM_ SG_ 3221225472 VehiclePneumSupplySuff "Signal indicating the actual supply pressure of the reservoir of the braking system is insufficient or sufficient.";
CM_ SG_ 3221225472 BrakeTemperatureStatus "Signal which indicates that the brake temperature is higher than a specific level.";
CM_ SG_ 3221225472 BrakeLiningSufficient "Signal which indicates that the brake lining is sufficient/insufficient.";
CM_ SG_ 3221225472 TyrePressureSufficient "Signal which indicates that the tyre pressure is insufficient";
CM_ SG_ 3221225472 ODDRequest "Command signal to switch on or off the obstacle detection device (ODD).";
CM_ SG_ 3221225472 AntiTheftDeviceReq "Command signal to activate the anti-theft device.";
CM_ SG_ 3221225472 MaxVehicleSpeedLimit "Maximum vehicle velocity allowed.Maximum vehicle velocity allowed.";
CM_ SG_ 3221225472 EngineSpeedUpperLimit "The engine speed which cannot be exceeded.";
CM_ SG_ 3221225472 EngineSpeedLowerLimit "The minimum engine speed which the engine is allowed to reach.";
CM_ SG_ 3221225472 EngineTorqueMode "State signal which indicates which engine torque mode is currently generating, limiting, or controlling the torque";
CM_ SG_ 3221225472 PercentLoadAtCurrentSpeed "The ratio of actual engine percent torque to maximum indicated torque available at the current engine speed, clipped to zero torque during engine braking.";
CM_ SG_ 3221225472 EngineSpeed "Actual engine speed which is calculated over a minimum crankshaft angle of 720 degrees divided by
the number of cylinders.";
CM_ SG_ 3221225472 ActualEngine_PercTorque "The calculated output torque of the engine.";
CM_ SG_ 3221225472 DriversDemandEngine_PercTorque "The torque output of the engine requested by the driver.";
CM_ SG_ 3221225472 EngineRunning "Signal which indicates whether the engine is running.";
CM_ SG_ 3221225472 EngineControlAllowed "Switch signal which indicates that engine control is allowed.";
CM_ SG_ 3221225472 ClutchIndptdPTOFeedback "Signal which indicates the current state of the clutch independent power take off.";
CM_ SG_ 3221225472 AccelPedalPosition "The ratio of actual accelerator pedal position to maximum pedal position.";
CM_ SG_ 3221225472 AccelPedalLowIdleSwitch "Switch signal which indicates whether the accelerator pedal low idle switch is opened or closed.";
CM_ SG_ 3221225472 StarterActive "Signal which indicates whether the starter is in use.";
CM_ SG_ 3221225472 TorqueConvOilTemp "Temperature of the torque converter lubricant.";
CM_ SG_ 3221225472 TorqueConvtOilTempWarning "Signal which indicates that the torque converter oil temperature has reached its warning level.";
CM_ SG_ 3221225472 PTOControlAllowed "Switch signal which indicates that PTO control is allowed.";
CM_ SG_ 3221225472 SecEngineMtdPTOFeedback "Signal which indicates the current state of the second engine mounted power take off.";
CM_ SG_ 3221225472 FirstEngineMtdPTOFeedback "Signal which indicates the current state of the first engine mounted power take off.";
CM_ SG_ 3221225472 SecClutchDptdPTOFeedback "Signal which indicates the current state of the second clutch dependent power take off.";
CM_ SG_ 3221225472 FirstClutchDpdtPTOFeedback "Signal which indicates the current state of the first clutch dependent power take off.";
CM_ SG_ 3221225472 CurrentGear "The gear currently engaged in the transmission or the last gear engaged while the transmission is in process of shifting to the new or selected gear.";
CM_ SG_ 3221225472 PercentClutchSlip "Parameter which represents the ratio of input shaft speed to current engine speed (in percent).Parameter which represents the ratio of input shaft speed to current engine speed (in percent).";
CM_ SG_ 3221225472 ReferenceEngineTorque "The 100 % reference value for all defined indicated engine torque parameters.";
CM_ SG_ 3221225472 FuelLevelWarning "This signal indicates the decrease of the fuel level to a certain minimum.";
CM_ SG_ 3221225472 EngineOilPressureWarning "Signal which indicates that the engine oil pressure has reached its warning level.";
CM_ SG_ 3221225472 EngineCoolantTempWarning "Signal which indicates that the engine coolant temperature has reached its warning level.";
CM_ SG_ 3221225472 EngineOilPressure "Gauge pressure of the oil in the engine lubrication system as provided by the oil pump.";
CM_ SG_ 3221225472 EngineOilTemperature "Temperature of the engine lubricant.";
CM_ SG_ 3221225472 AmbientAirTemperature "Temperature of air surrounding vehicle.";
CM_ SG_ 3221225472 BodyPressure "The actual pressure in a body on the towed vehicle.";
CM_ SG_ 3221225472 BodyFluidLevel "The actual fluid level in a body on the towed vehicle.";
CM_ SG_ 3221225472 ThermalBodyTemperature "The actual temperature in a thermal body on the towed vehicle.";
CM_ SG_ 3221225472 RearObstacleDistance "The actual distance between the back of the towed vehicle and any obstacle.";
CM_ SG_ 3221225472 AntiTheftDeviceStatus "Signal which indicates that the anti-theft device is switched on or off.";
CM_ SG_ 3221225472 ODDStatus "Signal which indicates that an obstacle detection device (ODD) is active/inactive.";
CM_ SG_ 3221225472 ReqEngineSpeedUpperLim "The requested engine speed which is not to be exceeded.";
CM_ SG_ 3221225472 ReqEngineSpeedLowerLim "The requested minimum engine speed which the engine is to allow.";
CM_ SG_ 3221225472 ReqEngineTorqueLimit "The requested engine torque that the engine is not allowed to exceed, indicated as a ratio of the reference engine torque.";
CM_ SG_ 3221225472 ReqEngineSpeedLimit "The requested vehicle speed which the vehicle is not allowed to exceed.";
CM_ SG_ 3221225472 ReqEngineSpeed "This is the engine speed which the engine is expected to operate at.";
CM_ SG_ 3221225472 SecEngineMtdPTOSwitch "Signal which indicates the state of the second engine mounted power take off switch.";
CM_ SG_ 3221225472 SecClutchDpdtPTOSwitch "Signal which indicates the state of the second clutch dependent power take off switch.";
CM_ SG_ 3221225472 FirstClutchDpdtPTOSwitch "Signal which indicates the state of the first clutch dependent power take off switch.";
CM_ SG_ 3221225472 OperatingPanelActive "Signal which indicates that the operating panel is active.";
CM_ SG_ 3221225472 RefusePackerStepSwitch "Signal which indicates the state of the refuse packer step switch.";
CM_ SG_ 3221225472 EngineStopSwitch "Signal which indicates the state of the engine stop switch.";
CM_ SG_ 3221225472 EngineStartSwitch "Signal which indicates the state of the engine start switch.";
CM_ SG_ 3221225472 StarterLockoutSwitch "Signal which indicates the state of the starter lockout switch.";
CM_ SG_ 3221225472 RqstedPercentClutchSlip "Command signal to influence the clutch.";
CM_ SG_ 3221225472 FirstEngineMtdPTOSwitch "Signal which indicates the state of the first engine mounted power take off switch.";
CM_ SG_ 3221225472 ClutchIndpdtPTOSwitch "Signal which indicates the state of the clutch independent power take off switch.";
CM_ SG_ 3221225472 TrailerLeftSideMarkerLight "This signal indicates the state of the trailer left-hand side marker light(s).";
CM_ SG_ 3221225472 TrailerLeftReversingLight "This signal indicates the state of the trailer left-hand reversing light(s).";
CM_ SG_ 3221225472 TrailerLeftRearWidIndLight "This signal indicates the state of the trailer left-hand rear width indicator light(s).";
CM_ SG_ 3221225472 TrailerLeftRearRegPltLight "This signal indicates the state of the trailer left-hand rear registration-plate light(s).";
CM_ SG_ 3221225472 TrailerLeftRearLight "This signal indicates the state of the trailer left-hand rear light(s).";
CM_ SG_ 3221225472 TrailerLeftRearFogLight "This signal indicates the state of the trailer left-hand rear fog light(s).";
CM_ SG_ 3221225472 TrailerLeftDirIndLight "This signal indicates the state of the trailer left-hand direction indicator light(s).";
CM_ SG_ 3221225472 TrailerLeftCrnMarkerLight "This signal indicates the state of the trailer left-hand corner marker light(s).";
CM_ SG_ 3221225472 TrailerInteriorLight "This signal indicates the state of the trailer interior light(s).";
CM_ SG_ 3221225472 TrailerWorkLamp "This signal indicates the state of the trailer work lamp(s).";
CM_ SG_ 3221225472 TrailerRotatingIdentLight "This signal indicates the state of the trailer rotating identification light(s).";
CM_ SG_ 3221225472 TrailerRightStopLight "This signal indicates the state of the trailer right-hand stop light(s).";
CM_ SG_ 3221225472 TrailerRightSideMrkLight "This signal indicates the state of the trailer right-hand side marker light(s).";
CM_ SG_ 3221225472 TrailerRightReversingLight "This signal indicates the state of the trailer right-hand reversing light(s).";
CM_ SG_ 3221225472 TrailRightRearWidIndLight "This signal indicates the state of the trailer right-hand rear width indicator light(s).";
CM_ SG_ 3221225472 TrailerRightRearRegPltLight "This signal indicates the state of the trailer right-hand rear registration-plate light(s).";
CM_ SG_ 3221225472 TrailerRightRearLight "This signal indicates the state of the trailer right-hand rear light(s).";
CM_ SG_ 3221225472 TrailerRightRearFogLight "This signal indicates the state of the trailer right-hand rear fog light(s).";
CM_ SG_ 3221225472 TrailerRightDirIndLight "This signal indicates the state of the trailer right-hand direction indicator light(s).";
CM_ SG_ 3221225472 TrailerRightCrnMarkerLight "This signal indicates the state of the trailer right-hand corner marker light(s).";
CM_ SG_ 3221225472 TrailerRearWarningLight "This signal indicates the state of the trailer rear warning light(s).";
CM_ SG_ 3221225472 TrailerLeftStopLight "This signal indicates the state of the trailer left-hand stop light(s).";
CM_ SG_ 3221225472 ProtocolCtrlInformation "Part of Network Protocol Control Information (N_PCI) of a ISO 15765 message.Part of Network Protocol Control Information (N_PCI) of a ISO 15765 message.";
CM_ SG_ 3221225472 FilterMode "Filter mode for Network PG";
CM_ SG_ 3221225472 ToPort "Destination port for network PG";
CM_ SG_ 3221225472 FromPort "Source port for Network PG";
CM_ SG_ 3221225472 ParkingAndTrailerAirPress "The pneumatic pressure in the circuit or reservoir for the parking brake and the trailer supply.";
CM_ SG_ 3221225472 DrivenAxleLoad "Actual static vertical load on driven axle of the commercial vehicle. In case of more than one driven axle the value of the axle with the highest vertical load is transmitted.";
CM_ SG_ 3221225472 AuxEquipSupplyPressure "The pneumatic pressure in the auxiliary circuit.";
CM_ SG_ 3221225472 StopLevelChangeReq "Command signal to stop immediately any change of the actual body height level.";
CM_ SG_ 3221225472 RampLevelStorageReq "Command signal to store the actual body height level as new programmed and memorised ramp levels 1 or 2 in the ECU";
CM_ SG_ 3221225472 LevelControlReq "Command signal to enable or disable the automatic level control.";
CM_ SG_ 3221225472 RampLevelReq "Command signal to control the body height to a level programmed and memorised in the ECU.";
CM_ SG_ 3221225472 SteeringAxleLockingReq "Command signal to lock the steering axle.";
CM_ SG_ 3221225472 LiftAxle2PositionReq "Command signal to control the lift axle position / tag axle load condition.";
CM_ SG_ 3221225472 LiftAxle1PositionReq "Command signal to control the lift axle position / tag axle load condition.";
CM_ SG_ 3221225472 TractionHelpReq "Command signal to control the lift axle position / tag axle load condition to transfer more load on the driven axle of the commercial vehicle.";
CM_ SG_ 3221225472 LevelChangeReqRearAxle "Command signal to control the body height [up (lifting)/down (lowering)] for the rear axle.";
CM_ SG_ 3221225472 LevelChangeReqFrontAxle "Command signal to control the body height [up (lifting)/down (lowering)] for the front axle.";
CM_ SG_ 3221225472 RideHeightRequest "Command signal to activate a normal ride body height. The normal levels 1 and 2 are trailer specific body heights.";
CM_ SG_ 3221225472 LevelControl "Signal which indicates that the automatic level control is enabled or disabled.";
CM_ SG_ 3221225472 NominalVehBodyLevelRearAxle "Actual nominal vehicle body height.";
CM_ SG_ 3221225472 NominalVehBodyLevelFrontAxle "Actual nominal vehicle body height.";
CM_ SG_ 3221225472 RampLevel "Signal which indicates the level of the body height as an anser to 'ramp level request'.";
CM_ SG_ 3221225472 NormalLevel "Signal which indicates the normal levels of the vehicle independently of a specific request.";
CM_ SG_ 3221225472 StopLevelChangeAcknowledge "Signal which indicates the stop of any level change due to a 'stop request'.";
CM_ SG_ 3221225472 LevelChangeRearAxle "Signal which indicates the level change of the body height at the rear axle due to any external requests.";
CM_ SG_ 3221225472 LevelChangeFrontAxle "Signal which indicates the level change of the body height at the front axle due to any external requests.";
CM_ SG_ 3221225472 RampLevelStorage "Signal which indicates the storage of a new ramp level in the ECU.";
CM_ SG_ 3221225472 SteeringAxleLocking "Signal which indicates the actual steering axle locking status.";
CM_ SG_ 3221225472 LiftAxle2Pos "Signal which indicates the position / load condition of lift axle / tag axle #2.Signal which indicates the position / load condition of lift axle / tag axle #2.";
CM_ SG_ 3221225472 LiftAxle1Pos "Signal which indicates the position / load condition of lift axle / tag axle #1.Signal which indicates the position / load condition of lift axle / tag axle #1.";
CM_ SG_ 3221225472 RampLevelPosition "Signal which indicates the ramp level positions of the vehicle independently of a specific request.";
CM_ SG_ 3221225472 TractionHelp "Signal which indicates that a load transfer is active.";
CM_ SG_ 3221225472 LevelCtrlSysRideHeightLevel "Signal which indicates the body height position of the vehicle as an answer to 'ride height request'.";
CM_ SG_ 3221225472 RelVehBodyLevelRearAxle "Actual relative vehicle body height.";
CM_ SG_ 3221225472 RelVehBodyLevelFrontAxle "Actual relative vehicle body height.";
CM_ SG_ 3221225472 TyrePressThresholdDetect "Signal indicating the pressure level of the tyre.";
CM_ SG_ 3221225472 TyreModulePowerSupply "Signal indicating the power supply of the tyre module is sufficient to achieve the specified performance of the module.";
CM_ SG_ 3221225472 TyreTemperature "The temperature measured by the tyre module.";
CM_ SG_ 3221225472 AirLeakageDetection "The pressure loss of a tyre.";
CM_ SG_ 3221225472 TyreWheelIdentification2 "First part of the identification number of the tyre or whee (number of axles).";
CM_ SG_ 3221225472 TyreWheelIdentification1 "First part of the identification number of the tyre or whee (position on each axle).";
CM_ SG_ 3221225472 XBRPriority "The XBR Priority is used as an input to the brake system to manage the priority of overlapping external and internal requests.";
CM_ SG_ 3221225472 ExtlAccelerationDemand "Parameter provided to the brake system from external sources.";
CM_ SG_ 3221225472 WaterInFuelIndicator "Signal which indicates the presence of water in the fuel.";
CM_ SG_ 3221225472 CargoWeight "The mass of freight carried.";
BA_DEF_ SG_  "SigType" ENUM  "Default","Range","RangeSigned","ASCII","Discrete","Control","ReferencePGN","DTC","StringDelimiter","StringLength","StringLengthControl";
BA_DEF_ SG_  "GenSigStartValue" INT 0 10000;
BA_DEF_ SG_  "GenSigSendType" ENUM  "Cyclic","OnWrite","reserved","OnChange","reserved","reserved","reserved","NoSigSendType";
BA_DEF_ SG_  "GenSigILSupport" ENUM  "Yes","No";
BA_DEF_ SG_  "GenSigEVName" STRING ;
BA_DEF_ SG_  "SPN" INT 0 524287;
BA_DEF_ BO_  "GenMsgILSupport" ENUM  "Yes","No";
BA_DEF_ BO_  "GenMsgRequestable" INT 0 1;
BA_DEF_ BO_  "GenMsgSendType" ENUM  "cyclic","reserved","cyclicIfActive","reserved","reserved","reserved","reserved","reserved","noMsgSendType";
BA_DEF_ BO_  "VFrameFormat" ENUM  "StandardCAN","ExtendedCAN","reserved","J1939PG";
BA_DEF_ BO_  "GenMsgCycleTime" INT 0 3600000;
BA_DEF_ BU_  "NodeLayerModules" STRING ;
BA_DEF_ BU_  "NmStationAddress" INT 0 255;
BA_DEF_ BU_  "NmJ1939AAC" INT 0 1;
BA_DEF_ BU_  "NmJ1939IndustryGroup" INT 0 7;
BA_DEF_ BU_  "NmJ1939System" INT 0 127;
BA_DEF_ BU_  "NmJ1939SystemInstance" INT 0 15;
BA_DEF_ BU_  "NmJ1939Function" INT 0 255;
BA_DEF_ BU_  "NmJ1939FunctionInstance" INT 0 7;
BA_DEF_ BU_  "NmJ1939ECUInstance" INT 0 7;
BA_DEF_ BU_  "NmJ1939ManufacturerCode" INT 0 2047;
BA_DEF_ BU_  "NmJ1939IdentityNumber" INT 0 2097151;
BA_DEF_ BU_  "ECU" STRING ;
BA_DEF_  "DatabaseVersion" STRING ;
BA_DEF_  "BusType" STRING ;
BA_DEF_  "ProtocolType" STRING ;
BA_DEF_  "SAE_J1939_75_SpecVersion" STRING ;
BA_DEF_  "SAE_J1939_21_SpecVersion" STRING ;
BA_DEF_  "SAE_J1939_73_SpecVersion" STRING ;
BA_DEF_  "SAE_J1939_71_SpecVersion" STRING ;
BA_DEF_DEF_  "SigType" "Default";
BA_DEF_DEF_  "GenSigStartValue" 0;
BA_DEF_DEF_  "GenSigSendType" "NoSigSendType";
BA_DEF_DEF_  "GenSigILSupport" "Yes";
BA_DEF_DEF_  "GenSigEVName" "Env@Nodename_@Signame";
BA_DEF_DEF_  "SPN" 0;
BA_DEF_DEF_  "GenMsgILSupport" "Yes";
BA_DEF_DEF_  "GenMsgRequestable" 1;
BA_DEF_DEF_  "GenMsgSendType" "noMsgSendType";
BA_DEF_DEF_  "VFrameFormat" "J1939PG";
BA_DEF_DEF_  "GenMsgCycleTime" 0;
BA_DEF_DEF_  "NodeLayerModules" "";
BA_DEF_DEF_  "NmStationAddress" 254;
BA_DEF_DEF_  "NmJ1939AAC" 0;
BA_DEF_DEF_  "NmJ1939IndustryGroup" 0;
BA_DEF_DEF_  "NmJ1939System" 0;
BA_DEF_DEF_  "NmJ1939SystemInstance" 0;
BA_DEF_DEF_  "NmJ1939Function" 0;
BA_DEF_DEF_  "NmJ1939FunctionInstance" 0;
BA_DEF_DEF_  "NmJ1939ECUInstance" 0;
BA_DEF_DEF_  "NmJ1939ManufacturerCode" 0;
BA_DEF_DEF_  "NmJ1939IdentityNumber" 0;
BA_DEF_DEF_  "ECU" "";
BA_DEF_DEF_  "DatabaseVersion" "";
BA_DEF_DEF_  "BusType" "";
BA_DEF_DEF_  "ProtocolType" "";
BA_DEF_DEF_  "SAE_J1939_75_SpecVersion" "";
BA_DEF_DEF_  "SAE_J1939_21_SpecVersion" "";
BA_DEF_DEF_  "SAE_J1939_73_SpecVersion" "";
BA_DEF_DEF_  "SAE_J1939_71_SpecVersion" "";
BA_ "SAE_J1939_71_SpecVersion" "2007-08";
BA_ "SAE_J1939_73_SpecVersion" "2004-09";
BA_ "SAE_J1939_21_SpecVersion" "2006-10";
BA_ "SAE_J1939_75_SpecVersion" "2005-10";
BA_ "ProtocolType" "J1939";
BA_ "BusType" "CAN";
BA_ "DatabaseVersion" "7.0 SP3";
BA_ "NmStationAddress" BU_ EBS 11;
BA_ "NodeLayerModules" BU_ EBS "J1939_IL.DLL";
BA_ "NmJ1939Function" BU_ EBS 9;
BA_ "NmJ1939ManufacturerCode" BU_ EBS 1861;
BA_ "NmJ1939IdentityNumber" BU_ EBS 603211;
BA_ "ECU" BU_ EBS "EBS";
BA_ "NmStationAddress" BU_ EMS 0;
BA_ "NodeLayerModules" BU_ EMS "J1939_IL.DLL";
BA_ "NmJ1939ManufacturerCode" BU_ EMS 1861;
BA_ "NmJ1939IdentityNumber" BU_ EMS 603212;
BA_ "ECU" BU_ EMS "EMS";
BA_ "SPN" SG_ 3221225472 FailureModeIdentifier1 1215;
BA_ "SPN" SG_ 3221225472 SPN1High 1214;
BA_ "SPN" SG_ 3221225472 SPN1 1214;
BA_ "SPN" SG_ 3221225472 TextDisplayIndex 3614;
BA_ "SigType" SG_ 3221225472 TextDisplayIndex 1;
BA_ "SPN" SG_ 3221225472 TextDisplayInstructions 3613;
BA_ "SPN" SG_ 3221225472 MovementStatusOfRamp3 3818;
BA_ "SigType" SG_ 3221225472 MovementStatusOfRamp3 4;
BA_ "SPN" SG_ 3221225472 EnableStatusOfRamp3 3817;
BA_ "SigType" SG_ 3221225472 EnableStatusOfRamp3 4;
BA_ "SPN" SG_ 3221225472 RetractStatusOfRamp3 3816;
BA_ "SigType" SG_ 3221225472 RetractStatusOfRamp3 4;
BA_ "SPN" SG_ 3221225472 MovementStatusOfRamp2 3815;
BA_ "SigType" SG_ 3221225472 MovementStatusOfRamp2 4;
BA_ "SPN" SG_ 3221225472 EnableStatusOfRamp2 3814;
BA_ "SigType" SG_ 3221225472 EnableStatusOfRamp2 4;
BA_ "SPN" SG_ 3221225472 RetractStatusOfRamp2 3813;
BA_ "SigType" SG_ 3221225472 RetractStatusOfRamp2 4;
BA_ "SPN" SG_ 3221225472 MovementStatusOfRamp1 3812;
BA_ "SigType" SG_ 3221225472 MovementStatusOfRamp1 4;
BA_ "SPN" SG_ 3221225472 EnableStatusOfRamp1 3811;
BA_ "SigType" SG_ 3221225472 EnableStatusOfRamp1 4;
BA_ "SPN" SG_ 3221225472 RetractStatusOfRamp1 3810;
BA_ "SigType" SG_ 3221225472 RetractStatusOfRamp1 4;
BA_ "SPN" SG_ 3221225472 MaxCrankAttemptsPerStartAttempt 3670;
BA_ "SigType" SG_ 3221225472 MaxCrankAttemptsPerStartAttempt 1;
BA_ "SPN" SG_ 3221225472 EngExhstGsRcirculationValve2Pos 3822;
BA_ "SigType" SG_ 3221225472 EngExhstGsRcirculationValve2Pos 1;
BA_ "SPN" SG_ 3221225472 EngExhstGsRecirculationValvePos 27;
BA_ "SigType" SG_ 3221225472 EngExhstGsRecirculationValvePos 1;
BA_ "SPN" SG_ 3221225472 EngExhstGsRcrculationValve2Ctrl 3821;
BA_ "SigType" SG_ 3221225472 EngExhstGsRcrculationValve2Ctrl 1;
BA_ "SPN" SG_ 3221225472 EngIntkVlvActtonOilPressForCyl4 3627;
BA_ "SigType" SG_ 3221225472 EngIntkVlvActtonOilPressForCyl4 1;
BA_ "SPN" SG_ 3221225472 EngIntkVlvActtonOilPressForCyl3 3626;
BA_ "SigType" SG_ 3221225472 EngIntkVlvActtonOilPressForCyl3 1;
BA_ "SPN" SG_ 3221225472 EngIntkVlvActtonOilPressForCyl2 3625;
BA_ "SigType" SG_ 3221225472 EngIntkVlvActtonOilPressForCyl2 1;
BA_ "SPN" SG_ 3221225472 EngIntkVlvActtonOilPressForCyl1 3624;
BA_ "SigType" SG_ 3221225472 EngIntkVlvActtonOilPressForCyl1 1;
BA_ "SPN" SG_ 3221225472 EngIntkVlvActtonOilPressForCyl8 3631;
BA_ "SigType" SG_ 3221225472 EngIntkVlvActtonOilPressForCyl8 1;
BA_ "SPN" SG_ 3221225472 EngIntkVlvActtonOilPressForCyl7 3630;
BA_ "SigType" SG_ 3221225472 EngIntkVlvActtonOilPressForCyl7 1;
BA_ "SPN" SG_ 3221225472 EngIntkVlvActtonOilPressForCyl6 3629;
BA_ "SigType" SG_ 3221225472 EngIntkVlvActtonOilPressForCyl6 1;
BA_ "SPN" SG_ 3221225472 EngIntkVlvActtonOilPressForCyl5 3628;
BA_ "SigType" SG_ 3221225472 EngIntkVlvActtonOilPressForCyl5 1;
BA_ "SPN" SG_ 3221225472 EngIntkVlvActtnOilPressForCyl12 3635;
BA_ "SigType" SG_ 3221225472 EngIntkVlvActtnOilPressForCyl12 1;
BA_ "SPN" SG_ 3221225472 EngIntkVlvActtnOilPressForCyl11 3634;
BA_ "SigType" SG_ 3221225472 EngIntkVlvActtnOilPressForCyl11 1;
BA_ "SPN" SG_ 3221225472 EngIntkVlvActtnOilPressForCyl10 3633;
BA_ "SigType" SG_ 3221225472 EngIntkVlvActtnOilPressForCyl10 1;
BA_ "SPN" SG_ 3221225472 EngIntkVlvActtonOilPressForCyl9 3632;
BA_ "SigType" SG_ 3221225472 EngIntkVlvActtonOilPressForCyl9 1;
BA_ "SPN" SG_ 3221225472 EngIntkVlvActtnOilPressForCyl16 3639;
BA_ "SigType" SG_ 3221225472 EngIntkVlvActtnOilPressForCyl16 1;
BA_ "SPN" SG_ 3221225472 EngIntkVlvActtnOilPressForCyl15 3638;
BA_ "SigType" SG_ 3221225472 EngIntkVlvActtnOilPressForCyl15 1;
BA_ "SPN" SG_ 3221225472 EngIntkVlvActtnOilPressForCyl14 3637;
BA_ "SigType" SG_ 3221225472 EngIntkVlvActtnOilPressForCyl14 1;
BA_ "SPN" SG_ 3221225472 EngIntkVlvActtnOilPressForCyl13 3636;
BA_ "SigType" SG_ 3221225472 EngIntkVlvActtnOilPressForCyl13 1;
BA_ "SPN" SG_ 3221225472 EngIntkVlvActtnOilPressForCyl20 3643;
BA_ "SigType" SG_ 3221225472 EngIntkVlvActtnOilPressForCyl20 1;
BA_ "SPN" SG_ 3221225472 EngIntkVlvActtnOilPressForCyl19 3642;
BA_ "SigType" SG_ 3221225472 EngIntkVlvActtnOilPressForCyl19 1;
BA_ "SPN" SG_ 3221225472 EngIntkVlvActtnOilPressForCyl18 3641;
BA_ "SigType" SG_ 3221225472 EngIntkVlvActtnOilPressForCyl18 1;
BA_ "SPN" SG_ 3221225472 EngIntkVlvActtnOilPressForCyl17 3640;
BA_ "SigType" SG_ 3221225472 EngIntkVlvActtnOilPressForCyl17 1;
BA_ "SPN" SG_ 3221225472 EGRCoolerBypassActuatorPostion 3672;
BA_ "SigType" SG_ 3221225472 EGRCoolerBypassActuatorPostion 1;
BA_ "SPN" SG_ 3221225472 EngSparkPlug4 1297;
BA_ "SigType" SG_ 3221225472 EngSparkPlug4 1;
BA_ "SPN" SG_ 3221225472 EngSparkPlug3 1296;
BA_ "SigType" SG_ 3221225472 EngSparkPlug3 1;
BA_ "SPN" SG_ 3221225472 EngSparkPlug2 1295;
BA_ "SigType" SG_ 3221225472 EngSparkPlug2 1;
BA_ "SPN" SG_ 3221225472 EngSparkPlug1 1294;
BA_ "SigType" SG_ 3221225472 EngSparkPlug1 1;
BA_ "SPN" SG_ 3221225472 EngSparkPlug8 1301;
BA_ "SigType" SG_ 3221225472 EngSparkPlug8 1;
BA_ "SPN" SG_ 3221225472 EngSparkPlug7 1300;
BA_ "SigType" SG_ 3221225472 EngSparkPlug7 1;
BA_ "SPN" SG_ 3221225472 EngSparkPlug6 1299;
BA_ "SigType" SG_ 3221225472 EngSparkPlug6 1;
BA_ "SPN" SG_ 3221225472 EngSparkPlug5 1298;
BA_ "SigType" SG_ 3221225472 EngSparkPlug5 1;
BA_ "SPN" SG_ 3221225472 EngSparkPlug12 1305;
BA_ "SigType" SG_ 3221225472 EngSparkPlug12 1;
BA_ "SPN" SG_ 3221225472 EngSparkPlug11 1304;
BA_ "SigType" SG_ 3221225472 EngSparkPlug11 1;
BA_ "SPN" SG_ 3221225472 EngSparkPlug10 1303;
BA_ "SigType" SG_ 3221225472 EngSparkPlug10 1;
BA_ "SPN" SG_ 3221225472 EngSparkPlug9 1302;
BA_ "SigType" SG_ 3221225472 EngSparkPlug9 1;
BA_ "SPN" SG_ 3221225472 EngSparkPlug16 1309;
BA_ "SigType" SG_ 3221225472 EngSparkPlug16 1;
BA_ "SPN" SG_ 3221225472 EngSparkPlug15 1308;
BA_ "SigType" SG_ 3221225472 EngSparkPlug15 1;
BA_ "SPN" SG_ 3221225472 EngSparkPlug14 1307;
BA_ "SigType" SG_ 3221225472 EngSparkPlug14 1;
BA_ "SPN" SG_ 3221225472 EngSparkPlug13 1306;
BA_ "SigType" SG_ 3221225472 EngSparkPlug13 1;
BA_ "SPN" SG_ 3221225472 EngSparkPlug20 1313;
BA_ "SigType" SG_ 3221225472 EngSparkPlug20 1;
BA_ "SPN" SG_ 3221225472 EngSparkPlug19 1312;
BA_ "SigType" SG_ 3221225472 EngSparkPlug19 1;
BA_ "SPN" SG_ 3221225472 EngSparkPlug18 1311;
BA_ "SigType" SG_ 3221225472 EngSparkPlug18 1;
BA_ "SPN" SG_ 3221225472 EngSparkPlug17 1310;
BA_ "SigType" SG_ 3221225472 EngSparkPlug17 1;
BA_ "SPN" SG_ 3221225472 EngSparkPlug24 1317;
BA_ "SigType" SG_ 3221225472 EngSparkPlug24 1;
BA_ "SPN" SG_ 3221225472 EngSparkPlug23 1316;
BA_ "SigType" SG_ 3221225472 EngSparkPlug23 1;
BA_ "SPN" SG_ 3221225472 EngSparkPlug22 1315;
BA_ "SigType" SG_ 3221225472 EngSparkPlug22 1;
BA_ "SPN" SG_ 3221225472 EngSparkPlug21 1314;
BA_ "SigType" SG_ 3221225472 EngSparkPlug21 1;
BA_ "SPN" SG_ 3221225472 LaneDepartureWarningEnableCmd 3564;
BA_ "SigType" SG_ 3221225472 LaneDepartureWarningEnableCmd 4;
BA_ "SPN" SG_ 3221225472 J2012DTCOccurrenceCount 3622;
BA_ "SPN" SG_ 3221225472 J2012DTCStatus 3621;
BA_ "SPN" SG_ 3221225472 NumberOfJ2012DTCs 3619;
BA_ "SigType" SG_ 3221225472 NumberOfJ2012DTCs 1;
BA_ "SPN" SG_ 3221225472 PrtcltTrpActvRgnrtnInhbtdDTVhclS 3709;
BA_ "SigType" SG_ 3221225472 PrtcltTrpActvRgnrtnInhbtdDTVhclS 4;
BA_ "SPN" SG_ 3221225472 PrtcltTrpActvRgnrtnInhbtdDTOtOfN 3708;
BA_ "SigType" SG_ 3221225472 PrtcltTrpActvRgnrtnInhbtdDTOtOfN 4;
BA_ "SPN" SG_ 3221225472 PrtcltTrpActvRgnrtnInhbtdDTAcclP 3707;
BA_ "SigType" SG_ 3221225472 PrtcltTrpActvRgnrtnInhbtdDTAcclP 4;
BA_ "SPN" SG_ 3221225472 PrtcltTrpActvRgnrtnInhbtdDTPTOAc 3706;
BA_ "SigType" SG_ 3221225472 PrtcltTrpActvRgnrtnInhbtdDTPTOAc 4;
BA_ "SPN" SG_ 3221225472 PrtcltTrpActvRgnrtnInhbtdDTSrvcB 3705;
BA_ "SigType" SG_ 3221225472 PrtcltTrpActvRgnrtnInhbtdDTSrvcB 4;
BA_ "SPN" SG_ 3221225472 PrtcltTrpActvRgnrtnInhbtdDTCltch 3704;
BA_ "SigType" SG_ 3221225472 PrtcltTrpActvRgnrtnInhbtdDTCltch 4;
BA_ "SPN" SG_ 3221225472 PrtcltTrpActvRgnrtnInhbtdDTInhbt 3703;
BA_ "SigType" SG_ 3221225472 PrtcltTrpActvRgnrtnInhbtdDTInhbt 4;
BA_ "SPN" SG_ 3221225472 PrtcltTrpActvRgnrtnInhbtdStatus 3702;
BA_ "SigType" SG_ 3221225472 PrtcltTrpActvRgnrtnInhbtdStatus 4;
BA_ "SPN" SG_ 3221225472 ParticulateTrapStatus 3701;
BA_ "SPN" SG_ 3221225472 PrtcltTrpActvRegenerationStatus 3700;
BA_ "SigType" SG_ 3221225472 PrtcltTrpActvRegenerationStatus 4;
BA_ "SPN" SG_ 3221225472 PrtcltTrpPssvRegenerationStatus 3699;
BA_ "SigType" SG_ 3221225472 PrtcltTrpPssvRegenerationStatus 4;
BA_ "SPN" SG_ 3221225472 ParticulateTrapLampCmd 3697;
BA_ "SPN" SG_ 3221225472 MessageChecksum 3690;
BA_ "SPN" SG_ 3221225472 MessageCounter 3689;
BA_ "SPN" SG_ 3221225472 SteerAngleSensorCalibrated 3688;
BA_ "SigType" SG_ 3221225472 SteerAngleSensorCalibrated 4;
BA_ "SPN" SG_ 3221225472 SteerAngleSensorActiveMode 3687;
BA_ "SigType" SG_ 3221225472 SteerAngleSensorActiveMode 4;
BA_ "SPN" SG_ 3221225472 SteerWheelAngleRange 3686;
BA_ "SigType" SG_ 3221225472 SteerWheelAngleRange 1;
BA_ "SPN" SG_ 3221225472 SteerWheelAngleRangeCounterType 3685;
BA_ "SigType" SG_ 3221225472 SteerWheelAngleRangeCounterType 4;
BA_ "SPN" SG_ 3221225472 SteerWheelAngleRangeCounter 3684;
BA_ "SPN" SG_ 3221225472 SteerWheelAngle 1807;
BA_ "SigType" SG_ 3221225472 SteerWheelAngle 1;
BA_ "SPN" SG_ 3221225472 CmdedCatalystReagentConsumption 3828;
BA_ "SigType" SG_ 3221225472 CmdedCatalystReagentConsumption 1;
BA_ "SPN" SG_ 3221225472 AvrgeCatalystReagentConsumption 3826;
BA_ "SigType" SG_ 3221225472 AvrgeCatalystReagentConsumption 1;
BA_ "SPN" SG_ 3221225472 TransferCaseStatus 3645;
BA_ "SPN" SG_ 3221225472 TransTorqueConvOilOutlTemp 3823;
BA_ "SPN" SG_ 3221225472 TransmissionOilLifeRemaining 4177;
BA_ "SPN" SG_ 3221225472 TransOilLevelSwitch 3533;
BA_ "SigType" SG_ 3221225472 TransOilLevelSwitch 4;
BA_ "SPN" SG_ 3221225472 TransOilFilterRestrictionSwitch 3359;
BA_ "SigType" SG_ 3221225472 TransOilFilterRestrictionSwitch 4;
BA_ "SPN" SG_ 3221225472 VehicleRoll 3623;
BA_ "SigType" SG_ 3221225472 VehicleRoll 1;
BA_ "SPN" SG_ 3221225472 TotalEngCruiseTime 1017;
BA_ "SigType" SG_ 3221225472 TotalEngCruiseTime 1;
BA_ "SPN" SG_ 3221225472 TotalDriveAverageLoadFactor 1016;
BA_ "SigType" SG_ 3221225472 TotalDriveAverageLoadFactor 1;
BA_ "SPN" SG_ 3221225472 TripDriveAverageLoadFactor 1015;
BA_ "SigType" SG_ 3221225472 TripDriveAverageLoadFactor 1;
BA_ "SPN" SG_ 3221225472 TripAverageEngSpeed 1014;
BA_ "SigType" SG_ 3221225472 TripAverageEngSpeed 1;
BA_ "SPN" SG_ 3221225472 TripMaxEngSpeed 1013;
BA_ "SigType" SG_ 3221225472 TripMaxEngSpeed 1;
BA_ "SPN" SG_ 3221225472 ImplementRearWorkLight 2394;
BA_ "SigType" SG_ 3221225472 ImplementRearWorkLight 4;
BA_ "SPN" SG_ 3221225472 ImplementLeftForwardWorkLight 2400;
BA_ "SigType" SG_ 3221225472 ImplementLeftForwardWorkLight 4;
BA_ "SPN" SG_ 3221225472 ImplementRightForwardWorkLight 2402;
BA_ "SigType" SG_ 3221225472 ImplementRightForwardWorkLight 4;
BA_ "SPN" SG_ 3221225472 ImplementLeftFacingWorkLight 2598;
BA_ "SigType" SG_ 3221225472 ImplementLeftFacingWorkLight 4;
BA_ "SPN" SG_ 3221225472 ImplementRightFacingWorkLight 2407;
BA_ "SigType" SG_ 3221225472 ImplementRightFacingWorkLight 4;
BA_ "SPN" SG_ 3221225472 ImplementOEMOption1Light 2396;
BA_ "SigType" SG_ 3221225472 ImplementOEMOption1Light 4;
BA_ "SPN" SG_ 3221225472 ImplementOEMOption2Light 2398;
BA_ "SigType" SG_ 3221225472 ImplementOEMOption2Light 4;
BA_ "SPN" SG_ 3221225472 TrctrFrontHighMountedWorkLights 2356;
BA_ "SigType" SG_ 3221225472 TrctrFrontHighMountedWorkLights 4;
BA_ "SPN" SG_ 3221225472 TrctorFrontLowMountedWorkLights 2354;
BA_ "SigType" SG_ 3221225472 TrctorFrontLowMountedWorkLights 4;
BA_ "SPN" SG_ 3221225472 TrctorSideHighMountedWorkLights 2366;
BA_ "SigType" SG_ 3221225472 TrctorSideHighMountedWorkLights 4;
BA_ "SPN" SG_ 3221225472 TractorSideLowMountedWorkLights 2364;
BA_ "SigType" SG_ 3221225472 TractorSideLowMountedWorkLights 4;
BA_ "SPN" SG_ 3221225472 TrctorRearHighMountedWorkLights 2362;
BA_ "SigType" SG_ 3221225472 TrctorRearHighMountedWorkLights 4;
BA_ "SPN" SG_ 3221225472 TractorRearLowMountedWorkLights 2360;
BA_ "SigType" SG_ 3221225472 TractorRearLowMountedWorkLights 4;
BA_ "SPN" SG_ 3221225472 TrctrUndersideMountedWorkLights 2358;
BA_ "SigType" SG_ 3221225472 TrctrUndersideMountedWorkLights 4;
BA_ "SPN" SG_ 3221225472 RearFogLights 2390;
BA_ "SigType" SG_ 3221225472 RearFogLights 4;
BA_ "SPN" SG_ 3221225472 TractorMarkerLight 2378;
BA_ "SigType" SG_ 3221225472 TractorMarkerLight 4;
BA_ "SPN" SG_ 3221225472 ImplementMarkerLight 2380;
BA_ "SigType" SG_ 3221225472 ImplementMarkerLight 4;
BA_ "SPN" SG_ 3221225472 TractorClearanceLight 2382;
BA_ "SigType" SG_ 3221225472 TractorClearanceLight 4;
BA_ "SPN" SG_ 3221225472 ImplementClearanceLight 2384;
BA_ "SigType" SG_ 3221225472 ImplementClearanceLight 4;
BA_ "SPN" SG_ 3221225472 LeftStopLight 2372;
BA_ "SigType" SG_ 3221225472 LeftStopLight 4;
BA_ "SPN" SG_ 3221225472 RightStopLight 2374;
BA_ "SigType" SG_ 3221225472 RightStopLight 4;
BA_ "SPN" SG_ 3221225472 CenterStopLight 2376;
BA_ "SigType" SG_ 3221225472 CenterStopLight 4;
BA_ "SPN" SG_ 3221225472 BackUpLightAndAlarmHorn 2392;
BA_ "SigType" SG_ 3221225472 BackUpLightAndAlarmHorn 4;
BA_ "SPN" SG_ 3221225472 LeftTurnSignalLights 2368;
BA_ "SigType" SG_ 3221225472 LeftTurnSignalLights 4;
BA_ "SPN" SG_ 3221225472 RightTurnSignalLights 2370;
BA_ "SigType" SG_ 3221225472 RightTurnSignalLights 4;
BA_ "SPN" SG_ 3221225472 RotatingBeaconLight 2386;
BA_ "SigType" SG_ 3221225472 RotatingBeaconLight 4;
BA_ "SPN" SG_ 3221225472 TractorFrontFogLights 2388;
BA_ "SigType" SG_ 3221225472 TractorFrontFogLights 4;
BA_ "SPN" SG_ 3221225472 HighBeamHeadLightData 2348;
BA_ "SigType" SG_ 3221225472 HighBeamHeadLightData 4;
BA_ "SPN" SG_ 3221225472 LowBeamHeadLightData 2350;
BA_ "SigType" SG_ 3221225472 LowBeamHeadLightData 4;
BA_ "SPN" SG_ 3221225472 AltBeamHeadLightData 2352;
BA_ "SigType" SG_ 3221225472 AltBeamHeadLightData 4;
BA_ "SPN" SG_ 3221225472 RunningLight 2404;
BA_ "SigType" SG_ 3221225472 RunningLight 4;
BA_ "SPN" SG_ 3221225472 ImplementRearWorkLightCmd 2405;
BA_ "SigType" SG_ 3221225472 ImplementRearWorkLightCmd 4;
BA_ "SPN" SG_ 3221225472 ImplmentLeftForwardWorkLightCmd 2399;
BA_ "SigType" SG_ 3221225472 ImplmentLeftForwardWorkLightCmd 4;
BA_ "SPN" SG_ 3221225472 ImplmntRightForwardWorkLightCmd 2401;
BA_ "SigType" SG_ 3221225472 ImplmntRightForwardWorkLightCmd 4;
BA_ "SPN" SG_ 3221225472 LightingDataRqCmd 2393;
BA_ "SigType" SG_ 3221225472 LightingDataRqCmd 4;
BA_ "SPN" SG_ 3221225472 ImplementLeftFacingWorkLightCmd 2597;
BA_ "SigType" SG_ 3221225472 ImplementLeftFacingWorkLightCmd 4;
BA_ "SPN" SG_ 3221225472 ImplmentRightFacingWorkLightCmd 2406;
BA_ "SigType" SG_ 3221225472 ImplmentRightFacingWorkLightCmd 4;
BA_ "SPN" SG_ 3221225472 ImplementOEMOption1LightCmd 2395;
BA_ "SigType" SG_ 3221225472 ImplementOEMOption1LightCmd 4;
BA_ "SPN" SG_ 3221225472 ImplementOEMOption2LightCmd 2397;
BA_ "SigType" SG_ 3221225472 ImplementOEMOption2LightCmd 4;
BA_ "SPN" SG_ 3221225472 TrctrFrntHghMuntedWorkLightsCmd 2355;
BA_ "SigType" SG_ 3221225472 TrctrFrntHghMuntedWorkLightsCmd 4;
BA_ "SPN" SG_ 3221225472 TrctrFrntLwMountedWorkLightsCmd 2353;
BA_ "SigType" SG_ 3221225472 TrctrFrntLwMountedWorkLightsCmd 4;
BA_ "SPN" SG_ 3221225472 TrctrSdHighMountedWorkLightsCmd 2365;
BA_ "SigType" SG_ 3221225472 TrctrSdHighMountedWorkLightsCmd 4;
BA_ "SPN" SG_ 3221225472 TrctrSdeLowMountedWorkLightsCmd 2363;
BA_ "SigType" SG_ 3221225472 TrctrSdeLowMountedWorkLightsCmd 4;
BA_ "SPN" SG_ 3221225472 TrctrRrHighMountedWorkLightsCmd 2361;
BA_ "SigType" SG_ 3221225472 TrctrRrHighMountedWorkLightsCmd 4;
BA_ "SPN" SG_ 3221225472 TrctrRarLowMountedWorkLightsCmd 2359;
BA_ "SigType" SG_ 3221225472 TrctrRarLowMountedWorkLightsCmd 4;
BA_ "SPN" SG_ 3221225472 TrctrUndrsdMountedWorkLightsCmd 2357;
BA_ "SigType" SG_ 3221225472 TrctrUndrsdMountedWorkLightsCmd 4;
BA_ "SPN" SG_ 3221225472 RearFogLightCmd 2389;
BA_ "SigType" SG_ 3221225472 RearFogLightCmd 4;
BA_ "SPN" SG_ 3221225472 TractorMarkerLightCmd 2377;
BA_ "SigType" SG_ 3221225472 TractorMarkerLightCmd 4;
BA_ "SPN" SG_ 3221225472 ImplementMarkerLightCmd 2379;
BA_ "SigType" SG_ 3221225472 ImplementMarkerLightCmd 4;
BA_ "SPN" SG_ 3221225472 TractorClearanceLightCmd 2381;
BA_ "SigType" SG_ 3221225472 TractorClearanceLightCmd 4;
BA_ "SPN" SG_ 3221225472 ImplementClearanceLightCmd 2383;
BA_ "SigType" SG_ 3221225472 ImplementClearanceLightCmd 4;
BA_ "SPN" SG_ 3221225472 LeftStopLightCmd 2371;
BA_ "SigType" SG_ 3221225472 LeftStopLightCmd 4;
BA_ "SPN" SG_ 3221225472 RightStopLightCmd 2373;
BA_ "SigType" SG_ 3221225472 RightStopLightCmd 4;
BA_ "SPN" SG_ 3221225472 CenterStopLightCmd 2375;
BA_ "SigType" SG_ 3221225472 CenterStopLightCmd 4;
BA_ "SPN" SG_ 3221225472 BackUpLightAndAlarmHornCmd 2391;
BA_ "SigType" SG_ 3221225472 BackUpLightAndAlarmHornCmd 4;
BA_ "SPN" SG_ 3221225472 LeftTurnSignalLightsCmd 2367;
BA_ "SigType" SG_ 3221225472 LeftTurnSignalLightsCmd 4;
BA_ "SPN" SG_ 3221225472 RightTurnSignalLightsCmd 2369;
BA_ "SigType" SG_ 3221225472 RightTurnSignalLightsCmd 4;
BA_ "SPN" SG_ 3221225472 RotatingBeaconLightCmd 2385;
BA_ "SigType" SG_ 3221225472 RotatingBeaconLightCmd 4;
BA_ "SPN" SG_ 3221225472 TractorFrontFogLightsCmd 2387;
BA_ "SigType" SG_ 3221225472 TractorFrontFogLightsCmd 4;
BA_ "SPN" SG_ 3221225472 HighBeamHeadLightCmd 2347;
BA_ "SigType" SG_ 3221225472 HighBeamHeadLightCmd 4;
BA_ "SPN" SG_ 3221225472 LowBeamHeadLightCmd 2349;
BA_ "SigType" SG_ 3221225472 LowBeamHeadLightCmd 4;
BA_ "SPN" SG_ 3221225472 AltBeamHeadLightCmd 2351;
BA_ "SigType" SG_ 3221225472 AltBeamHeadLightCmd 4;
BA_ "SPN" SG_ 3221225472 RunningLightCmd 2403;
BA_ "SigType" SG_ 3221225472 RunningLightCmd 4;
BA_ "SPN" SG_ 3221225472 BladeCtrlMode 1578;
BA_ "SigType" SG_ 3221225472 BladeCtrlMode 1;
BA_ "SPN" SG_ 3221225472 BladeDurationAndDirection 1577;
BA_ "SigType" SG_ 3221225472 BladeDurationAndDirection 1;
BA_ "SPN" SG_ 3221225472 EngActualIgntTiming 1436;
BA_ "SigType" SG_ 3221225472 EngActualIgntTiming 1;
BA_ "SPN" SG_ 3221225472 EngDesiredIgntTiming3 1435;
BA_ "SigType" SG_ 3221225472 EngDesiredIgntTiming3 1;
BA_ "SPN" SG_ 3221225472 EngDesiredIgntTiming2 1434;
BA_ "SigType" SG_ 3221225472 EngDesiredIgntTiming2 1;
BA_ "SPN" SG_ 3221225472 EngDesiredIgntTiming1 1433;
BA_ "SigType" SG_ 3221225472 EngDesiredIgntTiming1 1;
BA_ "SPN" SG_ 3221225472 EngCyl20IgntTiming 1432;
BA_ "SigType" SG_ 3221225472 EngCyl20IgntTiming 1;
BA_ "SPN" SG_ 3221225472 EngCyl19IgntTiming 1431;
BA_ "SigType" SG_ 3221225472 EngCyl19IgntTiming 1;
BA_ "SPN" SG_ 3221225472 EngCyl18IgntTiming 1430;
BA_ "SigType" SG_ 3221225472 EngCyl18IgntTiming 1;
BA_ "SPN" SG_ 3221225472 EngCyl17IgntTiming 1429;
BA_ "SigType" SG_ 3221225472 EngCyl17IgntTiming 1;
BA_ "SPN" SG_ 3221225472 EngCyl16IgntTiming 1428;
BA_ "SigType" SG_ 3221225472 EngCyl16IgntTiming 1;
BA_ "SPN" SG_ 3221225472 EngCyl15IgntTiming 1427;
BA_ "SigType" SG_ 3221225472 EngCyl15IgntTiming 1;
BA_ "SPN" SG_ 3221225472 EngCyl14IgntTiming 1426;
BA_ "SigType" SG_ 3221225472 EngCyl14IgntTiming 1;
BA_ "SPN" SG_ 3221225472 EngCyl13IgntTiming 1425;
BA_ "SigType" SG_ 3221225472 EngCyl13IgntTiming 1;
BA_ "SPN" SG_ 3221225472 EngCyl12IgntTiming 1424;
BA_ "SigType" SG_ 3221225472 EngCyl12IgntTiming 1;
BA_ "SPN" SG_ 3221225472 EngCyl11IgntTiming 1423;
BA_ "SigType" SG_ 3221225472 EngCyl11IgntTiming 1;
BA_ "SPN" SG_ 3221225472 EngCyl10IgntTiming 1422;
BA_ "SigType" SG_ 3221225472 EngCyl10IgntTiming 1;
BA_ "SPN" SG_ 3221225472 EngCyl9IgntTiming 1421;
BA_ "SigType" SG_ 3221225472 EngCyl9IgntTiming 1;
BA_ "SPN" SG_ 3221225472 EngCyl8IgntTiming 1420;
BA_ "SigType" SG_ 3221225472 EngCyl8IgntTiming 1;
BA_ "SPN" SG_ 3221225472 EngCyl7IgntTiming 1419;
BA_ "SigType" SG_ 3221225472 EngCyl7IgntTiming 1;
BA_ "SPN" SG_ 3221225472 EngCyl6IgntTiming 1418;
BA_ "SigType" SG_ 3221225472 EngCyl6IgntTiming 1;
BA_ "SPN" SG_ 3221225472 EngCyl5IgntTiming 1417;
BA_ "SigType" SG_ 3221225472 EngCyl5IgntTiming 1;
BA_ "SPN" SG_ 3221225472 EngCyl4IgntTiming 1416;
BA_ "SigType" SG_ 3221225472 EngCyl4IgntTiming 1;
BA_ "SPN" SG_ 3221225472 EngCyl3IgntTiming 1415;
BA_ "SigType" SG_ 3221225472 EngCyl3IgntTiming 1;
BA_ "SPN" SG_ 3221225472 EngCyl2IgntTiming 1414;
BA_ "SigType" SG_ 3221225472 EngCyl2IgntTiming 1;
BA_ "SPN" SG_ 3221225472 EngCyl1IgntTiming 1413;
BA_ "SigType" SG_ 3221225472 EngCyl1IgntTiming 1;
BA_ "SPN" SG_ 3221225472 EngCyl20IgntTransSecondOutput 1412;
BA_ "SigType" SG_ 3221225472 EngCyl20IgntTransSecondOutput 1;
BA_ "SPN" SG_ 3221225472 EngCyl19IgntTransSecondOutput 1411;
BA_ "SigType" SG_ 3221225472 EngCyl19IgntTransSecondOutput 1;
BA_ "SPN" SG_ 3221225472 EngCyl18IgntTransSecondOutput 1410;
BA_ "SigType" SG_ 3221225472 EngCyl18IgntTransSecondOutput 1;
BA_ "SPN" SG_ 3221225472 EngCyl17IgntTransSecondOutput 1409;
BA_ "SigType" SG_ 3221225472 EngCyl17IgntTransSecondOutput 1;
BA_ "SPN" SG_ 3221225472 EngCyl16IgntTransSecondOutput 1408;
BA_ "SigType" SG_ 3221225472 EngCyl16IgntTransSecondOutput 1;
BA_ "SPN" SG_ 3221225472 EngCyl15IgntTransSecondOutput 1407;
BA_ "SigType" SG_ 3221225472 EngCyl15IgntTransSecondOutput 1;
BA_ "SPN" SG_ 3221225472 EngCyl14IgntTransSecondOutput 1406;
BA_ "SigType" SG_ 3221225472 EngCyl14IgntTransSecondOutput 1;
BA_ "SPN" SG_ 3221225472 EngCyl13IgntTransSecondOutput 1405;
BA_ "SigType" SG_ 3221225472 EngCyl13IgntTransSecondOutput 1;
BA_ "SPN" SG_ 3221225472 EngCyl12IgntTransSecondOutput 1404;
BA_ "SigType" SG_ 3221225472 EngCyl12IgntTransSecondOutput 1;
BA_ "SPN" SG_ 3221225472 EngCyl11IgntTransSecondOutput 1403;
BA_ "SigType" SG_ 3221225472 EngCyl11IgntTransSecondOutput 1;
BA_ "SPN" SG_ 3221225472 EngCyl10IgntTransSecondOutput 1402;
BA_ "SigType" SG_ 3221225472 EngCyl10IgntTransSecondOutput 1;
BA_ "SPN" SG_ 3221225472 EngCyl9IgntTransSecondOutput 1401;
BA_ "SigType" SG_ 3221225472 EngCyl9IgntTransSecondOutput 1;
BA_ "SPN" SG_ 3221225472 EngCyl8IgntTransSecondOutput 1400;
BA_ "SigType" SG_ 3221225472 EngCyl8IgntTransSecondOutput 1;
BA_ "SPN" SG_ 3221225472 EngCyl7IgntTransSecondOutput 1399;
BA_ "SigType" SG_ 3221225472 EngCyl7IgntTransSecondOutput 1;
BA_ "SPN" SG_ 3221225472 EngCyl6IgntTransSecondOutput 1398;
BA_ "SigType" SG_ 3221225472 EngCyl6IgntTransSecondOutput 1;
BA_ "SPN" SG_ 3221225472 EngCyl5IgntTransSecondOutput 1397;
BA_ "SigType" SG_ 3221225472 EngCyl5IgntTransSecondOutput 1;
BA_ "SPN" SG_ 3221225472 EngCyl4IgntTransSecondOutput 1396;
BA_ "SigType" SG_ 3221225472 EngCyl4IgntTransSecondOutput 1;
BA_ "SPN" SG_ 3221225472 EngCyl3IgntTransSecondOutput 1395;
BA_ "SigType" SG_ 3221225472 EngCyl3IgntTransSecondOutput 1;
BA_ "SPN" SG_ 3221225472 EngCyl2IgntTransSecondOutput 1394;
BA_ "SigType" SG_ 3221225472 EngCyl2IgntTransSecondOutput 1;
BA_ "SPN" SG_ 3221225472 EngCyl1IgntTransSecondOutput 1393;
BA_ "SigType" SG_ 3221225472 EngCyl1IgntTransSecondOutput 1;
BA_ "SPN" SG_ 3221225472 EngOprtrPrmryIntrmdtSpdSlctStte 2892;
BA_ "SPN" SG_ 3221225472 EngOprtrPrmryIntrmdtSpeedSelect 2880;
BA_ "SPN" SG_ 3221225472 EngTotalIdleHours 235;
BA_ "SigType" SG_ 3221225472 EngTotalIdleHours 1;
BA_ "SPN" SG_ 3221225472 EngTotalIdleFuelUsed 236;
BA_ "SigType" SG_ 3221225472 EngTotalIdleFuelUsed 1;
BA_ "SPN" SG_ 3221225472 EngIntakeManifold6Temp 1803;
BA_ "SigType" SG_ 3221225472 EngIntakeManifold6Temp 1;
BA_ "SPN" SG_ 3221225472 EngIntakeManifold5Temp 1802;
BA_ "SigType" SG_ 3221225472 EngIntakeManifold5Temp 1;
BA_ "SPN" SG_ 3221225472 EngIntakeManifold4Temp 1133;
BA_ "SigType" SG_ 3221225472 EngIntakeManifold4Temp 1;
BA_ "SPN" SG_ 3221225472 EngIntakeManifold3Temp 1132;
BA_ "SigType" SG_ 3221225472 EngIntakeManifold3Temp 1;
BA_ "SPN" SG_ 3221225472 EngIntakeManifold2Temp 1131;
BA_ "SigType" SG_ 3221225472 EngIntakeManifold2Temp 1;
BA_ "SPN" SG_ 3221225472 EngTurbo4BoostPress 1130;
BA_ "SigType" SG_ 3221225472 EngTurbo4BoostPress 1;
BA_ "SPN" SG_ 3221225472 EngTurbo3BoostPress 1129;
BA_ "SigType" SG_ 3221225472 EngTurbo3BoostPress 1;
BA_ "SPN" SG_ 3221225472 EngTurbo2BoostPress 1128;
BA_ "SigType" SG_ 3221225472 EngTurbo2BoostPress 1;
BA_ "SPN" SG_ 3221225472 EngTurbo1BoostPress 1127;
BA_ "SigType" SG_ 3221225472 EngTurbo1BoostPress 1;
BA_ "SPN" SG_ 3221225472 EngAirFilter4DiffPress 2811;
BA_ "SigType" SG_ 3221225472 EngAirFilter4DiffPress 1;
BA_ "SPN" SG_ 3221225472 EngAirFilter3DiffPress 2810;
BA_ "SigType" SG_ 3221225472 EngAirFilter3DiffPress 1;
BA_ "SPN" SG_ 3221225472 EngAirFilter2DiffPress 2809;
BA_ "SigType" SG_ 3221225472 EngAirFilter2DiffPress 1;
BA_ "SPN" SG_ 3221225472 EngIntakeManifold2Press 3562;
BA_ "SigType" SG_ 3221225472 EngIntakeManifold2Press 1;
BA_ "SPN" SG_ 3221225472 EngIntakeManifold1AbsPress 3563;
BA_ "SigType" SG_ 3221225472 EngIntakeManifold1AbsPress 1;
BA_ "SPN" SG_ 3221225472 CabHeatingZone 1680;
BA_ "SigType" SG_ 3221225472 CabHeatingZone 4;
BA_ "SPN" SG_ 3221225472 EngHeatingZone 1679;
BA_ "SigType" SG_ 3221225472 EngHeatingZone 4;
BA_ "SPN" SG_ 3221225472 CabVentilation 1678;
BA_ "SigType" SG_ 3221225472 CabVentilation 4;
BA_ "SPN" SG_ 3221225472 AuxilaryHeaterWaterPumpStatus 1676;
BA_ "SigType" SG_ 3221225472 AuxilaryHeaterWaterPumpStatus 4;
BA_ "SPN" SG_ 3221225472 AuxHeaterMode 1677;
BA_ "SPN" SG_ 3221225472 AuxHeaterOutputPowerPercent 1689;
BA_ "SigType" SG_ 3221225472 AuxHeaterOutputPowerPercent 1;
BA_ "SPN" SG_ 3221225472 AuxHeaterInputAirTemp 1688;
BA_ "SigType" SG_ 3221225472 AuxHeaterInputAirTemp 1;
BA_ "SPN" SG_ 3221225472 AuxHeaterOutputCoolantTemp 1687;
BA_ "SigType" SG_ 3221225472 AuxHeaterOutputCoolantTemp 1;
BA_ "SPN" SG_ 3221225472 RearAxleRightWheelSpeed 1595;
BA_ "SigType" SG_ 3221225472 RearAxleRightWheelSpeed 1;
BA_ "SPN" SG_ 3221225472 RearAxleLeftWheelSpeed 1594;
BA_ "SigType" SG_ 3221225472 RearAxleLeftWheelSpeed 1;
BA_ "SPN" SG_ 3221225472 FrontAxleRightWheelSpeed 1593;
BA_ "SigType" SG_ 3221225472 FrontAxleRightWheelSpeed 1;
BA_ "SPN" SG_ 3221225472 FrontAxleLeftWheelSpeed 1592;
BA_ "SigType" SG_ 3221225472 FrontAxleLeftWheelSpeed 1;
BA_ "SPN" SG_ 3221225472 FireApparatusPumpEngagement 2599;
BA_ "SigType" SG_ 3221225472 FireApparatusPumpEngagement 4;
BA_ "SPN" SG_ 3221225472 EngHydPressGovernorSwitch 1764;
BA_ "SigType" SG_ 3221225472 EngHydPressGovernorSwitch 4;
BA_ "SPN" SG_ 3221225472 EngHydPrssGovernorModeIndicator 1763;
BA_ "SigType" SG_ 3221225472 EngHydPrssGovernorModeIndicator 4;
BA_ "SPN" SG_ 3221225472 HydPress 1762;
BA_ "SigType" SG_ 3221225472 HydPress 1;
BA_ "SPN" SG_ 3221225472 HydBrakeFluidLevelSwitch 2931;
BA_ "SigType" SG_ 3221225472 HydBrakeFluidLevelSwitch 4;
BA_ "SPN" SG_ 3221225472 HydBrakeSystemAudibleWarningCmd 2930;
BA_ "SigType" SG_ 3221225472 HydBrakeSystemAudibleWarningCmd 4;
BA_ "SPN" SG_ 3221225472 HydBrkePressSupplyStateCircuit2 2583;
BA_ "SigType" SG_ 3221225472 HydBrkePressSupplyStateCircuit2 4;
BA_ "SPN" SG_ 3221225472 HydBrkePressSupplyStateCircuit1 2582;
BA_ "SigType" SG_ 3221225472 HydBrkePressSupplyStateCircuit1 4;
BA_ "SPN" SG_ 3221225472 HydBrkPressWarningStateCircuit2 2585;
BA_ "SigType" SG_ 3221225472 HydBrkPressWarningStateCircuit2 4;
BA_ "SPN" SG_ 3221225472 HydBrkPressWarningStateCircuit1 2584;
BA_ "SigType" SG_ 3221225472 HydBrkPressWarningStateCircuit1 4;
BA_ "SPN" SG_ 3221225472 HydBrakePressCircuit2 2581;
BA_ "SigType" SG_ 3221225472 HydBrakePressCircuit2 1;
BA_ "SPN" SG_ 3221225472 HydBrakePressCircuit1 2580;
BA_ "SigType" SG_ 3221225472 HydBrakePressCircuit1 1;
BA_ "SPN" SG_ 3221225472 TripDriveFuelEconomy 1006;
BA_ "SigType" SG_ 3221225472 TripDriveFuelEconomy 1;
BA_ "SPN" SG_ 3221225472 TripCruiseFuelUsed 1011;
BA_ "SigType" SG_ 3221225472 TripCruiseFuelUsed 1;
BA_ "SPN" SG_ 3221225472 TripVehicleIdleFuelUsed 1010;
BA_ "SigType" SG_ 3221225472 TripVehicleIdleFuelUsed 1;
BA_ "SPN" SG_ 3221225472 TripPTONonmovingFuelUsed 1009;
BA_ "SigType" SG_ 3221225472 TripPTONonmovingFuelUsed 1;
BA_ "SPN" SG_ 3221225472 TripPTOMovingFuelUsed 1008;
BA_ "SigType" SG_ 3221225472 TripPTOMovingFuelUsed 1;
BA_ "SPN" SG_ 3221225472 TripDriveFuelUsed 1007;
BA_ "SigType" SG_ 3221225472 TripDriveFuelUsed 1;
BA_ "SPN" SG_ 3221225472 EngFuelValve1OutletAbsPress 2980;
BA_ "SigType" SG_ 3221225472 EngFuelValve1OutletAbsPress 1;
BA_ "SPN" SG_ 3221225472 EngAirToFuelDiffPress 1392;
BA_ "SigType" SG_ 3221225472 EngAirToFuelDiffPress 1;
BA_ "SPN" SG_ 3221225472 EngFuelValveDiffPress 1391;
BA_ "SigType" SG_ 3221225472 EngFuelValveDiffPress 1;
BA_ "SPN" SG_ 3221225472 EngFuelValveInletAbsPress 1390;
BA_ "SigType" SG_ 3221225472 EngFuelValveInletAbsPress 1;
BA_ "SPN" SG_ 3221225472 EngFuelFlowRate2 1441;
BA_ "SigType" SG_ 3221225472 EngFuelFlowRate2 1;
BA_ "SPN" SG_ 3221225472 EngFuelFlowRate1 1440;
BA_ "SigType" SG_ 3221225472 EngFuelFlowRate1 1;
BA_ "SPN" SG_ 3221225472 EngRqedFuelValve2Pos 1766;
BA_ "SigType" SG_ 3221225472 EngRqedFuelValve2Pos 1;
BA_ "SPN" SG_ 3221225472 EngRqedFuelValve1Pos 1765;
BA_ "SigType" SG_ 3221225472 EngRqedFuelValve1Pos 1;
BA_ "SPN" SG_ 3221225472 EngFuelValve2Pos 1443;
BA_ "SigType" SG_ 3221225472 EngFuelValve2Pos 1;
BA_ "SPN" SG_ 3221225472 EngFuelValve1Pos 1442;
BA_ "SigType" SG_ 3221225472 EngFuelValve1Pos 1;
BA_ "SPN" SG_ 3221225472 EngFuelSpecificGravity 1389;
BA_ "SigType" SG_ 3221225472 EngFuelSpecificGravity 1;
BA_ "SPN" SG_ 3221225472 TripAverageFuelRate 1031;
BA_ "SigType" SG_ 3221225472 TripAverageFuelRate 1;
BA_ "SPN" SG_ 3221225472 TotalEngPTOFuelUsed 1030;
BA_ "SigType" SG_ 3221225472 TotalEngPTOFuelUsed 1;
BA_ "SPN" SG_ 3221225472 SpecificHeatRatio 1767;
BA_ "SigType" SG_ 3221225472 SpecificHeatRatio 1;
BA_ "SPN" SG_ 3221225472 TotalFuelUsed 1040;
BA_ "SigType" SG_ 3221225472 TotalFuelUsed 1;
BA_ "SPN" SG_ 3221225472 TripFuel 1039;
BA_ "SigType" SG_ 3221225472 TripFuel 1;
BA_ "SPN" SG_ 3221225472 SensorSupplyVoltage6 3514;
BA_ "SigType" SG_ 3221225472 SensorSupplyVoltage6 1;
BA_ "SPN" SG_ 3221225472 SensorSupplyVoltage5 3513;
BA_ "SigType" SG_ 3221225472 SensorSupplyVoltage5 1;
BA_ "SPN" SG_ 3221225472 SensorSupplyVoltage4 3512;
BA_ "SigType" SG_ 3221225472 SensorSupplyVoltage4 1;
BA_ "SPN" SG_ 3221225472 SensorSupplyVoltage3 3511;
BA_ "SigType" SG_ 3221225472 SensorSupplyVoltage3 1;
BA_ "SPN" SG_ 3221225472 SensorSupplyVoltage2 3510;
BA_ "SigType" SG_ 3221225472 SensorSupplyVoltage2 1;
BA_ "SPN" SG_ 3221225472 SensorSupplyVoltage1 3509;
BA_ "SigType" SG_ 3221225472 SensorSupplyVoltage1 1;
BA_ "SPN" SG_ 3221225472 EnggmntSttusTransInputShaftPTO1 3460;
BA_ "SigType" SG_ 3221225472 EnggmntSttusTransInputShaftPTO1 4;
BA_ "SPN" SG_ 3221225472 EnggmntSttusTransInputShaftPTO2 3461;
BA_ "SigType" SG_ 3221225472 EnggmntSttusTransInputShaftPTO2 4;
BA_ "SPN" SG_ 3221225472 EnggmntSttusTransOutputShaftPTO 3462;
BA_ "SigType" SG_ 3221225472 EnggmntSttusTransOutputShaftPTO 4;
BA_ "SPN" SG_ 3221225472 EnggmntSttsTrnsfrCsOtptShaftPTO 3463;
BA_ "SigType" SG_ 3221225472 EnggmntSttsTrnsfrCsOtptShaftPTO 4;
BA_ "SPN" SG_ 3221225472 EnggmntCnsntTransInputShaftPTO1 3456;
BA_ "SigType" SG_ 3221225472 EnggmntCnsntTransInputShaftPTO1 4;
BA_ "SPN" SG_ 3221225472 EnggmntCnsntTransInputShaftPTO2 3457;
BA_ "SigType" SG_ 3221225472 EnggmntCnsntTransInputShaftPTO2 4;
BA_ "SPN" SG_ 3221225472 EnggmntCnsntTransOutputShaftPTO 3458;
BA_ "SigType" SG_ 3221225472 EnggmntCnsntTransOutputShaftPTO 4;
BA_ "SPN" SG_ 3221225472 EnggmntCnsntTrnsfrCsOtptShftPTO 3459;
BA_ "SigType" SG_ 3221225472 EnggmntCnsntTrnsfrCsOtptShftPTO 4;
BA_ "SPN" SG_ 3221225472 EnableSwitchTransInputShaftPTO1 3452;
BA_ "SigType" SG_ 3221225472 EnableSwitchTransInputShaftPTO1 4;
BA_ "SPN" SG_ 3221225472 EnableSwitchTransInputShaftPTO2 3453;
BA_ "SigType" SG_ 3221225472 EnableSwitchTransInputShaftPTO2 4;
BA_ "SPN" SG_ 3221225472 EnableSwitchTransOutputShaftPTO 3454;
BA_ "SigType" SG_ 3221225472 EnableSwitchTransOutputShaftPTO 4;
BA_ "SPN" SG_ 3221225472 EnblSwtchTrnsfrCsOutputShaftPTO 3455;
BA_ "SigType" SG_ 3221225472 EnblSwtchTrnsfrCsOutputShaftPTO 4;
BA_ "SPN" SG_ 3221225472 EngFuelValve2OutletAbsPress 3469;
BA_ "SigType" SG_ 3221225472 EngFuelValve2OutletAbsPress 1;
BA_ "SPN" SG_ 3221225472 EngFuelTemp2 3468;
BA_ "SigType" SG_ 3221225472 EngFuelTemp2 1;
BA_ "SPN" SG_ 3221225472 EngGasMassFlowRate2 3467;
BA_ "SigType" SG_ 3221225472 EngGasMassFlowRate2 1;
BA_ "SPN" SG_ 3221225472 EngFuelValve2InletAbsPress 3466;
BA_ "SigType" SG_ 3221225472 EngFuelValve2InletAbsPress 1;
BA_ "SPN" SG_ 3221225472 EngCentrifugalOilFilterSpeed 3343;
BA_ "SigType" SG_ 3221225472 EngCentrifugalOilFilterSpeed 1;
BA_ "SPN" SG_ 3221225472 EngCoolantPumpDiffPress 3342;
BA_ "SigType" SG_ 3221225472 EngCoolantPumpDiffPress 1;
BA_ "SPN" SG_ 3221225472 EngChargeAirCooler2InletPress 3341;
BA_ "SigType" SG_ 3221225472 EngChargeAirCooler2InletPress 1;
BA_ "SPN" SG_ 3221225472 EngChargeAirCooler1InletPress 3340;
BA_ "SigType" SG_ 3221225472 EngChargeAirCooler1InletPress 1;
BA_ "SPN" SG_ 3221225472 EngIntercoolerCoolantLevel 3668;
BA_ "SigType" SG_ 3221225472 EngIntercoolerCoolantLevel 1;
BA_ "SPN" SG_ 3221225472 EngChargeAirCoolerOutletPress 2631;
BA_ "SigType" SG_ 3221225472 EngChargeAirCoolerOutletPress 1;
BA_ "SPN" SG_ 3221225472 EngAftercoolerCoolantLevel 3676;
BA_ "SigType" SG_ 3221225472 EngAftercoolerCoolantLevel 1;
BA_ "SPN" SG_ 3221225472 EngVrableGeometryTurboActuator1 641;
BA_ "SigType" SG_ 3221225472 EngVrableGeometryTurboActuator1 1;
BA_ "SPN" SG_ 3221225472 EngTrbCmprssorBypassActuatorPos 3675;
BA_ "SigType" SG_ 3221225472 EngTrbCmprssorBypassActuatorPos 1;
BA_ "SPN" SG_ 3221225472 EngTurboCompressorCtrl 3470;
BA_ "SigType" SG_ 3221225472 EngTurboCompressorCtrl 1;
BA_ "SPN" SG_ 3221225472 EnableStatusOfDoor10 3441;
BA_ "SigType" SG_ 3221225472 EnableStatusOfDoor10 4;
BA_ "SPN" SG_ 3221225472 OpenStatusOfDoor10 3440;
BA_ "SigType" SG_ 3221225472 OpenStatusOfDoor10 4;
BA_ "SPN" SG_ 3221225472 LockStatusOfDoor10 3439;
BA_ "SigType" SG_ 3221225472 LockStatusOfDoor10 4;
BA_ "SPN" SG_ 3221225472 EnableStatusOfDoor9 3438;
BA_ "SigType" SG_ 3221225472 EnableStatusOfDoor9 4;
BA_ "SPN" SG_ 3221225472 OpenStatusOfDoor9 3437;
BA_ "SigType" SG_ 3221225472 OpenStatusOfDoor9 4;
BA_ "SPN" SG_ 3221225472 LockStatusOfDoor9 3436;
BA_ "SigType" SG_ 3221225472 LockStatusOfDoor9 4;
BA_ "SPN" SG_ 3221225472 EnableStatusOfDoor8 3435;
BA_ "SigType" SG_ 3221225472 EnableStatusOfDoor8 4;
BA_ "SPN" SG_ 3221225472 OpenStatusOfDoor8 3434;
BA_ "SigType" SG_ 3221225472 OpenStatusOfDoor8 4;
BA_ "SPN" SG_ 3221225472 LockStatusOfDoor8 3433;
BA_ "SigType" SG_ 3221225472 LockStatusOfDoor8 4;
BA_ "SPN" SG_ 3221225472 EnableStatusOfDoor7 3432;
BA_ "SigType" SG_ 3221225472 EnableStatusOfDoor7 4;
BA_ "SPN" SG_ 3221225472 OpenStatusOfDoor7 3431;
BA_ "SigType" SG_ 3221225472 OpenStatusOfDoor7 4;
BA_ "SPN" SG_ 3221225472 LockStatusOfDoor7 3430;
BA_ "SigType" SG_ 3221225472 LockStatusOfDoor7 4;
BA_ "SPN" SG_ 3221225472 EnableStatusOfDoor6 3429;
BA_ "SigType" SG_ 3221225472 EnableStatusOfDoor6 4;
BA_ "SPN" SG_ 3221225472 OpenStatusOfDoor6 3428;
BA_ "SigType" SG_ 3221225472 OpenStatusOfDoor6 4;
BA_ "SPN" SG_ 3221225472 LockStatusOfDoor6 3427;
BA_ "SigType" SG_ 3221225472 LockStatusOfDoor6 4;
BA_ "SPN" SG_ 3221225472 EnableStatusOfDoor5 3426;
BA_ "SigType" SG_ 3221225472 EnableStatusOfDoor5 4;
BA_ "SPN" SG_ 3221225472 OpenStatusOfDoor5 3425;
BA_ "SigType" SG_ 3221225472 OpenStatusOfDoor5 4;
BA_ "SPN" SG_ 3221225472 LockStatusOfDoor5 3424;
BA_ "SigType" SG_ 3221225472 LockStatusOfDoor5 4;
BA_ "SPN" SG_ 3221225472 EnableStatusOfDoor4 3423;
BA_ "SigType" SG_ 3221225472 EnableStatusOfDoor4 4;
BA_ "SPN" SG_ 3221225472 OpenStatusOfDoor4 3422;
BA_ "SigType" SG_ 3221225472 OpenStatusOfDoor4 4;
BA_ "SPN" SG_ 3221225472 LockStatusOfDoor4 3421;
BA_ "SigType" SG_ 3221225472 LockStatusOfDoor4 4;
BA_ "SPN" SG_ 3221225472 EnableStatusOfDoor3 3420;
BA_ "SigType" SG_ 3221225472 EnableStatusOfDoor3 4;
BA_ "SPN" SG_ 3221225472 OpenStatusOfDoor3 3419;
BA_ "SigType" SG_ 3221225472 OpenStatusOfDoor3 4;
BA_ "SPN" SG_ 3221225472 LockStatusOfDoor3 3418;
BA_ "SigType" SG_ 3221225472 LockStatusOfDoor3 4;
BA_ "SPN" SG_ 3221225472 EnableStatusOfDoor2 3417;
BA_ "SigType" SG_ 3221225472 EnableStatusOfDoor2 4;
BA_ "SPN" SG_ 3221225472 OpenStatusOfDoor2 3416;
BA_ "SigType" SG_ 3221225472 OpenStatusOfDoor2 4;
BA_ "SPN" SG_ 3221225472 LockStatusOfDoor2 3415;
BA_ "SigType" SG_ 3221225472 LockStatusOfDoor2 4;
BA_ "SPN" SG_ 3221225472 EnableStatusOfDoor1 3414;
BA_ "SigType" SG_ 3221225472 EnableStatusOfDoor1 4;
BA_ "SPN" SG_ 3221225472 OpenStatusOfDoor1 3413;
BA_ "SigType" SG_ 3221225472 OpenStatusOfDoor1 4;
BA_ "SPN" SG_ 3221225472 LockStatusOfDoor1 3412;
BA_ "SigType" SG_ 3221225472 LockStatusOfDoor1 4;
BA_ "SPN" SG_ 3221225472 CatalystReagentType 3521;
BA_ "SPN" SG_ 3221225472 CtlystRgntPrprtesPreliminaryFMI 3520;
BA_ "SPN" SG_ 3221225472 CtlystRagentTemp2PreliminaryFMI 3519;
BA_ "SPN" SG_ 3221225472 CatalystReagentConductivity 3518;
BA_ "SigType" SG_ 3221225472 CatalystReagentConductivity 1;
BA_ "SPN" SG_ 3221225472 CatalystReagentConcentration 3516;
BA_ "SigType" SG_ 3221225472 CatalystReagentConcentration 1;
BA_ "SPN" SG_ 3221225472 CatalystReagentTemp2 3515;
BA_ "SigType" SG_ 3221225472 CatalystReagentTemp2 1;
BA_ "SPN" SG_ 3221225472 RqdGnrtrAvrgLneLineACRMSVoltage 3386;
BA_ "SigType" SG_ 3221225472 RqdGnrtrAvrgLneLineACRMSVoltage 1;
BA_ "SPN" SG_ 3221225472 EngThrottleActuator2CtrlCmd 3465;
BA_ "SigType" SG_ 3221225472 EngThrottleActuator2CtrlCmd 1;
BA_ "SPN" SG_ 3221225472 EngThrottleActuator1CtrlCmd 3464;
BA_ "SigType" SG_ 3221225472 EngThrottleActuator1CtrlCmd 1;
BA_ "SPN" SG_ 3221225472 EngFuelActuator2CtrlCmd 1244;
BA_ "SigType" SG_ 3221225472 EngFuelActuator2CtrlCmd 1;
BA_ "SPN" SG_ 3221225472 EngFuelActuator1CtrlCmd 633;
BA_ "SigType" SG_ 3221225472 EngFuelActuator1CtrlCmd 1;
BA_ "SPN" SG_ 3221225472 EngCyl24KnockLevel 1375;
BA_ "SigType" SG_ 3221225472 EngCyl24KnockLevel 1;
BA_ "SPN" SG_ 3221225472 EngCyl23KnockLevel 1374;
BA_ "SigType" SG_ 3221225472 EngCyl23KnockLevel 1;
BA_ "SPN" SG_ 3221225472 EngCyl22KnockLevel 1373;
BA_ "SigType" SG_ 3221225472 EngCyl22KnockLevel 1;
BA_ "SPN" SG_ 3221225472 EngCyl21KnockLevel 1372;
BA_ "SigType" SG_ 3221225472 EngCyl21KnockLevel 1;
BA_ "SPN" SG_ 3221225472 EngCyl20KnockLevel 1371;
BA_ "SigType" SG_ 3221225472 EngCyl20KnockLevel 1;
BA_ "SPN" SG_ 3221225472 EngCyl19KnockLevel 1370;
BA_ "SigType" SG_ 3221225472 EngCyl19KnockLevel 1;
BA_ "SPN" SG_ 3221225472 EngCyl18KnockLevel 1369;
BA_ "SigType" SG_ 3221225472 EngCyl18KnockLevel 1;
BA_ "SPN" SG_ 3221225472 EngCyl17KnockLevel 1368;
BA_ "SigType" SG_ 3221225472 EngCyl17KnockLevel 1;
BA_ "SPN" SG_ 3221225472 EngCyl15KnockLevel 1366;
BA_ "SigType" SG_ 3221225472 EngCyl15KnockLevel 1;
BA_ "SPN" SG_ 3221225472 EngCyl14KnockLevel 1365;
BA_ "SigType" SG_ 3221225472 EngCyl14KnockLevel 1;
BA_ "SPN" SG_ 3221225472 EngCyl13KnockLevel 1364;
BA_ "SigType" SG_ 3221225472 EngCyl13KnockLevel 1;
BA_ "SPN" SG_ 3221225472 EngCyl12KnockLevel 1363;
BA_ "SigType" SG_ 3221225472 EngCyl12KnockLevel 1;
BA_ "SPN" SG_ 3221225472 EngCyl11KnockLevel 1362;
BA_ "SigType" SG_ 3221225472 EngCyl11KnockLevel 1;
BA_ "SPN" SG_ 3221225472 EngCyl10KnockLevel 1361;
BA_ "SigType" SG_ 3221225472 EngCyl10KnockLevel 1;
BA_ "SPN" SG_ 3221225472 EngCyl9KnockLevel 1360;
BA_ "SigType" SG_ 3221225472 EngCyl9KnockLevel 1;
BA_ "SPN" SG_ 3221225472 EngCyl16KnockLevel 1367;
BA_ "SigType" SG_ 3221225472 EngCyl16KnockLevel 1;
BA_ "SPN" SG_ 3221225472 EngCyl8KnockLevel 1359;
BA_ "SigType" SG_ 3221225472 EngCyl8KnockLevel 1;
BA_ "SPN" SG_ 3221225472 EngCyl7KnockLevel 1358;
BA_ "SigType" SG_ 3221225472 EngCyl7KnockLevel 1;
BA_ "SPN" SG_ 3221225472 EngCyl6KnockLevel 1357;
BA_ "SigType" SG_ 3221225472 EngCyl6KnockLevel 1;
BA_ "SPN" SG_ 3221225472 EngCyl5KnockLevel 1356;
BA_ "SigType" SG_ 3221225472 EngCyl5KnockLevel 1;
BA_ "SPN" SG_ 3221225472 EngCyl4KnockLevel 1355;
BA_ "SigType" SG_ 3221225472 EngCyl4KnockLevel 1;
BA_ "SPN" SG_ 3221225472 EngCyl3KnockLevel 1354;
BA_ "SigType" SG_ 3221225472 EngCyl3KnockLevel 1;
BA_ "SPN" SG_ 3221225472 EngCyl2KnockLevel 1353;
BA_ "SigType" SG_ 3221225472 EngCyl2KnockLevel 1;
BA_ "SPN" SG_ 3221225472 EngCyl1KnockLevel 1352;
BA_ "SigType" SG_ 3221225472 EngCyl1KnockLevel 1;
BA_ "SPN" SG_ 3221225472 EngCyl9CombustionStatus 3395;
BA_ "SigType" SG_ 3221225472 EngCyl9CombustionStatus 4;
BA_ "SPN" SG_ 3221225472 EngCyl8CombustionStatus 3394;
BA_ "SigType" SG_ 3221225472 EngCyl8CombustionStatus 4;
BA_ "SPN" SG_ 3221225472 EngCyl7CombustionStatus 3393;
BA_ "SigType" SG_ 3221225472 EngCyl7CombustionStatus 4;
BA_ "SPN" SG_ 3221225472 EngCyl6CombustionStatus 3392;
BA_ "SigType" SG_ 3221225472 EngCyl6CombustionStatus 4;
BA_ "SPN" SG_ 3221225472 EngCyl5CombustionStatus 3391;
BA_ "SigType" SG_ 3221225472 EngCyl5CombustionStatus 4;
BA_ "SPN" SG_ 3221225472 EngCyl4CombustionStatus 3390;
BA_ "SigType" SG_ 3221225472 EngCyl4CombustionStatus 4;
BA_ "SPN" SG_ 3221225472 EngCyl3CombustionStatus 3389;
BA_ "SigType" SG_ 3221225472 EngCyl3CombustionStatus 4;
BA_ "SPN" SG_ 3221225472 EngCyl2CombustionStatus 3388;
BA_ "SigType" SG_ 3221225472 EngCyl2CombustionStatus 4;
BA_ "SPN" SG_ 3221225472 EngCyl24CombustionStatus 3410;
BA_ "SigType" SG_ 3221225472 EngCyl24CombustionStatus 4;
BA_ "SPN" SG_ 3221225472 EngCyl23CombustionStatus 3409;
BA_ "SigType" SG_ 3221225472 EngCyl23CombustionStatus 4;
BA_ "SPN" SG_ 3221225472 EngCyl22CombustionStatus 3408;
BA_ "SigType" SG_ 3221225472 EngCyl22CombustionStatus 4;
BA_ "SPN" SG_ 3221225472 EngCyl21CombustionStatus 3407;
BA_ "SigType" SG_ 3221225472 EngCyl21CombustionStatus 4;
BA_ "SPN" SG_ 3221225472 EngCyl20CombustionStatus 3406;
BA_ "SigType" SG_ 3221225472 EngCyl20CombustionStatus 4;
BA_ "SPN" SG_ 3221225472 EngCyl1CombustionStatus 3387;
BA_ "SigType" SG_ 3221225472 EngCyl1CombustionStatus 4;
BA_ "SPN" SG_ 3221225472 EngCyl19CombustionStatus 3405;
BA_ "SigType" SG_ 3221225472 EngCyl19CombustionStatus 4;
BA_ "SPN" SG_ 3221225472 EngCyl18CombustionStatus 3404;
BA_ "SigType" SG_ 3221225472 EngCyl18CombustionStatus 4;
BA_ "SPN" SG_ 3221225472 EngCyl17CombustionStatus 3403;
BA_ "SigType" SG_ 3221225472 EngCyl17CombustionStatus 4;
BA_ "SPN" SG_ 3221225472 EngCyl16CombustionStatus 3402;
BA_ "SigType" SG_ 3221225472 EngCyl16CombustionStatus 4;
BA_ "SPN" SG_ 3221225472 EngCyl15CombustionStatus 3401;
BA_ "SigType" SG_ 3221225472 EngCyl15CombustionStatus 4;
BA_ "SPN" SG_ 3221225472 EngCyl14CombustionStatus 3400;
BA_ "SigType" SG_ 3221225472 EngCyl14CombustionStatus 4;
BA_ "SPN" SG_ 3221225472 EngCyl13CombustionStatus 3399;
BA_ "SigType" SG_ 3221225472 EngCyl13CombustionStatus 4;
BA_ "SPN" SG_ 3221225472 EngCyl12CombustionStatus 3398;
BA_ "SigType" SG_ 3221225472 EngCyl12CombustionStatus 4;
BA_ "SPN" SG_ 3221225472 EngCyl11CombustionStatus 3397;
BA_ "SigType" SG_ 3221225472 EngCyl11CombustionStatus 4;
BA_ "SPN" SG_ 3221225472 EngCyl10CombustionStatus 3396;
BA_ "SigType" SG_ 3221225472 EngCyl10CombustionStatus 4;
BA_ "SPN" SG_ 3221225472 RqGenOverallPowerFactorLagging 3385;
BA_ "SigType" SG_ 3221225472 RqGenOverallPowerFactorLagging 4;
BA_ "SPN" SG_ 3221225472 RqGeneratorOverallPowerFactor 3384;
BA_ "SigType" SG_ 3221225472 RqGeneratorOverallPowerFactor 1;
BA_ "SPN" SG_ 3221225472 RqGeneratorTotalACReactivePower 3383;
BA_ "SigType" SG_ 3221225472 RqGeneratorTotalACReactivePower 1;
BA_ "SPN" SG_ 3221225472 BladeRotationAngleFigureOfMerit 3332;
BA_ "SigType" SG_ 3221225472 BladeRotationAngleFigureOfMerit 4;
BA_ "SPN" SG_ 3221225472 RelBladeHeightFigureOfMerit 3367;
BA_ "SigType" SG_ 3221225472 RelBladeHeightFigureOfMerit 4;
BA_ "SPN" SG_ 3221225472 RelBladeMeasurementLatency 3366;
BA_ "SigType" SG_ 3221225472 RelBladeMeasurementLatency 1;
BA_ "SPN" SG_ 3221225472 BladeRotationAngle 3331;
BA_ "SigType" SG_ 3221225472 BladeRotationAngle 1;
BA_ "SPN" SG_ 3221225472 RelativeBladeHeight 3365;
BA_ "SigType" SG_ 3221225472 RelativeBladeHeight 1;
BA_ "SigType" SG_ 3221225472 VehicleType 4;
BA_ "SigType" SG_ 3221225472 BrakeLightSwitch 4;
BA_ "SigType" SG_ 3221225472 ASREngineControlActive 4;
BA_ "SigType" SG_ 3221225472 ASRBreakControlActive 4;
BA_ "SigType" SG_ 3221225472 VehicleRetarderCtrlActive 4;
BA_ "SigType" SG_ 3221225472 VehicleABSActive 4;
BA_ "SPN" SG_ 3221225472 RoadCurvature 1591;
BA_ "SigType" SG_ 3221225472 RoadCurvature 1;
BA_ "SigType" SG_ 3221225472 PneumaticControlLine 4;
BA_ "SigType" SG_ 3221225472 ABSOffroadRequest 4;
BA_ "SigType" SG_ 3221225472 TwoElCircuitsBrakeDemand 4;
BA_ "SigType" SG_ 3221225472 ActualRetarderPercTorque 1;
BA_ "SigType" SG_ 3221225472 Wheel_BasedVehicleSpeed 1;
BA_ "SigType" SG_ 3221225472 SupplyLineBrakingRequest 4;
BA_ "SigType" SG_ 3221225472 VDCActive 4;
BA_ "SigType" SG_ 3221225472 AutomTowedVehBreakActive 4;
BA_ "SigType" SG_ 3221225472 VehicleServiceBrakeActive 4;
BA_ "SPN" SG_ 3221225472 ReferenceRetarderTorque 556;
BA_ "SigType" SG_ 3221225472 ReferenceRetarderTorque 1;
BA_ "SigType" SG_ 3221225472 LoadingRampApproachAssist 4;
BA_ "SigType" SG_ 3221225472 SpringBrakeEngaged 4;
BA_ "SigType" SG_ 3221225472 ElectrLoadPropFunc 4;
BA_ "SigType" SG_ 3221225472 SpringBrakeInstalled 4;
BA_ "SigType" SG_ 3221225472 ElecSupplyOfNonBrakingSys 4;
BA_ "SigType" SG_ 3221225472 AmberWarningSignalReq 4;
BA_ "SigType" SG_ 3221225472 RedWarningSignalRequest 4;
BA_ "SigType" SG_ 3221225472 VehicleElectrSupplySuff 4;
BA_ "SigType" SG_ 3221225472 VehiclePneumSupplySuff 4;
BA_ "SigType" SG_ 3221225472 BrakeTemperatureStatus 4;
BA_ "SigType" SG_ 3221225472 BrakeLiningSufficient 4;
BA_ "SigType" SG_ 3221225472 TyrePressureSufficient 4;
BA_ "SigType" SG_ 3221225472 ODDRequest 4;
BA_ "SigType" SG_ 3221225472 AntiTheftDeviceReq 4;
BA_ "SPN" SG_ 3221225472 MaxVehicleSpeedLimit 74;
BA_ "SigType" SG_ 3221225472 MaxVehicleSpeedLimit 1;
BA_ "SigType" SG_ 3221225472 VehicleSpeed 1;
BA_ "SigType" SG_ 3221225472 PercentLoadAtCurrentSpeed 1;
BA_ "SigType" SG_ 3221225472 EngineSpeed 1;
BA_ "SigType" SG_ 3221225472 ActualEngine_PercTorque 1;
BA_ "SigType" SG_ 3221225472 DriversDemandEngine_PercTorque 1;
BA_ "SigType" SG_ 3221225472 EngineRunning 4;
BA_ "SigType" SG_ 3221225472 EngineControlAllowed 4;
BA_ "SigType" SG_ 3221225472 ClutchIndptdPTOFeedback 4;
BA_ "SigType" SG_ 3221225472 AccelPedalPosition 1;
BA_ "SigType" SG_ 3221225472 AccelPedalLowIdleSwitch 4;
BA_ "SigType" SG_ 3221225472 StarterActive 4;
BA_ "SigType" SG_ 3221225472 PTOControlAllowed 4;
BA_ "SigType" SG_ 3221225472 SecEngineMtdPTOFeedback 4;
BA_ "SigType" SG_ 3221225472 FirstEngineMtdPTOFeedback 4;
BA_ "SigType" SG_ 3221225472 SecClutchDptdPTOFeedback 4;
BA_ "SigType" SG_ 3221225472 FirstClutchDpdtPTOFeedback 4;
BA_ "SigType" SG_ 3221225472 CurrentGear 1;
BA_ "SPN" SG_ 3221225472 PercentClutchSlip 522;
BA_ "SigType" SG_ 3221225472 PercentClutchSlip 1;
BA_ "SigType" SG_ 3221225472 ReferenceEngineTorque 1;
BA_ "SigType" SG_ 3221225472 FuelLevelWarning 4;
BA_ "SigType" SG_ 3221225472 EngineOilPressureWarning 4;
BA_ "SigType" SG_ 3221225472 EngineOilPressure 1;
BA_ "SPN" SG_ 3221225472 EngineCoolantTemperature 110;
BA_ "SigType" SG_ 3221225472 EngineCoolantTemperature 1;
BA_ "SigType" SG_ 3221225472 EngineOilTemperature 1;
BA_ "SigType" SG_ 3221225472 AmbientAirTemperature 1;
BA_ "SigType" SG_ 3221225472 AntiTheftDeviceStatus 4;
BA_ "SigType" SG_ 3221225472 ODDStatus 4;
BA_ "SigType" SG_ 3221225472 SecEngineMtdPTOSwitch 4;
BA_ "SigType" SG_ 3221225472 SecClutchDpdtPTOSwitch 4;
BA_ "SigType" SG_ 3221225472 FirstClutchDpdtPTOSwitch 4;
BA_ "SigType" SG_ 3221225472 OperatingPanelActive 4;
BA_ "SigType" SG_ 3221225472 RefusePackerStepSwitch 4;
BA_ "SigType" SG_ 3221225472 EngineStopSwitch 4;
BA_ "SigType" SG_ 3221225472 EngineStartSwitch 4;
BA_ "SigType" SG_ 3221225472 StarterLockoutSwitch 4;
BA_ "SigType" SG_ 3221225472 RqstedPercentClutchSlip 1;
BA_ "SigType" SG_ 3221225472 FirstEngineMtdPTOSwitch 4;
BA_ "SigType" SG_ 3221225472 ClutchIndpdtPTOSwitch 4;
BA_ "SigType" SG_ 3221225472 TrailerLeftSideMarkerLight 4;
BA_ "SigType" SG_ 3221225472 TrailerLeftReversingLight 4;
BA_ "SigType" SG_ 3221225472 TrailerLeftRearWidIndLight 4;
BA_ "SigType" SG_ 3221225472 TrailerLeftRearRegPltLight 4;
BA_ "SigType" SG_ 3221225472 TrailerLeftRearLight 4;
BA_ "SigType" SG_ 3221225472 TrailerLeftRearFogLight 4;
BA_ "SigType" SG_ 3221225472 TrailerLeftDirIndLight 4;
BA_ "SigType" SG_ 3221225472 TrailerLeftCrnMarkerLight 4;
BA_ "SigType" SG_ 3221225472 TrailerInteriorLight 4;
BA_ "SigType" SG_ 3221225472 TrailerWorkLamp 4;
BA_ "SigType" SG_ 3221225472 TrailerRotatingIdentLight 4;
BA_ "SigType" SG_ 3221225472 TrailerRightStopLight 4;
BA_ "SigType" SG_ 3221225472 TrailerRightSideMrkLight 4;
BA_ "SigType" SG_ 3221225472 TrailerRightReversingLight 4;
BA_ "SigType" SG_ 3221225472 TrailRightRearWidIndLight 4;
BA_ "SigType" SG_ 3221225472 TrailerRightRearRegPltLight 4;
BA_ "SigType" SG_ 3221225472 TrailerRightRearLight 4;
BA_ "SigType" SG_ 3221225472 TrailerRightRearFogLight 4;
BA_ "SigType" SG_ 3221225472 TrailerRightDirIndLight 4;
BA_ "SigType" SG_ 3221225472 TrailerRightCrnMarkerLight 4;
BA_ "SigType" SG_ 3221225472 TrailerRearWarningLight 4;
BA_ "SigType" SG_ 3221225472 TrailerLeftStopLight 4;
BA_ "SigType" SG_ 3221225472 ControlByte 1;
BA_ "SigType" SG_ 3221225472 FilterMode 1;
BA_ "SigType" SG_ 3221225472 ParkingAndTrailerAirPress 1;
BA_ "SigType" SG_ 3221225472 AuxEquipSupplyPressure 1;
BA_ "SigType" SG_ 3221225472 StopLevelChangeReq 4;
BA_ "SigType" SG_ 3221225472 RampLevelStorageReq 4;
BA_ "SigType" SG_ 3221225472 LevelControlReq 4;
BA_ "SigType" SG_ 3221225472 RampLevelReq 4;
BA_ "SigType" SG_ 3221225472 SteeringAxleLockingReq 4;
BA_ "SigType" SG_ 3221225472 LiftAxle2PositionReq 4;
BA_ "SigType" SG_ 3221225472 LiftAxle1PositionReq 4;
BA_ "SigType" SG_ 3221225472 TractionHelpReq 4;
BA_ "SigType" SG_ 3221225472 LevelChangeReqRearAxle 4;
BA_ "SigType" SG_ 3221225472 LevelChangeReqFrontAxle 4;
BA_ "SigType" SG_ 3221225472 RideHeightRequest 4;
BA_ "SigType" SG_ 3221225472 LevelControl 4;
BA_ "SigType" SG_ 3221225472 RampLevel 4;
BA_ "SigType" SG_ 3221225472 NormalLevel 4;
BA_ "SigType" SG_ 3221225472 StopLevelChangeAcknowledge 4;
BA_ "SigType" SG_ 3221225472 LevelChangeRearAxle 4;
BA_ "SigType" SG_ 3221225472 LevelChangeFrontAxle 4;
BA_ "SigType" SG_ 3221225472 RampLevelStorage 4;
BA_ "SigType" SG_ 3221225472 SteeringAxleLocking 4;
BA_ "SPN" SG_ 3221225472 LiftAxle2Pos 1822;
BA_ "SigType" SG_ 3221225472 LiftAxle2Pos 4;
BA_ "SPN" SG_ 3221225472 LiftAxle1Pos 1743;
BA_ "SigType" SG_ 3221225472 LiftAxle1Pos 4;
BA_ "SigType" SG_ 3221225472 RampLevelPosition 4;
BA_ "SigType" SG_ 3221225472 TractionHelp 4;
BA_ "SigType" SG_ 3221225472 LevelCtrlSysRideHeightLevel 4;
BA_ "SigType" SG_ 3221225472 TyreModulePowerSupply 4;
BA_ "SPN" SG_ 3221225472 XBRMessageChecksum 3188;
BA_ "SPN" SG_ 3221225472 XBRMessageCounter 3189;
BA_ "SPN" SG_ 3221225472 XBRCtrlMode 2916;
BA_ "SigType" SG_ 3221225472 XBRCtrlMode 4;
BA_ "SPN" SG_ 3221225472 XBRPriority 2915;
BA_ "SigType" SG_ 3221225472 XBRPriority 4;
BA_ "SPN" SG_ 3221225472 XBREBIMode 2914;
BA_ "SigType" SG_ 3221225472 XBREBIMode 4;
BA_ "SPN" SG_ 3221225472 ExtlAccelerationDemand 2920;
BA_ "SigType" SG_ 3221225472 ExtlAccelerationDemand 1;
BA_ "SPN" SG_ 3221225472 WaterInFuelIndicator 97;
BA_ "SigType" SG_ 3221225472 WaterInFuelIndicator 4;
BA_ "SPN" SG_ 3221225472 CargoWeight 181;
BA_ "SigType" SG_ 3221225472 CargoWeight 1;
VAL_ 3221225472 FailureModeIdentifier1 31 "Not available" 19 "Received network data in error" 18 "Below normal (moderately severe)" 17 "Below normal (least severe)" 16 "Above normal (moderately severe)" 15 "Above normal (least severe)" 14 "Special intstructions" 13 "Out of calibration" 12 "Bad intelligent device" 11 "Root cause not known" 10 "Abnormal rate of change" 9 "Abnormal update rate" 8 "Abnormal frequency" 7 "Mechanical system not responding" 6 "Current above normal" 5 "Current below normal" 4 "Voltage below normal" 3 "Voltage above normal" 2 "Data erratic" 1 "Below normal (most severe)" 0 "Above normal (most severe)" ;
VAL_ 3221225472 TextDisplayInstructions 1 "HldDsplyPrsntlyDsplydInfrmtnShl" 0 "ClrDsplyDsplydInfrmtnShldBDltdN" 5 "1110Reserved" 4 "OvrwrtSbstrngAPrtnOfPrsntlyDspl" 3 "OvrwrtDsplyPrsntlyDsplydInfrmtn" 2 "AppndAtEndOfDsplyTrnsmttdInfrmt" ;
VAL_ 3221225472 MovementStatusOfRamp3 3 "notAvailable" 2 "error" 1 "rampBeingMoved" 0 "rampNotBeingMoved" ;
VAL_ 3221225472 EnableStatusOfRamp3 3 "notAvailable" 2 "error" 1 "rampEnabled" 0 "rampDisabled" ;
VAL_ 3221225472 RetractStatusOfRamp3 3 "notAvailable" 2 "error" 1 "rampEx" 0 "rampRetracted" ;
VAL_ 3221225472 MovementStatusOfRamp2 3 "notAvailable" 2 "error" 1 "rampBeingMoved" 0 "rampNotBeingMoved" ;
VAL_ 3221225472 EnableStatusOfRamp2 3 "notAvailable" 2 "error" 1 "rampEnabled" 0 "rampDisabled" ;
VAL_ 3221225472 RetractStatusOfRamp2 3 "notAvailable" 2 "error" 1 "rampEx" 0 "rampRetracted" ;
VAL_ 3221225472 MovementStatusOfRamp1 3 "notAvailable" 2 "error" 1 "rampBeingMoved" 0 "rampNotBeingMoved" ;
VAL_ 3221225472 EnableStatusOfRamp1 3 "notAvailable" 2 "error" 1 "rampEnabled" 0 "rampDisabled" ;
VAL_ 3221225472 RetractStatusOfRamp1 3 "notAvailable" 2 "error" 1 "rampEx" 0 "rampRetracted" ;
VAL_ 3221225472 LaneDepartureWarningEnableCmd 3 "DonTCare" 2 "Reserved" 1 "EnableLaneDepartureWarning" 0 "DisableLaneDepartureWarning" ;
VAL_ 3221225472 J2012DTCStatus 1 "DTCIsActive" 0 "DTCIsPreviouslyActive" ;
VAL_ 3221225472 PrtcltTrpActvRgnrtnInhbtdDTVhclS 3 "notAvailable" 2 "reservedForSAEAssignment" 1 "inhibited" 0 "notInhibited" ;
VAL_ 3221225472 PrtcltTrpActvRgnrtnInhbtdDTOtOfN 3 "notAvailable" 2 "reservedForSAEAssignment" 1 "inhibited" 0 "notInhibited" ;
VAL_ 3221225472 PrtcltTrpActvRgnrtnInhbtdDTAcclP 3 "notAvailable" 2 "reservedForSAEAssignment" 1 "inhibited" 0 "notInhibited" ;
VAL_ 3221225472 PrtcltTrpActvRgnrtnInhbtdDTPTOAc 3 "notAvailable" 2 "reservedForSAEAssignment" 1 "inhibited" 0 "notInhibited" ;
VAL_ 3221225472 PrtcltTrpActvRgnrtnInhbtdDTSrvcB 3 "notAvailable" 2 "reservedForSAEAssignment" 1 "inhibited" 0 "notInhibited" ;
VAL_ 3221225472 PrtcltTrpActvRgnrtnInhbtdDTCltch 3 "notAvailable" 2 "reservedForSAEAssignment" 1 "inhibited" 0 "notInhibited" ;
VAL_ 3221225472 PrtcltTrpActvRgnrtnInhbtdDTInhbt 3 "notAvailable" 2 "reservedForSAEAssignment" 1 "inhibited" 0 "notInhibited" ;
VAL_ 3221225472 PrtcltTrpActvRgnrtnInhbtdStatus 3 "notAvailable" 2 "reservedForSAEAssignment" 1 "inhibited" 0 "notInhibited" ;
VAL_ 3221225472 ParticulateTrapStatus 7 "notAvailable" 6 "reservedForSAEAssignment" 3 "RegenerationNeededHighestLevel" 2 "RegenerationNeededModerateLevel" 1 "RegenerationNeededLowestLevel" 0 "RegenerationNotNeeded" ;
VAL_ 3221225472 PrtcltTrpActvRegenerationStatus 3 "notAvailable" 2 "rgnrtnNddAtmtcllyInttdActvRgnrt" 1 "active" 0 "notActive" ;
VAL_ 3221225472 PrtcltTrpPssvRegenerationStatus 3 "notAvailable" 2 "reservedForSAEAssignment" 1 "active" 0 "notActive" ;
VAL_ 3221225472 ParticulateTrapLampCmd 7 "notAvailable" 4 "OnFastBlink" 6 "reservedForSAEAssignment" 1 "OnSolid" 0 "Off" ;
VAL_ 3221225472 SteerAngleSensorCalibrated 3 "NotAvailable" 2 "Reserved" 1 "SASCalibrated" 0 "SASNotCalibrated" ;
VAL_ 3221225472 SteerAngleSensorActiveMode 3 "NotAvailable" 2 "Reserved" 1 "NormalModeActive" 0 "ProgrammingModeActive" ;
VAL_ 3221225472 SteerWheelAngleRangeCounterType 3 "SignalNotAvailable" 2 "NotDefined" 1 "AbsNumberOfCounts" 0 "RelativeNumberOfCounts" ;
VAL_ 3221225472 TransferCaseStatus 6 "error" 5 "TrnsfrCsShftInPrgrssGrNtCnfrmed" 4 "WheelLow" 2 "neutral" 1 "WheelHigh" ;
VAL_ 3221225472 TransOilLevelSwitch 3 "NotAvailable" 2 "Error" 1 "FullNotEmpty" 0 "Empty" ;
VAL_ 3221225472 TransOilFilterRestrictionSwitch 3 "NotAvailable" 2 "Error" 1 "RestrictionExistsOnOilFilter" 0 "NoRestriction" ;
VAL_ 3221225472 ImplementRearWorkLight 3 "NotAvailable" 2 "FaultDetected" 1 "Activate" 0 "Deactivate" ;
VAL_ 3221225472 ImplementLeftForwardWorkLight 3 "NotAvailable" 2 "FaultDetected" 1 "Activate" 0 "Deactivate" ;
VAL_ 3221225472 ImplementRightForwardWorkLight 3 "NotAvailable" 2 "FaultDetected" 1 "Activate" 0 "Deactivate" ;
VAL_ 3221225472 ImplementLeftFacingWorkLight 3 "NotAvailable" 2 "FaultDetected" 1 "Activate" 0 "Deactivate" ;
VAL_ 3221225472 ImplementRightFacingWorkLight 3 "NotAvailable" 2 "FaultDetected" 1 "Activate" 0 "Deactivate" ;
VAL_ 3221225472 ImplementOEMOption1Light 3 "NotAvailable" 2 "FaultDetected" 1 "Activate" 0 "Deactivate" ;
VAL_ 3221225472 ImplementOEMOption2Light 3 "NotAvailable" 2 "FaultDetected" 1 "Activate" 0 "Deactivate" ;
VAL_ 3221225472 TrctrFrontHighMountedWorkLights 3 "NotAvailable" 2 "FaultDetected" 1 "Activate" 0 "Deactivate" ;
VAL_ 3221225472 TrctorFrontLowMountedWorkLights 3 "NotAvailable" 2 "FaultDetected" 1 "Activate" 0 "Deactivate" ;
VAL_ 3221225472 TrctorSideHighMountedWorkLights 3 "NotAvailable" 2 "FaultDetected" 1 "Activated" 0 "Deactivated" ;
VAL_ 3221225472 TractorSideLowMountedWorkLights 3 "NotAvailable" 2 "FaultDetected" 1 "Activated" 0 "Deactivated" ;
VAL_ 3221225472 TrctorRearHighMountedWorkLights 3 "NotAvailable" 2 "FaultDetected" 1 "Activated" 0 "Deactivated" ;
VAL_ 3221225472 TractorRearLowMountedWorkLights 3 "NotAvailable" 2 "FaultDetected" 1 "Activate" 0 "Deactivate" ;
VAL_ 3221225472 TrctrUndersideMountedWorkLights 3 "NotAvailable" 2 "FaultDetected" 1 "Activate" 0 "Deactivate" ;
VAL_ 3221225472 RearFogLights 3 "NotAvailable" 2 "FaultDetected" 1 "Activated" 0 "Deactivated" ;
VAL_ 3221225472 TractorMarkerLight 3 "NotAvailable" 2 "FaultDetected" 1 "Activated" 0 "Deactivated" ;
VAL_ 3221225472 ImplementMarkerLight 3 "NotAvailable" 2 "FaultDetected" 1 "Activated" 0 "Deactivated" ;
VAL_ 3221225472 TractorClearanceLight 3 "NotAvailable" 2 "FaultDetected" 1 "Activated" 0 "Deactivated" ;
VAL_ 3221225472 ImplementClearanceLight 3 "NotAvailable" 2 "FaultDetected" 1 "Activated" 0 "Deactivated" ;
VAL_ 3221225472 LeftStopLight 3 "NotAvailable" 2 "FaultDetected" 1 "Activated" 0 "Deactivated" ;
VAL_ 3221225472 RightStopLight 3 "NotAvailable" 2 "FaultDetected" 1 "Activated" 0 "Deactivated" ;
VAL_ 3221225472 CenterStopLight 3 "NotAvailable" 2 "FaultDetected" 1 "Activated" 0 "Deactivated" ;
VAL_ 3221225472 BackUpLightAndAlarmHorn 3 "NotAvailable" 2 "FaultDetected" 1 "Activated" 0 "Deactivated" ;
VAL_ 3221225472 LeftTurnSignalLights 3 "NotAvailable" 2 "FaultDetected" 1 "Activated" 0 "Deactivated" ;
VAL_ 3221225472 RightTurnSignalLights 3 "NotAvailable" 2 "FaultDetected" 1 "Activated" 0 "Deactivated" ;
VAL_ 3221225472 RotatingBeaconLight 3 "NotAvailable" 2 "FaultDetected" 1 "Activated" 0 "Deactivated" ;
VAL_ 3221225472 TractorFrontFogLights 3 "NotAvailable" 2 "FaultDetected" 1 "Activated" 0 "Deactivated" ;
VAL_ 3221225472 HighBeamHeadLightData 3 "NotAvailable" 2 "FaultDetected" 1 "Activate" 0 "Deactivate" ;
VAL_ 3221225472 LowBeamHeadLightData 3 "NotAvailable" 2 "FaultDetected" 1 "Activate" 0 "Deactivate" ;
VAL_ 3221225472 AltBeamHeadLightData 3 "NotAvailable" 2 "FaultDetected" 1 "Activate" 0 "Deactivate" ;
VAL_ 3221225472 RunningLight 3 "NotAvailable" 2 "FaultDetected" 1 "Activate" 0 "Deactivate" ;
VAL_ 3221225472 ImplementRearWorkLightCmd 3 "DonTCare" 2 "Reserved" 1 "Activate" 0 "Deactivate" ;
VAL_ 3221225472 ImplmentLeftForwardWorkLightCmd 3 "DonTCare" 2 "Reserved" 1 "Activate" 0 "Deactivate" ;
VAL_ 3221225472 ImplmntRightForwardWorkLightCmd 3 "DonTCare" 2 "Reserved" 1 "Activate" 0 "Deactivate" ;
VAL_ 3221225472 LightingDataRqCmd 3 "DonTCare" 2 "Reserved" 1 "Activate" 0 "Deactivate" ;
VAL_ 3221225472 ImplementLeftFacingWorkLightCmd 3 "DonTCare" 2 "Reserved" 1 "Activate" 0 "Deactivate" ;
VAL_ 3221225472 ImplmentRightFacingWorkLightCmd 3 "DonTCare" 2 "Reserved" 1 "Activate" 0 "Deactivate" ;
VAL_ 3221225472 ImplementOEMOption1LightCmd 3 "DonTCare" 2 "Reserved" 1 "Activate" 0 "Deactivate" ;
VAL_ 3221225472 ImplementOEMOption2LightCmd 3 "DonTCare" 2 "Reserved" 1 "Activate" 0 "Deactivate" ;
VAL_ 3221225472 TrctrFrntHghMuntedWorkLightsCmd 3 "DonTCare" 2 "Reserved" 1 "Activate" 0 "Deactivate" ;
VAL_ 3221225472 TrctrFrntLwMountedWorkLightsCmd 3 "DonTCare" 2 "Reserved" 1 "Activate" 0 "Deactivate" ;
VAL_ 3221225472 TrctrSdHighMountedWorkLightsCmd 3 "DonTCare" 2 "Reserved" 1 "Activate" 0 "Deactivate" ;
VAL_ 3221225472 TrctrSdeLowMountedWorkLightsCmd 3 "DonTCare" 2 "Reserved" 1 "Activate" 0 "Deactivate" ;
VAL_ 3221225472 TrctrRrHighMountedWorkLightsCmd 3 "DonTCare" 2 "Reserved" 1 "Activate" 0 "Deactivate" ;
VAL_ 3221225472 TrctrRarLowMountedWorkLightsCmd 3 "DonTCare" 2 "Reserved" 1 "Activate" 0 "Deactivate" ;
VAL_ 3221225472 TrctrUndrsdMountedWorkLightsCmd 3 "DonTCare" 2 "Reserved" 1 "Activate" 0 "Deactivate" ;
VAL_ 3221225472 RearFogLightCmd 3 "DonTCare" 2 "Reserved" 1 "Activate" 0 "Deactivate" ;
VAL_ 3221225472 TractorMarkerLightCmd 3 "DonTCare" 2 "Reserved" 1 "Activate" 0 "Deactivate" ;
VAL_ 3221225472 ImplementMarkerLightCmd 3 "DonTCare" 2 "Reserved" 1 "Activate" 0 "Deactivate" ;
VAL_ 3221225472 TractorClearanceLightCmd 3 "DonTCare" 2 "Reserved" 1 "Activate" 0 "Deactivate" ;
VAL_ 3221225472 ImplementClearanceLightCmd 3 "DonTCare" 2 "Reserved" 1 "Activate" 0 "Deactivate" ;
VAL_ 3221225472 LeftStopLightCmd 3 "DonTCare" 2 "Reserved" 1 "Activate" 0 "Deactivate" ;
VAL_ 3221225472 RightStopLightCmd 3 "DonTCare" 2 "Reserved" 1 "Activate" 0 "Deactivate" ;
VAL_ 3221225472 CenterStopLightCmd 3 "DonTCare" 2 "Reserved" 1 "Activate" 0 "Deactivate" ;
VAL_ 3221225472 BackUpLightAndAlarmHornCmd 3 "DonTCare" 2 "Reserved" 1 "Activate" 0 "Deactivate" ;
VAL_ 3221225472 LeftTurnSignalLightsCmd 3 "DonTCare" 2 "Reserved" 1 "Activate" 0 "Deactivate" ;
VAL_ 3221225472 RightTurnSignalLightsCmd 3 "DonTCare" 2 "Reserved" 1 "Activate" 0 "Deactivate" ;
VAL_ 3221225472 RotatingBeaconLightCmd 3 "DonTCare" 2 "Reserved" 1 "Activate" 0 "Deactivate" ;
VAL_ 3221225472 TractorFrontFogLightsCmd 3 "DonTCare" 2 "Reserved" 1 "Activate" 0 "Deactivate" ;
VAL_ 3221225472 HighBeamHeadLightCmd 3 "DonTCare" 2 "Reserved" 1 "Activate" 0 "Deactivate" ;
VAL_ 3221225472 LowBeamHeadLightCmd 3 "DonTCare" 2 "Reserved" 1 "Activate" 0 "Deactivate" ;
VAL_ 3221225472 AltBeamHeadLightCmd 3 "DonTCare" 2 "Reserved" 1 "Activate" 0 "Deactivate" ;
VAL_ 3221225472 RunningLightCmd 3 "DonTCare" 2 "Reserved" 1 "Activate" 0 "Deactivate" ;
VAL_ 3221225472 BladeCtrlMode 2 "InactiveAutomaticMode" 1 "AutomaticMode" 0 "ManualMode" ;
VAL_ 3221225472 EngOprtrPrmryIntrmdtSpdSlctStte 15 "NotAvailable" 14 "SAEReserved" 1 "thr1101CtrlSttIsISCSttng1Thru13" 0 "CtrlSttIsISCFnctnltyIsNtRqdEngO" ;
VAL_ 3221225472 EngOprtrPrmryIntrmdtSpeedSelect 15 "NotAvailable" 14 "ErrorCondition" 1 "thr1101IndctsThtISCSttng1Thr13I" 0 "IndctsThtISCFnctnltyIsNtRqdEngO" ;
VAL_ 3221225472 CabHeatingZone 3 "NotAvailable" 2 "Reserved" 1 "CabHeatingZoneOn" 0 "CabHeatingZoneOff" ;
VAL_ 3221225472 EngHeatingZone 3 "NotAvailable" 2 "Reserved" 1 "EngHeatingZoneOn" 0 "EngHeatingZoneOff" ;
VAL_ 3221225472 CabVentilation 3 "NotAvailable" 2 "Reserved" 1 "CabIsVentilated" 0 "CabNotVentilated" ;
VAL_ 3221225472 AuxilaryHeaterWaterPumpStatus 3 "NotAvailable" 2 "Reserved" 1 "WaterPumpIsRunning" 0 "WaterPumpIsNotRunning" ;
VAL_ 3221225472 AuxHeaterMode 15 "NotAvailable" 14 "Error" 4 "1101NotDefined" 3 "NormalMode" 2 "EconomyMode" 1 "OffDTADRPrErpnRgltnsFrTrnsprtOf" 0 "HeaterNotActive" ;
VAL_ 3221225472 FireApparatusPumpEngagement 3 "NotAvailableNotInstalled" 2 "Error" 1 "PumpEngaged" 0 "PumpNotEngaged" ;
VAL_ 3221225472 EngHydPressGovernorSwitch 3 "NotAvailable" 2 "ErrorIndicator" 1 "PressModeActive" 0 "PressModeInactive" ;
VAL_ 3221225472 EngHydPrssGovernorModeIndicator 3 "NotAvailable" 2 "ErrorIndicator" 1 "Enabled" 0 "Disabled" ;
VAL_ 3221225472 HydBrakeFluidLevelSwitch 3 "NotAvailable" 2 "ErrorIndicator" 1 "FluidLevelIsSufficient" 0 "FluidLevelIsNotSufficient" ;
VAL_ 3221225472 HydBrakeSystemAudibleWarningCmd 3 "DontCare" 2 "Reserved" 1 "AudibleWarningOn" 0 "AudibleWarningOff" ;
VAL_ 3221225472 HydBrkePressSupplyStateCircuit2 3 "NotAvailable" 2 "ErrorIndicator" 1 "SupplyIsReliable" 0 "SupplyIsNotReliable" ;
VAL_ 3221225472 HydBrkePressSupplyStateCircuit1 3 "NotAvailable" 2 "ErrorIndicator" 1 "SupplyIsReliable" 0 "SupplyIsNotReliable" ;
VAL_ 3221225472 HydBrkPressWarningStateCircuit2 3 "NotAvailable" 2 "ErrorIndicator" 1 "PressLevelBelowWarningLevel" 0 "PressLevelSufficient" ;
VAL_ 3221225472 HydBrkPressWarningStateCircuit1 3 "NotAvailable" 2 "ErrorIndicator" 1 "PressLevelBelowWarningLevel" 0 "PressLevelSufficient" ;
VAL_ 3221225472 EnggmntSttusTransInputShaftPTO1 3 "NotAvailable" 2 "Error" 1 "DriveIsEngaged" 0 "DriveNotEngaged" ;
VAL_ 3221225472 EnggmntSttusTransInputShaftPTO2 3 "NotAvailable" 2 "Error" 1 "DriveIsEngaged" 0 "DriveNotEngaged" ;
VAL_ 3221225472 EnggmntSttusTransOutputShaftPTO 3 "NotAvailable" 2 "Error" 1 "DriveIsEngaged" 0 "DriveNotEngaged" ;
VAL_ 3221225472 EnggmntSttsTrnsfrCsOtptShaftPTO 3 "NotAvailable" 2 "Error" 1 "DriveIsEngaged" 0 "DriveNotEngaged" ;
VAL_ 3221225472 EnggmntCnsntTransInputShaftPTO1 3 "NotAvailable" 2 "Error" 1 "CnsentGivenPTODriveMayBeEngaged" 0 "CnsntNtGvnPTODrvShldNtBeEngaged" ;
VAL_ 3221225472 EnggmntCnsntTransInputShaftPTO2 3 "NotAvailable" 2 "Error" 1 "CnsentGivenPTODriveMayBeEngaged" 0 "CnsntNtGvnPTODrvShldNtBeEngaged" ;
VAL_ 3221225472 EnggmntCnsntTransOutputShaftPTO 3 "NotAvailable" 2 "Error" 1 "CnsentGivenPTODriveMayBeEngaged" 0 "CnsntNtGvnPTODrvShldNtBeEngaged" ;
VAL_ 3221225472 EnggmntCnsntTrnsfrCsOtptShftPTO 3 "NotAvailable" 2 "Error" 1 "CnsentGivenPTODriveMayBeEngaged" 0 "CnsntNtGvnPTODrvShldNtBeEngaged" ;
VAL_ 3221225472 EnableSwitchTransInputShaftPTO1 3 "NotAvailable" 2 "Error" 1 "EnblSwtchOffPTOOperationDesired" 0 "EnblSwtchOffPTOOprtonNotDesired" ;
VAL_ 3221225472 EnableSwitchTransInputShaftPTO2 3 "NotAvailable" 2 "Error" 1 "EnblSwtchOffPTOOperationDesired" 0 "EnblSwtchOffPTOOprtonNotDesired" ;
VAL_ 3221225472 EnableSwitchTransOutputShaftPTO 3 "NotAvailable" 2 "Error" 1 "EnblSwtchOffPTOOperationDesired" 0 "EnblSwtchOffPTOOprtonNotDesired" ;
VAL_ 3221225472 EnblSwtchTrnsfrCsOutputShaftPTO 3 "NotAvailable" 2 "Error" 1 "EnblSwtchOffPTOOperationDesired" 0 "EnblSwtchOffPTOOprtonNotDesired" ;
VAL_ 3221225472 EngTurboCompressorCtrl 4 "RprsntsFllyOpnTypcllyTrbCmprssr" ;
VAL_ 3221225472 EnableStatusOfDoor10 3 "notAvailable" 2 "error" 1 "doorEnabled" 0 "doorDisabled" ;
VAL_ 3221225472 OpenStatusOfDoor10 3 "notAvailable" 2 "error" 1 "doorOpened" 0 "doorClosed" ;
VAL_ 3221225472 LockStatusOfDoor10 3 "notAvailable" 2 "error" 1 "locked" 0 "unlocked" ;
VAL_ 3221225472 EnableStatusOfDoor9 3 "notAvailable" 2 "error" 1 "doorEnabled" 0 "doorDisabled" ;
VAL_ 3221225472 OpenStatusOfDoor9 3 "notAvailable" 2 "error" 1 "doorOpened" 0 "doorClosed" ;
VAL_ 3221225472 LockStatusOfDoor9 3 "notAvailable" 2 "error" 1 "locked" 0 "unlocked" ;
VAL_ 3221225472 EnableStatusOfDoor8 3 "notAvailable" 2 "error" 1 "doorEnabled" 0 "doorDisabled" ;
VAL_ 3221225472 OpenStatusOfDoor8 3 "notAvailable" 2 "error" 1 "doorOpened" 0 "doorClosed" ;
VAL_ 3221225472 LockStatusOfDoor8 3 "notAvailable" 2 "error" 1 "locked" 0 "unlocked" ;
VAL_ 3221225472 EnableStatusOfDoor7 3 "notAvailable" 2 "error" 1 "doorEnabled" 0 "doorDisabled" ;
VAL_ 3221225472 OpenStatusOfDoor7 3 "notAvailable" 2 "error" 1 "doorOpened" 0 "doorClosed" ;
VAL_ 3221225472 LockStatusOfDoor7 3 "notAvailable" 2 "error" 1 "locked" 0 "unlocked" ;
VAL_ 3221225472 EnableStatusOfDoor6 3 "notAvailable" 2 "error" 1 "doorEnabled" 0 "doorDisabled" ;
VAL_ 3221225472 OpenStatusOfDoor6 3 "notAvailable" 2 "error" 1 "doorOpened" 0 "doorClosed" ;
VAL_ 3221225472 LockStatusOfDoor6 3 "notAvailable" 2 "error" 1 "locked" 0 "unlocked" ;
VAL_ 3221225472 EnableStatusOfDoor5 3 "notAvailable" 2 "error" 1 "doorEnabled" 0 "doorDisabled" ;
VAL_ 3221225472 OpenStatusOfDoor5 3 "notAvailable" 2 "error" 1 "doorOpened" 0 "doorClosed" ;
VAL_ 3221225472 LockStatusOfDoor5 3 "notAvailable" 2 "error" 1 "locked" 0 "unlocked" ;
VAL_ 3221225472 EnableStatusOfDoor4 3 "notAvailable" 2 "error" 1 "doorEnabled" 0 "doorDisabled" ;
VAL_ 3221225472 OpenStatusOfDoor4 3 "notAvailable" 2 "error" 1 "doorOpened" 0 "doorClosed" ;
VAL_ 3221225472 LockStatusOfDoor4 3 "notAvailable" 2 "error" 1 "locked" 0 "unlocked" ;
VAL_ 3221225472 EnableStatusOfDoor3 3 "notAvailable" 2 "error" 1 "doorEnabled" 0 "doorDisabled" ;
VAL_ 3221225472 OpenStatusOfDoor3 3 "notAvailable" 2 "error" 1 "doorOpened" 0 "doorClosed" ;
VAL_ 3221225472 LockStatusOfDoor3 3 "notAvailable" 2 "error" 1 "locked" 0 "unlocked" ;
VAL_ 3221225472 EnableStatusOfDoor2 3 "notAvailable" 2 "error" 1 "doorEnabled" 0 "doorDisabled" ;
VAL_ 3221225472 OpenStatusOfDoor2 3 "notAvailable" 2 "error" 1 "doorOpened" 0 "doorClosed" ;
VAL_ 3221225472 LockStatusOfDoor2 3 "notAvailable" 2 "error" 1 "locked" 0 "unlocked" ;
VAL_ 3221225472 EnableStatusOfDoor1 3 "notAvailable" 2 "error" 1 "doorEnabled" 0 "doorDisabled" ;
VAL_ 3221225472 OpenStatusOfDoor1 3 "notAvailable" 2 "error" 1 "doorOpened" 0 "doorClosed" ;
VAL_ 3221225472 LockStatusOfDoor1 3 "notAvailable" 2 "error" 1 "locked" 0 "unlocked" ;
VAL_ 3221225472 CatalystReagentType 15 "NotAvailable" 14 "ErrrDtctdWthUrRgntTypeDetection" 13 "NtAblTDtrmneCatalystReagentType" 4 "to1100ReservedForSAEAssignment" 3 "CatalystReagentIsProper" 2 "CatalystReagentIsDiesel" 1 "CatalystReagentIsWater" 0 "CatalystReagentIsUrea" ;
VAL_ 3221225472 EngCyl9CombustionStatus 3 "NotAvailable" 2 "Error" 1 "CombustionExists" 0 "NoCombustion" ;
VAL_ 3221225472 EngCyl8CombustionStatus 3 "NotAvailable" 2 "Error" 1 "CombustionExists" 0 "NoCombustion" ;
VAL_ 3221225472 EngCyl7CombustionStatus 3 "NotAvailable" 2 "Error" 1 "CombustionExists" 0 "NoCombustion" ;
VAL_ 3221225472 EngCyl6CombustionStatus 3 "NotAvailable" 2 "Error" 1 "CombustionExists" 0 "NoCombustion" ;
VAL_ 3221225472 EngCyl5CombustionStatus 1 "CombustionExists" 0 "NoCombustion" 3 "NotAvailable" 2 "Error" ;
VAL_ 3221225472 EngCyl4CombustionStatus 3 "NotAvailable" 2 "Error" 1 "CombustionExists" 0 "NoCombustion" ;
VAL_ 3221225472 EngCyl3CombustionStatus 3 "NotAvailable" 2 "Error" 1 "CombustionExists" 0 "NoCombustion" ;
VAL_ 3221225472 EngCyl2CombustionStatus 3 "NotAvailable" 2 "Error" 1 "CombustionExists" 0 "NoCombustion" ;
VAL_ 3221225472 EngCyl24CombustionStatus 3 "NotAvailable" 2 "Error" 1 "CombustionExists" 0 "NoCombustion" ;
VAL_ 3221225472 EngCyl23CombustionStatus 3 "NotAvailable" 2 "Error" 1 "CombustionExists" 0 "NoCombustion" ;
VAL_ 3221225472 EngCyl22CombustionStatus 3 "NotAvailable" 2 "Error" 1 "CombustionExists" 0 "NoCombustion" ;
VAL_ 3221225472 EngCyl21CombustionStatus 3 "NotAvailable" 2 "Error" 1 "CombustionExists" 0 "NoCombustion" ;
VAL_ 3221225472 EngCyl20CombustionStatus 3 "NotAvailable" 2 "Error" 1 "CombustionExists" 0 "NoCombustion" ;
VAL_ 3221225472 EngCyl1CombustionStatus 3 "NotAvailable" 2 "Error" 1 "CombustionExists" 0 "NoCombustion" ;
VAL_ 3221225472 EngCyl19CombustionStatus 3 "NotAvailable" 2 "Error" 1 "CombustionExists" 0 "NoCombustion" ;
VAL_ 3221225472 EngCyl18CombustionStatus 3 "NotAvailable" 2 "Error" 1 "CombustionExists" 0 "NoCombustion" ;
VAL_ 3221225472 EngCyl17CombustionStatus 3 "NotAvailable" 2 "Error" 1 "CombustionExists" 0 "NoCombustion" ;
VAL_ 3221225472 EngCyl16CombustionStatus 3 "NotAvailable" 2 "Error" 1 "CombustionExists" 0 "NoCombustion" ;
VAL_ 3221225472 EngCyl15CombustionStatus 3 "NotAvailable" 2 "Error" 1 "CombustionExists" 0 "NoCombustion" ;
VAL_ 3221225472 EngCyl14CombustionStatus 3 "NotAvailable" 2 "Error" 1 "CombustionExists" 0 "NoCombustion" ;
VAL_ 3221225472 EngCyl13CombustionStatus 3 "NotAvailable" 2 "Error" 1 "CombustionExists" 0 "NoCombustion" ;
VAL_ 3221225472 EngCyl12CombustionStatus 3 "NotAvailable" 2 "Error" 1 "CombustionExists" 0 "NoCombustion" ;
VAL_ 3221225472 EngCyl11CombustionStatus 3 "NotAvailable" 2 "Error" 1 "CombustionExists" 0 "NoCombustion" ;
VAL_ 3221225472 EngCyl10CombustionStatus 3 "NotAvailable" 2 "Error" 1 "CombustionExists" 0 "NoCombustion" ;
VAL_ 3221225472 RqGenOverallPowerFactorLagging 3 "NotAvailable" 2 "Error" 1 "Lagging" 0 "Leading" ;
VAL_ 3221225472 BladeRotationAngleFigureOfMerit 3 "AngleNotAvailable" 2 "AngleFailed" 1 "AngleDegraded" 0 "AngleFullyFunctional" ;
VAL_ 3221225472 RelBladeHeightFigureOfMerit 3 "HeightNotAvailable" 2 "HeightFailed" 1 "HeightDegraded" 0 "HeightFullyFunctional" ;
VAL_ 3221225472 VehicleType 1 "Dolly axle" 0 "Towing or towed vehicle" ;
VAL_ 3221225472 BrakeLightSwitch 1 "Switch on" 0 "Switch off" ;
VAL_ 3221225472 ASREngineControlActive 3 "NotAvailable" 2 "Reserved" 1 "ASREngineControlActive" 0 "ASREngnCntrlPassiveButInstalled" ;
VAL_ 3221225472 ASRBreakControlActive 1 "Active" 0 "Passive, but installed" ;
VAL_ 3221225472 VehicleRetarderCtrlActive 1 "Active" 0 "Passive" ;
VAL_ 3221225472 VehicleABSActive 1 "Active" 0 "Passiv, but installed" ;
VAL_ 3221225472 PneumaticControlLine 1 "Towing veh with pn ctrl line" 0 "Towing veh without pn ctrl line" ;
VAL_ 3221225472 ABSOffroadRequest 1 "ABS off-road switch on" 0 "ABS off-road switch off" ;
VAL_ 3221225472 TwoElCircuitsBrakeDemand 1 "Two el. circuit brake available" 0 "One el. circuit brake available" ;
VAL_ 3221225472 SupplyLineBrakingRequest 1 "Supply line braking request" 0 "No supply line braking request" ;
VAL_ 3221225472 VDCActive 1 "Active" 0 "Passive, but installed" ;
VAL_ 3221225472 AutomTowedVehBreakActive 1 "Active" 0 "Passive" ;
VAL_ 3221225472 VehicleServiceBrakeActive 1 "Active" 0 "Passive" ;
VAL_ 3221225472 LoadingRampApproachAssist 1 "Assistance active" 0 "Assistance not active" ;
VAL_ 3221225472 SpringBrakeEngaged 1 "Vehicle spring brake is engaged" 0 "Vehicle spring brake is released" ;
VAL_ 3221225472 ElectrLoadPropFunc 1 "Vehicle with el. load proportion" 0 "Vehicle without el. load proport" ;
VAL_ 3221225472 SpringBrakeInstalled 1 "Vehicle with spring brakes" 0 "Vehicle without spring brakes" ;
VAL_ 3221225472 ElecSupplyOfNonBrakingSys 1 "Supply switched on" 0 "Supply switched off" ;
VAL_ 3221225472 AmberWarningSignalReq 1 "Towed vehicle failure indicated" 0 "No towed vehicle failure indicat" ;
VAL_ 3221225472 RedWarningSignalRequest 1 "Towed vehicle failure indicated" 0 "No towed vehicle failure indicat" ;
VAL_ 3221225472 VehicleElectrSupplySuff 1 "Vehicle el. supply sufficient" 0 "Vehicle el. supply insufficient" ;
VAL_ 3221225472 TyreWheelIdentTemp2 15 "Axle position 15" 14 "Axle position 14" 13 "Axle position 13" 12 "Axle position 12" 11 "Axle position 11" 10 "Axle position 10" 9 "Axle position 9" 8 "Axle position 8" 7 "Axle position 7" 6 "Axle position 6" 5 "Axle position 5" 4 "Axle position 4" 3 "Axle position 3" 2 "Axle position 2" 1 "Axle position 1" 0 "Axle position not identified" ;
VAL_ 3221225472 TyreWheelIdentTemp1 15 "Wheel position 15" 14 "Wheel position 14" 13 "Wheel position 13" 12 "Wheel position 12" 11 "Wheel position 11" 10 "Wheel position 10" 9 "Wheel position 9" 8 "Wheel position 8" 7 "Wheel position 7" 6 "Wheel position 6" 5 "Wheel position 5" 4 "Wheel position 4" 3 "Wheel position 3" 2 "Wheel position 2" 1 "Wheel position 1" 0 "Wheel position not identified" ;
VAL_ 3221225472 TyreWheelIdentPressure2 15 "Axle position 15" 14 "Axle position 14" 13 "Axle position 13" 12 "Axle position 12" 11 "Axle position 11" 10 "Axle position 10" 9 "Axle position 9" 8 "Axle position 8" 7 "Axle position 7" 6 "Axle position 6" 5 "Axle position 5" 4 "Axle position 4" 3 "Axle position 3" 2 "Axle position 2" 1 "Axle position 1" 0 "Axle position not identified" ;
VAL_ 3221225472 TyreWheelIdentPressure1 15 "Wheel position 15" 14 "Wheel position 14" 13 "Wheel position 13" 12 "Wheel position 12" 11 "Wheel position 11" 10 "Wheel position 10" 9 "Wheel position 9" 8 "Wheel position 8" 7 "Wheel position 7" 6 "Wheel position 6" 5 "Wheel position 5" 4 "Wheel position 4" 3 "Wheel position 3" 2 "Wheel position 2" 1 "Wheel position 1" 0 "Wheel position not identified" ;
VAL_ 3221225472 TyreWheelIdentLining2 15 "Axle position 15" 14 "Axle position 14" 13 "Axle position 13" 12 "Axle position 12" 11 "Axle position 11" 10 "Axle position 10" 9 "Axle position 9" 8 "Axle position 8" 7 "Axle position 7" 6 "Axle position 6" 5 "Axle position 5" 4 "Axle position 4" 3 "Axle position 3" 2 "Axle position 2" 1 "Axle position 1" 0 "Axle position not identified" ;
VAL_ 3221225472 TyreWheelIdentLining1 15 "Wheel position 15" 14 "Wheel position 14" 13 "Wheel position 13" 12 "Wheel position 12" 11 "Wheel position 11" 10 "Wheel position 10" 9 "Wheel position 9" 8 "Wheel position 8" 7 "Wheel position 7" 6 "Wheel position 6" 5 "Wheel position 5" 4 "Wheel position 4" 3 "Wheel position 3" 2 "Wheel position 2" 1 "Wheel position 1" 0 "Wheel position not identified" ;
VAL_ 3221225472 VehiclePneumSupplySuff 1 "Pneumatic supply sufficient" 0 "Pneumatic supply insufficient" ;
VAL_ 3221225472 BrakeTemperatureStatus 1 "Brake temperature normal" 0 "Brake temperature out of range" ;
VAL_ 3221225472 BrakeLiningSufficient 1 "Brake linings sufficient" 0 "Brake linings insufficient" ;
VAL_ 3221225472 TyrePressureSufficient 1 "Tyre pressure sufficient" 0 "Tyre pressure insufficient" ;
VAL_ 3221225472 ODDRequest 3 "Take no action" 1 "ODD on" 0 "ODD off" ;
VAL_ 3221225472 AntiTheftDeviceReq 3 "Take no action" 1 "Anti-theft device on" 0 "Anti-theft device off" ;
VAL_ 3221225472 EngineTorqueMode 15 "Not available" 11 "Remote accelerator" 10 "Braking system" 9 "High speed governor" 8 "Torque limiting" 7 "ABS control" 6 "Transmission control" 5 "ASR control" 4 "Road speed governor" 3 "PTO governor" 2 "Cruise control" 1 "Accelerator pedal/operator selec" 0 "Low idle governor/no request (de" ;
VAL_ 3221225472 EngineRunning 1 "Engine running" 0 "Engine not running" ;
VAL_ 3221225472 EngineControlAllowed 1 "Engine control allowed" 0 "Engine control not allowed" ;
VAL_ 3221225472 ClutchIndptdPTOFeedback 1 "Engaged" 0 "Not engaged" ;
VAL_ 3221225472 AccelPedalLowIdleSwitch 1 "In low idle condition" 0 "Not in low idle condition" ;
VAL_ 3221225472 StarterActive 1 "Starter active" 0 "Starter not active" ;
VAL_ 3221225472 TorqueConvtOilTempWarning 2 "Warning" 1 "Prewarning" 0 "No warning" ;
VAL_ 3221225472 PTOControlAllowed 1 "PTO control allowed" 0 "PTO control not allowed" ;
VAL_ 3221225472 SecEngineMtdPTOFeedback 1 "Limits activated" 0 "Limits not activated" ;
VAL_ 3221225472 FirstEngineMtdPTOFeedback 1 "Limits activated" 0 "Limits not activated" ;
VAL_ 3221225472 SecClutchDptdPTOFeedback 1 "Engaged" 0 "Not engaged" ;
VAL_ 3221225472 FirstClutchDpdtPTOFeedback 1 "Engaged" 0 "Not engaged" ;
VAL_ 3221225472 FuelLevelWarning 1 "Fuel level warning on" 0 "Fuel level warning off" ;
VAL_ 3221225472 EngineOilPressureWarning 1 "Warning" 0 "No warning" ;
VAL_ 3221225472 EngineCoolantTempWarning 2 "Warning" 1 "Prewarning" 0 "No warning" ;
VAL_ 3221225472 AntiTheftDeviceStatus 1 "Anti-theft device on" 0 "Anti-theft device off" ;
VAL_ 3221225472 ODDStatus 1 "ODD active" 0 "ODD inactive" ;
VAL_ 3221225472 SecEngineMtdPTOSwitch 1 "Switched on" 0 "Switched off" ;
VAL_ 3221225472 SecClutchDpdtPTOSwitch 1 "Switched on" 0 "Switched off" ;
VAL_ 3221225472 FirstClutchDpdtPTOSwitch 1 "Switched on" 0 "Switched off" ;
VAL_ 3221225472 OperatingPanelActive 1 "Operating panel active" 0 "Operating panel not active" ;
VAL_ 3221225472 RefusePackerStepSwitch 1 "Switched on" 0 "Switched off" ;
VAL_ 3221225472 EngineStopSwitch 1 "Switched on" 0 "Switched off" ;
VAL_ 3221225472 EngineStartSwitch 1 "Switched on" 0 "Switched off" ;
VAL_ 3221225472 StarterLockoutSwitch 1 "Switched on" 0 "Switched off" ;
VAL_ 3221225472 FirstEngineMtdPTOSwitch 1 "Switched on" 0 "Switched off" ;
VAL_ 3221225472 ClutchIndpdtPTOSwitch 1 "Switched on" 0 "Switched off" ;
VAL_ 3221225472 TrailerLeftSideMarkerLight 1 "Lamp(s) lit" 0 "Lamp(s) not lit" ;
VAL_ 3221225472 TrailerLeftReversingLight 1 "Lamp(s) lit" 0 "Lamp(s) not lit" ;
VAL_ 3221225472 TrailerLeftRearWidIndLight 1 "Lamp(s) lit" 0 "Lamp(s) not lit" ;
VAL_ 3221225472 TrailerLeftRearRegPltLight 1 "Lamp(s) lit" 0 "Lamp(s) not lit" ;
VAL_ 3221225472 TrailerLeftRearLight 1 "Lamp(s) lit" 0 "Lamp(s) not lit" ;
VAL_ 3221225472 TrailerLeftRearFogLight 1 "Lamp(s) lit" 0 "Lamp(s) not lit" ;
VAL_ 3221225472 TrailerLeftDirIndLight 1 "Lamp(s) lit" 0 "Lamp(s) not lit" ;
VAL_ 3221225472 TrailerLeftCrnMarkerLight 1 "Lamp(s) lit" 0 "Lamp(s) not lit" ;
VAL_ 3221225472 TrailerInteriorLight 1 "Lamp(s) lit" 0 "Lamp(s) not lit" ;
VAL_ 3221225472 TrailerWorkLamp 1 "Lamp(s) lit" 0 "Lamp(s) not lit" ;
VAL_ 3221225472 TrailerRotatingIdentLight 1 "Lamp(s) lit" 0 "Lamp(s) not lit" ;
VAL_ 3221225472 TrailerRightStopLight 1 "Lamp(s) lit" 0 "Lamp(s) not lit" ;
VAL_ 3221225472 TrailerRightSideMrkLight 1 "Lamp(s) lit" 0 "Lamp(s) not lit" ;
VAL_ 3221225472 TrailerRightReversingLight 1 "Lamp(s) lit" 0 "Lamp(s) not lit" ;
VAL_ 3221225472 TrailRightRearWidIndLight 1 "Lamp(s) lit" 0 "Lamp(s) not lit" ;
VAL_ 3221225472 TrailerRightRearRegPltLight 1 "Lamp(s) lit" 0 "Lamp(s) not lit" ;
VAL_ 3221225472 TrailerRightRearLight 1 "Lamp(s) lit" 0 "Lamp(s) not lit" ;
VAL_ 3221225472 TrailerRightRearFogLight 1 "Lamp(s) lit" 0 "Lamp(s) not lit" ;
VAL_ 3221225472 TrailerRightDirIndLight 1 "Lamp(s) lit" 0 "Lamp(s) not lit" ;
VAL_ 3221225472 TrailerRightCrnMarkerLight 1 "Lamp(s) lit" 0 "Lamp(s) not lit" ;
VAL_ 3221225472 TrailerRearWarningLight 1 "Lamp(s) lit" 0 "Lamp(s) not lit" ;
VAL_ 3221225472 TrailerLeftStopLight 1 "Lamp(s) lit" 0 "Lamp(s) not lit" ;
VAL_ 3221225472 FlowStatus 2 "Overflow" 1 "Wait " 0 "Continue To Send" ;
VAL_ 3221225472 ProtocolCtrlInformation 3 "Flow control " 2 "Consecutive frame" 1 "First frame" 0 "Single frame" ;
VAL_ 3221225472 ControlByte 6 "MFDB_CreateEntry" 5 "MFDB_SetMode" 4 "MFDB_Clear" 3 "MFDB_Delete" 2 "MFDB_Add" 1 "MFDB_Response" 0 "MFDB_Request" ;
VAL_ 3221225472 FilterMode 1 "PassSpecificPGNs" 0 "BlockSpecificPGNs" ;
VAL_ 3221225472 StopLevelChangeReq 3 "Take no action" 1 "Stop request" 0 "No stop request" ;
VAL_ 3221225472 RampLevelStorageReq 3 "Take no action" 1 "Store ramp level 2" 0 "Store ramp level 1" ;
VAL_ 3221225472 LevelControlReq 3 "Take no action" 1 "Enable level control" 0 "Disable level control" ;
VAL_ 3221225472 RampLevelReq 3 "Take no action" 1 "Ramp level 2" 0 "Ramp level 1" ;
VAL_ 3221225472 SteeringAxleLockingReq 3 "Take no action" 1 "Lock steering axle" 0 "Unlock steering axle" ;
VAL_ 3221225472 LiftAxle2PositionReq 3 "Take no action" 1 "Position up / tag axle unladen" 0 "Position down / tag axle laden" ;
VAL_ 3221225472 LiftAxle1PositionReq 3 "Don't care/take no action" 2 "Reserved" 1 "Position up / tag axle unladen" 0 "Position down / tag axle laden" ;
VAL_ 3221225472 TractionHelpReq 3 "Take no action" 1 "Traction help request" 0 "No traction help request" ;
VAL_ 3221225472 LevelChangeReqRearAxle 2 "Take no action" 1 "Vehicle body down (lowering)" 0 "Vehicle body up (lifting)" ;
VAL_ 3221225472 LevelChangeReqFrontAxle 2 "Take no action" 1 "Vehicle body down (lowering)" 0 "Vehicle body up (lifting)" ;
VAL_ 3221225472 RideHeightRequest 2 "Take no action" 1 "Normal level 2" 0 "Normal level 1" ;
VAL_ 3221225472 LevelControl 1 "Level control enabled" 0 "Level control disabled" ;
VAL_ 3221225472 RampLevel 1 "Body at requested ramp level" 0 "Body not at requested ramp level" ;
VAL_ 3221225472 NormalLevel 3 "Not available" 1 "Normal level 2" 0 "Normal level 1" ;
VAL_ 3221225472 StopLevelChangeAcknowledge 1 "Level change stopped" 0 "No stop request" ;
VAL_ 3221225472 LevelChangeRearAxle 1 "Body lifting/lowering active" 0 "Body lifting/lowering not active" ;
VAL_ 3221225472 LevelChangeFrontAxle 1 "Body lifting/lowering active" 0 "Body lifting/lowering not active" ;
VAL_ 3221225472 RampLevelStorage 1 "New ramp level stored" 0 "No new storage request" ;
VAL_ 3221225472 SteeringAxleLocking 1 "Steering axle locked" 0 "Steering axle unlocked" ;
VAL_ 3221225472 LiftAxle2Pos 3 "NotAvailable" 2 "Error" 1 "LiftAxlePosUp_TagAxleUnladen" 0 "LiftAxlePosDown_TagAxleLaden" ;
VAL_ 3221225472 LiftAxle1Pos 3 "NotAvailable" 2 "Error" 1 "LiftAxlePosUp_TagAxleUnladen" 0 "LiftAxlePosDown_TagAxleLaden" ;
VAL_ 3221225472 RampLevelPosition 3 "Not available" 1 "Ramp level 2" 0 "Ramp level 1" ;
VAL_ 3221225472 TractionHelp 1 "Traction help active" 0 "Traction help inactive" ;
VAL_ 3221225472 LevelCtrlSysRideHeightLevel 1 "Vehicle body at requested level" 0 "Vehicle body not at req. level" ;
VAL_ 3221225472 TyrePressThresholdDetect 7 "Not available" 6 "Error indicator" 5 "Not defined" 4 "Extreme under pressure" 3 "Under pressure" 2 "No warning pressure" 1 "Over pressure" 0 "Extreme over pressure" ;
VAL_ 3221225472 TyreModulePowerSupply 1 "Sufficient power supply" 0 "Insufficient power supply" ;
VAL_ 3221225472 TyreWheelIdentification2 15 "Axle position 15" 14 "Axle position 14" 13 "Axle position 13" 12 "Axle position 12" 11 "Axle position 11" 10 "Axle position 10" 9 "Axle position 9" 8 "Axle position 8" 7 "Axle position 7" 6 "Axle position 6" 5 "Axle position 5" 4 "Axle position 4" 3 "Axle position 3" 2 "Axle position 2" 1 "Axle position 1" 0 "Axle position not identified" ;
VAL_ 3221225472 TyreWheelIdentification1 15 "Wheel position 15" 14 "Wheel position 14" 13 "Wheel position 13" 12 "Wheel position 12" 11 "Wheel position 11" 10 "Wheel position 10" 9 "Wheel position 9" 8 "Wheel position 8" 7 "Wheel position 7" 6 "Wheel position 6" 5 "Wheel position 5" 4 "Wheel position 4" 3 "Wheel position 3" 2 "Wheel position 2" 1 "Wheel position 1" 0 "Wheel position not identified" ;
VAL_ 3221225472 XBRCtrlMode 3 "NotDefined" 2 "AcclrtnCtrlWthMxMdExctXBRAcclrt" 1 "AcclrtnCtrlWthAddtnMdAddXBRAccl" 0 "OvrrdDsbldDsblAnyExstngCtrlCmdd" ;
VAL_ 3221225472 XBRPriority 3 "LwPrrtyUsdInOvrrdDsbldXBRCtrlMd" 2 "MdmPrrtyUsdFrACCSystmsThsMdDsNt" 1 "HighPriorityNotDefined" 0 "HghstPrrtyUsdFrEmrgncySttnsEgFr" ;
VAL_ 3221225472 XBREBIMode 3 "NotDefined" 2 "EndranceBrakeIntegrationAllowed" 1 "OnlyEnduranceBrakesAllowed" 0 "NEndrnceBrakeIntegrationAllowed" ;
VAL_ 3221225472 WaterInFuelIndicator 3 "NotAvailable" 2 "Error" 1 "Yes" 0 "No" ;
