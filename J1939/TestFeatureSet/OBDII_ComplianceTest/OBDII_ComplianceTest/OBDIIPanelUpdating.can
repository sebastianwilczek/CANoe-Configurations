/*@@var:*/
variables
{
    byte counter = 0;
    
    msTimer panelTimer;
    msTimer testEndTimer;
}
/*@@end*/

/*@@startStart:Start:*/
on start
{
    putValueToControl("OBDII Compliance Test Setup Panel","UserInstructions","\t\t\t\tTEST BEGIN");
    setTimer(panelTimer, 2000);
}
           
/*@@end*/

/*@@timer:panelTimer:*/
on timer panelTimer
{
    switch(counter)
    {
        case(0):
        {
            putValueToControl("OBDII Compliance Test Setup Panel","UserInstructions","\t\t\t\tINITIALIZING TEST:  \n\t\tPlease watch this window for important instructions!");
            counter++;
            setTimer(panelTimer, 3000);
        }
        break;
        
        case (1):
        {
            putValueToControl("OBDII Compliance Test Setup Panel","UserInstructions","1) Completely fill out fields below.\n2) Test will utilize Pop-up windows for questions requiring user interaction. (More Instructions...)");
            counter++;
            setTimer(panelTimer, 7000);
        }
        break;

        default:
        {
            putValueToControl("OBDII Compliance Test Setup Panel","UserInstructions","3) Press 'Start OBDII Compliance Test' button to begin the test.\n4) Follow instructions given on pop-up windows and answer questions.");        
        }
    }
}
/*@@end*/

/*@@stop:StopMeasurement:*/
on stopMeasurement
{
    putValueToControl("OBDII Compliance Test Setup Panel","UserInstructions","\t\t\t\tMEASUREMENT STOPPED");
}
/*@@end*/

/*@@timer:testEndTimer:*/
on timer testEndTimer
{
    putValueToControl("OBDII Compliance Test Setup Panel","UserInstructions","\t\t\t\tTEST COMPLETE");    

}
/*@@end*/

/*@@envVar:EnvEMS_EndTest:*/
on envVar EnvEMS_EndTest
{
    if(getValue(this))
    {
        cancelTimer(testEndTimer);
    }
    else
    {
        setTimer(testEndTimer, 50);
    }    
}
/*@@end*/

