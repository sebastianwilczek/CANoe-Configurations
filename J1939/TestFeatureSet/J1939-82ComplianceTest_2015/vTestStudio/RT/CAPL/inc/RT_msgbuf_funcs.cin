/*@!Encoding:1252*/
includes
{
}

variables
{
}

// ==============================================================================================================
// get id out of the given entry. (masks out the extended high-bits)
dword CT_GetId(struct MsgBufEntry e)
{
  return e.id & 0x1FFFFFFF;
}

// ==============================================================================================================
// get source address out of entry
byte CT_GetSrc(struct MsgBufEntry e)
{
  return CT_GetSrc(CT_GetId(e));
}
// ==============================================================================================================
// get destination address out of entry
byte CT_GetDst(struct MsgBufEntry e)
{
  return CT_GetDst(CT_GetId(e));
}
// ==============================================================================================================
// get pgn out of the given entry.
dword CT_GetPGN(struct MsgBufEntry e)
{
  return CT_GetPGN(CT_GetId(e));
}
// ==============================================================================================================
// get prio out of the given entry.
dword CT_GetPrio(struct MsgBufEntry e)
{
  return CT_GetPrio(CT_GetId(e));
}
// ==============================================================================================================
// get EDP out of the given entry.
dword CT_GetEDP(struct MsgBufEntry e)
{
  return CT_GetEDP(CT_GetId(e));
}
// ==============================================================================================================
// get DP out of the given entry.
dword CT_GetDP(struct MsgBufEntry e)
{
  return CT_GetDP(CT_GetId(e));
}
// ==============================================================================================================
// get n-th data byte of given message buf entry.
byte CT_GetDataByte( byte n, struct MsgBufEntry e)
{
  if (n< elcount(e.data))
  {
    return e.data[n];
  }
  return 0;
}
// ==============================================================================================================
// get n-th data word of given message buf entry.
word CT_GetDataWord( byte n, struct MsgBufEntry e)
{
  if (n< elcount(e.data))
  {
    return swapWord((e.data[n]<<8) | e.data[n+1]);
  }
  return 0;
}
// ==============================================================================================================
// get n-th data dword of given message buf entry.
dword CT_GetDataDWord( byte n, struct MsgBufEntry e)
{
  if ((n+3) < elcount(e.data))
  {
    return swapDWord((e.data[n+0]<<24) | (e.data[n+1]<<16) | (e.data[n+2]<<8) | (e.data[n+3]));
  }
  return 0;
}
// ==============================================================================================================
// get n-th data qword of given message buf entry.
qword CT_GetDataQWord( byte n, struct MsgBufEntry e)
{
  if ((n+7)< elcount(e.data))
  {
    return
      swapQWord
      (
            ((qword)e.data[n+0]<<56) | ((qword)e.data[n+1]<<48) | ((qword)e.data[n+2]<<40) | ((qword)e.data[n+3]<<32)
        |   ((qword)e.data[n+4]<<24) | ((qword)e.data[n+5]<<16) | ((qword)e.data[n+6]<<8)  | ((qword)e.data[n+7])
      )
    ;
  }
  return 0;
}
// ==============================================================================================================
// get TPCM ctrl word out of a given msgbuf entry.
// if given entry is not a TPCM, 0 is returned.
byte CT_GetTPCMCtrlByte(struct MsgBufEntry e)
{
  if (CT_GetPgn(e) == gc_PGN_TPCM)
  {
    return CT_GetDataByte(0, e);
  }
  return 0;
}
// ==============================================================================================================
// get TPCM pgn out of a given msgbuf entry.
// if given entry is not a TPCM, invalid pgn is returned.
dword CT_GetTPCMPgn(struct MsgBufEntry e)
{
  if (CT_GetPgn(e) == gc_PGN_TPCM)
  {
    return (CT_GetDataDWord(4, e) & 0xFFFFFF00)>>8 ;
  }
  return gc_PGN_INVALID;
}
// ==============================================================================================================
// get TPCM package count out of a given msgbuf entry.
// if given entry is not a TPCM, 0 is returned.
byte CT_GetTPCMRTSPkgCount(struct MsgBufEntry e)
{
  if (CT_GetPgn(e) == gc_PGN_TPCM)
  {
    return CT_GetDataByte(3, e);
  }
  return 0;
}
// ==============================================================================================================
// get TPCM package count out of a given msgbuf entry.
// if given entry is not a TPCM, 0 is returned.
byte CT_GetTPCMCTSPkgCount(struct MsgBufEntry e)
{
  if (CT_GetPgn(e) == gc_PGN_TPCM)
  {
    return CT_GetDataByte(1, e);
  }
  return 0;
}
// ==============================================================================================================
// get TPCM max packages out of a given msgbuf entry.
// if given entry is not a TPCM, 0 is returned.
byte CT_GetTPCMRTSMaxPkgs(struct MsgBufEntry e)
{
  if (CT_GetPgn(e) == gc_PGN_TPCM)
  {
    return CT_GetDataByte(4, e);
  }
  return 0;
}
// ==============================================================================================================
// get TPCM max packages out of a given msgbuf entry.
// if given entry is not a TPCM, 0 is returned.
byte CT_GetTPCMCTSNextPkg(struct MsgBufEntry e)
{
  if (CT_GetPgn(e) == gc_PGN_TPCM)
  {
    return CT_GetDataByte(2, e);
  }
  return 0;
}
