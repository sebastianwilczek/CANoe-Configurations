/*@!Encoding:1252*/
includes
{
  #include "CTF_A05.cin"
}

// ==============================================================================================================
export testcase CTC_A05_01_BAM_Init()
{
  struct gPGAttrs pgis[long];
  
  // give title and description for this testcase
  CT_BEGIN(0x0501, "BAM Transport:  Ensure the Broadcast Announce message and its resulting Data Transfer data packets are valid (content and format)");
  CT_DESC("Verify the TP.CM_BAM message has correct values for the PGN, 'Total message size' & 'Number of packets' parameters. Verify the 'Total message size' and 'Number of packets' from the original TP.CM_BAM message matches what is actually sent in the resulting TP.DT data packets transmitted by the DUT. Verify the TP.CM_BAM message is sent to the Global Address. ");

  // describe the preconditions of the test.
  CT_PRECOND(1, "DUT can respond with BAM to the configured requestable PGNs with DLC>8.");
  
  // describe the strategy...
  CT_STRAT(1, "Request the configured non cyclic requestable PGN's with DLC>8 by BAM.");

  // note the reference to documents / specifications
  CT_DOC_21(1, "5.10.2.1");
  CT_DOC_21("5.10.3 - Figure 15");
  CT_DOC_21("5.10.3.5");

  CT_GetReqPGIs(pgis, gNonCyclic, gDLCx);
  CTF_A05_01_BAM_Init(gTOOL_Addr, gDUT_Addr, pgis);
  
  // end the testcase.
  CT_END();
}

// ==============================================================================================================
export testcase CTC_A05_02_BAM_Data_Timing_First_DT()
{
  struct gPGAttrs pgis[long];
  
  // give title and description for this testcase
  CT_BEGIN(0x0502, "BAM Transport:  Ensure the Broadcast Announce Message is sent prior to Data Transfer data packets.");
  CT_DESC("Verify DUT transmits the TP.CM_BAM message prior to sending any TP.DT data packets (5.10.2.1). Verify time between the TP.CM_BAM message and first TP.DT data packet is between 50 ms and 200ms (Tr).");

  // describe the preconditions of the test.
  CT_PRECOND(1, "DUT can respond with BAM to the configured requestable PGNs with DLC>8.");
  
  // describe the strategy...
  CT_STRAT(1, "Request the configured non cyclic requestable PGN's with DLC>8 by BAM.");

  // note the reference to documents / specifications
  CT_DOC_21(1, "5.10.1.3");
  CT_DOC_21("5.10.2.1");
  CT_DOC_21("5.10.3.5");

  CT_GetReqPGIs(pgis, gNonCyclic, gDLCx);
  CTF_A05_02_BAM_Data_Timing_First_DT(gTOOL_Addr, gDUT_Addr, pgis);
  
  // end the testcase.
  CT_END();
}

// ==============================================================================================================
export testcase CTC_A05_03_BAM_Data_Timing_Subsequent_DTs()
{
  struct gPGAttrs pgis[long];
  
  // give title and description for this testcase
  CT_BEGIN(0x0503, "BAM Transport:  Ensure the timing between the Data Transfer data packets for a BAM transport is within defined bounds.");
  CT_DESC("Verify that consecutive, sequential TP.DT data packets for BAM transport are sent with a minimum 50 ms and maximum 200 ms (Tr) between one another (i.e., all TP.DT data packets except for the first TP.DT data packet following the TP.CM_BAM message).");

  // describe the preconditions of the test.
  CT_PRECOND(1, "DUT can respond with BAM to the configured requestable PGNs with DLC>8.");
  
  // describe the strategy...
  CT_STRAT(1, "Request the configured non cyclic requestable PGN's with DLC>8 by BAM.");

  // note the reference to documents / specifications
  CT_DOC_21(1, "5.10.1.3");
  CT_DOC_21("5.12.3");

  CT_GetReqPGIs(pgis, gNonCyclic, gDLCx);
  CTF_A05_03_BAM_Data_Timing_Subsequent_DTs(gTOOL_Addr, gDUT_Addr, pgis);
  
  // end the testcase.
  CT_END();
}

// ==============================================================================================================
export testcase CTC_A05_04_BAM_No_Abort()
{
  struct gPGAttrs pgis[long];
  
  // give title and description for this testcase
  CT_BEGIN(0x0504, "BAM Transport:  Ensure DUT does not send a Connection Abort for the BAM Transport");
  CT_DESC("Verify DUT does not transmit a TP.Conn_Abort message for any reason for its own BAM transport. Verify DUT ignores a received TP.Conn_Abort message for the PGN being transported using a BAM transport.");

  // describe the preconditions of the test.
  CT_PRECOND(1, "DUT can respond with BAM to the configured requestable PGNs with DLC>8.");
  
  // describe the strategy...
  CT_STRAT(1, "Request the configured non cyclic requestable PGN's with DLC>8 by BAM.");

  // note the reference to documents / specifications
  CT_DOC_21(1, "5.10.2.4");

  CT_GetReqPGIs(pgis, gNonCyclic, gDLCx);
  CTF_A05_04_BAM_No_Abort(gTOOL_Addr, gDUT_Addr, pgis);
  
  // end the testcase.
  CT_END();
}

// ==============================================================================================================
export testcase CTC_A05_05_BAM_Data_Content()
{
  struct gPGAttrs pgis[long];
  
  // give title and description for this testcase
  CT_BEGIN(0x0505, "BAM Transport:  Ensure the Data Transfer data packets for a BAM transport contain the correct content");
  CT_DESC("Verify the first data byte of each TP.DT data packet for a BAM transport is a valid Sequence Number (1-255). Verify remaining 7 bytes of each TP.DT data packet for the BAM are correct data for the given packet. Verify the TP.DT Data Packets for the BAM transport are sent to the Global Address.");

  // describe the preconditions of the test.
  CT_PRECOND(1, "DUT can respond with BAM to the configured requestable PGNs with DLC>8.");
  CT_PRECOND("To check the data content correctness the DUT has to support the configured FIXED PGN. (optional)");
  
  // describe the strategy...
  CT_STRAT(1, "Request the configured non cyclic requestable PGN's with DLC>8 by BAM.");
  CT_STRAT("To check the TP.DT content the commanded address must be supported by the DUT. Then the content is checked against the DUT's device name within the response.");

  // note the reference to documents / specifications
  CT_DOC_21(1, "5.10.1.3");
  CT_DOC_21("5.10.2.3");
  CT_DOC_21("5.10.4");

  CT_GetReqPGIs(pgis, gNonCyclic, gDLCx);
  CTF_A05_05_BAM_Data_Content(gTOOL_Addr, gDUT_Addr, pgis);
  
  // end the testcase.
  CT_END();
}

// ==============================================================================================================
export testcase CTC_A05_06_BAM_Data_Sequence()
{
  struct gPGAttrs pgis[long];
  
  // give title and description for this testcase
  CT_BEGIN(0x0506, "BAM Transport:  Ensure the Data Transfer data packets for a BAM transport are sent in sequential order ");
  CT_DESC("Verify DUT transmits the TP.DT data packets for a BAM transport in ascending sequential order (beginning with Sequence Number = ‘1’, and counting up).");

  // describe the preconditions of the test.
  CT_PRECOND(1, "DUT can respond with BAM to the configured requestable PGNs with DLC>8.");
  
  // describe the strategy...
  CT_STRAT(1, "Request the configured non cyclic requestable PGN's with DLC>8 by BAM.");

  // note the reference to documents / specifications
  CT_DOC_21(1, "5.10.1.1");
  CT_DOC_21("5.10.1.2");
  CT_DOC_21("5.10.1.4");

  CT_GetReqPGIs(pgis, gNonCyclic, gDLCx);
  CTF_A05_06_BAM_Data_Sequence(gTOOL_Addr, gDUT_Addr, pgis);
  
  // end the testcase.
  CT_END();
}

// ==============================================================================================================
export testcase CTC_A05_07_BAM_Data_DLC()
{
  struct gPGAttrs pgis[long];
  
  // give title and description for this testcase
  CT_BEGIN(0x0507, "BAM Transport:  Ensure every Data Transfer data packet contains 8 data bytes ");
  CT_DESC("Verify DUT transmits each TP.DT data packet for a BAM transport with 8 bytes in the data field .");

  // describe the preconditions of the test.
  CT_PRECOND(1, "DUT can respond with BAM to the configured requestable PGNs with DLC>8.");
  
  // describe the strategy...
  CT_STRAT(1, "Request the configured non cyclic requestable PGN's with DLC>8 by BAM.");

  // note the reference to documents / specifications
  CT_DOC_21(1, "5.2.7.2");
  CT_DOC_21("5.10.1.3");
  CT_DOC_21("5.10.4");

  CT_GetReqPGIs(pgis, gNonCyclic, gDLCx);
  CTF_A05_07_BAM_Data_DLC(gTOOL_Addr, gDUT_Addr, pgis);
  
  // end the testcase.
  CT_END();
}

// ==============================================================================================================
export testcase CTC_A05_08_BAM_Data_Padding()
{
  struct gPGAttrs pgis[long];
  
  // give title and description for this testcase
  CT_BEGIN(0x0508, "BAM Transport:  Ensure extra (unused) bytes of last Data Transfer data packet is/are filled-in correctly.");
  CT_DESC("Verify last TP.DT data packet for a BAM transport is sent with an 8 byte data field and the unused bytes of this packet are filled with 0xFF.");

  // describe the preconditions of the test.
  CT_PRECOND(1, "DUT can respond with BAM to the configured requestable PGNs with DLC>8.");
  
  // describe the strategy...
  CT_STRAT(1, "Request the configured non cyclic requestable PGN's with DLC>8 by BAM.");

  // note the reference to documents / specifications
  CT_DOC_21(1, "5.2.7.2");
  CT_DOC_21("5.10.1.3");
  CT_DOC_21("5.10.4");

  CT_GetReqPGIs(pgis, gNonCyclic, gDLCx);
  CTF_A05_08_BAM_Data_Padding(gTOOL_Addr, gDUT_Addr, pgis);
  
  // end the testcase.
  CT_END();
}

// ==============================================================================================================
export testcase CTC_A05_09_BAM_Data_Prio()
{
  struct gPGAttrs pgis[long];
  
  // give title and description for this testcase
  CT_BEGIN(0x0509, "BAM Transport: Ensure Priority of Data Transfer data packets is set to correct value");
  CT_DESC("Verify DUT sends each TP.DT data packet for any BAM transport using a Priority of 7 (Priority 7 is used regardless of the PGN being transported).");

  // describe the preconditions of the test.
  CT_PRECOND(1, "DUT can respond with BAM to the configured requestable PGNs with DLC>8.");
  
  // describe the strategy...
  CT_STRAT(1, "Request the configured non cyclic requestable PGN's with DLC>8 by BAM.");

  // note the reference to documents / specifications
  CT_DOC_21(1, "5.10.4 - Figure 16");

  CT_GetReqPGIs(pgis, gNonCyclic, gDLCx);
  CTF_A05_09_BAM_Data_Prio(gTOOL_Addr, gDUT_Addr, pgis);
  
  // end the testcase.
  CT_END();
}

// ==============================================================================================================
export testcase CTC_A05_10_BAM_Singularity()
{
  struct gPGAttrs pgis[long];
  
  // give title and description for this testcase
  CT_BEGIN(0x050a, "BAM Transport:  Ensure only one active BAM transport per Originator at a time");
  CT_DESC("Verify DUT doesn't start another BAM transport until it completes a previous BAM transport.");

  // describe the preconditions of the test.
  CT_PRECOND(1, "DUT can respond with BAM to the configured requestable PGNs with DLC>8.");
  
  // describe the strategy...
  CT_STRAT(1, "Request the configured non cyclic requestable PGN's with DLC>8 globally.");
  CT_STRAT("Do a request (A) from tool node");
  CT_STRAT("Await TPCM.BAM");
  CT_STRAT("Request (B) PGN from another node during BAM.");
  CT_STRAT("Await both requests to be answered in sequence.");
  CT_STRAT("Check if there are overlapping TPCM.BAM's within the transport to know that the responses are sent sequentially and not in parallel.");

  // note the reference to documents / specifications
  CT_DOC_21(1, "5.10.5.1");

  CT_GetReqPGIs(pgis, gNonCyclic, gDLCx);
  CTF_A05_10_BAM_Singularity(gDUT_Addr, pgis);
  
  // end the testcase.
  CT_END();
}

// ==============================================================================================================
export testcase CTC_A05_11_BAM_Simultaneous()
{
  struct gPGAttrs pgis[long];
  
  // give title and description for this testcase
  CT_BEGIN(0x050b, "BAM Transport:  Ensure simultaneous BAM transports with different Originators");
  CT_DESC("Verify DUT is able to use a BAM transport to send a PGN while another Controller Application is also using a BAM transport to transport a PGN.");

  // describe the preconditions of the test.
  CT_PRECOND(1, "DUT can respond with BAM to the configured requestable PGNs with DLC>8.");
  
  // describe the strategy...
  CT_STRAT(1, "Tool starts BAM and requests the configured non cyclic requestable PGN's with DLC>8 by BAM.");
  CT_STRAT("Tool starts BAM with a pgn");
  CT_STRAT("Tool requests pgn globally, so DUT shall start a BAM simultaneously");
  CT_STRAT("Await the DUT's BAM transfer completes within the Tool's BAM");
  CT_STRAT("Await the Tool's BAM finishes before continuing with next pgn");

  // note the reference to documents / specifications
  CT_DOC_21(1, "5.10.5.1");

  CT_GetReqPGIs(pgis, gNonCyclic, gDLCx);
  CTF_A05_11_BAM_Simultaneous(gTOOL_Addr, gDUT_Addr, pgis);
  
  // end the testcase.
  CT_END();
}
