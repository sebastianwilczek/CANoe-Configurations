/*@!Encoding:1252*/
includes
{
  #include "CTF_A06.cin"
}

// ==============================================================================================================
export testcase CTC_A06_01_BAM_Receive_PGN()
{
  // give title and description for this testcase
  CT_BEGIN(0x0601, "Verify DUT inspects the PGN (including DP and EDP) in the TP.CM_BAM message");
  CT_DESC("Verify DUT successfully receives a BAM transport when the PGN, ‘Total message size’ & ‘Number of packets’ parameters reported in the TP.CM_BAM message are of correct size and format. Verify DUT inspects the DP and EDP for the PGN in the TP.CM_BAM message. Verify the sender of TP.CM_BAM message is sent to the Global Address. Verify the sender’s  overall message size matches the ‘Total message size’ indicated in the TP.CM_BAM message. Verify the sender’s number of TP.DT packets matches the ‘Number of packets’ indicated in the TP.CM_BAM message");

  // describe the preconditions of the test.
  CT_PRECOND(1, "DUT supports Commanded Address.");
  
  // describe the strategy...
  CT_STRAT(1, "Tester uses BAM to command the DUT to change it address.");
  CT_STRAT("If the DUT reacts it reacts with an Address Claimed under the new address.");
  CT_STRAT("Tester uses a wrong PGN for the commanded address message with modified DP/EDP.");
  CT_STRAT("DUT shall not react on the wrong commanded address message with modified DP/EDP within T3 (give enough time)");

  // note the reference to documents / specifications
  CT_DOC_21(1, "5.10.2.1");
  CT_DOC_21("5.10.3 - Figure 15");
  CT_DOC_21("5.10.3.5");

  CTF_A06_01_BAM_Receive_PGN(gTOOL_Addr, gDUT_Addr);
  
  // end the testcase.
  CT_END();
}

// ==============================================================================================================
export testcase CTC_A06_02_BAM_Receive_Discard_Invalid()
{
  struct gPGAttrs pgis[long];
  
  // give title and description for this testcase
  CT_BEGIN(0x0602, "Ensure DUT validates TP.CM_BAM message parameter values (content and format) ");
  CT_DESC("Verify DUT discards the BAM transport and doesn't send a TP.Conn_Abort message when it receives a TP.CM_BAM message with invalid or incorrect parameter values. Examples:  ‘total message size’ is outside defined bounds (i.e. reported value is less than 9 or greater than 1785 [bytes]), the specified ‘number of packets’ is incorrect for the overall message size (i.e., 17 byte PGN data size sent in 4 data packets), etc");

  // describe the preconditions of the test.
  CT_PRECOND(1, "DUT supports Commanded Address.");
  
  // describe the strategy...
  CT_STRAT(1, "Tester uses BAM to command the DUT to change it address using invalid BAM messages...");
  CT_STRAT("DUT shall show no reaction and shall not send TP.Conn_Abort.");

  // note the reference to documents / specifications
  CT_DOC_21(1, "5.10.2.1");
  CT_DOC_21("5.10.3 - Figure 15");
  CT_DOC_21("5.10.3.5");

  CT_GetReqPGIs(pgis, gNonCyclic, gDLCx);
  CTF_A06_02_BAM_Receive_Discard_Invalid(gTOOL_Addr, gDUT_Addr, pgis);
  
  // end the testcase.
  CT_END();
}

// ==============================================================================================================
export testcase CTC_A06_03_BAM_Receive_No_Abort_Unsupported_PGN()
{
  // give title and description for this testcase
  CT_BEGIN(0x0603, "Ensure DUT discards BAM transport for an unsupported PGN (content and format)");
  CT_DESC("Verify DUT discards the BAM transport and doesn't send a TP.Conn_Abort message when it receives a TP.CM_BAM message for a PGN not supported by the DUT.");

  // describe the strategy...
  CT_STRAT(1, "Tester sends a bunch of PGN's by BAM.");
  CT_STRAT("DUT shall show no reaction and shall not send TP.Conn_Abort.");

  // note the reference to documents / specifications
  CT_DOC_21(1, "5.10.2.1");
  CT_DOC_21("5.10.3 - Figure 15");
  CT_DOC_21("5.10.3.5");

  CTF_A06_03_BAM_Receive_No_Abort_Unsupported_PGN(gTOOL_Addr, gDUT_Addr);
  
  // end the testcase.
  CT_END();
}

// ==============================================================================================================
export testcase CTC_A06_04_BAM_Receive_Timing()
{
  // give title and description for this testcase
  CT_BEGIN(0x0604, "Ensure the time between BAM transport messages meets  the timing requirements (DUT as Responder)");
  CT_DESC("Verify DUT receives a BAM transport when the time between the TP.CM_BAM message and the first TP.DT data packet is between 50 ms and 750 ms (T1). Verify DUT  does not send a TP.Conn_Abort or a NACK when the time between the TP.CM_BAM message and the first TP.DT data packet is less than 50 ms. Verify DUT receives a BAM transport when the time between the TP.CM_BAM message and the first TP.DT data packet is less than or equal to 750 ms (T1). Verify DUT ignores a BAM transport when the time between the TP.CM_BAM message and the first TP.DT packet is greater than 750 ms (T1).");

  // describe the preconditions of the test.
  CT_PRECOND(1, "DUT supports commanded address.");
  
  // describe the strategy...
  CT_STRAT(1, "Tester sends correct and wrong timed Commanded Address'.");
  CT_STRAT("DUT shall do ACL and no NACK or ABORT.");

  // note the reference to documents / specifications
  CT_DOC_21(1, "5.10.2.1");
  CT_DOC_21("5.10.1.3 - Appendix C, C.1, Figure C3");

  CTF_A06_04_BAM_Receive_Timing(gTOOL_Addr, gDUT_Addr);
  
  // end the testcase.
  CT_END();
}

// ==============================================================================================================
export testcase CTC_A06_05_BAM_Receive_Timing_DT()
{
  // give title and description for this testcase
  CT_BEGIN(0x0605, "Ensure DUT receives TP.DT data packets for BAM transport when received within timing requirements (DUT as Responder)");
  CT_DESC("Verify DUT successfully receives the BAM transport when the time between consecutive TP.DT data packets is between 50 ms and 200 ms (Tr). Verify DUT’s does not send a TP.Conn_Abort or a NACK when the time between consecutive TP.DT data packets is less than 50 ms. Verify DUT successfully receives the BAM transport when the time between consecutive TP.DT data packets is more than 200 ms (Tr) but less than 750 ms (T1). Verify DUT discards the BAM transport when the time between consecutive TP.DT data packets is more than 750 ms (T1) ");

  // describe the preconditions of the test.
  CT_PRECOND(1, "DUT supports commanded address.");
  
  // describe the strategy...
  CT_STRAT(1, "Tester sends correct and wrong timed Commanded Address'.");
  CT_STRAT("DUT shall do ACL and no NACK or ABORT.");

  // note the reference to documents / specifications
  CT_DOC_21(1, "5.10.1.3");
  CT_DOC_21("5.10.2.4");
  CT_DOC_21("5.12.3 - Figure C3");

  CTF_A06_05_BAM_Receive_Timing_DT(gTOOL_Addr, gDUT_Addr);
  
  // end the testcase.
  CT_END();
}

// ==============================================================================================================
export testcase CTC_A06_06_BAM_Receive_DT_Seq()
{
  // give title and description for this testcase
  CT_BEGIN(0x0606, "Receiving BAM transport data packets in sequential order (DUT as Responder)");
  CT_DESC("Verify DUT successfully receives the BAM transport when the TP.DT data packets are sent in sequential order. Verify DUT discards the BAM transport when the TP.DT data packets are sent out of sequential order. Verify the sender’s TP.DT Data Packets for the BAM transport are sent to the Global Address.");

  // describe the preconditions of the test.
  CT_PRECOND(1, "DUT supports commanded address.");
  
  // describe the strategy...
  CT_STRAT(1, "Tester sends correct and wrong DT sequences.");
  CT_STRAT("DUT shall do ACL on correct DT sequences and ignore on wrong sequences.");

  // note the reference to documents / specifications
  CT_DOC_21(1, "5.10.1.1");
  CT_DOC_21("5.10.1.2");
  CT_DOC_21("5.10.1.4");

  CTF_A06_06_BAM_Receive_DT_Seq(gTOOL_Addr, gDUT_Addr);
  
  // end the testcase.
  CT_END();
}

// ==============================================================================================================
export testcase CTC_A06_07_BAM_Receive_DT_Wrong_DLC()
{
  // give title and description for this testcase
  CT_BEGIN(0x0607, "Ensure DUT discards BAM transport when TP.DT data packets are not correct size (DUT as Responder)");
  CT_DESC("Verify DUT discards the BAM transport if any TP.DT data packet has less than 8 bytes");

  // describe the preconditions of the test.
  CT_PRECOND(1, "DUT supports commanded address.");
  
  // describe the strategy...
  CT_STRAT(1, "Tester sends Commanded Address with an incorrect DT of DLC<8.");
  CT_STRAT("DUT shall ignore it.");

  // note the reference to documents / specifications
  CT_DOC_21(1, "5.10.1.3");
  CT_DOC_21("5.10.4 - Figure 16");
  CT_DOC_21("5.2.7.2");

  CTF_A06_07_BAM_Receive_DT_Wrong_DLC(gTOOL_Addr, gDUT_Addr);
  
  // end the testcase.
  CT_END();
}

// ==============================================================================================================
export testcase CTC_A06_08_BAM_Receive_DT_Prios()
{
  // give title and description for this testcase
  CT_BEGIN(0x0608, "Ensure DUT accepts BAM transport when Priority of TP.DT data packets are not correct value (DUT as Responder)");
  CT_DESC("Verify DUT receives TP.DT data packets even if the TP.DT messages use a Priority other than 7");

  // describe the preconditions of the test.
  CT_PRECOND(1, "DUT supports commanded address.");
  
  // describe the strategy...
  CT_STRAT(1, "Tester sends Commanded Address with DTs of different prios.");
  CT_STRAT("DUT shall react on them.");

  // note the reference to documents / specifications
  CT_DOC_21(1, "5.10.4 - Figure 16");

  CTF_A06_08_BAM_Receive_DT_Prios(gTOOL_Addr, gDUT_Addr);
  
  // end the testcase.
  CT_END();
}

// ==============================================================================================================
export testcase CTC_A06_09_BAM_Receive_DT_Uses_Padding()
{
  // give title and description for this testcase
  CT_BEGIN(0x0609, "Ensure DUT properly reassembles received TP.DT data packets(DUT as Responder)");
  CT_DESC("Verify DUT correctly ignores any unused bytes of last TP.DT packet  (reference the ‘Total message size, number of bytes’ from TP.CM_BAM message)");

  // describe the preconditions of the test.
  CT_PRECOND(1, "DUT supports commanded address.");
  
  // describe the strategy...
  CT_STRAT(1, "Tester sends Commanded Address with last DT using padding bytes different from 0xFF.");
  CT_STRAT("DUT shall react on Commanded Address.");

  // note the reference to documents / specifications
  CT_DOC_21(1, "5.10.1.4");
  CT_DOC_21("5.10.3");
  CT_DOC_21("5.10.4");

  CTF_A06_09_BAM_Receive_DT_Uses_Padding(gTOOL_Addr, gDUT_Addr);
  
  // end the testcase.
  CT_END();
}

// ==============================================================================================================
export testcase CTC_A06_10_BAM_Receive_NoEOM()
{
  // give title and description for this testcase
  CT_BEGIN(0x060a, "Ensure DUT doesn’t transmit an End of Message Acknowledge following the reception of the final Data Transfer data packet (DUT as Responder)");
  CT_DESC("Verify DUT does not transmit a TP.CM_EndOfMsgACK message after the final TP.DT data packet of a BAM transport");

  // describe the preconditions of the test.
  CT_PRECOND(1, "DUT supports commanded address.");
  
  // describe the strategy...
  CT_STRAT(1, "Tester sends Commanded Address to DUT.");
  CT_STRAT("DUT shall react on Commanded Address with ACL but not with any EOM.");

  // note the reference to documents / specifications
  CT_DOC_21(1, "5.10.2.4");

  CTF_A06_10_BAM_Receive_NoEOM(gTOOL_Addr, gDUT_Addr);
  
  // end the testcase.
  CT_END();
}

// ==============================================================================================================
export testcase CTC_A06_11_BAM_Receive_No_Abort_Invalid()
{
  // give title and description for this testcase
  CT_BEGIN(0x060b, "Ensure DUT never transmits a Connection Abort ");
  CT_DESC("Verify DUT does not send a TP. Conn_Abort message for any reason for a BAM transport (e.g., out of sequence data packets, missing data packets, etc.)");

  // describe the strategy...
  CT_STRAT(1, "Tester sends some invalid BAMs");
  CT_STRAT("DUT has not to send any TP.Conn_Abort.");

  // note the reference to documents / specifications
  CT_DOC_21(1, "5.10.2.4");

  CTF_A06_11_BAM_Receive_No_Abort_Invalid(gTOOL_Addr, gDUT_Addr);
  
  // end the testcase.
  CT_END();
}

// ==============================================================================================================
export testcase CTC_A06_12_BAM_Receive_Singularity()
{
  // give title and description for this testcase
  CT_BEGIN(0x060c, "Ensure DUT supports only one BAM transport from a Controller Application at any given time");
  CT_DESC("Verify DUT discards a TP.CM_BAM message from a Controller Application (Source Address) when received before the previous TP.CM_BAM message’s associated TP.DT data packets (from the same Controller Application) have been completely transmitted");

  // describe the strategy...
  CT_STRAT(1, "Tester sends BAM during another one.");
  CT_STRAT("During BAM is running, it sends a Commanded Address. Both have to be discarded.");
  CT_STRAT("During Commanded Address is running, it sends another BAM. Both have to be discarded.");

  // note the reference to documents / specifications
  CT_DOC_21(1, "5.10.5.1");

  CTF_A06_12_BAM_Receive_Singularity(gTOOL_Addr, gDUT_Addr);
  
  // end the testcase.
  CT_END();
}

// ==============================================================================================================
export testcase CTC_A06_13_BAM_Receive_Multiple_Transport()
{
  // give title and description for this testcase
  CT_BEGIN(0x060d, "Ensure DUT supports multiple  BAM transports from different Controller Applications");
  CT_DESC("Verify DUT can handle receiving TP.CM_BAM messages from different Controller Applications (multiple Source Addresses)");

  // describe the strategy...
  CT_STRAT(1, "One long BAM is sent from a foreign source.");
  CT_STRAT("During long BAM from tool, the Commanded Address is sent from another node.");
  CT_STRAT("DUT shall react on the Commanded Address.");

  // note the reference to documents / specifications
  CT_DOC_21(1, "5.10.5.1");

  CTF_A06_13_BAM_Receive_Multiple_Transport(gTOOL_Addr, gDUT_Addr);
  
  // end the testcase.
  CT_END();
}

