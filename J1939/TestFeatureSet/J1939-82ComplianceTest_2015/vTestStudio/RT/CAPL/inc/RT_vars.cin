/*@!Encoding:1252*/
includes
{
  #include "RT_config.cin"
}

variables
{
  // (very) global variables that can not be assigned to another CAPL module.
}

// ==============================================================================================================
// Initialize global variables, and test configuration.
// called within each CT_BEGIN.
void CT_InitVars()
{
  gReactor_ReactWithAbortOnDT_Active = 0;
  gReactor_ReactWithAbortOnDT_DA     = gc_BC_ADDR;

  initJ1939PGData(gPgLastAC);
  gPgLastAC.sa = gc_BC_ADDR;
  gPgLastAC.da = gc_NULL_ADDR;
  
}
