/*@!Encoding:1252*/
void Path_Split(char s[], char d[], char f[])
{
  char b[4096];
  long p,o;

  p = -1;
  o = 0;
  snprintf(b, elcount(b), s);
  snprintf(f, elcount(f), s);
  str_replace(b, "\\", "/");
  
  if (strstr(b, "/")>=0)
  {
    while (1)
    {
      p = strstr_regex_off(b, o, "/.*$"); // last delimiter position...
      if (p<0)
      {
        p = o;
        break;
      }
      o = p+1;
    }
  }
  
  if (p>0)
  {
    substr_cpy(d, s, 0, p-1, elCount(d));
    snprintf(b, elcount(b), d);
    str_replace(b, "\\", "\\\\");
    substr_cpy(f, s, p, strlen(s)-p, elcount(f));
  }
  
}