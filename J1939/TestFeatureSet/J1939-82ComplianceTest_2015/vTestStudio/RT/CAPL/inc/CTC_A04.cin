/*@!Encoding:1252*/
includes
{
  #include "CTF_A04.cin"
}

// ==============================================================================================================
export testcase CTC_A04_01_MsgTolerance()
{
  byte memCyclicDisabled;
  struct gPGAttrs pgis[long];
  
  // give title and description for this testcase
  CT_BEGIN(0x0401, "Standard Frame Message Tolerance");
  CT_DESC("Verify DUT operation is not adversely affected by CAN Standard Frames on the network");

  // describe the preconditions of the test.
  CT_PRECOND(1, "DUT has produce cyclic messages");
  CT_PRECOND("DUT has to provides requestable messages");
  
  // describe the strategy...
  CT_STRAT(1, "Generate continuously high frequent low prio standard CAN Frames (11bit) during the test");
  CT_STRAT("Request all requestable messages from the DUT. They have to be answered correctly");
  CT_STRAT("Wait 4 times the max. cycle time of all cyclic messages");
  CT_STRAT("The cyclic messages have to be sent within abs. and rel. message tolerance to identify they are not disturbed");

  // note the reference to documents / specifications
  CT_DOC_21(1, "5.1.3");

  memCyclicDisabled = @CT::CFG::DUT::CyclicDisabled;
  @CT::CFG::DUT::CyclicDisabled = 0; // enable cyclic sending to avoid precondition error.
  
  CT_GetPgis(pgis);
  CTF_A04_01_MsgTolerance(pgis);
  
  @CT::CFG::DUT::CyclicDisabled = memCyclicDisabled; // set cyclic sending to the value it has before the test.
  
  // end the testcase.
  CT_END();
}

// ==============================================================================================================
// check if DUT is not a CAN2A device.
export testcase CTC_A04_02_CAN2B()
{
  // give title and description for this testcase
  CT_BEGIN(0x0402, "Device is not a CAN2.0A device.");
  CT_DESC("Verify DUT is not a CAN 2.0A device by issuing 29-bit (CAN 2.0B) Extended CAN Frames and check for error frames.");

  // describe the preconditions of the test.
  CT_PRECOND(1, "DUT is at least a CAN2.0B device.");
  
  // describe the strategy...
  CT_STRAT(1, "Generate 29bit messages for some seconds and check for error frames.");

  // note the reference to documents / specifications
  CT_DOC_21(1, "5.1.3");
  
  // describe the teststeps
  CTF_A04_02_CAN2B();
  
  // end the testcase.
  CT_END();
}

// ==============================================================================================================
// DUT receives PGN request regardless of the prio.
export testcase CTC_A04_03_PGNReceivePrioIndep()
{
  char reportText[1024];
  byte src,dst;
  struct gPGAttrs pgis[long];
  
  src = gTOOL_Addr;
  dst = gDUT_Addr;
  
  // give title and description for this testcase
  CT_BEGIN(0x0403, "PGN received independant of priority bits.");
  CT_DESC("Verify DUT receives a PGN regardless of the priority bits in 29-bit header.  Change priority bits and confirm received.");

  // describe the preconditions of the test.
  CT_PRECOND(1, "DUT answers to a configured non requestable PGN with NACK.");
  
  // describe the strategy...
  CT_STRAT(1, "Request all configured non requestable PGN's with different priorities.");
  CT_STRAT("Check if DUT answers with NACK to the request (independantly of the requested prio).");

  // note the reference to documents / specifications
  CT_DOC_21(1, "5.2.1");
  
  // describe the teststeps
  CT_GetNonReqPGIs(pgis);
  CTF_A04_03_PGNReceivePrioIndep(src, dst, pgis);
  
  // end the testcase.
  CT_END();
}

// ==============================================================================================================
// Use of EDP Bit to identify PGN
export testcase CTC_A04_04_EDPinPGN()
{
  char reportText[1024];
  byte src,dst;
  struct gPGAttrs pgis[long];
  
  src = gTOOL_Addr;
  dst = gDUT_Addr;
  
  // give title and description for this testcase
  CT_BEGIN(0x0404, "Use of EDP Bit to identify PGN.");
  CT_DESC("Verify DUT evaluates the EDP Bit when processing in 29-bit CAN Frames. (Same CAN header except for EDP bit and different data values to see if DUT acts on data values)");
  // describe the preconditions of the test.
  CT_PRECOND(1, "DUT answers to a configured non requestable PGN with NACK.");
  
  // describe the strategy...
  CT_STRAT(1, "Use request message to request all non requestable PGNs. NACK is expected.");
  CT_STRAT("By setting EDP within the request, the DUT shall not react on this request (it isnt a request!), else it ignores EDP, that is a failure.");

  // note the reference to documents / specifications
  CT_DOC_21(1, "5.2.2");
  
  // describe the teststeps
  CT_GetNonReqPGIs(pgis);
  CTF_A04_04_EDPinPGN(src, dst, pgis);
  
  // end the testcase.
  CT_END();
}

// ==============================================================================================================
// Use of DP Bit to identify PGN
export testcase CTC_A04_05_DPinPGN()
{
  char reportText[1024];
  byte src,dst;
  struct gPGAttrs pgis[long];
  
  src = gTOOL_Addr;
  dst = gDUT_Addr;
  
  // give title and description for this testcase
  CT_BEGIN(0x0405, "Use of DP Bit to identify PGN.");
  CT_DESC("Verify DUT evaluates the DP Bit when processing in 29-bit CAN Frames. (Same CAN header except for DP bit and different data values to see if DUT acts on data values)");
  // describe the preconditions of the test.
  CT_PRECOND(1, "DUT answers to a configured non requestable PGN with NACK.");
  
  // describe the strategy...
  CT_STRAT(1, "Use request message to request all non requestable PGNs. NACK is expected.");
  CT_STRAT("By setting DP within the request, the DUT shall not react on this request (it isnt a request!), else it ignores DP, that is a failure.");

  // note the reference to documents / specifications
  CT_DOC_21(1, "5.2.3");
  
  // describe the teststeps
  CT_GetNonReqPGIs(pgis);
  CTF_A04_05_DPinPGN(src, dst, pgis);
  
  // end the testcase.
  CT_END();
}

// ==============================================================================================================
// Filtering on destination address
export testcase CTC_A04_06_FilterOnDstAddr()
{
  char reportText[1024];
  byte src,dst;
  struct gPGAttrs pgis[long];
  
  src = gTOOL_Addr;
  dst = gDUT_Addr;
  
  // give title and description for this testcase
  CT_BEGIN(0x0406, "Filtering on destination address.");
  CT_DESC("Verify DUT evaluates the Destination Address for 29-bit CAN Frames.  (Same PGN sent to different DAs containing different data values to confirm DUT acts only on data values sent to its address) ");
  // describe the preconditions of the test.
  CT_PRECOND(1, "DUT answers to a configured non requestable PGN with NACK.");
  
  // describe the strategy...
  CT_STRAT(1, "Use request message to request all non requestable PGNs. NACK is expected.");
  CT_STRAT("Request the message again, but to another (unknown) node, and check the DUT does not react.");

  // note the reference to documents / specifications
  CT_DOC_21(1, "5.2.5.1");
  CT_DOC_21("5.4.2 - Table 5");
  
  // describe the teststeps
  CT_GetNonReqPGIs(pgis);
  CTF_A04_06_FilterOnDstAddr(src, dst, pgis);

  // end the testcase.
  CT_END();
}

// ==============================================================================================================
// Supports Receive of Global Destination Address
export testcase CTC_A04_07_GlobDestAddr()
{
  char reportText[1024];
  byte src,dst;
  struct gPGAttrs pgis[long];
  
  src = gTOOL_Addr;
  
  // give title and description for this testcase
  CT_BEGIN(0x0407, "Supports Receive of Global Destination Address.");
  CT_DESC("Verify DUT responds to globally addressed messages.");
  
  // describe the preconditions of the test.
  CT_PRECOND(1, "DUT has requestable messages with DLC8.");
  
  // describe the strategy...
  CT_STRAT(1, "Request all configured requestable messages with DLC8 globally (highest prio). DLC>8 not used, due potentially disturbance of cyclic message TPs.");

  // note the reference to documents / specifications
  CT_DOC_21(1, "5.2.5.1");
  
  // describe the teststeps
  //CT_GetReqPGIs( pgis, gCyclicDontCare, gDLC8 );
  CTF_A04_07_GlobDestAddr(gTOOL_Addr, gDUT_Addr);
  
  // end the testcase.
  CT_END();
}

// ==============================================================================================================
// Supports Receive of Global Destination Address
export testcase CTC_A04_08_PDUProcCapabilities_xxx()
{
  byte src,dst;
  struct gPGAttrs pgis[long];
    
  src = gTOOL_Addr;
  dst = gDUT_Addr;
  
  // give title and description for this testcase
  CT_BEGIN(0x0408, "PDU Processing Capabilities.");
  CT_DESC("Verify device does not lose any messages when the data link is at 100 percent utilization for 10 ms.");
  
  // describe the preconditions of the test.
  CT_PRECOND(1, "DUT has to answer to non requestable PGN requests with NACK.");
  
  // describe the strategy...
  CT_STRAT(1, "Create a P2P burst for about 10ms and request a non requestable PGN from the DUT.");
  CT_STRAT("Check DUT answers with NACK within Tr (200ms)");
  CT_STRAT("Create a broadcast burst for about 10ms and request a non requestable PGN from the DUT.");
  CT_STRAT("Check DUT answers with NACK within Tr (200ms)");
  
  // note the reference to documents / specifications
  CT_DOC_21(1, "5.11");
  
  // describe the teststeps
  CT_GetNonReqPGIs( pgis );
  CTF_A04_08_PDUProcCapabilities(src, dst, pgis);
  
  // end the testcase.
  CT_END();
}

// ==============================================================================================================
// Supports Receive of Global Destination Address
export testcase CTC_A04_08_PDUProcCapabilities()
{
  byte src,dst;
  struct gPGAttrs pgis[long];
    
  src = gTOOL_Addr;
  dst = gDUT_Addr;
  
  // give title and description for this testcase
  CT_BEGIN(0x0408, "PDU Processing Capabilities.");
  CT_DESC("Verify device does not lose any messages when the data link is at 100 percent utilization for 10 ms.");
  
  // describe the preconditions of the test.
  CT_PRECOND(1, "DUT has to answer to non requestable PGN requests with NACK.");
  
  // describe the strategy...
  CT_STRAT(1, "Create a P2P burst for about 10ms and request a non requestable PGN from the DUT at the beginning of this burst.");
  CT_STRAT("Check DUT answers with NACK within Tr (200ms)");
  CT_STRAT("Wait T3 (1250ms)");
  CT_STRAT("Repeat the burst and do the request directly at the burst's end.");
  CT_STRAT("Check DUT answers with NACK within Tr (200ms)");
  CT_STRAT("Wait T3 (1250ms)");
  CT_STRAT("Create a broadcast burst for about 10ms and request a non requestable PGN from the DUT at the beginning of this burst");
  CT_STRAT("Check DUT answers with NACK within Tr (200ms)");
  CT_STRAT("Wait T3 (1250ms)");
  CT_STRAT("Repeat the burst and do the request directly at the burst's end.");
  CT_STRAT("Check DUT answers with NACK within Tr (200ms)");
  CT_STRAT("Wait T3 (1250ms)");
  
  // note the reference to documents / specifications
  CT_DOC_21(1, "5.11");
  
  // describe the teststeps
  CT_GetNonReqPGIs( pgis );
  CTF_A04_08_PDUProcCapabilities(src, dst, pgis);
  
  // end the testcase.
  CT_END();
}

// ==============================================================================================================
// Multipacket PGN as single CAN dataframe
export testcase CTC_A04_09_Multipacket_Single()
{
  byte src,dst;
  struct gPGAttrs pgis[long];
  src = gTOOL_Addr;
  dst = gDUT_Addr;
  
  // give title and description for this testcase
  CT_BEGIN(0x0409, "Capability of DUT to receive a multipacket-capable PGN that is sent as single CAN Data Frame when Data field has less than 9 bytes of data.");
  CT_DESC("Verify DUT can receive the multipacket PGN using the single 29-bit CAN Extended Frame format.");
  
  // describe the preconditions of the test.
  // CT_PRECOND(1, "");
  
  // describe the strategy...
  //CT_STRAT(1, "");
  //CT_STRAT("");

  // note the reference to documents / specifications
  CT_DOC_21(1, "5.2.7.1");
  CT_DOC_21("5.2.7.2");
  CT_DOC_21("5.10.5.2");
  
  // describe the teststeps
  CT_GetReqPGIs( pgis ); // it's not testable this is a place holder...
  CTF_A04_09_Multipacket_Single(src, dst, pgis);
  
  // end the testcase.
  CT_END();
}

// ==============================================================================================================
// Multipacket PDU1
export testcase CTC_A04_10_Multipacket_PDU1()
{
  byte src,dst;
  struct gPGAttrs pgis[long];
  src = gTOOL_Addr;
  dst = gDUT_Addr;
  
  // give title and description for this testcase
  CT_BEGIN(0x040a, "Capability of the DUT to concurrently receive a multipacket-capable Destination Specific (PDU1) PGN");
  CT_DESC("Verify DUT can receive both concurrent instances of same PDU1 PGN - one instance with less than 9 bytes (as a single CAN Frame) and the other instance with more than 9 bytes (through RTS/CTS).");
  
  // describe the preconditions of the test.
  // CT_PRECOND(1, "");
  
  // describe the strategy...
  //CT_STRAT(1, "");
  //CT_STRAT("");

  // note the reference to documents / specifications
  CT_DOC_21(1, "5.2.7.1");
  CT_DOC_21("5.2.7.2");
  CT_DOC_21("5.10.5.3");
  
  // describe the teststeps
  CT_GetReqPGIs( pgis ); // it's not testable this is a place holder...
  CTF_A04_10_Multipacket_PDU1(src, dst, pgis);
  
  // end the testcase.
  CT_END();
}

// ==============================================================================================================
// Multipacket PDU2
export testcase CTC_A04_11_Multipacket_PDU2()
{
  byte src,dst;
  struct gPGAttrs pgis[long];
  src = gTOOL_Addr;
  dst = gDUT_Addr;
  
  // give title and description for this testcase
  CT_BEGIN(0x040b, "Capability of the DUT to receive a multipacket-capable Broadcast (PDU2) PGN");
  CT_DESC("Verify DUT can receive both concurrent instances of same PDU 2 PGN - one instance with less than 9 bytes (as a single CAN Frame) and the other instance with more than 9 bytes (through BAM) ");
  
  // describe the preconditions of the test.
  // CT_PRECOND(1, "");
  
  // describe the strategy...
  //CT_STRAT(1, "");
  //CT_STRAT("");

  // note the reference to documents / specifications
  CT_DOC_21(1, "5.2.7.1");
  CT_DOC_21("5.2.7.2");
  CT_DOC_21("5.10.5.3");
  
  // describe the teststeps
  CT_GetReqPGIs( pgis ); // it's not testable this is a place holder...
  CTF_A04_11_Multipacket_PDU2(src, dst, pgis);
  
  // end the testcase.
  CT_END();
}

// ==============================================================================================================
// Requests
export testcase CTC_A04_12_Requests()
{
  byte src,dst;
  struct gPGAttrs pgis[long];
  char reportText[1024];
  
  src = gTOOL_Addr;
  dst = gDUT_Addr;
  
  // give title and description for this testcase
  CT_BEGIN(0x040c, "Correct Interpretation of 'Requested PGN' in Request (PGN 59904)");
  CT_DESC("Verify DUT properly interprets 'Requested PGN' in Request message by monitoring for correct PGN response");
  
  // describe the preconditions of the test.
  CT_PRECOND(1, "DUT answers to requests with PG, ACK, or NACK without timeouts.");
  
  // describe the strategy...
  CT_STRAT(1, "Request all configured non cyclic PGN's and check for a proper reaction without timeout.");

  // note the reference to documents / specifications
  CT_DOC_21(1, "5.4.2 - Figure 8");
  
  // describe the teststeps
  CT_GetPGIs( pgis, gReqDontCare, gRTSDontCare, gNonCyclic, gDlcDontCare, gExpResp_PG_ACK_NACK);
  CTF_A04_12_Request(src, dst, pgis);
  
  // end the testcase.
  CT_END();
}

// ==============================================================================================================
export testcase CTC_A04_13_P2P_Response_PDU1_DLC8()
{
  byte src;
  byte dst;
  struct gPGAttrs pgis[long];
  
  src = gTOOL_Addr;
  dst = gDUT_Addr;

  // give title and description for this testcase.
  CT_BEGIN(0x040d, "Proper Response to Destination Specific Request for Single Packet Destination Specific (PDU1) PGN and DLC8 ");
  CT_DESC("Verify DUT sends the Requested PGN with the Destination Address set to the Source Address from the Request message");

  // describe the preconditions of the test.
  CT_PRECOND(1, "DUT has to respond to configured requestable PDU1 messages with DLC8.");
  
  // describe the strategy...
  CT_STRAT(1, "Request configured requestable message from DUT by Tool");

  // note the reference to documents / specifications
  CT_DOC_21(1, "5.2.7");
  CT_DOC_21("5.4.2 - Table 5");
  CT_DOC_21("5.12.3");
  
  // describe the teststeps
  CT_GetPGIs( pgis, gRequestable, gRTSDontCare, gCyclicDontCare, gDLC8, gExpResp_PG, gPDU1 );
  CTF_A04_13_P2P_Response_PDU1_DLC8(src, dst, pgis);
  
  // end the testcase.
  CT_END();
}

// ==============================================================================================================
export testcase CTC_A04_14_Glob_Response_PDU1_DLC8()
{
  byte src;
  byte dst;
  struct gPGAttrs pgis[long];
  
  src = gTOOL_Addr;
  dst = gDUT_Addr;

  // give title and description for this testcase.
  CT_BEGIN(0x040e, "Proper Response to global Request for Single Packet Destination Specific (PDU1) PGN and DLC8 ");
  CT_DESC("Verify DUT sends the Requested PGN with the Destination Address set to the global address.");

  // describe the preconditions of the test.
  CT_PRECOND(1, "DUT has to respond to configured requestable messages.");
  
  // describe the strategy...
  CT_STRAT(1, "Request globally configured requestable message from DUT by Tool");

  // note the reference to documents / specifications
  CT_DOC_21(1, "5.2.7");
  CT_DOC_21("5.4.2 - Table 5");
  CT_DOC_21("5.12.3");
  
  // describe the teststeps
  CT_GetPGIs( pgis, gRequestable, gRTSDontCare, gCyclicDontCare, gDLC8, gExpResp_PG, gPDU1 );
  CTF_A04_14_Glob_Response_PDU1_DLC8(src, dst, pgis);
  
  // end the testcase.
  CT_END();
}

// ==============================================================================================================
export testcase CTC_A04_15_P2P_Response_PDU1_DLCx()
{
  byte src;
  byte dst;
  struct gPGAttrs pgis[long];
  
  src = gTOOL_Addr;
  dst = gDUT_Addr;

  // give title and description for this testcase.
  CT_BEGIN(0x040f, "Proper Response to Destination Specific Request for multipacket Destination Specific (PDU1) PGN containing 9 bytes of data or more ");
  CT_DESC("Verify DUT uses the SAE J1939 Transport Protocol RTS/CTS to send the Requested PGN to the Source Address from the Request message ");

  // describe the preconditions of the test.
  CT_PRECOND(1, "DUT has to respond to configured requestable messages.");
  
  // describe the strategy...
  CT_STRAT(1, "Request configured requestable message from DUT by Tool");

  // note the reference to documents / specifications
  CT_DOC_21(1, "5.4.2 - Table 5");
  CT_DOC_21("5.12.3");
  
  // describe the teststeps
  CT_GetPGIs( pgis, gRequestable, gRTSDontCare, gCyclicDontCare, gDLCx, gExpResp_PG, gPDU1 );
  CTF_A04_15_P2P_Response_PDU1_DLCx(src, dst, pgis);
  
  // end the testcase.
  CT_END();
}

// ==============================================================================================================
export testcase CTC_A04_16_Glob_Response_PDU1_DLCx()
{
  byte src;
  byte dst;
  struct gPGAttrs pgis[long];
  
  src = gTOOL_Addr;
  dst = gDUT_Addr;

  // give title and description for this testcase.
  CT_BEGIN(0x0410, "Proper Response to Global Request for Multipacket Destination Specific (PDU1) PGN containing 9 bytes of data or more ");
  CT_DESC("Verify DUT uses the SAE J1939 Transport Protocol BAM to send the Requested PGN");
  
  // describe the preconditions of the test.
  CT_PRECOND(1, "DUT has to respond to configured requestable messages.");
  
  // describe the strategy...
  CT_STRAT(1, "Request globally configured requestable message from DUT by Tool");

  // note the reference to documents / specifications
  CT_DOC_21(1, "5.4.2 - Table 5");
  CT_DOC_21("5.12.3");
  
  // describe the teststeps
  CT_GetPGIs( pgis, gRequestable, gRTSDontCare, gCyclicDontCare, gDLCx, gExpResp_PG, gPDU1 );
  CTF_A04_16_Glob_Response_PDU1_DLCx(src, dst, pgis);
  
  // end the testcase.
  CT_END();
}

// ==============================================================================================================
export testcase CTC_A04_17_P2P_Response_PDU2_DLC8()
{
  byte src;
  byte dst;
  struct gPGAttrs pgis[long];
  
  src = gTOOL_Addr;
  dst = gDUT_Addr;

  // give title and description for this testcase.
  CT_BEGIN(0x0411, "Proper Response to Destination Specific Request for Single Packet Broadcast (PDU2) PGN and DLC8");
  CT_DESC("Verify DUT sends the Requested PGN ");

  // describe the preconditions of the test.
  CT_PRECOND(1, "DUT has to respond to configured requestable messages.");
  
  // describe the strategy...
  CT_STRAT(1, "Request configured requestable message from DUT by Tool");

  // note the reference to documents / specifications
  CT_DOC_21(1, "5.4.2 - Table 5");
  CT_DOC_21("5.12.3");
  
  // describe the teststeps
  CT_GetPGIs( pgis, gRequestable, gRTSDontCare, gCyclicDontCare, gDLC8, gExpResp_PG, gPDU2 );
  CTF_A04_17_P2P_Response_PDU2_DLC8(src, dst, pgis);
  
  // end the testcase.
  CT_END();
}

// ==============================================================================================================
export testcase CTC_A04_18_Glob_Response_PDU2_DLC8()
{
  byte src;
  byte dst;
  struct gPGAttrs pgis[long];

  src = gTOOL_Addr;
  dst = gDUT_Addr;

  // give title and description for this testcase.
  CT_BEGIN(0x0412, "Proper Response to Global Request for Single Packet Broadcast (PDU2) PGN and DLC8");
  CT_DESC("Verify DUT sends the Requested PGN ");

  // describe the preconditions of the test.
  CT_PRECOND(1, "DUT has to respond to configured requestable messages.");
  
  // describe the strategy...
  CT_STRAT(1, "Request globally configured requestable message from DUT by Tool");

  // note the reference to documents / specifications
  CT_DOC_21(1, "5.4.2 - Table 5");
  CT_DOC_21("5.12.3");
  
  // describe the teststeps
  CT_GetPGIs( pgis, gRequestable, gRTSDontCare, gCyclicDontCare, gDLC8, gExpResp_PG, gPDU2 );
  CTF_A04_18_Glob_Response_PDU2_DLC8(src, dst, pgis);
  
  // end the testcase.
  CT_END();
}

// ==============================================================================================================
export testcase CTC_A04_19_P2P_Response_PDU2_DLCx()
{
  byte src;
  byte dst;
  struct gPGAttrs pgis[long];
  
  src = gTOOL_Addr;
  dst = gDUT_Addr;

  // give title and description for this testcase.
  CT_BEGIN(0x0413, " Proper Response to Destination Specific Request for Multipacket Broadcast (PDU2) PGN containing 9 bytes of data or more ");
  CT_DESC("Verify DUT uses the SAE J1939 Transport Protocol RTS/CTS to send the Requested PGN to the Source Address from the Request message");

  // describe the preconditions of the test.
  CT_PRECOND(1, "DUT has to respond to configured requestable messages.");
  
  // describe the strategy...
  CT_STRAT(1, "Request configured requestable message from DUT by Tool");

  // note the reference to documents / specifications
  CT_DOC_21(1, "5.4.2 - Table 5");
  CT_DOC_21("5.12.3");
  
  // describe the teststeps
  CT_GetPGIs( pgis, gRequestable, gRTSDontCare, gCyclicDontCare, gDLCx, gExpResp_PG, gPDU2 );
  CTF_A04_19_P2P_Response_PDU2_DLCx(src, dst, pgis);
  
  // end the testcase.
  CT_END();
}

// ==============================================================================================================
export testcase CTC_A04_20_Glob_Response_PDU2_DLCx()
{
  byte src;
  byte dst;
  struct gPGAttrs pgis[long];
  
  src = gTOOL_Addr;
  dst = gDUT_Addr;

  // give title and description for this testcase.
  CT_BEGIN(0x0414, "Proper Response to Global Request for Multipacket Broadcast (PDU2) PGN containing 9 bytes of data or more ");
  CT_DESC("Verify DUT uses the SAE J1939 Transport Protocol BAM to send the Requested PGN");
  
  // describe the preconditions of the test.
  CT_PRECOND(1, "DUT has to respond to configured requestable messages.");
  
  // describe the strategy...
  CT_STRAT(1, "Request globally configured requestable message from DUT by Tool");

  // note the reference to documents / specifications
  CT_DOC_21(1, "5.4.2 - Table 5");
  CT_DOC_21("5.12.3");
  
  // describe the teststeps
  CT_GetPGIs( pgis, gRequestable, gRTSDontCare, gCyclicDontCare, gDLCx, gExpResp_PG, gPDU2 );
  CTF_A04_20_Glob_Response_PDU2_DLCx(src, dst, pgis);
  
  // end the testcase.
  CT_END();
}

// ==============================================================================================================
// A04_21_Response_Timing
// ==============================================================================================================
//
// this is a combined test-sequence designed directly in the .vtt-Tree.
// it executes A04_13 - A04_20 that implies the timing, and suceeds when all of the tests are passed.
//
//

// ==============================================================================================================
export testcase CTC_A04_22_P2P_NACK()
{
  byte src;
  byte dst;
  struct gPGAttrs pgis[long];
  
  src = gTOOL_Addr;
  dst = gDUT_Addr;

  // give title and description for this testcase.
  CT_BEGIN(0x0416, "Proper NACK Response for Destination Specific Request sent to DUT’s Address for a PGN that is not supported by DUT");
  CT_DESC("Verify DUT sends an Acknowledgement (PGN 59392) containing the Requested PGN and indicates a Negative Acknowledgment (control Byte = 1; NACK) only if the DUT was the destination of the request. Verify DUT uses the Global Address for the Acknowledgement message. Verify the Requested PGN that was sent by DUT in Data field has the correct content (byte order and position). Verify the 'Address Negative Acknowledgement' parameter contains a valid or appropriate address value. Verify DUT sends NACK within 200 ms (Tr) after the Request ");
  
  // describe the preconditions of the test.
  CT_PRECOND(1, "There are PGNs for non requestable messages configured.");
  
  // describe the strategy...
  CT_STRAT(1, "Request non requestable PGN and await NACK within 200ms.");

  // note the reference to documents / specifications
  CT_DOC_21(1, "5.4.2 - Table 5");
  CT_DOC_21("5.4.4");
  CT_DOC_21("5.12.3");
  
  // describe the teststeps
  CT_GetNonReqPGIs(pgis, gCyclicDontCare);
  CTF_A04_22_P2P_NACK(src, dst, pgis);
  
  // end the testcase.
  CT_END();
}

// ==============================================================================================================
export testcase CTC_A04_23_Glob_NACK()
{
  byte src;
  byte dst;
  struct gPGAttrs pgis[long];
  
  src = gTOOL_Addr;
  dst = gDUT_Addr;

  // give title and description for this testcase.
  CT_BEGIN(0x0417, "No Response for Globally Addressed Request for a PGN not supported by DUT");
  CT_DESC("Verify DUT does not send any Acknowledgement message (PGN 59392). Monitor for DUT messages for at least 1.25 s (T3) to verify the DUT does not send an Acknowledgement for the requested PGN ");
  
  // describe the preconditions of the test.
  CT_PRECOND(1, "There are PGNs for non requestable non cyclic messages configured.");
  
  // describe the strategy...
  CT_STRAT(1, "Request non requestable non cyclic PGN and watch for NACK timeout within 1250ms.");

  // note the reference to documents / specifications
  CT_DOC_21(1, "5.4.2 - Table 5");
  CT_DOC_21("5.4.4");
  CT_DOC_21("5.12.3");
  
  // describe the teststeps
  CT_GetNonReqPGIs(pgis, gNonCyclic);
  CTF_A04_23_Glob_NACK(src, pgis);
  
  // end the testcase.
  CT_END();
}

// ==============================================================================================================
export testcase CTC_A04_24_Applicaple_ACK_Response()
{
  byte src;
  byte dst;
  
  src = gTOOL_Addr;
  dst = gDUT_Addr;

  // give title and description for this testcase.
  CT_BEGIN(0x0418, "Proper use of ACK Response when Applicable.");
  CT_DESC("Verify DUT sends an Acknowledgement (PGN 59392) containing the Requested PGN and indicates a Positive Acknowledgment (control byte=0; ACK) only if the DUT was the destination of the triggering message. Verify DUT uses the Global Address for the Acknowledgement message. Verify the Requested PGN that was sent by DUT in Data field has the correct content (byte order and position). Verify the 'Address Acknowledged' parameter contains a valid or appropriate address value. Verify DUT sends ACK within 200 ms (Tr) ");
  
  // describe the preconditions of the test.
  CT_PRECOND(1, "DUT answers with ACK to DM3 and DM11.");
  
  // describe the strategy...
  CT_STRAT(1, "Request DM3 and DM11. Check the Answers of these clear requests for addressing, timing and content.");

  // note the reference to documents / specifications
  CT_DOC_21(1, "5.4.2 - Table 5");
  CT_DOC_21("5.4.4");
  
  // describe the teststeps
  CTF_A04_24_Applicaple_ACK_Response(src, dst);
  
  // end the testcase.
  CT_END();
}

// ==============================================================================================================
export testcase CTC_A04_25_ACK_DENY()
{
  byte src;
  byte dst;
  struct gPGAttrs pgis[long];
  
  src = gTOOL_Addr;
  dst = gDUT_Addr;

  // give title and description for this testcase.
  CT_BEGIN(0x0419, "Proper use of Access Denied Response for Destination Specific Request sent to DUT Address.");
  CT_DESC("Verify DUT sends an Acknowledgement (PGN 59392) containing the Requested PGN and and indicates Access Denied (control byte =2; PGN supported but security denied access) only if the DUT was the destination of the triggering message. Verify DUT uses the Global Address for the Acknowledgement message. Verify the Requested PGN that was sent by DUT in Data field has the correct content (byte order and position). Verify the 'Address Access Denied' parameter contains a valid or appropriate address value. Verify DUT sends ACK within 200 ms (Tr) ");
  
  // describe the preconditions of the test.
  CT_PRECOND(1, "DUT answers with Access Denied for the configured DENY PGNs (PDU Type 1).");
  
  // describe the strategy...
  CT_STRAT(1, "Request the configured Access Denied PGNs and check for valid answer.");

  // note the reference to documents / specifications
  CT_DOC_21(1, "5.4.2 - Table 5");
  CT_DOC_21("5.4.4");
  
  // describe the teststeps
  CT_GetReqPGIs(pgis, gExpResp_DENY, gPDU1);
  CTF_A04_25_ACK_DENY(src, dst, pgis);
  
  // end the testcase.
  CT_END();
}

// ==============================================================================================================
export testcase CTC_A04_26_ACK_BUSY()
{
  byte src;
  byte dst;
  struct gPGAttrs pgis[long];
  
  src = gTOOL_Addr;
  dst = gDUT_Addr;

  // give title and description for this testcase.
  CT_BEGIN(0x041a, "Proper use of Cannot Respond Response for Destination Specific Request sent to DUT Address.");
  CT_DESC("Verify DUT sends an Acknowledgement (PGN 59392) containing the Requested PGN and indicates Cannot Respond (control byte =3; PGN supported but ECU is busy and cannot respond now. Re-request the data at a later time ) only if the DUT was the destination of the request. Verify DUT uses the Global Address for the Acknowledgement message. Verify the Requested PGN that was sent by DUT in Data field has the correct content (byte order and position). Verify the 'Address Access Denied' parameter contains a valid or appropriate address value. Verify DUT sends ACK within 200 ms (Tr)");
  
  // describe the preconditions of the test.
  CT_PRECOND(1, "DUT answers Cannot Respond (BUSY) for the configured BUSY PGNs. (PDU Type 1)");
  
  // describe the strategy...
  CT_STRAT(1, "Request the configured busy pgns and check for valid answer.");

  // note the reference to documents / specifications
  CT_DOC_21(1, "5.4.2 - Table 5");
  CT_DOC_21("5.4.4");
  
  // describe the teststeps
  CT_GetReqPGIs(pgis, gExpResp_BUSY, gPDU1);
  CTF_A04_26_ACK_BUSY(src, dst, pgis);
  
  // end the testcase.
  CT_END();
}

// ==============================================================================================================
export testcase CTC_A04_27_ACK_Address()
{
  byte src;
  byte dst;
  struct gPGAttrs pgis[long];
  
  src = gTOOL_Addr;
  dst = gDUT_Addr;

  // give title and description for this testcase.
  CT_BEGIN(0x041b, "Support of the Address Acknowledge data byte for each Acknowledge message type");
  CT_DESC("Verify the Address Acknowledge' parameter (ACK), Address Negative Acknowledge parameter (NACK), Address Access Denied (Access Denied) parameter and Address Busy parameter (Cannot Respond) contains a valid or appropriate address value ");
  
  // describe the preconditions of the test.
  CT_PRECOND(1, "DUT has misc PGNs that can be answered with ACK or NACK.");
  
  // describe the strategy...
  CT_STRAT(1, "Request all configured ACK producing PGNs and all non requestable PGNs and check for the address value in payload (byte5).");

  // note the reference to documents / specifications
  CT_DOC_21(1, "5.4.4");
  
  // describe the teststeps
  CT_GetPGIs( pgis, gReqDontCare, gRTSDontCare, gCyclicDontCare, gDlcDontCare, gExpResp_ACK_NACK);
  
  CTF_A04_27_ACK_Address(gTOOL_Addr, gDUT_Addr, pgis);
  
  // end the testcase.
  CT_END();
}

// ==============================================================================================================
export testcase CTC_A04_28_Request2_Xfer_PGN_Yes()
{
  byte src;
  byte dst;
  struct gPGAttrs pgis[long];
  
  src = gTOOL_Addr;
  dst = gDUT_Addr;

  // give title and description for this testcase.
  CT_BEGIN(0x041c, "Correct Response to Request2 with 'yes' for the \"Use Transfer PGN\" Option ");
  CT_DESC("Verify the response data field byte contains a valid or appropriate address value. Verify  the  device  responding  to  the request  shall  report  the  same information  it  would  with  PGN  59904 as  the  first  data  set  in  this  response.  If a device only has one data set, then it shall respond with the one data set utilizing the Transfer PG. ");
  
  // describe the preconditions of the test.
  CT_PRECOND(1, "DUT supports Request2, Transfer PGN 51712 (0xCA00) and PGNs that can be requested using Request2.");
  
  // describe the strategy...
  CT_STRAT(1, "Request all configured Request2 PGNs using transfer mode, and check the Transfer PG response.");

  // note the reference to documents / specifications
  CT_DOC_21(1, "5.4.6");
  CT_DOC_21("5.4.7");
  
  // describe the teststeps
  CT_GetReqPGIs( pgis );
  CTF_A04_28_Request2_Xfer_PGN_Yes(gTOOL_Addr, gDUT_Addr, pgis);
  
  // end the testcase.
  CT_END();
}

// ==============================================================================================================
export testcase CTC_A04_29_Request2_Xfer_PGN_No()
{
  byte src;
  byte dst;
  struct gPGAttrs pgis[long];
  
  src = gTOOL_Addr;
  dst = gDUT_Addr;

  // give title and description for this testcase.
  CT_BEGIN(0x041d, "Correct Response to Request2 with 'no' for the \"Use Transfer PGN\" Option");
  CT_DESC("Verify the response data field byte contains a valid or appropriate address value ");
  
  // describe the preconditions of the test.
  CT_PRECOND(1, "DUT supports Request2 and PGNs that can be requested using Request2.");
  
  // describe the strategy...
  CT_STRAT(1, "Request all configured Request2 PGNs using no transfer mode, and check the response to be no Transfer PG.");

  // note the reference to documents / specifications
  CT_DOC_21(1, "5.4.6");
  
  // describe the teststeps
  CT_GetReqPGIs( pgis );
  CTF_A04_29_Request2_Xfer_PGN_No(gTOOL_Addr, gDUT_Addr, pgis);

  // end the testcase.
  CT_END();
}

// ==============================================================================================================
export testcase CTC_A04_30_Response2_NACK()
{
  byte src;
  byte dst;
  struct gPGAttrs pgis[long];
  
  src = gTOOL_Addr;
  dst = gDUT_Addr;

  // give title and description for this testcase.
  CT_BEGIN(0x041e, " Proper NACK Response for Request2 for Unsupported PGN ");
  CT_DESC("Verify the response data field byte contains a valid or appropriate address value ");
  
  // describe the preconditions of the test.
  CT_PRECOND(1, "DUT supports Request2.");
  
  // describe the strategy...
  CT_STRAT(1, "Use request2 for all configured non cyclic non requestable messages and await NACK");

  // note the reference to documents / specifications
  CT_DOC_21(1, "5.4.6");
  
  // describe the teststeps
  CT_GetNonReqPGIs( pgis );
  if (@CT::DEBUG::CONFIG)
  {
    CT_PrintPgnInfoList(pgis);
  }
  CTF_A04_30_Response2_NACK(gTOOL_Addr, gDUT_Addr, pgis);

  // end the testcase.
  CT_END();
}

// ==============================================================================================================
export testcase CTC_A04_31_ThirdParty_Requests()
{
  byte src;
  byte dst;
  src = gTOOL_Addr;
  dst = gDUT_Addr;

  // give title and description for this testcase.
  CT_BEGIN(0x041f, " Proper Acknowledgement Behavior for Destination Specific Request (PGN 59904) sent to a different Address ");
  CT_DESC("Verify DUT does not respond to the Request message since the Request message was not addressed to the DUT");
  
  // describe the preconditions of the test.
  CT_PRECOND(1, "-");
  
  // describe the strategy...
  CT_STRAT(1, "All 239 possible type 1 PGNs are requested to 239 different foreign nodes.");
  CT_STRAT("Additionally 10 type2 PGNs are also requested to nodes 240 to 250.");
  CT_STRAT("After the requests await T3 and check the DUT had shown NO reaction during this communication.");

  // note the reference to documents / specifications
  CT_DOC_21(1, "5.4.2 - Table 5");
  CT_DOC_21("5.4.4");
  
  // describe the teststeps
  CTF_A04_31_ThirdParty_Requests(gTOOL_Addr, gDUT_Addr);
  
  // end the testcase.
  CT_END();
}
