/*@!Encoding:1252*/
includes
{
  #include "CTF_A03.cin"
}

// ==============================================================================================================
export testcase CTC_A03_01_PGN()
{
  char reportText[1024];
  long n;
  dword pgn;
  byte src;
  byte dst;
  struct gPGAttrs pgis[long];
  
  src = gTOOL_Addr;
  dst = gDUT_Addr;

  // give title and description for this testcase.
  CT_BEGIN(0x0301, "Check position and order of PGN in the 29-bit Frame Header");
  CT_DESC("Verify proper placement of PGN within 29-bit header of all CAN Data Frames");

  // describe the preconditions of the test.
  CT_PRECOND(1, "DUT has to respond to configured requestable messages.");
  
  // describe the strategy...
  CT_STRAT(1, "Request configured requestable messages from DUT by Tool");
  
  // note the reference to documents / specifications
  CT_DOC_21(1, "5.1.1");
  CT_DOC_21("5.1.2 - Table 1");
  
  // describe the teststeps
  
  CT_GetReqPGIs(pgis, gExpResp_PG);
  CTF_A03_01_PGN(src, dst, pgis);
  
  // end the testcase.
  CT_END();
}

// ==============================================================================================================
// precond: dut responds with the configured respondable pg
export testcase CTC_A03_02_EDP()
{
  char reportText[1024];
  dword pgn;
  byte src;
  byte dst;
  byte c;
  struct gPGAttrs pgis[long];
  
  // use these values out of the onfiguration...
  src = gTOOL_Addr;
  dst = gDUT_Addr;
  
  // give title and description for this testcase
  CT_BEGIN(0x0302, "Use of EDP Bit to identify PGN");
  CT_DESC("Verify DUT properly sets the EDP Bit for all 29-bit CAN Data Frames");
  
  // describe the preconditions of the test.
  CT_PRECOND(1, "DUT has to respond to configured requestable message.");

  // describe the strategy...
  
  CT_STRAT(1, "Request configured requestable messages from DUT by Tool");
  CT_STRAT("Await answer and check the EDP within the answer.");

  // note the reference to documents / specifications
  CT_DOC_21(1, "5.2.2");
  
  // describe the teststeps
  CT_GetReqPGIs(pgis, gExpResp_PG);
  CTF_A03_02_EDP(src, dst, pgis);
  
  // end the testcase.
  CT_END();
}

// ==============================================================================================================
// precond: dut responds with the configured respondable pg
export testcase CTC_A03_03_DP()
{
  char reportText[1024];
  dword pgn;
  byte src;
  byte dst;
  struct gPGAttrs pgis[long];
  
  // use these values out of the onfiguration...
  src = gTOOL_Addr;
  dst = gDUT_Addr;
  
  // give title and description for this testcase
  CT_BEGIN(0x0303, "Use of DP Bit to identify PGN");
  CT_DESC("Verify DUT properly sets the DP Bit for all 29-bit CAN Data Frames");
  
  // describe the preconditions of the test.
  CT_PRECOND(1, "DUT has to respond to configured requestable message.");

  // describe the strategy...
  CT_STRAT(1, "Request configured requestable message from DUT by Tool");
  CT_STRAT("Await answer and check the DP within the answer.");

  // note the reference to documents / specifications
  CT_DOC_21(1, "5.2.3");
  
  // describe the teststeps
  CT_GetReqPGIs(pgis, gExpResp_PG);
  CTF_A03_03_DP(src, dst, pgis);
  
  // end the testcase.
  CT_END();
}

// ==============================================================================================================
// precond: dut responds with the configured respondable pg
export testcase CTC_A03_04_DLC()
{
  char reportText[1024];
  dword pgn;
  byte src;
  byte dst;
  struct gPGAttrs pgis[long];

  // use these values out of the onfiguration...
  src = gTOOL_Addr;
  dst = gDUT_Addr;
  
  // give title and description for this testcase
  CT_BEGIN(0x0304, "Data Field Byte Length");
  CT_DESC("Verify the length of the CAN Data field for all 29-bit CAN Data Frames (Page 1&2) is 8 bytes, except for PGN 59904 frames.");
    
  // describe the preconditions of the test.
  CT_PRECOND(1, "DUT has to respond to configured requestable message.");

  // describe the strategy...
  CT_STRAT(1, "Request configured requestable message from DUT by Tool");
  CT_STRAT("Await answer and check the DLC within the answer.");

  // note the reference to documents / specifications
  CT_DOC_21(1, "5.2.7.1");
  CT_DOC_21("5.2.7.2");
  
  // describe the teststeps
  CT_GetReqPGIs(pgis, gExpResp_PG);
  CTF_A03_04_DLC(src, dst, pgis);
  
  // end the testcase.
  CT_END();
}

// ==============================================================================================================
// precond: dut answers to address claim request.
export testcase CTC_A03_05_DataByteOrder()
{
  byte srcReq, srcResp;
  byte dstReq, dstResp;
  
  // use these values out of the onfiguration...
  srcReq = gTOOL_Addr;
  dstReq = gDUT_Addr;
  srcResp = gDUT_Addr;
  dstResp = gc_BC_ADDR;
  
  // give title and description for this testcase
  CT_BEGIN(0x0305, "Byte Ordering within Data Field");
  CT_DESC("Verify proper byte ordering of the parameter data for multiple byte parameters.  (e.g., Verify Address Claim data, PGN 60928).  This verification also applies to -7X.");
    
  // describe the preconditions of the test.
  CT_PRECOND(1, "DUT has to support Address Claiming.");

  // describe the strategy...
  CT_STRAT(1, "Request Address Claim PGN from DUT by Tool");
  CT_STRAT("Await answer and check the device name within the answer.");

  // note the reference to documents / specifications
  CT_DOC_21(1, "5.4");
  
  // describe the teststeps
  CTF_A03_05_DataByteOrder(srcReq, dstReq, srcResp, dstResp);
  
  CT_WAIT(350); // wait 350 ms after doing request to not send requests too quick...
  
  // end the testcase.
  CT_END();
}

// ==============================================================================================================
// precond: dut contains respondable DM01 with DLC=8
// precond: dut contains respondable DM03 and clears the error buffers, so that DM1 is minimal (for pad byte testing)
export testcase CTC_A03_06_DataPadding()
{
  byte srcReq, srcResp;
  byte dstReq, dstResp;
  
  // use these values out of the onfiguration...
  srcReq = gTOOL_Addr;
  dstReq = gDUT_Addr;
  srcResp = gDUT_Addr;
  dstResp = gTOOL_Addr;
  
  // give title and description for this testcase
  CT_BEGIN(0x0306, "Multipacket capable PGN with less than 9 bytes of data sent as single CAN Data Frame with 8 byte data field.");
  CT_DESC("Verify DUT indeed uses single CAN Frame to send PGN under this situation. Verify any unused bytes are filled with $FF.");

  // describe the preconditions of the test.
  CT_PRECOND(1, "DUT has to support clearing the memory by requesting DM11 and has to ACK this request.");
  CT_PRECOND("DUT may keep free from any errors after clearing over DM11. (e.g. cyclic current errors...)");
  CT_PRECOND("DUT has to respond to DM01 request with DLC=8 and NOT using transport protocol.");

  // describe the strategy...
  CT_STRAT(1, "Clear the error memory within DUT by requesting DM11. Response does not matter.");
  CT_STRAT("Request DM01 from DUT by Tool");
  CT_STRAT("Await DM01 answer. For a clear error memory in DUT, the DM01 contains 2 padding bytes at the end. Check these.");

  // note the reference to documents / specifications
  CT_DOC_21(1, "5.2.7.1");
  CT_DOC_21("5.2.7.2");
  CT_DOC_21("5.10.5.2");
  
  // describe the teststeps
  CTF_A03_06_DataPadding(srcReq, dstReq, srcResp, dstResp);
  
  CT_WAIT(350); // wait 350 ms after doing request to not send requests too quick...
  
  // end the testcase.
  CT_END();
}

// ==============================================================================================================
// This test can not be done actively.
export testcase CTC_A03_07_ReqSched()
{
  // give title and description for this testcase
  CT_BEGIN(0x0307, "Request Scheduling");
  CT_DESC("Verify the DUT does not send a Request message for a PGN if that PGN was received with the last 50 ms");

  // note the reference to documents / specifications
  CT_DOC_21(1, "5.12.2");
  
  CTF_A03_07_ReqSched(1);
  
  CT_END();
}

// ==============================================================================================================
// This test can not be done actively.
export testcase CTC_A03_08_ReqRetr()
{
  // give title and description for this testcase
  CT_BEGIN(0x0308, "Request Retries");
  CT_DESC("Verify the DUT stops sending the same Request message after the third attempt (i.e., second retry). A Request retry is issued after failure to receive a response within 1.25 s (T3) after sending the Request.");

  // note the reference to documents / specifications
  CT_DOC_21(1, "5.4.2");
  CT_DOC_21("5.12.3");

  CTF_A03_08_ReqRetr(1);
  
  CT_END();
}

// ==============================================================================================================
export testcase CTC_A03_09_ReqInterpret()
{
  // give title and description for this testcase
  CT_BEGIN(0x0309, "Correct Interpretation of 'Requested PGN' in Request (PGN 59904)");
  CT_DESC("Verify correct Request message’s structure. Verify the 'Requested PGN' contained in the Request message that is sent by the DUT has correct Data field content (byte order and position)");

  // note the reference to documents / specifications
  CT_DOC_21(1, "5.1.2");
  CT_DOC_21("5.4.2 - Figure 8");
  
  CTF_A03_09_ReqInterpret(1);
  
  // end the testcase.
  CT_END();
}

// ==============================================================================================================
export testcase CTC_A03_10_RespTime()
{
  // give title and description for this testcase
  CT_BEGIN(0x030a, "Response Timing");
  CT_DESC("Verify DUT waits 1.25 s (T3) for a required response before retrying or quitting");

  // note the reference to documents / specifications
  CT_DOC_21(1, "5.12.3");

  CTF_A03_10_RespTime(1);
  
  CT_END();
}

// ==============================================================================================================
export testcase CTC_A03_11_RespOwnGlobReq()
{
  // give title and description for this testcase
  CT_BEGIN(0x030b, "Devices Responds to its own Global Requests");
  CT_DESC("Verify DUT sends a response to its own global request within the 200 ms (Tr) Verify the DUT uses the appropriate type of response (global or no response)");

  // note the reference to documents / specifications
  CT_DOC_21(1, "5.10.2.4");
  CT_DOC_21("5.12.4");

  CTF_A03_11_RespOwnGlobReq(1);
  
  CT_END();
}

// ==============================================================================================================
export testcase CTC_A03_12_SupportAckAdrData()
{
  // give title and description for this testcase
  CT_BEGIN(0x030c, "Support of the Acknowledgement Address data byte for each ACK and NACK");
  CT_DESC("Verify DUT evaluates the 'Acknowledgement Address' data field byte to determine the context of the Acknowledgement (ACK and NACK of same PGN with different 'Acknowledgement Address' data values) ");

  // note the reference to documents / specifications
  CT_DOC_21(1, "5.4.4");

  CTF_A03_12_SupportAckAdrData(1);
  
  CT_END();
}

