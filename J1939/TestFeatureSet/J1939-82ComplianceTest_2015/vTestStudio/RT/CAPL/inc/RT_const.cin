/*@!Encoding:1252*/
includes
{
}

variables
{

  // GLOBAL CONSTANTS.
  char        gc_CT_CAPTION[255]             = "J1939-82 Compliance Test 2015";
  const dword gc_DLG_WAITING_TIME_MS         = 60*1000*5;     // 5 minute dialog waiting time.
  const dword gc_LISTEN_ONLY_CHECK_TIME_MS   = 30*1000;       // 30 seconds timeout for check DUT to be in listen only.
  const word  gc_J1939_PG_DLC_MAX            = 1785;          // MAX dlc for a PDU.
  const dword gc_TP_MAX_DURATION             = 55000;
  const dword gc_PGN_MAX_VALID               = 0x3FFFF;
  const dword gc_PGN_NM                      = 0x9300;
  const dword gc_PGN_AC                      = 0xEE00;
  const dword gc_PGN_AC_COMMANDED            = 0xFED8;
  const dword gc_PGN_SOFT                    = 0xFEDA;
  const dword gc_PGN_DM01                    = 0xFECA;
  const dword gc_PGN_DM03                    = 0xFECC;
  const dword gc_PGN_DM11                    = 0xFED3;
  const dword gc_PGN_ACK                     = 0xE800;
  const dword gc_PGN_NACK                    = 0xE800;
  const dword gc_PGN_TPCM                    = 0xEC00;
  const dword gc_PGN_TPDT                    = 0xEB00;
  const dword gc_PGN_RQST                    = 0xEA00;
  const dword gc_PGN_RQST2                   = 0xC900;
  const dword gc_PGN_XFER                    = 0xCA00;
  const dword gc_PGN_INVALID                 = 0xFFFFFFFF;
  const dword gc_PGN_ANY                     = 0xFFFFFFFF;    // == gc_PGN_INVALID;
  const dword gc_PGN_COMPONENT_ID            = 0xFEEB;
  const word  gc_RESP_TIMEOUT                = 200;
  const word  gc_TIMEOUT_AC                  = 250;
  const word  gc_TIMEOUT_TR                  = 200;
  const word  gc_TIMEOUT_TH                  = 500;
  const word  gc_TIMEOUT_T1                  = 750;
  const word  gc_TIMEOUT_T2                  = 1250;
  const word  gc_TIMEOUT_T3                  = 1250;
  const word  gc_TIMEOUT_T4                  = 1050;
  const byte  gc_BC_ADDR                     = 0xFF;
  const byte  gc_ANY_ADDR                    = 0xFF;
  const byte  gc_NULL_ADDR                   = 0xFE;
  const dword gc_INVALID_OR_IGNORE_ADDR      = 0xFFFFFFFF;
  const byte  gc_PRIO_DEFAULT                = 3;
  const byte  gc_PRIO_LOW                    = 7;
  const byte  gc_PRIO_HIGH                   = 0;
  const byte  gc_PRIO_TP_DATA                = 7;
  const dword gc_CANID_BITMASK_PGN           = 0x00FF0000;
  const dword gc_CANID_BITMASK_PGN_SRC       = 0x00FF00FF;
  const dword gc_CANID_BITMASK_PGN_DST       = 0x00FFFF00;
  const dword gc_CANID_BITMASK_PGN_SRC_DST   = 0x00FFFFFF;
  const dword gc_CANID_BITMASK_EPGN          = 0x03FF0000;
  const dword gc_CANID_BITMASK_EPGN_SRC      = 0x03FF00FF;
  const dword gc_CANID_BITMASK_EPGN_DST      = 0x03FFFF00;
  const dword gc_CANID_BITMASK_EPGN_SRC_DST  = 0x03FFFFFF;
  const dword gc_CANID_BITMASK_PRIO          = 0x1C000000;
  const dword gc_CANID_BITMASK_EDP           = 0x02000000;
  const dword gc_CANID_BITMASK_DP            = 0x01000000;
  const dword gc_CANID_BITMASK_SRC           = 0x000000FF;
  const dword gc_CANID_BITMASK_DST           = 0x0000FF00;
  const dword gc_CANID_BITMASK_SRC_DST       = 0x0000FFFF;
  const word  gc_TP_BAM_MIN_DT               = 50;
  const word  gc_TP_BAM_MAX_DT               = 200;           // == gc_TIMEOUT_TR;
  const word  gc_TP_BAM_MAX_RECEIVE_DT       = 750;           // == gc_TIMEOUT_T1;
  const word  gc_TP_MAX_RECEIVE_DT           = 1050;          // == gc_TIMEOUT_T4;
  const byte  gc_TPCM_CTRL_WORD_RTS          = 0x10;
  const byte  gc_TPCM_CTRL_WORD_CTS          = 0x11;
  const byte  gc_TPCM_CTRL_WORD_EOM          = 0x13;
  const byte  gc_TPCM_CTRL_WORD_ABORT        = 0xFF;
  const byte  gc_TPCM_CTRL_WORD_BAM          = 0x20;
  const byte  gc_TPCM_CTRL_WORD_ANY          = 0;
  const byte  gc_ACK_CTRL_WORD_ACK           = 0x00;
  const byte  gc_ACK_CTRL_WORD_NACK          = 0x01;
  const byte  gc_ACK_CTRL_WORD_DENY          = 0x02;
  const byte  gc_ACK_CTRL_WORD_BUSY          = 0x03;
  const word  gc_MAX_CTS_HOLD                = 1045;          // == gc_TIMEOUT_T4-5;
  const qword gc_NM_RESERVED_BITMASK         = 0x0001000000100000LL;
  const qword gc_AC_RESERVED_BITMASK         = 0x0001000000000000LL;
}