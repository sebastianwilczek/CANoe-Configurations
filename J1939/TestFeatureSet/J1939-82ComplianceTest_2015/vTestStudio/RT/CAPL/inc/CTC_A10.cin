/*@!Encoding:1252*/
includes
{
  #include "CTF_A10.cin"
}

// ==============================================================================================================
export testcase CTC_A10_01_CA_NAME()
{
  // give title and description for this testcase
  CT_BEGIN(0x0a01, "CA NAME");
  CT_DESC("Verify the NAME contents for the CA (DUT) align with -81");

  // describe the preconditions of the test.
  CT_PRECOND(1, "J1939-81");
  
  // describe the strategy...
  CT_STRAT(1, "Request AC from DUT and check NAME alignment DUT's response within Tr (200ms)");

  // note the reference to documents / specifications
  CT_DOC_81(1, "4.2");
  CT_DOC_81("4.5.8");

  CTF_A10_01_CA_NAME(gTOOL_Addr, gDUT_Addr, gDUT_DevName);
  
  // end the testcase.
  CT_END();
}

// ==============================================================================================================
export testcase CTC_A10_02_System_Initialization()
{
  // give title and description for this testcase
  CT_BEGIN(0x0a02, "System Initialization");
  CT_DESC("Verify each CA transmits an address claim at power-up system initialization.");

  // describe the preconditions of the test.
  CT_PRECOND(1, "J1939-81");
  
  // describe the strategy...
  CT_STRAT(1, "Tell the user to reset / boot up the DUT within a given time and check for an AC from DUT.");

  // note the reference to documents / specifications
  CT_DOC_81(1, "4.5");

  CTF_A10_02_System_Initialization(gDUT_Addr, gDUT_DevName);
  
  // end the testcase.
  CT_END();
}

// ==============================================================================================================
export testcase CTC_A10_03_Non_AAC_Device_Fails()
{
  // give title and description for this testcase
  CT_BEGIN(0x0a03, "Non-Configurable Address CA");
  CT_DESC("Verify that a non-configurable address CA or service configurable address CA stops transmitting and sends a Cannot Claim Address message if it fails to claim a valid address.");

  // describe the preconditions of the test.
  CT_PRECOND(1, "J1939-81");
  CT_PRECOND("DUT has to be a non-configurable address device");
  
  // describe the strategy...
  CT_STRAT(1, "If device has AAC bit set in it's device name, the test is not suitable and will be marked as inconclusive.");
  CT_STRAT("Tool tries to use DUT's address with an AC under NAME of higher prio...");
  CT_STRAT("Check that DUT sends Cannot Claim Address message within 250ms.");
  CT_STRAT("Check the Cannot Claim message's content.");
  CT_STRAT("Check DUT keeps in listen only mode for at least 30 seconds");
  CT_STRAT("Check DUT reacts on an request in listen only mode.");
  CT_STRAT("Tell user to reset the DUT");

  // note the reference to documents / specifications
  CT_DOC_81(1, "4.7.1");

  CTF_A10_03_Non_AAC_Device_Fails(gTOOL_Addr, gDUT_Addr, gDUT_DevName);
  
  // end the testcase.
  CT_END();
}

// ==============================================================================================================
export testcase CTC_A10_04_CommandedAddresses_On_CC_Device()
{
  // give title and description for this testcase
  CT_BEGIN(0x0a04, "Commanded Addresses");
  CT_DESC("Verify that a command configurable address CA can receive a Commanded Address message and either initiate an address claim procedure with the new address or, if it cannot claim the new address, issue an address claim for its current address.");

  // describe the preconditions of the test.
  CT_PRECOND(1, "J1939-81");
  CT_PRECOND("DUT has to be a command configurable address device");
  
  // describe the strategy...
  CT_STRAT(1, "If device is configured not to support Commanded Address, the test is not suitable and will be marked as inconclusive.");
  CT_STRAT("Send Commanded Address to the DUT and await AC from DUT within Tr (200ms)");
  CT_STRAT("Check payload from DUT's ACL to be the configured NAME");
  CT_STRAT("Check DUT uses the new address or it's current address in it's ACL.");
  CT_STRAT("Tell user to reset the DUT");

  // note the reference to documents / specifications
  CT_DOC_81(1, "4.6.1");

  CTF_A10_04_CommandedAddresses_On_CC_Device(gTOOL_Addr, gDUT_Addr, gDUT_DevName);
  
  // end the testcase.
  CT_END();
}

// ==============================================================================================================
export testcase CTC_A10_05_Address_Recalculation_On_AAC_Device()
{
  // give title and description for this testcase
  CT_BEGIN(0x0a05, "Self-Configurable Address CA");
  CT_DESC("Verify that a self-configurable address CA can re-calculate and claim another address if it is not successful in claiming the calculated address. ");

  // describe the preconditions of the test.
  CT_PRECOND(1, "J1939-81");
  
  // describe the strategy...
  CT_STRAT(1, "If device has no AAC bit set in it's device name, the test is not suitable and will be marked as inconclusive.");
  CT_STRAT("Tool tries to use DUT's address with an AC under NAME of higher prio...");
  CT_STRAT("Check for DUT's response for a recalculated address within 250ms");
  CT_STRAT("Tool tries to use current DUT's address again");
  CT_STRAT("Check for DUT's response for a recalculated address within 250ms");
  CT_STRAT("Tell user to reset the DUT");

  // note the reference to documents / specifications
  CT_DOC_81(1, "4.3.1");
  CT_DOC_81("4.5.4.3");

  CTF_A10_05_Address_Recalculation_On_AAC_Device(gTOOL_Addr, gDUT_Addr, gDUT_DevName);
  
  // end the testcase.
  CT_END();
}

// ==============================================================================================================
export testcase CTC_A10_06_Send_AC_Request()
{
  // give title and description for this testcase
  CT_BEGIN(0x0a06, "Request for Address Claimed ");
  CT_DESC("Verify a CA can send a request for address claimed and process responses.");

  // describe the preconditions of the test.
  CT_PRECOND(1, "J1939-81");
  // describe the strategy...
  CT_STRAT(1, "Currently not testable, due action can not be triggered from DUT.");
  
  
  // note the reference to documents / specifications
  CT_DOC_81(1, "4.5.7");

  CTF_A10_06_Send_AC_Request(gTOOL_Addr, gDUT_Addr);
  
  // end the testcase.
  CT_END();
}

// ==============================================================================================================
export testcase CTC_A10_07_Receive_AC_Request_Glob()
{
  // give title and description for this testcase
  CT_BEGIN(0x0a07, "Request for Address Claimed");
  CT_DESC("Verify a CA responds to a request for address claimed sent to the global address with an Address Claimed/Cannot Claim message (or nothing if that CA has not yet attempted to claim an address). ");
  
  // describe the preconditions of the test.
  CT_PRECOND(1, "J1939-81");
  CT_PRECOND("DUT has to be online.");
  
  // describe the strategy...
  CT_STRAT(1, "Request AC globally and check DUT responds with AC or Cannot Claim message within Tr (200ms).");
  CT_STRAT("If DUT responds with an Cannot Claim, then tell user to reset the DUT.");

  // note the reference to documents / specifications
  CT_DOC_81(1, "4.5.3.1");

  CTF_A10_07_Receive_AC_Request_Glob(gTOOL_Addr, gDUT_Addr, gDUT_DevName);
  
  // end the testcase.
  CT_END();
}

// ==============================================================================================================
export testcase CTC_A10_08_Receive_AC_Request_P2P()
{
  // give title and description for this testcase
  CT_BEGIN(0x0a08, "Request for Address Claimed ");
  CT_DESC("Verify a CA responds to a request for address claimed sent to the DUT address with an Address Claimed/Cannot Claim message (or nothing if that CA has not yet attempted to claim an address). ");

  // describe the preconditions of the test.
  CT_PRECOND(1, "J1939-81");
  CT_PRECOND("DUT has to be online.");
  
  // describe the strategy...
  CT_STRAT(1, "Request AC directly from DUT and check DUT responds with AC or Cannot Claim Address message within Tr (200ms).");
  CT_STRAT("If DUT responds with an Cannot Claim, then tell user to reset the DUT.");

  // note the reference to documents / specifications
  CT_DOC_81(1, "4.5.3.2");

  CTF_A10_08_Receive_AC_Request_P2P(gTOOL_Addr, gDUT_Addr, gDUT_DevName);
  
  // end the testcase.
  CT_END();
}

// ==============================================================================================================
export testcase CTC_A10_09_Behaviour_After_AC_Bootup()
{
  // give title and description for this testcase
  CT_BEGIN(0x0a09, "Address Claimed Cannot Claim");
  CT_DESC("Verify a CA sends an Address Claimed message upon initialization and waits for the defined period before resuming normal network traffic.  Single Address CAs with addresses in the 0-127 and 248-253 ranges may begin regular network communications immediately after sending the address claim message. Other CAs shall not begin or resume origination of normal network traffic until 250 ms after claiming an address (See J1939-81 Figure A1 of Appendix A) to allow contending claims to be made before the address is used. ");

  // describe the preconditions of the test.
  CT_PRECOND(1, "J1939-81");
  
  // describe the strategy...
  CT_STRAT("Check for predefined address range.");
  CT_STRAT("Tell the user to reset the DUT.");
  CT_STRAT("Check for non AC messages from DUT within 250ms after AC");
  
  // note the reference to documents / specifications
  CT_DOC_81(1, "4.5");

  CTF_A10_09_Behaviour_After_AC_Bootup(gTOOL_Addr, gDUT_Addr, gDUT_DevName);
  
  // end the testcase.
  CT_END();
}

// ==============================================================================================================
export testcase CTC_A10_10_Receive_AC_Low_Prio_Conflict()
{
  // give title and description for this testcase
  CT_BEGIN(0x0a0a, "Address Claimed Cannot Claim");
  CT_DESC("Claimed message with a lower priority claiming its own source address responds with an Address Claimed Message. ");

  // describe the preconditions of the test.
  CT_PRECOND(1, "J1939-81");
  
  // describe the strategy...
  CT_STRAT(-1, "Tool tries to use DUT's address with an AC under NAME of lower prio...");
  CT_STRAT("Check that DUT sends AC message with the same address within 250ms.");

  // note the reference to documents / specifications
  CT_DOC_81(1, "4.5.3.3");

  CTF_A10_10_Receive_AC_Low_Prio_Conflict(gTOOL_Addr, gDUT_Addr, gDUT_DevName);
  
  // end the testcase.
  CT_END();
}

// ==============================================================================================================
export testcase CTC_A10_11_Receive_AC_High_Prio_Conflict()
{
  // give title and description for this testcase
  CT_BEGIN(0x0a0b, "Address Claimed Cannot Claim ");
  CT_DESC("Verify a CA receiving an Address Claimed message with a higher priority claiming its own source address either attempts to claim a new address or responds with a Cannot Claim message after a time delay. ");

  // describe the preconditions of the test.
  CT_PRECOND(1, "J1939-81");
  
  // describe the strategy...
  CT_STRAT(-1, "Tool tries to use DUT's address with an AC under NAME of higher prio...");
  CT_STRAT("Check that DUT sends AC or Cannot Claim Address message within 250ms.");
  CT_STRAT("If DUT answered with Cannot Claim address message, tell the user to reset the DUT.");

  // note the reference to documents / specifications
  CT_DOC_81(1, "4.5.3.3");

  CTF_A10_11_Receive_AC_High_Prio_Conflict(gTOOL_Addr, gDUT_Addr, gDUT_DevName);
  
  // end the testcase.
  CT_END();
}

// ==============================================================================================================
export testcase CTC_A10_12_Receive_AC_Request_If_Not_Claimed()
{
  // give title and description for this testcase
  CT_BEGIN(0x0a0c, "Address Not Claimed");
  CT_DESC("Verify a CA that cannot claim an address sends the Cannot Claim message in response to the Request for Address Claimed.  No other messages shall be sent. ");

  // describe the preconditions of the test.
  CT_PRECOND(1, "J1939-81");
  
  // describe the strategy...
  CT_STRAT(1, "A) If device has no AAC bit set in it's device name:");
  CT_STRAT("A1. Tool tries to use DUT's address with an AC under NAME of higher prio...");
  CT_STRAT("A2. Check that DUT sends Cannot Claim Address message within 250ms.");
  CT_STRAT("A3. Request AC and check DUT responds with Cannot Claim within Tr (200ms).");
  CT_STRAT("A4. Check no other messages than cannot claim were sent in listen only mode.");
  CT_STRAT("A5. Tell the user to reset the DUT.");

  CT_STRAT(1, "B) If device has AAC bit set in it's device name, test passes.");

  // note the reference to documents / specifications
  CT_DOC_81(1, "4.5.7");

  CTF_A10_12_Receive_AC_Request_If_Not_Claimed(gTOOL_Addr, gDUT_Addr, gDUT_DevName);
  
  // end the testcase.
  CT_END();
}

// ==============================================================================================================
export testcase CTC_A10_13_Power_Interruption_Short()
{
  // give title and description for this testcase
  CT_BEGIN(0x0a0d01, "Power Interruption");
  CT_DESC("Verify a CA does not perform network initialization with a power loss < 2ms.");

  // describe the preconditions of the test.
  CT_PRECOND(1, "J1939-81");
  
  // describe the strategy...
  CT_STRAT(1, "Show a Yes/No dialog to check if the user is able to simulate a power loss < 2ms.");
  CT_STRAT("In the case the user is NOT able, he shall answer with 'NO'. This testcase then is inconclusive.");
  CT_STRAT("In the case the user is able, the dialog also advices him to execute it and answer the dialog with 'Yes'");
  CT_STRAT("After the user clicked 'YES' the buffer is checked that the DUT did not send an initial bootup AC during the this power loss.");

  // note the reference to documents / specifications
  CT_DOC_81(1, "4.8.1");

  CTF_A10_13_Power_Interruption(gTOOL_Addr, gDUT_Addr, gDUT_DevName, 1);
  
  // end the testcase.
  CT_END();
}
// ==============================================================================================================
export testcase CTC_A10_13_Power_Interruption_Long()
{
  // give title and description for this testcase
  CT_BEGIN(0x0a0d02, "Power Interruption");
  CT_DESC("Verify a CA does perform network initialization with a power loss > 1 second. ");

  // describe the preconditions of the test.
  CT_PRECOND(1, "J1939-81");
  
  // describe the strategy...
  CT_STRAT(1, "Tell the user to simulate a power loss >1 second within a given time and check for an AC from DUT.");

  // note the reference to documents / specifications
  CT_DOC_81(1, "4.8.1");

  CTF_A10_13_Power_Interruption(gTOOL_Addr, gDUT_Addr, gDUT_DevName, 0);
  
  // end the testcase.
  CT_END();
}

// ==============================================================================================================
export testcase CTC_A10_14_Network_Disruption()
{
  // give title and description for this testcase
  CT_BEGIN(0x0a0e, "Network Disruption");
  CT_DESC("Verify that a CA can be connected, disconnected, and powered up without disrupting network communications. ");

  // describe the preconditions of the test.
  CT_PRECOND(1, "J1939-81");
  
  // describe the strategy...
  CT_STRAT(1, "Ask user if DUT is connected and working. Await user's answer.");
  CT_STRAT("Ask the user if he diconnected and reconnected the DUT some times. Await user's answer.");
  CT_STRAT("Ask the user if he powered the DUT on/off some times. Await user's answer.");
  CT_STRAT("Check that there are no error frames on the bus.");
  CT_STRAT("On any dialog timeout the test will be inconclusive.");
  CT_STRAT("If user clicks No to any of the dialogs, the test just fails.");
  CT_STRAT("At the end the user tell the user to reset the DUT and await its AC");

  // note the reference to documents / specifications
  CT_DOC_81(1, "4.8.2.4");

  CTF_A10_14_Network_Disruption(gTOOL_Addr, gDUT_Addr, gDUT_DevName);
  
  // end the testcase.
  CT_END();
}

// ==============================================================================================================
export testcase CTC_A10_15_Address_Continuity()
{
  // give title and description for this testcase
  CT_BEGIN(0x0a0f, "Address Continuity");
  CT_DESC("Verify that a CA attempts (if applicable) to use the same address and addresses for CAs that are communicated with across power-down and power-up cycles.");

  // describe the preconditions of the test.
  CT_PRECOND(1, "J1939-81");
  
  // describe the strategy...
  CT_STRAT(1, "Test opens a dialog and instructs user to reset the DUT within 5 minutes 3 times.");
  CT_STRAT("Check that DUT answer with AC within waiting time.");
  CT_STRAT("If DUT supports Commanded Address, then DUT's address is reconfigured.");
  CT_STRAT("If DUT has AAC bit set, then Tool claims DUT's current address and checks answer.");
  CT_STRAT("Test opens a dialog and instructs user to reboot the DUT within 5 minutes.");
  CT_STRAT("Check DUT answers with expected AC under the last address it claimed.");

  // note the reference to documents / specifications
  CT_DOC_81(1, "4.8.2.5");

  CTF_A10_15_Address_Continuity(gTOOL_Addr, gDUT_Addr, gDUT_DevName);
  
  // end the testcase.
  CT_END();
}

// ==============================================================================================================
export testcase CTC_A10_16_Address_Violation_Response()
{
  // give title and description for this testcase
  CT_BEGIN(0x0a10, "Address Violation response");
  CT_DESC("Verify that a CA that receives a message, other than the address claimed message, which uses the CA’s own SA, sends the address claim message to the global address but no more often than every 5 seconds. ");

  // describe the preconditions of the test.
  CT_PRECOND(1, "J1939-81");

  // describe the strategy...
  CT_STRAT("1. Test opens a dialog and instructs user to reset the DUT within 5 minutes.");
  CT_STRAT("2. Wait 2s.");
  CT_STRAT("3. Tester sends messages from the DUT's SA every 500ms.");
  CT_STRAT("4. Wait for first ACL (reclaim) from DUT within 10s");
  CT_STRAT("5. Wait for second ACL (reclaim) from DUT within 10s");
  CT_STRAT("6. Check ACL's time distance >=5s.");  
  
  // note the reference to documents / specifications
  CT_DOC_81(1, "4.7.2.1");

  CTF_A10_16_Address_Violation_Response(gTOOL_Addr, gDUT_Addr);
  
  // end the testcase.
  CT_END();
}

// ==============================================================================================================
export testcase CTC_A10_17_System_Notification_Of_Continued_Address_Violation()
{
  // give title and description for this testcase
  CT_BEGIN(0x0a11, "System Notification of continued address violation ");
  CT_DESC("Verify that a CA that detects an address violation (as above) and is unable to resolve it, sends a DTC with SPN=2000+SA and FMI=31");
  
  // describe the preconditions of the test.
  CT_PRECOND(1, "J1939-81");
  
  // describe the strategy...
  CT_STRAT("1. Test opens a dialog and instructs user to reset the DUT within 5 minutes.");
  CT_STRAT("2. Wait 2s.");
  CT_STRAT("3. Tester sends messages from the DUT's SA every 500ms");
  CT_STRAT("4. Wait for DM01 from DUT within 30s, check if there is a DTC (SPN 2000+SA, FMI 31)");

  // note the reference to documents / specifications
  CT_DOC_81(1, "4.7.2.2");

  CTF_A10_17_System_Notification_Of_Continued_Address_Violation(gTOOL_Addr, gDUT_Addr);
  
  // end the testcase.
  CT_END();
}

// ==============================================================================================================
export testcase CTC_A10_18_NAME_Management()
{
  // give title and description for this testcase
  CT_BEGIN(0x0a12, "NAME Management");
  CT_DESC("Verify that a CA that supports NAME. Management can have parts of its NAME changed through the NM message PGN 37632");

  // describe the preconditions of the test.
  CT_PRECOND(1, "J1939-81");
  
  // describe the strategy...
  CT_STRAT(-1, "1. Test opens a dialog and instructs user to reset the DUT within 5 minutes.");
  CT_STRAT(" ");
  CT_STRAT("For each of the n-th quantifier flags:");
  CT_STRAT("2. Check pending:");
  CT_STRAT("- Send NM Set Pending for change using the 'n-th' quantifier flag.");
  CT_STRAT("- Await NM message from DUT within Tr (200ms)");
  CT_STRAT("- If DUT answered with NM NACK, step is passed and next field is checked.");
  CT_STRAT(" ");
  CT_STRAT("3. Check adoption:");
  CT_STRAT("- If DUT answers with NM ACK, validate the pending NAME and SA to be correct.");
  CT_STRAT("- Send NM Adopt for the pending NAME and await AC within 250ms.");
  CT_STRAT("- Validate the NAME and SA in AC Response to be correct.");
  CT_STRAT("- Wait 200ms and continue with the next quantifier flag. (restart with step 2)");
  CT_STRAT(" ");
  CT_STRAT("4. Soft reset the DUT's original NAME: (set ALL fields)");
  CT_STRAT("- Send NM Set Pending for change using the all quantifier flag.");
  CT_STRAT("- Await NM message from DUT within Tr (200ms)");
  CT_STRAT("- If DUT answered with NM NACK, step is passed.");
  CT_STRAT(" ");
  CT_STRAT("5. Final step after all fields are set:");
  CT_STRAT("- Reset the DUT's original NAME over NM command. If this works, test is done.");
  CT_STRAT("- Test opens a dialog and instructs user to reset the DUT within 5 minutes, if the NM soft reset didn't work.");
    
  // note the reference to documents / specifications
  CT_DOC_81(1, "4.6.2.2");
  CT_DOC_81("4.6.2.3.5");

  CTF_A10_18_NAME_Management(gTOOL_Addr, gDUT_Addr, gDUT_DevName);
  
  // end the testcase.
  CT_END();
}

