/*@!Encoding:1252*/
// ==============================================================================================================
// split values in a csv string into a list of dwords.
void CSV_SplitHexValues(dword result[long], char in[])
{
  dword p,c,r;
  char elem[255], num[255];
  
  result.clear();
  if (strlen(in)==0) return;
  
  r=0;
  for (p=elcount(elem)-1; p>0; p--) elem[p] = 0;
  
  for (c=0; c<=strlen(in); c++)
  {
    switch(in[c])
    {
      case '\r':
      case '\n':
      case ' ':
      case '\t': break;

      case 'x':
      case 'X': for (p=elcount(elem)-1; p>0; p--) elem[p] = 0; break;
        
      case '\0':
      case ',':
      case ';': 
      {
        if (strlen(elem)>0)
        {
          snprintf(num, elcount(num), "0x%s", elem);
          result[r++] = (dword)atol(num);
          for (p=elcount(elem)-1; p>0; p--) elem[p] = 0;
        }
        break;
      }
      default: 
      {
        elem[p++] = in[c]; 
        break;
      }
    }
  }
}

// ==============================================================================================================
// get byte n out of qword.
byte GetQWB(qword w, byte n)
{
  qword m;
  m = 0xFF00000000000000LL >> ((7-n)*8);
  return (byte) ( (w & m) >> (n*8) );
}

// ==============================================================================================================
// get byte n out of dword.
byte GetDWB(dword w, byte n)
{
  qword m;
  m = 0xFF000000 >> ((3-n)*8);
  return (byte) ( (w & m) >> (n*8) );
}

// ==============================================================================================================
// build CSV from dword values...
void CSV_HexFromDWords(char result[], dword values[long])
{
  byte first;
  char hexStr[5];
  first = 1;
  snprintf(result, elcount(result), "");
  for (long k: values)
  {
    snprintf(hexStr, elcount(hexStr), "%.04x", values[k]);
    if (!first)
    {
      strncat(result, ",", elcount(result));
    }
    strncat(result, hexStr, elcount(result));
    first=0;
  }
}

// ==============================================================================================================
// convert qword in a CSV of bytes...
void CSV_HexFromQWord(char result[], qword w)
{
      snprintf(result, elcount(result), "%.02x, %.02x, %.02x, %.02x, %.02x, %.02x, %.02x, %.02x"
      , GetQWB(w, 7)
      , GetQWB(w, 6)
      , GetQWB(w, 5)
      , GetQWB(w, 4)
      , GetQWB(w, 3)
      , GetQWB(w, 2)
      , GetQWB(w, 1)
      , GetQWB(w, 0)
      );
}

// ==============================================================================================================
// convert dword in a CSV of bytes...
void CSV_HexFromDWord(char result[], dword w)
{
      snprintf(result, elcount(result), "%.02x, %.02x, %.02x, %.02x"
      , GetDWB(w, 3)
      , GetDWB(w, 2)
      , GetDWB(w, 1)
      , GetDWB(w, 0)
      );
}

