/*@!Encoding:1252*/
// ==============================================================================================================
// debug output helper. Writes message with "DEBUG prefix" to write and into trace.
void CT_DEBUG(byte active, char info[]) { CT_Info(active, "DEBUG", info); }
void CT_DEBUG(char info[]){ CT_DEBUG(1, info); }

void CT_DEBUG32(byte active, char info[], dword v) { snprintf(info, elcount(info), info, v); CT_DEBUG(active, info); }
void CT_DEBUG32(byte active, char info[], dword v1, dword v2) { snprintf(info, elcount(info), info, v1, v2); CT_DEBUG(active, info); }
void CT_DEBUG32(byte active, char info[], dword v1, dword v2, dword v3) { snprintf(info, elcount(info), info, v1, v2, v3); CT_DEBUG(active, info); }
void CT_DEBUG32(byte active, char info[], dword v1, dword v2, dword v3, dword v4) { snprintf(info, elcount(info), info, v1, v2, v3, v4); CT_DEBUG(active, info); }
void CT_DEBUG32(byte active, char info[], dword v1, dword v2, dword v3, dword v4, dword v5) { snprintf(info, elcount(info), info, v1, v2, v3, v4, v5); CT_DEBUG(active, info); }
void CT_DEBUG32(byte active, char info[], dword v1, dword v2, dword v3, dword v4, dword v5, dword v6) { snprintf(info, elcount(info), info, v1, v2, v3, v4, v5, v6); CT_DEBUG(active, info); }
void CT_DEBUG32(byte active, char info[], dword v1, dword v2, dword v3, dword v4, dword v5, dword v6, dword v7) { snprintf(info, elcount(info), info, v1, v2, v3, v4, v5, v6, v7); CT_DEBUG(active, info); }
void CT_DEBUG32(byte active, char info[], dword v1, dword v2, dword v3, dword v4, dword v5, dword v6, dword v7, dword v8) { snprintf(info, elcount(info), info, v1, v2, v3, v4, v5, v6, v7, v8); CT_DEBUG(active, info); }
void CT_DEBUG32(byte active, char info[], dword v1, dword v2, dword v3, dword v4, dword v5, dword v6, dword v7, dword v8, dword v9) { snprintf(info, elcount(info), info, v1, v2, v3, v4, v5, v6, v7, v8, v9); CT_DEBUG(active, info); }

void CT_DEBUG32(char info[], dword v) { CT_DEBUG32(1, info, v); }
void CT_DEBUG32(char info[], dword v1, dword v2) { CT_DEBUG32(1, info, v1, v2); }
void CT_DEBUG32(char info[], dword v1, dword v2, dword v3){ CT_DEBUG32(1, info, v1, v2, v3); }
void CT_DEBUG32(char info[], dword v1, dword v2, dword v3, dword v4){ CT_DEBUG32(1, info, v1, v2, v3, v4); }
void CT_DEBUG32(char info[], dword v1, dword v2, dword v3, dword v4, dword v5){ CT_DEBUG32(1, info, v1, v2, v3, v4, v5); }
void CT_DEBUG32(char info[], dword v1, dword v2, dword v3, dword v4, dword v5, dword v6){ CT_DEBUG32(1, info, v1, v2, v3, v4, v5, v6); }
void CT_DEBUG32(char info[], dword v1, dword v2, dword v3, dword v4, dword v5, dword v6, dword v7){ CT_DEBUG32(1, info, v1, v2, v3, v4, v5, v6, v7); }
void CT_DEBUG32(char info[], dword v1, dword v2, dword v3, dword v4, dword v5, dword v6, dword v7, dword v8){ CT_DEBUG32(1, info, v1, v2, v3, v4, v5, v6, v7, v8); }
void CT_DEBUG32(char info[], dword v1, dword v2, dword v3, dword v4, dword v5, dword v6, dword v7, dword v8, dword v9){ CT_DEBUG32(1, info, v1, v2, v3, v4, v5, v6, v7, v8, v9); }

void CT_DEBUG64(byte active, char info[], qword v) { snprintf(info, elcount(info), info, v); CT_DEBUG(active, info); }
void CT_DEBUG64(byte active, char info[], qword v1, qword v2) { snprintf(info, elcount(info), info, v1, v2); CT_DEBUG(active, info); }
void CT_DEBUG64(byte active, char info[], qword v1, qword v2, qword v3) { snprintf(info, elcount(info), info, v1, v2, v3); CT_DEBUG(active, info); }
void CT_DEBUG64(byte active, char info[], qword v1, qword v2, qword v3, qword v4) { snprintf(info, elcount(info), info, v1, v2, v3, v4); CT_DEBUG(active, info); }
void CT_DEBUG64(byte active, char info[], qword v1, qword v2, qword v3, qword v4, qword v5) { snprintf(info, elcount(info), info, v1, v2, v3, v4, v5); CT_DEBUG(active, info); }
void CT_DEBUG64(byte active, char info[], qword v1, qword v2, qword v3, qword v4, qword v5, qword v6) { snprintf(info, elcount(info), info, v1, v2, v3, v4, v5, v6); CT_DEBUG(active, info); }
void CT_DEBUG64(byte active, char info[], qword v1, qword v2, qword v3, qword v4, qword v5, qword v6, qword v7) { snprintf(info, elcount(info), info, v1, v2, v3, v4, v5, v6, v7); CT_DEBUG(active, info); }
void CT_DEBUG64(byte active, char info[], qword v1, qword v2, qword v3, qword v4, qword v5, qword v6, qword v7, qword v8) { snprintf(info, elcount(info), info, v1, v2, v3, v4, v5, v6, v7, v8); CT_DEBUG(active, info); }
void CT_DEBUG64(byte active, char info[], qword v1, qword v2, qword v3, qword v4, qword v5, qword v6, qword v7, qword v8, qword v9) { snprintf(info, elcount(info), info, v1, v2, v3, v4, v5, v6, v7, v8, v9); CT_DEBUG(active, info); }

void CT_DEBUG64(char info[], qword v) { CT_DEBUG64(1, info, v); }
void CT_DEBUG64(char info[], qword v1, qword v2) { CT_DEBUG64(1, info, v1, v2); }
void CT_DEBUG64(char info[], qword v1, qword v2, qword v3){ CT_DEBUG64(1, info, v1, v2, v3); }
void CT_DEBUG64(char info[], qword v1, qword v2, qword v3, qword v4){ CT_DEBUG64(1, info, v1, v2, v3, v4); }
void CT_DEBUG64(char info[], qword v1, qword v2, qword v3, qword v4, qword v5){ CT_DEBUG64(1, info, v1, v2, v3, v4, v5); }
void CT_DEBUG64(char info[], qword v1, qword v2, qword v3, qword v4, qword v5, qword v6){ CT_DEBUG64(1, info, v1, v2, v3, v4, v5, v6); }
void CT_DEBUG64(char info[], qword v1, qword v2, qword v3, qword v4, qword v5, qword v6, qword v7){ CT_DEBUG64(1, info, v1, v2, v3, v4, v5, v6, v7); }
void CT_DEBUG64(char info[], qword v1, qword v2, qword v3, qword v4, qword v5, qword v6, qword v7, qword v8){ CT_DEBUG64(1, info, v1, v2, v3, v4, v5, v6, v7, v8); }
void CT_DEBUG64(char info[], qword v1, qword v2, qword v3, qword v4, qword v5, qword v6, qword v7, qword v8, qword v9){ CT_DEBUG64(1, info, v1, v2, v3, v4, v5, v6, v7, v8, v9); }

