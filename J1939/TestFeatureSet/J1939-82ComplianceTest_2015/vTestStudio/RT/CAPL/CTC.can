/*@!Encoding:1252*/
includes
{
  #include "inc/CTF.cin"
  #include "inc/CTC_A03.cin"
  #include "inc/CTC_A04.cin"
  #include "inc/CTC_A05.cin"
  #include "inc/CTC_A06.cin"
  #include "inc/CTC_A07.cin"
  #include "inc/CTC_A08.cin"
  #include "inc/CTC_A10.cin"
}
