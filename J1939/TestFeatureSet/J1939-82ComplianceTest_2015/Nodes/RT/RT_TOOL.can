/*@!Encoding:1252*/
includes
{
  
}

variables
{
  byte nodeState;
  mstimer timerMeaAutoStop;
}

on preStart
{
  @CT::CFG::TOOL::Channel = %CHANNEL%;
}

on start
{
  J1939ILControlInit();
  nodeState = 0;
}

on sysvar CT::CFG::TOOL::Enabled
{
  EnableNode(@CT::CFG::TOOL::Enabled);
}

on sysvar CT::TEST::CTRL::Running
{
  if (@CT::TEST::CTRL::AutostopMea) 
  {
    if (!@CT::TEST::CTRL::Running)
    {
      //write("Auto stop measurement.");
      setTimer(timerMeaAutoStop, 100);
    }
  }
}

on timer timerMeaAutoStop
{
  if (@CT::TEST::CTRL::AutostopMea) stop();
}

void EnableNode(byte state)
{
  if (state == nodeState) return;
  if (state)
  {
    J1939ILControlStart(@CT::CFG::TOOL::Addr);
  }
  else
  {
    J1939ILControlStop(1);
  }
  if (@CT::DEBUG::HELPER) write("TOOL NODE 0x%X ACTIVE: %d", @CT::CFG::TOOL::Addr, @CT::CFG::TOOL::Enabled);
  nodeState = state;
}