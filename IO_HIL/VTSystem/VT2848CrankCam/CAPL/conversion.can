/*@!Encoding:1252*/
includes
{
}

variables
{
}


on start
{
  double angle_time;
  
  if (@sysvar::CrankCam::EngSpd == 0)
  {
    @sysvar::VTS::VT2848_Ch47_Crank::WFTimeIncrement = 0;
    @sysvar::VTS::VT2848_Ch48_Cam::WFTimeIncrement = 0;
  }
    
  else
  {
    // U/min
    angle_time = @sysvar::CrankCam::EngSpd;
    // U/s
    angle_time = angle_time /60;
    // s/U
    angle_time = 1 / angle_time;
    // s/tooth
    angle_time = angle_time / 360;
  
    // time increment for crank and cam
    @sysvar::VTS::VT2848_Ch47_Crank::WFTimeIncrement = angle_time;
    @sysvar::VTS::VT2848_Ch48_Cam::WFTimeIncrement = angle_time;
  }
}


on sysvar sysvar::CrankCam::EngSpd
{
  double angle_time;

  if (@this == 0)
  {
    @sysvar::VTS::VT2848_Ch47_Crank::WFTimeIncrement = 0;
    @sysvar::VTS::VT2848_Ch48_Cam::WFTimeIncrement = 0;
  }
    
  else
  {
    // U/min
    angle_time = @this;
    // U/s
    angle_time = angle_time /60;
    // s/U
    angle_time = 1 / angle_time;
    // s/tooth
    angle_time = angle_time / 360;
  
    // time increment for crank and cam
    @sysvar::VTS::VT2848_Ch47_Crank::WFTimeIncrement = angle_time;
    @sysvar::VTS::VT2848_Ch48_Cam::WFTimeIncrement = angle_time;
  }
}

