/*@@var:*/
variables
{
}
/*@@end*/

/*@@sysvarChange:VTS_simulated::M2_Ch1::Cur:*/
on sysvar sysvar::VTS_simulated::M2_Ch1::Cur
{
  // Whenever the voltage changes check if LED has to be turned on
  if( @sysvar::VTS_simulated::M2_Ch1::Cur < 3 ) {
    // Turn LED off
    @sysvar::Aux::VT1004::RedLED1On = 0;
  }
  else {
    // Turn LED on
    @sysvar::Aux::VT1004::RedLED1On = 1;
  }//end if
}
/*@@end*/

/*@@sysvarChange:ECU::OutAnalogHeating:*/
on sysvar sysvar::ECU::OutAnalogHeating
{
  // Only react if no short circuit is detected
  if( @sysvar::VTS_simulated::M2_Ch2::RelayShortCircuit == 0 )
  {
    // Read in analog control voltage from the ECU
    @sysvar::VTS_simulated::M2_Ch2::Cur = @sysvar::ECU::OutAnalogHeating;
  }
}
/*@@end*/

/*@@sysvarChange:ECU::OutAnalogCooling:*/
on sysvar ECU::OutAnalogCooling
{
  // Read in analog control voltage from the ECU
  @sysvar::VTS_simulated::M2_Ch1::Cur = @sysvar::ECU::OutAnalogCooling;
}
/*@@end*/

/*@@sysvarChange:VTS_simulated::M2_Ch2::Cur:*/
on sysvar sysvar::VTS_simulated::M2_Ch2::Cur
{
  // Whenever the voltage changes check if LED has to be turned on
  if( @sysvar::VTS_simulated::M2_Ch2::Cur < 3 ) {
    // Turn LED off
    @sysvar::Aux::VT1004::RedLED2On = 0;
  }
  else {
    // Turn LED on
    @sysvar::Aux::VT1004::RedLED2On = 1;
  }//end if
}
/*@@end*/

/*@@sysvarChange:VTS_simulated::M2_Ch2::RelayShortCircuit:*/
on sysvar sysvar::VTS_simulated::M2_Ch2::RelayShortCircuit
{
  if( @sysvar::VTS_simulated::M2_Ch2::RelayShortCircuit == 1 )
  {
    // Short circuit
    @sysvar::VTS_simulated::M2_Ch2::Cur = 0;
  }
  else
  {
    // Normal operation
    @sysvar::VTS_simulated::M2_Ch2::Cur = @sysvar::ECU::OutAnalogHeating;
  }//end if 
}
/*@@end*/

/*@@sysvarChange:VTS_simulated::M2_Ch1::IntLoadResistor:*/
on sysvar sysvar::VTS_simulated::M2_Ch1::IntLoadResistor
{
  // Check if value has deviated too much from default
  if( @sysvar::VTS_simulated::M2_Ch1::IntLoadResistor > 600 || @sysvar::VTS_simulated::M2_Ch1::IntLoadResistor < 400 )
  {

  }//end if
}
/*@@end*/

/*@@sysvarChange:VTS_simulated::M3_SupInt::RefVoltage:*/
on sysvar sysvar::VTS_simulated::M3_SupInt::RefVoltage
{
  // User has changed the voltage value so adjust the current
  @sysvar::VTS_simulated::M3_Out1::AvgCurrent = @sysvar::VTS_simulated::M3_SupInt::RefVoltage*25.0;

  // Power LED on the VT7001: if voltage > 0 LED is on, otherwise LED is off
  if( @sysvar::VTS_simulated::M3_SupInt::RefVoltage >= 3 ) {
    @sysvar::Aux::VT7001::LEDOn = 1;
  }
  else {
    @sysvar::Aux::VT7001::LEDOn = 0;
  }//end if
}
/*@@end*/

/*@@sysvarChange:ECU::OutDigital:*/
on sysvar sysvar::ECU::OutDigital
{
  // Translate the digital signal into a voltage to display
  @sysvar::VTS_simulated::M4_Ch1::Cur = @sysvar::ECU::OutDigital*5;
}
/*@@end*/

