/*@@var:*/
variables
{
}
/*@@end*/

/*@@mainTest:MainTest():*/
void MainTest()
{
   if(@sysvar::VT2816::ButtonStartWF_Out1 == 0) return;

   // Choose voltage stimulation and waveform curve type
   sysvar::VTS::GPAnalog_Ch13.SetStimulationMode(1);
   sysvar::VTS::GPAnalog_Ch13.SetCurveType(2);

   // Load waveforms
   if(@sysvar::VT2816::Waveform_Out1 == 0)
      sysvar::VTS::GPAnalog_Ch13.LoadWFVoltage("Waveforms\\WFSquare.txt");
   else if(@sysvar::VT2816::Waveform_Out1 == 1)
      sysvar::VTS::GPAnalog_Ch13.LoadWFVoltage("Waveforms\\WFSawtooth.txt");
   else if(@sysvar::VT2816::Waveform_Out1 == 2)
      sysvar::VTS::GPAnalog_Ch13.LoadWFVoltage("Waveforms\\WFSine.txt");

   // Configure waveform. Parameters:
   // TimeIncrement (time to hold each sample)       = 5ms
   // Pause (pause between two waveform repetitions) = 0s
   // NumberOfRepeats (number of repetitions)        = 0 (unlimited)
   sysvar::VTS::GPAnalog_Ch13.SetWFParams(0.005, 0.0, 0);

   // Output the configured waveform
   sysvar::VTS::GPAnalog_Ch13.StartStimulation();
   
   // Set the LED
   @sysvar::VT2816::LEDOut1_Plus = 1;
}
/*@@end*/

