variables
{
}

void MainTest()
{
  /* Test description:
  // These test cases uses two VT modules. It is assumed that the first channels
  // of both modules are interconnected.
  // Testgroup 1 tests the voltage transfer between the two modules
  // Testgroup 2 tests the PWM transfer between the two modules
  */


  // Helper variables
  int i=0;


  TestGroupBegin("Voltage Tests", "Performs several voltage transfer tests");

  // Run the test
  for( i=1; i<=8; i++ )
    VoltageGenerationAndMeasurementTest(i);

  TestGroupEnd();



  TestGroupBegin("Frequency Tests", "Performs several frequency transfer tests");

  // Run the test
  for( i=1; i<=6; i++ )
    PWMGenerationAndMeasurementTest(i*250);

  TestGroupEnd();
}

testcase VoltageGenerationAndMeasurementTest ( double voltage )
{
  // Add test case information to the test report
  char buf[64];
  snprintf( buf, 64, "Voltage transfer test at %dV", (int)voltage );
  TestCaseTitle ("Test", buf);
  TestCaseDescription("This test case uses two VT modules. It is assumed that the first channels of both modules are interconnected. While the VT2004 is configured to generate a constant voltage of 7V on channel 1 the VT1004 is configured for voltage measurement (also on channel 1). The test case then checks if the voltage generated by the VT2004 module can bemeasured at the VT1004's input");



  // Step 1: Activate voltage generation on the VT2004 module (channel 1)

  // Set simulation mode to voltage generation
  sysvar::VTS::Stimulus_Ch1.SetStimulationMode(1);

  // Set the output curve type to be a constant
  sysvar::VTS::Stimulus_Ch1.SetCurveType(0);

  // Choose an output voltage (use @ to access the variable)
  @sysvar::VTS::Stimulus_Ch1::Voltage = voltage;

  // Start generating the signal
  sysvar::VTS::Stimulus_Ch1.StartStimulation();



  // Step 2: Activate voltage measurement on the VT1004 module (channel 1)

  // Set measurement mode to constant voltage measurement
  sysvar::VTS::Load_Ch1.SetMeasurementMode(0);



  // Step 3: perform the actual test

  // Wait 100 ms to make sure the above settings take effect
  TestWaitForTimeout(100);

  // Check if a voltage of +- 1V around given parameter can be measured
  if( abs(voltage-@sysvar::VTS::Load_Ch1::Cur) > 1.0 ) {
    // Test failed. No voltage or a wrong voltage was measured
    TestStepFail("No voltage or a wrong voltage was measured");
    return;
  }//end if

  // Testcase was successfull
}

testcase PWMGenerationAndMeasurementTest ( double f )
{
  // Add test case information to the test report
  char buf[64];
  snprintf( buf, 64, "PWM transfer test at %d Hz", (int)f );
  TestCaseTitle ("Test", buf);
  TestCaseDescription("This test case uses two VT modules. It is assumed that the first channels of both modules are interconnected. While the VT2004 is configured to generate a constant PWM signal on channel 1 the VT1004 is configured for PWM measurement (also on channel 1). The test case then checks if the frequency generated by the VT2004 module can bemeasured at the VT1004's input");


  // Step 1: Activate PWM generation on the VT2004 module (channel 1)

  // Set simulation mode to voltage generation
  sysvar::VTS::Stimulus_Ch1.SetStimulationMode(1);

  // Set the output curve type to be a PWM signal
  sysvar::VTS::Stimulus_Ch1.SetCurveType(1);

  // Specify the PWM signal (frequency, low and high voltage, duty cycle)
  @sysvar::VTS::Stimulus_Ch1::PWMFreq = f;
  sysvar::VTS::Stimulus_Ch1.SetPWMVoltageLow(0.0);
  sysvar::VTS::Stimulus_Ch1.SetPWMVoltageLow(5.0);
  @sysvar::VTS::Stimulus_Ch1::PWMDC = 40;

  // Start generating the signal
  sysvar::VTS::Stimulus_Ch1.StartStimulation();



  // Step 2: Activate PWM measurement on the VT1004 module (channel 1)

  // Set measurement mode to constant voltage measurement
  sysvar::VTS::Load_Ch1.SetMeasurementMode(0);

  // Set the threshold voltage to 3V
  sysvar::VTS::Load_Ch1.SetPWMThreshold(3);

  // Set the duration of each measurement
  sysvar::VTS::Load_Ch1.SetPWMMeasurementDuration(0.05);



  // Step 3: perform the actual test

  // Wait 100 ms to make sure the above settings take effect
  TestWaitForTimeout(500);

  // Check if a frequency of 7V (+- 1V) can be measured
  if( abs(f-@sysvar::VTS::Load_Ch1::PWMFreq) > 200.0 ) {
    // Test failed. No frequency or a wrong frequency was measured
    TestStepFail("No frequency or a wrong frequency was measured");
    return;
  }//end if

  // Testcase was successfull
}


