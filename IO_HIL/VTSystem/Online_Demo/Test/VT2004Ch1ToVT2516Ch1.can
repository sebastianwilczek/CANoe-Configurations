/*@@var:*/
variables
{
}
/*@@end*/

/*@@mainTest:MainTest():*/
void MainTest()
{
  /* Test description:
  // These test cases uses two VT modules. It is assumed that the first channels
  // of both modules are interconnected. While the VT2004 is configured to generate
  // a a PWM signal of 500 Hz on channel 1 the VT2516 is configured for PWM
  // measurement (also on channel 1). The test cases then check if the PWM frequency
  // generated by the VT2004 module can bemeasured at the VT2516's input.
  */


  // Helper variables
  int i=0;
  
  // Run the test
  for( i=1; i<=15; i++ )
    PWMGenerationAndMeasurementTest( i*100 );
}
/*@@end*/

/*@@testcase:PWMGenerationAndMeasurementTest(float):*/
testcase PWMGenerationAndMeasurementTest ( double f )
{
  // Add test case information to the test report
  char buf[64];
  snprintf( buf, 64, "PWM frequency transfer test at %d Hz", (int)f );
  TestCaseTitle ("Test", buf);
  TestCaseDescription("This test case uses two VT modules. It is assumed that the first channels of both modules are interconnected. While the VT2004 is configured to generate a a PWM signal on channel 1 the VT2516 is configured for PWM measurement (also on channel 1). The test case then checks if the PWM frequency generated by the VT2004 module can bemeasured at the VT2516's input.");


  // Step 1: Activate PWM generation on the VT2004 module (channel 1)

  // Set simulation mode to voltage generation
  sysvar::VTS::Stimulus_Ch1.SetStimulationMode(1);

  // Set curve type to be a PWM signal
  sysvar::VTS::Stimulus_Ch1.SetCurveType(1);

  // Set the PWm frequency to f Hz
  @sysvar::VTS::Stimulus_Ch1::PWMFreq = f;

  // Set the low and high voltages to 0V rep. 5V
  sysvar::VTS::Stimulus_Ch1.SetPWMVoltageLow(0.0);
  sysvar::VTS::Stimulus_Ch1.SetPWMVoltageLow(5.0);

  // Set the PWM duty cycle to 40%
  @sysvar::VTS::Stimulus_Ch1::PWMDC = 40.0;

  // Start the signal generation
  sysvar::VTS::Stimulus_Ch1.StartStimulation();



  // Step 2: Activate PWM frequency measurement on the VT2516 module (channel 1)

  // Measure the PWM signal in blocks of 50ms length
  sysvar::VTS::Digital_Ch1.SetPWMMeasurementDuration(0.05);



  // Step 3: perform the actual test

  // Wait 100 ms to make sure the above settings take effect
  TestWaitForTimeout(100);

  // Check if a PWM frequency of f Hz (+-10 Hz) can be measured
  if( abs(f- @sysvar::VTS::Digital_Ch1::PWMFreq) > 10.0 ) {
    // Test failed. No frequency or a wrong frequency was measured
    TestStepFail("No frequency or a wrong frequency was measured");
    return;
  }//end if

  // Testcase was successfull
}
/*@@end*/

