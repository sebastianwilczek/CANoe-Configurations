/*@@var:*/
variables
{
}
/*@@end*/

/*@@mainTest:MainTest():*/
void MainTest()
{
  // This is no actual test case but rather an
  // initialization script for the VT7001 module.
  // It gets called when the "Start VT7001"-Button
  // on the VT7001 simulation panel is clicked.

  // Start VT7001
  sysvar::VTS::Power.SetInterconnectionMode(3);
  sysvar::VTS::Power_SupInt.SetRefVoltageMode(1);
  @sysvar::VTS::Power_SupInt::RefVoltage = 3.0;
  @sysvar::VTS::Power_Out1::Active = 1;
  @sysvar::VTS::Power_Out2::Active = 1;

  // Set flag
  @sysvar::VT7001::Started = 1;
}
/*@@end*/

