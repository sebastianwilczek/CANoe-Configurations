variables
{
}

void MainTest()
{
  /* Test description:
  // These test cases uses two VT modules. It is assumed that the first channels
  // of both modules are interconnected. While the VT7001 is configured to generate
  // a constant voltage  on channel 1 the VT1004 is configured for voltage
  // measurement (also on channel 1). The test cases then check if the voltage
  // generated by the VT7001 module can bemeasured at the VT1004's input.
  */

  // helper variables
  int i=0;

  // Run the test
  for( i=5; i<=15; i+=5 )
    VoltageGenerationAndMeasurementTest(i);
}

testcase VoltageGenerationAndMeasurementTest ( double v )
{
  // Add test case information to the test report
  char buf[64];
  snprintf( buf, 64, "Voltage transfer test at %dV", (int)v );
  TestCaseTitle ("Test", buf);
  TestCaseDescription("This test case uses two VT modules. It is assumed that the first channels of both modules are interconnected. While the VT7001 is configured to generate a constant voltage on channel 1 the VT1004 is configured for voltage measurement (also on channel 1). The test case then checks if the voltage generated by the VT7001 module can bemeasured at the VT1004's input");


  // Step 1: Activate voltage generation on the VT7001 module (output 1)

  // Activate the internal power supply on output 1 (ext. power supply is used for output 2)
  sysvar::VTS::Power.SetInterconnectionMode(3);

  // Use a constant output voltage
  sysvar::VTS::Power_SupInt.SetRefVoltageMode(1);

  // The the output voltage to v
  @sysvar::VTS::Power_SupInt::RefVoltage = v;

  // Activate output 1
  @sysvar::VTS::Power_Out1::Active = 1;



  // Step 2: Activate voltage measurement on the VT1004 module (channel 1)

  // Set measurement mode to constant voltage measurement
  sysvar::VTS::Load_Ch1.SetMeasurementMode(0);

  // Step 3: perform the actual test

  // Wait 1000 ms to make sure the above settings take effect
  TestWaitForTimeout(1000);

  // Check if a voltage of v (+- 1V) can be measured
  if( abs(v-@sysvar::VTS::Load_Ch1::Cur) > 1.0 ) {
    // Test failed. No voltage or a wrong voltage was measured
    TestStepFail("No voltage or a wrong voltage was measured");
    return;
  }//end if

  // Testcase was successfull
}


