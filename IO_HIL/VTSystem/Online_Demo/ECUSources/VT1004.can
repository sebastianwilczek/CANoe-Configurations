/*@@var:*/
variables
{
  // Defines the modes in which each channel can be
  enum VT1004Modes { None, ShortCircuit, Measurement };

  // Stores the mode in which each channel is
  enum VT1004Modes VT1004Ch1Mode = None;
  enum VT1004Modes VT1004Ch2Mode = None;
  enum VT1004Modes VT1004Ch3Mode = None;
  enum VT1004Modes VT1004Ch4Mode = None;

  // Used to refresh measurement values
  msTimer refreshTimer;
}
/*@@end*/

/*@@sysvarChange:VT1004::Ch1_ShortCircuit:*/
on sysvar sysvar::VT1004::Ch1_ShortCircuit
{
  // Go to short circuit mode on this channel (switchMode function handles the VT configuration change)
  if( VT1004Ch1Mode == ShortCircuit )
    switchModeVT1004( 1, Measurement );
  else
    switchModeVT1004( 1, ShortCircuit );

  // Send setting from the panel to the VT module
  @sysvar::VTS::Load_Ch1::RelayShortCircuit = @sysvar::VT1004::Ch1_ShortCircuit;
}
/*@@end*/

/*@@sysvarChange:VT1004::Ch2_ShortCircuit:*/
on sysvar sysvar::VT1004::Ch2_ShortCircuit
{
  // Go to short circuit mode on this channel (switchMode function handles the VT configuration change)
  switchModeVT1004( 2, ShortCircuit );
  // Send setting from the panel to the VT module
  @sysvar::VTS::Load_Ch2::RelayShortCircuit = @sysvar::VT1004::Ch2_ShortCircuit;
}
/*@@end*/

/*@@sysvarChange:VT1004::Ch3_ShortCircuit:*/
on sysvar sysvar::VT1004::Ch3_ShortCircuit
{
  // Go to short circuit mode on this channel (switchMode function handles the VT configuration change)
  switchModeVT1004( 3, ShortCircuit );
  // Send setting from the panel to the VT module
  @sysvar::VTS::Load_Ch3::RelayShortCircuit = @sysvar::VT1004::Ch3_ShortCircuit;
}
/*@@end*/

/*@@sysvarChange:VT1004::Ch4_ShortCircuit:*/
on sysvar sysvar::VT1004::Ch4_ShortCircuit
{
  // Go to short circuit mode on this channel (switchMode function handles the VT configuration change)
  switchModeVT1004( 4, ShortCircuit );
  // Send setting from the panel to the VT module
  @sysvar::VTS::Load_Ch4::RelayShortCircuit = @sysvar::VT1004::Ch4_ShortCircuit;
}
/*@@end*/

/*@@caplFunc:switchModeVT1004(int,VT1004Modes):*///function
switchModeVT1004 ( int channel, enum VT1004Modes mode )
{
  /* This function checks if the given channel is already in the given mode.
  // If that's the case nothing is done. If not, the channel is switched to
  // that mode. Therefore the neccessary functions are called and variables
  // are set. Please check the CANoe help for details on these VT specific
  // variables and functions.
  */

  if( channel == 1 ) {
    if( VT1004Ch1Mode != mode ) {
      VT1004Ch1Mode = mode;
      if( mode == ShortCircuit ) {
        // Nothing to do here
      }
      else if( mode == Measurement ) {
        // Configure VT module channel for measurement
        // See the CANoe help for details on the functions/variables
        sysvar::VTS::Load_Ch1.SetMeasurementMode(0);
        sysvar::VTS::Load_Ch1.SetPWMThreshold(3);
        sysvar::VTS::Load_Ch1.SetPWMMeasurementDuration(0.05);
      }//end if
    }//end if
  }
  else if( channel == 2 ) {
    if( VT1004Ch2Mode != mode ) {
     VT1004Ch2Mode = mode;
      if( mode == ShortCircuit ) {
        // Nothing to do here
      }
      else if( mode == Measurement ) {
        // Configure VT module channel for measurement
        // See the CANoe help for details on the functions/variables
        sysvar::VTS::Load_Ch2.SetMeasurementMode(0);
        sysvar::VTS::Load_Ch2.SetPWMThreshold(3);
        sysvar::VTS::Load_Ch2.SetPWMMeasurementDuration(0.05);
      }//end if
    }//end if
  }
  else if( channel == 3 ) {
    if( VT1004Ch3Mode != mode ) {
     VT1004Ch3Mode = mode;
      if( mode == ShortCircuit ) {
      }
      else if( mode == Measurement ) {
        // Configure VT module channel for measurement
        // See the CANoe help for details on the functions/variables
        sysvar::VTS::Load_Ch3.SetMeasurementMode(0);
        sysvar::VTS::Load_Ch3.SetPWMThreshold(3);
        sysvar::VTS::Load_Ch3.SetPWMMeasurementDuration(0.05);
      }//end if
    }//end if
  }
  else if( channel == 4 ) {
    if( VT1004Ch4Mode != mode ) {
     VT1004Ch4Mode = mode;
      if( mode == ShortCircuit ) {
      }
     else if( mode == Measurement ) {
        // Configure VT module channel for measurement
        // See the CANoe help for details on the functions/variables
        sysvar::VTS::Load_Ch4.SetMeasurementMode(0);
        sysvar::VTS::Load_Ch4.SetPWMThreshold(3);
        sysvar::VTS::Load_Ch4.SetPWMMeasurementDuration(0.05);
      }//end if
    }//end if
  }
}
/*@@end*/

/*@@timer:refreshTimer:*/
on timer refreshTimer
{
  float voltage = 0.0;
  float freq = 0.0;

  /* Check for every channel if it is in voltage measurement mode.
  // If that's the case read the current voltage value and store it
  // in the corresponding system variable to display it in the panel.
  // Also check if the voltage is >, < or = 0V. The indication LED's
  // color is then set accordingly (red, blue, off).
  */

  if( VT1004Ch1Mode == Measurement ) {
    freq = @sysvar::VTS::Load_Ch1::PWMFreq;
    @sysvar::VT1004::Ch1_Frequency = freq;

    voltage = @sysvar::VTS::Load_Ch1::Cur;
    @sysvar::VT1004::Ch1_Voltage = voltage;
    if( abs(voltage < 3.0) )  @sysvar::VT1004::Ch1_VoltageLED = 0;
    else if( voltage < -3.0 )  @sysvar::VT1004::Ch1_VoltageLED = 2;
    else if( voltage > 3.0 || abs(freq) > 1.0 )  @sysvar::VT1004::Ch1_VoltageLED = 1;
  }//end if

  if( VT1004Ch2Mode == Measurement ) {
    freq = @sysvar::VTS::Load_Ch2::PWMFreq;
    @sysvar::VT1004::Ch2_Frequency = freq;

    voltage = @sysvar::VTS::Load_Ch2::Cur;
    @sysvar::VT1004::Ch2_Voltage = voltage;
    if( abs(voltage < 3.0) )  @sysvar::VT1004::Ch2_VoltageLED = 0;
    else if( voltage < -3.0 )  @sysvar::VT1004::Ch2_VoltageLED = 2;
    else if( voltage > 3.0 || abs(freq) > 1.0 )  @sysvar::VT1004::Ch2_VoltageLED = 1;
  }//end if

  if( VT1004Ch3Mode == Measurement ) {
    freq = @sysvar::VTS::Load_Ch3::PWMFreq;
    @sysvar::VT1004::Ch3_Frequency = freq;

    voltage = @sysvar::VTS::Load_Ch3::Cur;
    @sysvar::VT1004::Ch3_Voltage = voltage;
    if( abs(voltage < 3.0) )  @sysvar::VT1004::Ch3_VoltageLED = 0;
    else if( voltage < -3.0 )  @sysvar::VT1004::Ch3_VoltageLED = 2;
    else if( voltage > 3.0 || abs(freq) > 1.0 )  @sysvar::VT1004::Ch3_VoltageLED = 1;
  }//end if

  if( VT1004Ch4Mode == Measurement ) {
    freq = @sysvar::VTS::Load_Ch4::PWMFreq;
    @sysvar::VT1004::Ch4_Frequency = freq;

    voltage = @sysvar::VTS::Load_Ch4::Cur;
    @sysvar::VT1004::Ch4_Voltage = voltage;
    if( abs(voltage < 3.0) )  @sysvar::VT1004::Ch4_VoltageLED = 0;
    else if( voltage < -3.0 )  @sysvar::VT1004::Ch4_VoltageLED = 2;
    else if( voltage > 3.0 || abs(freq) > 1.0 )  @sysvar::VT1004::Ch4_VoltageLED = 1;
  }//end if
}
/*@@end*/

/*@@startStart:Start:*/
on start
{
  // Restart the timer
  setTimerCyclic(refreshTimer,100);

  // Activate measurement for all 4 channels
  switchModeVT1004( 1, Measurement );
  switchModeVT1004( 2, Measurement );
  switchModeVT1004( 3, Measurement );
  switchModeVT1004( 4, Measurement );
}
/*@@end*/

