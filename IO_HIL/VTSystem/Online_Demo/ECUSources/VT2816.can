/*@@var:*/
variables
{
}
/*@@end*/

/*@@sysvarChange:VT2816::Out1Voltage:*/
on sysvar sysvar::VT2816::Out1Voltage
{
  // Set curve type constant value
  sysvar::VTS::GPAnalog_Ch13.SetCurveType(0);

  // Set voltage
  @sysvar::VTS::GPAnalog_Ch13::Voltage = @this;
  
  // Set the LED
  @sysvar::VT2816::LEDOut1_Plus = (@this > 0);
}
/*@@end*/

/*@@startStart:Start:*/
on start
{
  // Set output range to 0-28V
  sysvar::VTS::GPAnalog_Ch13.SetOutputRange(0);
  sysvar::VTS::GPAnalog_Ch14.SetOutputRange(0);

  // Activate voltage stimulation
  sysvar::VTS::GPAnalog_Ch13.SetStimulationMode(1);
  sysvar::VTS::GPAnalog_Ch14.SetStimulationMode(1);
}
/*@@end*/

/*@@sysvarChange:VT2816::Out2Voltage:*/
on sysvar sysvar::VT2816::Out2Voltage
{
  // Set curve type constant value
  sysvar::VTS::GPAnalog_Ch14.SetCurveType(0);

  // Set voltage
  @sysvar::VTS::GPAnalog_Ch14::Voltage = @this;
  
  // Set the LED
  @sysvar::VT2816::LEDOut2_Plus = (@this > 0);
}
/*@@end*/

/*@@sysvarChange:VT2816::Ch1_MeasMode:*/
on sysvar sysvar::VT2816::Ch1_MeasMode
{
  if(@this == 0) // Voltage measurement
  {
    sysvar::VTS::GPAnalog_Ch1.SetMeasurementMode(1);
    
    @sysvar::VT2816::LED_In1_Cur = 0;
  }
  else // Current measurement
  {
    sysvar::VTS::GPAnalog_Ch1.SetMeasurementMode(4);
    
    @sysvar::VT2816::LED_In1_Minus = 0;
    @sysvar::VT2816::LED_In1_Plus = 0;
    @sysvar::VT2816::LED_In1_Cur = 1;
  }
}
/*@@end*/

/*@@sysvarChange:VT2816::Ch2_MeasMode:*/
on sysvar sysvar::VT2816::Ch2_MeasMode
{
  if(@this == 0) // Voltage measurement
  {
    sysvar::VTS::GPAnalog_Ch2.SetMeasurementMode(1);
    
    @sysvar::VT2816::LED_In2_Cur = 0;
  }
  else // Current measurement
  {
    sysvar::VTS::GPAnalog_Ch2.SetMeasurementMode(4);
    
    @sysvar::VT2816::LED_In2_Minus = 0;
    @sysvar::VT2816::LED_In2_Plus = 0;
    @sysvar::VT2816::LED_In2_Cur = 1;
  }
}
/*@@end*/

/*@@sysvarChange:VTS::GPAnalaog_Ch1::AvgVoltage:*/
on sysvar sysvar::VTS::GPAnalog_Ch1::AvgVoltage
{
  if(@this > 0)
  {
    @sysvar::VT2816::LED_In1_Minus = 0;
    @sysvar::VT2816::LED_In1_Plus = 1;
  }
  else
  {
    @sysvar::VT2816::LED_In1_Minus = 1;
    @sysvar::VT2816::LED_In1_Plus = 0;
  }
}
/*@@end*/

/*@@sysvarChange:VTS::GPAnalaog_Ch2::AvgVoltage:*/
on sysvar sysvar::VTS::GPAnalog_Ch2::AvgVoltage
{
  if(@this > 0)
  {
    @sysvar::VT2816::LED_In2_Minus = 0;
    @sysvar::VT2816::LED_In2_Plus = 1;
  }
  else
  {
    @sysvar::VT2816::LED_In2_Minus = 1;
    @sysvar::VT2816::LED_In2_Plus = 0;
  }
}
/*@@end*/
