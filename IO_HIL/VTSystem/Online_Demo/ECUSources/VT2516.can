/*@@var:*/
variables
{
  // Defines the modes in which each channel can be
  enum VT2516Modes { None, DigitalOut, PWMGenerator };

  // Stores the mode in which each channel is
  enum VT2516Modes VT2516Ch1Mode = None;
  enum VT2516Modes VT2516Ch2Mode = None;
  enum VT2516Modes VT2516Ch3Mode = None;
  enum VT2516Modes VT2516Ch4Mode = None;

  // Used to refresh measurement values
  msTimer refreshTimer;
}
/*@@end*/

/*@@sysvarChange:VT2516::Ch1_Frequency:*/
on sysvar sysvar::VT2516::Ch1_Frequency
{
  // Enable PWM
  @sysvar::VT2516::Ch1_PWMActive = 1;

  // Go to PWM output mode on this channel (switchMode function handles the VT configuration change)
  switchModeVT2516( 1, PWMGenerator );
  // Send setting from the panel to the VT module
  @sysvar::VTS::Digital_Ch1::PWMOutputFreq  = @sysvar::VT2516::Ch1_Frequency;
}
/*@@end*/

/*@@sysvarChange:VT2516::Ch2_Frequency:*/
on sysvar sysvar::VT2516::Ch2_Frequency
{
  // Enable PWM
  @sysvar::VT2516::Ch2_PWMActive = 1;

  // Go to PWM output mode on this channel (switchMode function handles the VT configuration change)
  switchModeVT2516( 2, PWMGenerator );
  // Send setting from the panel to the VT module
  @sysvar::VTS::Digital_Ch2::PWMOutputFreq  = @sysvar::VT2516::Ch2_Frequency;
}
/*@@end*/

/*@@sysvarChange:VT2516::Ch3_Frequency:*/
on sysvar sysvar::VT2516::Ch3_Frequency
{
  // Enable PWM
  @sysvar::VT2516::Ch3_PWMActive = 1;

  // Go to PWM output mode on this channel (switchMode function handles the VT configuration change)
  switchModeVT2516( 3, PWMGenerator );
  // Send setting from the panel to the VT module
  @sysvar::VTS::Digital_Ch3::PWMOutputFreq  = @sysvar::VT2516::Ch3_Frequency;
}
/*@@end*/

/*@@sysvarChange:VT2516::Ch4_Frequency:*/
on sysvar sysvar::VT2516::Ch4_Frequency
{
  // Enable PWM
  @sysvar::VT2516::Ch4_PWMActive = 1;

  // Go to PWM output mode on this channel (switchMode function handles the VT configuration change)
  switchModeVT2516( 4, PWMGenerator );
  // Send setting from the panel to the VT module
  @sysvar::VTS::Digital_Ch4::PWMOutputFreq  = @sysvar::VT2516::Ch4_Frequency;
}
/*@@end*/

/*@@caplFunc:switchModeVT2516(int,VT2516Modes):*///function
switchModeVT2516 ( int channel, enum VT2516Modes mode )
{
  /* This function checks if the given channel is already in the given mode.
  // If that's the case nothing is done. If not, the channel is switched to
  // that mode. Therefore the neccessary functions are called and variables
  // are set. Please check the CANoe help for details on these VT specific
  // variables and functions.
  */

  if( channel == 1 ) {
    if( VT2516Ch1Mode != mode ) {
      VT2516Ch1Mode = mode;
      if( mode == DigitalOut ) {
        // Configure VT module channel as a digital output generator
        // See the CANoe help for details on the functions/variables
        sysvar::VTS::Digital_Ch1.SetPWMVoltageHigh (5.0);
        sysvar::VTS::Digital_Ch1.SetPWMVoltageLow (0.0);
        sysvar::VTS::Digital_Ch1.SetCurveType (0);
        sysvar::VTS::Digital_Ch1.SetStimulationMode (1);
      }
      else if( mode == PWMGenerator ) {
        // Configure VT module channel as a PWM generator
        // See the CANoe help for details on the functions/variables
        sysvar::VTS::Digital_Ch1.StopStimulation();
        sysvar::VTS::Digital_Ch1.SetStimulationMode(1);
        sysvar::VTS::Digital_Ch1.SetCurveType(1);
        sysvar::VTS::Digital_Ch1.SetPWMVoltageLow(0.0);
        sysvar::VTS::Digital_Ch1.SetPWMVoltageHigh(5.0);
        sysvar::VTS::Digital_Ch1.SetPWMRepeats(0);
        sysvar::VTS::Digital_Ch1.StartStimulation();
        @sysvar::VTS::Digital_Ch1::PWMOutputDC = 40;
        @sysvar::VT2516::Ch1_DigitalOut = 0;
      }//end if
    }//end if
  }
  else if( channel == 2 ) {
    if( VT2516Ch2Mode != mode ) {
     VT2516Ch2Mode = mode;
      if( mode == DigitalOut ) {
        // Configure VT module channel as a digital output generator
        // See the CANoe help for details on the functions/variables
        sysvar::VTS::Digital_Ch2.SetPWMVoltageHigh (5.0);
        sysvar::VTS::Digital_Ch2.SetPWMVoltageLow (0.0);
        sysvar::VTS::Digital_Ch2.SetCurveType (0);
        sysvar::VTS::Digital_Ch2.SetStimulationMode (1);
      }
      else if( mode == PWMGenerator ) {
        // Configure VT module channel as a PWM generator
        // See the CANoe help for details on the functions/variables
        sysvar::VTS::Digital_Ch2.StopStimulation();
        sysvar::VTS::Digital_Ch2.SetStimulationMode(1);
        sysvar::VTS::Digital_Ch2.SetCurveType(1);
        sysvar::VTS::Digital_Ch2.SetPWMVoltageLow(0.0);
        sysvar::VTS::Digital_Ch2.SetPWMVoltageHigh(5.0);
        sysvar::VTS::Digital_Ch2.SetPWMRepeats(0);
        sysvar::VTS::Digital_Ch2.StartStimulation();
        @sysvar::VTS::Digital_Ch2::PWMOutputDC = 40;
        @sysvar::VT2516::Ch2_DigitalOut = 0;
      }//end if
    }//end if
  }
  else if( channel == 3 ) {
    if( VT2516Ch3Mode != mode ) {
     VT2516Ch3Mode = mode;
      if( mode == DigitalOut ) {
        // Configure VT module channel as a digital output generator
        // See the CANoe help for details on the functions/variables
        sysvar::VTS::Digital_Ch3.SetPWMVoltageHigh (5.0);
        sysvar::VTS::Digital_Ch3.SetPWMVoltageLow (0.0);
        sysvar::VTS::Digital_Ch3.SetCurveType (0);
        sysvar::VTS::Digital_Ch3.SetStimulationMode (1);
      }
      else if( mode == PWMGenerator ) {
        // Configure VT module channel as a PWM generator
        // See the CANoe help for details on the functions/variables
        sysvar::VTS::Digital_Ch3.StopStimulation();
        sysvar::VTS::Digital_Ch3.SetStimulationMode(1);
        sysvar::VTS::Digital_Ch3.SetCurveType(1);
        sysvar::VTS::Digital_Ch3.SetPWMVoltageLow(0.0);
        sysvar::VTS::Digital_Ch3.SetPWMVoltageHigh(5.0);
        sysvar::VTS::Digital_Ch3.SetPWMRepeats(0);
        sysvar::VTS::Digital_Ch3.StartStimulation();
        @sysvar::VTS::Digital_Ch3::PWMOutputDC = 40;
        @sysvar::VT2516::Ch3_DigitalOut = 0;
      }//end if
    }//end if
  }
  else if( channel == 4 ) {
    if( VT2516Ch4Mode != mode ) {
     VT2516Ch4Mode = mode;
      if( mode == DigitalOut ) {
        // Configure VT module channel as a digital output generator
        // See the CANoe help for details on the functions/variables
        sysvar::VTS::Digital_Ch4.SetPWMVoltageHigh (5.0);
        sysvar::VTS::Digital_Ch4.SetPWMVoltageLow (0.0);
        sysvar::VTS::Digital_Ch4.SetCurveType (0);
        sysvar::VTS::Digital_Ch4.SetStimulationMode (1);
      }
      else if( mode == PWMGenerator ) {
        // Configure VT module channel as a PWM generator
        // See the CANoe help for details on the functions/variables
        sysvar::VTS::Digital_Ch4.StopStimulation();
        sysvar::VTS::Digital_Ch4.SetStimulationMode(1);
        sysvar::VTS::Digital_Ch4.SetCurveType(1);
        sysvar::VTS::Digital_Ch4.SetPWMVoltageLow(0.0);
        sysvar::VTS::Digital_Ch4.SetPWMVoltageHigh(5.0);
        sysvar::VTS::Digital_Ch4.SetPWMRepeats(0);
        sysvar::VTS::Digital_Ch4.StartStimulation();
        @sysvar::VTS::Digital_Ch4::PWMOutputDC = 40;
        @sysvar::VT2516::Ch4_DigitalOut = 0;
      }//end if
    }//end if
  }
}
/*@@end*/

/*@@sysvarChange:VT2516::Ch1_DigitalOut:*/
on sysvar sysvar::VT2516::Ch1_DigitalOut
{
  // Go to digital output mode on this channel (switchMode function handles the VT configuration change)
  switchModeVT2516( 1, DigitalOut );
  // Send setting from the panel to the VT module
  @sysvar::VTS::Digital_Ch1::DigitalOutput  = @sysvar::VT2516::Ch1_DigitalOut;

  // Disable PWM
  @sysvar::VT2516::Ch1_PWMActive = 0;
}
/*@@end*/

/*@@sysvarChange:VT2516::Ch2_DigitalOut:*/
on sysvar sysvar::VT2516::Ch2_DigitalOut
{
  // Go to digital output mode on this channel (switchMode function handles the VT configuration change)
  switchModeVT2516( 2, DigitalOut );
  // Send setting from the panel to the VT module
  @sysvar::VTS::Digital_Ch2::DigitalOutput  = @sysvar::VT2516::Ch2_DigitalOut;

  // Disable PWM
  @sysvar::VT2516::Ch2_PWMActive = 0;
}
/*@@end*/

/*@@sysvarChange:VT2516::Ch3_DigitalOut:*/
on sysvar sysvar::VT2516::Ch3_DigitalOut
{
  // Go to digital output mode on this channel (switchMode function handles the VT configuration change)
  switchModeVT2516( 3, DigitalOut );
  // Send setting from the panel to the VT module
  @sysvar::VTS::Digital_Ch3::DigitalOutput  = @sysvar::VT2516::Ch3_DigitalOut;

  // Disable PWM
  @sysvar::VT2516::Ch3_PWMActive = 0;
}
/*@@end*/

/*@@sysvarChange:VT2516::Ch4_DigitalOut:*/
on sysvar sysvar::VT2516::Ch4_DigitalOut
{
  // Go to digital output mode on this channel (switchMode function handles the VT configuration change)
  switchModeVT2516( 4, DigitalOut );
  // Send setting from the panel to the VT module
  @sysvar::VTS::Digital_Ch4::DigitalOutput  = @sysvar::VT2516::Ch4_DigitalOut;

  // Disable PWM
  @sysvar::VT2516::Ch4_PWMActive = 0;
}
/*@@end*/

/*@@timer:refreshTimer:*/
on timer refreshTimer
{
  float voltage = 0.0;
  float freq = 0.0;


  /* Read the current voltage value and store it in the
  // corresponding system variable to display it in the panel.
  */

    voltage = @sysvar::VTS::Digital_Ch1::Cur;
    @sysvar::VT2516::Ch1_Voltage = voltage;

    voltage = @sysvar::VTS::Digital_Ch2::Cur;
    @sysvar::VT2516::Ch2_Voltage = voltage;

    voltage = @sysvar::VTS::Digital_Ch3::Cur;
    @sysvar::VT2516::Ch3_Voltage = voltage;

    voltage = @sysvar::VTS::Digital_Ch4::Cur;
    @sysvar::VT2516::Ch4_Voltage = voltage;


  /* Read the current frequency value and store it in the
  // corresponding system variable to display it in the panel.
  */

    freq = @sysvar::VTS::Digital_Ch1::PWMFreq;
    @sysvar::VT2516::Ch1_PWM = freq;

    freq = @sysvar::VTS::Digital_Ch2::PWMFreq;
    @sysvar::VT2516::Ch2_PWM = freq;

    freq = @sysvar::VTS::Digital_Ch3::PWMFreq;
    @sysvar::VT2516::Ch3_PWM = freq;

    freq = @sysvar::VTS::Digital_Ch4::PWMFreq;
    @sysvar::VT2516::Ch4_PWM = freq;

  // Update LEDs
  UpdateLEDs();
}
/*@@end*/

/*@@caplFunc:UpdateLEDs():*///function
UpdateLEDs ()
{
    @sysvar::VT2516::Ch1_LED = @sysvar::VTS::Digital_Ch1::Bits[0];
    @sysvar::VT2516::Ch2_LED = @sysvar::VTS::Digital_Ch2::Bits[0];
    @sysvar::VT2516::Ch3_LED = @sysvar::VTS::Digital_Ch3::Bits[0];
    @sysvar::VT2516::Ch4_LED = @sysvar::VTS::Digital_Ch4::Bits[0];
}
/*@@end*/

/*@@startStart:Start:*/
on start
{
    // Configure VT module channel for measurement
    // See the CANoe help for details on the functions/variables
    @sysvar::VT2516::Ch1_DigitalOut = 0;
    @sysvar::VT2516::Ch2_DigitalOut = 0;
    @sysvar::VT2516::Ch3_DigitalOut = 0;
    @sysvar::VT2516::Ch4_DigitalOut = 0;
    
    SetTimerCyclic(refreshTimer, 100);
}
/*@@end*/

/*@@sysvarChange:VT2516::Ch1_PWMActive:*/
on sysvar sysvar::VT2516::Ch1_PWMActive
{
  if( @sysvar::VT2516::Ch1_PWMActive == 1 )
  {
    switchModeVT2516( 1, None );
    switchModeVT2516( 1, PWMGenerator );

  }
  else
    sysvar::VTS::Digital_Ch1.StopStimulation();
}
/*@@end*/

/*@@sysvarChange:VT2516::Ch2_PWMActive:*/
on sysvar sysvar::VT2516::Ch2_PWMActive
{
  if( @sysvar::VT2516::Ch2_PWMActive == 1 )
  {
    switchModeVT2516( 2, None );
    switchModeVT2516( 2, PWMGenerator );

  }
  else
    sysvar::VTS::Digital_Ch2.StopStimulation();
}
/*@@end*/

/*@@sysvarChange:VT2516::Ch3_PWMActive:*/
on sysvar sysvar::VT2516::Ch3_PWMActive
{
  if( @sysvar::VT2516::Ch3_PWMActive == 1 )
  {
    switchModeVT2516( 3, None );
    switchModeVT2516( 3, PWMGenerator );

  }
  else
    sysvar::VTS::Digital_Ch3.StopStimulation();
}
/*@@end*/

/*@@sysvarChange:VT2516::Ch4_PWMActive:*/
on sysvar sysvar::VT2516::Ch4_PWMActive
{
  if( @sysvar::VT2516::Ch4_PWMActive == 1 )
  {
    switchModeVT2516( 4, None );
    switchModeVT2516( 4, PWMGenerator );

  }
  else
    sysvar::VTS::Digital_Ch4.StopStimulation();
}
/*@@end*/

