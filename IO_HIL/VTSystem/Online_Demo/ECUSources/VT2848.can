/*@@var:*/
variables
{
  // Defines the modes in which each channel can be
  enum VT2848Modes { None, DigitalOut, PWMGenerator };

  // Stores the mode in which each channel is
  enum VT2848Modes VT2848Ch1Mode = None;
  enum VT2848Modes VT2848Ch2Mode = None;
  enum VT2848Modes VT2848Ch3Mode = None;
  enum VT2848Modes VT2848Ch4Mode = None;

  // Used to refresh measurement values
  msTimer refreshTimer;
}
/*@@end*/

/*@@sysvarChange:VT2848::Ch1_DigitalOut:*/
on sysvar sysvar::VT2848::Ch1_DigitalOut
{
  // Send setting from the panel to the VT module
  @sysvar::VTS::GPDigital_Ch1::DigitalOutput  = @sysvar::VT2848::Ch1_DigitalOut;
  
  // Set output mode so that PWM measurement is possible
  if(@sysvar::VT2848::Ch1_DigitalOut == 0) sysvar::VTS::GPDigital_Ch1.SetOutputMode(0);
  else                                     sysvar::VTS::GPDigital_Ch1.SetOutputMode(3);
}
/*@@end*/

/*@@sysvarChange:VT2848::Ch2_DigitalOut:*/
on sysvar sysvar::VT2848::Ch2_DigitalOut
{
  // Send setting from the panel to the VT module
  @sysvar::VTS::GPDigital_Ch2::DigitalOutput  = @sysvar::VT2848::Ch2_DigitalOut;
  
  // Set output mode so that PWM measurement is possible
  if(@sysvar::VT2848::Ch2_DigitalOut == 0) sysvar::VTS::GPDigital_Ch2.SetOutputMode(0);
  else                                     sysvar::VTS::GPDigital_Ch2.SetOutputMode(3);
}
/*@@end*/

/*@@sysvarChange:VT2848::Ch3_DigitalOut:*/
on sysvar sysvar::VT2848::Ch3_DigitalOut
{
  // Send setting from the panel to the VT module
  @sysvar::VTS::GPDigital_Ch3::DigitalOutput  = @sysvar::VT2848::Ch3_DigitalOut;
  
  // Set output mode so that PWM measurement is possible
  if(@sysvar::VT2848::Ch3_DigitalOut == 0) sysvar::VTS::GPDigital_Ch3.SetOutputMode(0);
  else                                     sysvar::VTS::GPDigital_Ch3.SetOutputMode(3);
}
/*@@end*/

/*@@sysvarChange:VT2848::Ch4_DigitalOut:*/
on sysvar sysvar::VT2848::Ch4_DigitalOut
{
  // Send setting from the panel to the VT module
  @sysvar::VTS::GPDigital_Ch4::DigitalOutput  = @sysvar::VT2848::Ch4_DigitalOut;
  
  // Set output mode so that PWM measurement is possible
  if(@sysvar::VT2848::Ch4_DigitalOut == 0) sysvar::VTS::GPDigital_Ch4.SetOutputMode(0);
  else                                     sysvar::VTS::GPDigital_Ch4.SetOutputMode(3);
}
/*@@end*/

/*@@timer:refreshTimer:*/
on timer refreshTimer
{
  int digiIn = 0;
  float freq = 0.0;


  /* Read the current voltage value and store it in the
  // corresponding system variable to display it in the panel.
  */

    digiIn = @sysvar::VTS::GPDigital_Ch1::CurBit;
    @sysvar::VT2848::Ch1_DigiIn = digiIn;

    digiIn = @sysvar::VTS::GPDigital_Ch2::CurBit;
    @sysvar::VT2848::Ch2_DigiIn = digiIn;

    digiIn = @sysvar::VTS::GPDigital_Ch3::CurBit;
    @sysvar::VT2848::Ch3_DigiIn = digiIn;

    digiIn = @sysvar::VTS::GPDigital_Ch4::CurBit;
    @sysvar::VT2848::Ch4_DigiIn = digiIn;


  /* Read the current frequency value and store it in the
  // corresponding system variable to display it in the panel.
  */

    freq = @sysvar::VTS::GPDigital_Ch1::PWMFreq;
    @sysvar::VT2848::Ch1_PWM = freq;

    freq = @sysvar::VTS::GPDigital_Ch2::PWMFreq;
    @sysvar::VT2848::Ch2_PWM = freq;

    freq = @sysvar::VTS::GPDigital_Ch3::PWMFreq;
    @sysvar::VT2848::Ch3_PWM = freq;

    freq = @sysvar::VTS::GPDigital_Ch4::PWMFreq;
    @sysvar::VT2848::Ch4_PWM = freq;

  // Update LEDs
  UpdateLEDs();
}
/*@@end*/

/*@@caplFunc:UpdateLEDs():*///function
UpdateLEDs ()
{
    @sysvar::VT2848::Ch1_LED = @sysvar::VTS::GPDigital_Ch1::CurBit || @sysvar::VT2848::Ch1_DigitalOut;
    @sysvar::VT2848::Ch2_LED = @sysvar::VTS::GPDigital_Ch2::CurBit || @sysvar::VT2848::Ch2_DigitalOut;
    @sysvar::VT2848::Ch3_LED = @sysvar::VTS::GPDigital_Ch3::CurBit || @sysvar::VT2848::Ch3_DigitalOut;
    @sysvar::VT2848::Ch4_LED = @sysvar::VTS::GPDigital_Ch4::CurBit || @sysvar::VT2848::Ch4_DigitalOut;
}
/*@@end*/

/*@@startStart:Start:*/
on start
{
    // Configure VT module channel for measurement
    // See the CANoe help for details on the functions/variables

    // Choose Vext as source for high value for channels 1-4, also set threshold to 3V
    sysvar::VTS::GPDigital.SetOutputSource(0, 0);
    sysvar::VTS::GPDigital.SetThreshold(0, 3.0);

    // Initialize channels
    sysvar::VTS::GPDigital_Ch1.SetCurveType (0);
    sysvar::VTS::GPDigital_Ch1.SetOutputMode (3);
    sysvar::VTS::GPDigital_Ch1.SetPWMMeasurementDuration(0.05);
    @sysvar::VT2848::Ch1_DigitalOut = 0;

    sysvar::VTS::GPDigital_Ch2.SetCurveType (0);
    sysvar::VTS::GPDigital_Ch2.SetOutputMode (3);
    sysvar::VTS::GPDigital_Ch2.SetPWMMeasurementDuration(0.05);
    @sysvar::VT2848::Ch2_DigitalOut = 0;

    sysvar::VTS::GPDigital_Ch3.SetCurveType (0);
    sysvar::VTS::GPDigital_Ch3.SetOutputMode (3);
    sysvar::VTS::GPDigital_Ch3.SetPWMMeasurementDuration(0.05);
    @sysvar::VT2848::Ch3_DigitalOut = 0;

    sysvar::VTS::GPDigital_Ch4.SetCurveType (0);
    sysvar::VTS::GPDigital_Ch4.SetOutputMode (3);
    sysvar::VTS::GPDigital_Ch4.SetPWMMeasurementDuration(0.05);
    @sysvar::VT2848::Ch4_DigitalOut = 0;

    // Restart the timer
    setTimerCyclic(refreshTimer,100);
}
/*@@end*/

