/*@@var:*/
variables
{
  // Used to refresh measurement values
  msTimer tTimerRefresh;
}
/*@@end*/

/*@@sysvarChange:VT7001::Ch1_Voltage:*/
on sysvar sysvar::VT7001::Ch1_Voltage
{
  // Adjust voltage on output 1
  @sysvar::VTS::Power_SupInt::RefVoltage = @sysvar::VT7001::Ch1_Voltage;

  // If voltage is != 0 turn led on
  if( abs(@sysvar::VT7001::Ch1_Voltage) > 3.0 ) @sysvar::VT7001::Ch1_VoltageLED = 1;
  else @sysvar::VT7001::Ch1_VoltageLED = 0;
}
/*@@end*/

/*@@sysvarChange:VT7001::Ch2_Voltage:*/
on sysvar sysvar::VT7001::Ch2_Voltage
{
  // Adjust voltage on output 2
  @sysvar::VTS::Power_Sup2::RefVoltage = @sysvar::VT7001::Ch2_Voltage;

  // If voltage is != 0 turn led on
  if( abs(@sysvar::VT7001::Ch2_Voltage) > 3.0 ) @sysvar::VT7001::Ch2_VoltageLED = 1;
  else @sysvar::VT7001::Ch2_VoltageLED = 0;
}
/*@@end*/

/*@@timer:tTimerRefresh:*/
on timer tTimerRefresh
{
  // Read average current values from both outputs and convert to [mA]
  @sysvar::VT7001::Ch1_Current = (@sysvar::VTS::Power_Out1::AvgCurrent)*1000.0;
  @sysvar::VT7001::Ch2_Current = (@sysvar::VTS::Power_Out2::AvgCurrent)*1000.0;
}
/*@@end*/

/*@@startStart:Start:*/
on start
{
  // Start the timer
  setTimerCyclic(tTimerRefresh,100);
}
/*@@end*/

