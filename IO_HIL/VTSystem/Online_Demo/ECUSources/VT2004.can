/*@@var:*/
variables
{
  // Defines the modes in which each channel can be
  enum VT2004Modes { None, ShortCircuit, DecadeResistor, VoltageGenerator, PWMGenerator };

  // Stores the mode in which each channel is
  enum VT2004Modes VT2004Ch1Mode = None;
  enum VT2004Modes VT2004Ch2Mode = None;
  enum VT2004Modes VT2004Ch3Mode = None;
  enum VT2004Modes VT2004Ch4Mode = None;
}
/*@@end*/

/*@@sysvarChange:VT2004::Ch1_ShortCircuit:*/
on sysvar sysvar::VT2004::Ch1_ShortCircuit
{
  // Go to short circuit mode on this channel (switchMode function handles the VT configuration change)
  switchModeVT2004( 1, ShortCircuit );
  // Send setting from the panel to the VT module
  @sysvar::VTS::Stimulus_Ch1::RelayShortCircuit = @sysvar::VT2004::Ch1_ShortCircuit;
}
/*@@end*/

/*@@sysvarChange:VT2004::Ch2_ShortCircuit:*/
on sysvar sysvar::VT2004::Ch2_ShortCircuit
{
  // Go to short circuit mode on this channel (switchMode function handles the VT configuration change)
  switchModeVT2004( 2, ShortCircuit );
  // Send setting from the panel to the VT module
  @sysvar::VTS::Stimulus_Ch2::RelayShortCircuit = @sysvar::VT2004::Ch2_ShortCircuit;
}
/*@@end*/

/*@@sysvarChange:VT2004::Ch3_ShortCircuit:*/
on sysvar sysvar::VT2004::Ch3_ShortCircuit
{
  // Go to short circuit mode on this channel (switchMode function handles the VT configuration change)
  switchModeVT2004( 3, ShortCircuit );
  // Send setting from the panel to the VT module
  @sysvar::VTS::Stimulus_Ch3::RelayShortCircuit = @sysvar::VT2004::Ch3_ShortCircuit;
}
/*@@end*/

/*@@sysvarChange:VT2004::Ch4_ShortCircuit:*/
on sysvar sysvar::VT2004::Ch4_ShortCircuit
{
  // Go to short circuit mode on this channel (switchMode function handles the VT configuration change)
  switchModeVT2004( 4, ShortCircuit );
  // Send setting from the panel to the VT module
  @sysvar::VTS::Stimulus_Ch4::RelayShortCircuit = @sysvar::VT2004::Ch4_ShortCircuit;
}
/*@@end*/

/*@@sysvarChange:VT2004::Ch1_Resistance:*/
on sysvar sysvar::VT2004::Ch1_Resistance
{
  // Activate the decade resistor on this channel (switchMode function handles the VT configuration change)
  switchModeVT2004( 1, DecadeResistor );
  // Send setting from the panel to the VT module
  @sysvar::VTS::Stimulus_Ch1::Resistor = @sysvar::VT2004::Ch1_Resistance;
}
/*@@end*/

/*@@sysvarChange:VT2004::Ch2_Resistance:*/
on sysvar sysvar::VT2004::Ch2_Resistance
{
  // Activate the decade resistor on this channel (switchMode function handles the VT configuration change)
  switchModeVT2004( 2, DecadeResistor );
  // Send setting from the panel to the VT module
  @sysvar::VTS::Stimulus_Ch2::Resistor = @sysvar::VT2004::Ch2_Resistance;
}
/*@@end*/

/*@@sysvarChange:VT2004::Ch3_Resistance:*/
on sysvar sysvar::VT2004::Ch3_Resistance
{
  // Activate the decade resistor on this channel (switchMode function handles the VT configuration change)
  switchModeVT2004( 3, DecadeResistor );
  // Send setting from the panel to the VT module
  @sysvar::VTS::Stimulus_Ch3::Resistor = @sysvar::VT2004::Ch3_Resistance;
}
/*@@end*/

/*@@sysvarChange:VT2004::Ch4_Resistance:*/
on sysvar sysvar::VT2004::Ch4_Resistance
{
  // Activate the decade resistor on this channel (switchMode function handles the VT configuration change)
  switchModeVT2004( 4, DecadeResistor );
  // Send setting from the panel to the VT module
  @sysvar::VTS::Stimulus_Ch4::Resistor = @sysvar::VT2004::Ch4_Resistance;
}
/*@@end*/

/*@@caplFunc:switchModeVT2004(int,VT2004Modes):*///function
switchModeVT2004 ( int channel, enum VT2004Modes mode )
{
  /* This function checks if the given channel is already in the given mode.
  // If that's the case nothing is done. If not, the channel is switched to
  // that mode. Therefore the neccessary functions are called and variables
  // are set. Please check the CANoe help for details on these VT specific
  // variables and functions.
  */

  if( channel == 1 ) {
    if( VT2004Ch1Mode != mode ) {
      VT2004Ch1Mode = mode;
      if( mode == ShortCircuit ) {
        sysvar::VTS::Stimulus_Ch1.StopStimulation();
      }
      else if( mode == DecadeResistor ) {
        // Configure VT module channel as a decade resistor
        // See the CANoe help for details on the functions/variables
        sysvar::VTS::Stimulus_Ch1.StopStimulation();
        sysvar::VTS::Stimulus_Ch1.SetStimulationMode(3);
        sysvar::VTS::Stimulus_Ch1.SetCurveType(0);
        sysvar::VTS::Stimulus_Ch1.StartStimulation();
        @sysvar::VT2004::Ch1_ResistorLEDActive = 1;
        @sysvar::VT2004::Ch1_VoltageLEDActive = 0;
      }
      else if( mode == VoltageGenerator ) {
        // Configure VT module channel as a voltage generator
        // See the CANoe help for details on the functions/variables
        sysvar::VTS::Stimulus_Ch1.StopStimulation();
        sysvar::VTS::Stimulus_Ch1.SetStimulationMode(1);
        sysvar::VTS::Stimulus_Ch1.SetCurveType(0);
        sysvar::VTS::Stimulus_Ch1.StartStimulation();
        @sysvar::VT2004::Ch1_ResistorLEDActive = 0;
        @sysvar::VT2004::Ch1_VoltageLEDActive = 1;
      }
      else if( mode == PWMGenerator ) {
        // Configure VT module channel as a PWM generator
        // See the CANoe help for details on the functions/variables
        sysvar::VTS::Stimulus_Ch1.StopStimulation();
        sysvar::VTS::Stimulus_Ch1.SetStimulationMode(1);
        sysvar::VTS::Stimulus_Ch1.SetCurveType(1);
        @sysvar::VTS::Stimulus_Ch1::PWMFreq = 100;
        sysvar::VTS::Stimulus_Ch1.SetPWMVoltageLow(0.0);
        sysvar::VTS::Stimulus_Ch1.SetPWMVoltageHigh(5.0);
        @sysvar::VTS::Stimulus_Ch1::PWMDC = 40;
        sysvar::VTS::Stimulus_Ch1.StartStimulation();
        @sysvar::VT2004::Ch1_ResistorLEDActive = 0;
        @sysvar::VT2004::Ch1_VoltageLEDActive = 1;
      }//end if
    }//end if
  }
  else if( channel == 2 ) {
    if( VT2004Ch2Mode != mode ) {
     VT2004Ch2Mode = mode;
      if( mode == ShortCircuit ) {
        sysvar::VTS::Stimulus_Ch2.StopStimulation();
      }
      else if( mode == DecadeResistor ) {
        // Configure VT module channel as a decade resistor
        // See the CANoe help for details on the functions/variables
        sysvar::VTS::Stimulus_Ch2.StopStimulation();
        sysvar::VTS::Stimulus_Ch2.SetStimulationMode(3);
        sysvar::VTS::Stimulus_Ch2.SetCurveType(0);
        sysvar::VTS::Stimulus_Ch2.StartStimulation();
        @sysvar::VT2004::Ch2_ResistorLEDActive = 1;
        @sysvar::VT2004::Ch2_VoltageLEDActive = 0;
      }
      else if( mode == VoltageGenerator ) {
        // Configure VT module channel as a voltage generator
        // See the CANoe help for details on the functions/variables
        sysvar::VTS::Stimulus_Ch2.StopStimulation();
        sysvar::VTS::Stimulus_Ch2.SetStimulationMode(1);
        sysvar::VTS::Stimulus_Ch2.SetCurveType(0);
        sysvar::VTS::Stimulus_Ch2.StartStimulation();
        @sysvar::VT2004::Ch2_ResistorLEDActive = 0;
        @sysvar::VT2004::Ch2_VoltageLEDActive = 1;
      }
      else if( mode == PWMGenerator ) {
        // Configure VT module channel as a PWM generator
        // See the CANoe help for details on the functions/variables
        sysvar::VTS::Stimulus_Ch2.StopStimulation();
        sysvar::VTS::Stimulus_Ch2.SetStimulationMode(1);
        sysvar::VTS::Stimulus_Ch2.SetCurveType(1);
        @sysvar::VTS::Stimulus_Ch2::PWMFreq = 100;
        sysvar::VTS::Stimulus_Ch2.SetPWMVoltageLow(0.0);
        sysvar::VTS::Stimulus_Ch2.SetPWMVoltageHigh(5.0);
        @sysvar::VTS::Stimulus_Ch2::PWMDC = 40;
        sysvar::VTS::Stimulus_Ch2.StartStimulation();
        @sysvar::VT2004::Ch2_ResistorLEDActive = 0;
        @sysvar::VT2004::Ch2_VoltageLEDActive = 1;
      }//end if
    }//end if
  }
  else if( channel == 3 ) {
    if( VT2004Ch3Mode != mode ) {
     VT2004Ch3Mode = mode;
      if( mode == ShortCircuit ) {
        sysvar::VTS::Stimulus_Ch3.StopStimulation();
      }
      else if( mode == DecadeResistor ) {
        // Configure VT module channel as a decade resistor
        // See the CANoe help for details on the functions/variables
        sysvar::VTS::Stimulus_Ch3.StopStimulation();
        sysvar::VTS::Stimulus_Ch3.SetStimulationMode(3);
        sysvar::VTS::Stimulus_Ch3.SetCurveType(0);
        sysvar::VTS::Stimulus_Ch3.StartStimulation();
        @sysvar::VT2004::Ch3_ResistorLEDActive = 1;
        @sysvar::VT2004::Ch3_VoltageLEDActive = 0;
      }
      else if( mode == VoltageGenerator ) {
        // Configure VT module channel as a voltage generator
        // See the CANoe help for details on the functions/variables
        sysvar::VTS::Stimulus_Ch3.StopStimulation();
        sysvar::VTS::Stimulus_Ch3.SetStimulationMode(1);
        sysvar::VTS::Stimulus_Ch3.SetCurveType(0);
        sysvar::VTS::Stimulus_Ch3.StartStimulation();
        @sysvar::VT2004::Ch3_ResistorLEDActive = 0;
        @sysvar::VT2004::Ch3_VoltageLEDActive = 1;
      }
      else if( mode == PWMGenerator ) {
        // Configure VT module channel as a PWM generator
        // See the CANoe help for details on the functions/variables
        sysvar::VTS::Stimulus_Ch3.StopStimulation();
        sysvar::VTS::Stimulus_Ch3.SetStimulationMode(1);
        sysvar::VTS::Stimulus_Ch3.SetCurveType(1);
        @sysvar::VTS::Stimulus_Ch3::PWMFreq = 100;
        sysvar::VTS::Stimulus_Ch3.SetPWMVoltageLow(0.0);
        sysvar::VTS::Stimulus_Ch3.SetPWMVoltageHigh(5.0);
        @sysvar::VTS::Stimulus_Ch3::PWMDC = 40;
        sysvar::VTS::Stimulus_Ch3.StartStimulation();
        @sysvar::VT2004::Ch3_ResistorLEDActive = 0;
        @sysvar::VT2004::Ch3_VoltageLEDActive = 1;
      }//end if
    }//end if
  }
  else if( channel == 4 ) {
    if( VT2004Ch4Mode != mode ) {
     VT2004Ch4Mode = mode;
      if( mode == ShortCircuit ) {
        sysvar::VTS::Stimulus_Ch4.StopStimulation();
      }
      else if( mode == DecadeResistor ) {
        // Configure VT module channel as a decade resistor
        // See the CANoe help for details on the functions/variables
        sysvar::VTS::Stimulus_Ch4.StopStimulation();
        sysvar::VTS::Stimulus_Ch4.SetStimulationMode(3);
        sysvar::VTS::Stimulus_Ch4.SetCurveType(0);
        sysvar::VTS::Stimulus_Ch4.StartStimulation();
        @sysvar::VT2004::Ch4_ResistorLEDActive = 1;
        @sysvar::VT2004::Ch4_VoltageLEDActive = 0;
      }
      else if( mode == VoltageGenerator ) {
        // Configure VT module channel as a voltage generator
        // See the CANoe help for details on the functions/variables
        sysvar::VTS::Stimulus_Ch4.StopStimulation();
        sysvar::VTS::Stimulus_Ch4.SetStimulationMode(1);
        sysvar::VTS::Stimulus_Ch4.SetCurveType(0);
        sysvar::VTS::Stimulus_Ch4.StartStimulation();
        @sysvar::VT2004::Ch4_ResistorLEDActive = 0;
        @sysvar::VT2004::Ch4_VoltageLEDActive = 1;
      }
      else if( mode == PWMGenerator ) {
        // Configure VT module channel as a PWM generator
        // See the CANoe help for details on the functions/variables
        sysvar::VTS::Stimulus_Ch4.StopStimulation();
        sysvar::VTS::Stimulus_Ch4.SetStimulationMode(1);
        sysvar::VTS::Stimulus_Ch4.SetCurveType(1);
        @sysvar::VTS::Stimulus_Ch4::PWMFreq = 100;
        sysvar::VTS::Stimulus_Ch4.SetPWMVoltageLow(0.0);
        sysvar::VTS::Stimulus_Ch4.SetPWMVoltageHigh(5.0);
        @sysvar::VTS::Stimulus_Ch4::PWMDC = 40;
        sysvar::VTS::Stimulus_Ch4.StartStimulation();
        @sysvar::VT2004::Ch4_ResistorLEDActive = 0;
        @sysvar::VT2004::Ch4_VoltageLEDActive = 1;
      }//end if
    }//end if
  }
}
/*@@end*/

/*@@sysvarChange:VT2004::Ch1_Voltage:*/
on sysvar sysvar::VT2004::Ch1_Voltage
{
  // Activate the voltage generator on this channel (switchMode function handles the VT configuration change)
  switchModeVT2004( 1, VoltageGenerator );
  // Send setting from the panel to the VT module
  @sysvar::VTS::Stimulus_Ch1::Voltage = @sysvar::VT2004::Ch1_Voltage;
}
/*@@end*/

/*@@sysvarChange:VT2004::Ch2_Voltage:*/
on sysvar sysvar::VT2004::Ch2_Voltage
{
  // Activate the voltage generator on this channel (switchMode function handles the VT configuration change)
  switchModeVT2004( 2, VoltageGenerator );
  // Send setting from the panel to the VT module
  @sysvar::VTS::Stimulus_Ch2::Voltage = @sysvar::VT2004::Ch2_Voltage;
}
/*@@end*/

/*@@sysvarChange:VT2004::Ch3_Voltage:*/
on sysvar sysvar::VT2004::Ch3_Voltage
{
  // Activate the voltage generator on this channel (switchMode function handles the VT configuration change)
  switchModeVT2004( 3, VoltageGenerator );
  // Send setting from the panel to the VT module
  @sysvar::VTS::Stimulus_Ch3::Voltage = @sysvar::VT2004::Ch3_Voltage;
}
/*@@end*/

/*@@sysvarChange:VT2004::Ch4_Voltage:*/
on sysvar sysvar::VT2004::Ch4_Voltage
{
  // Activate the voltage generator on this channel (switchMode function handles the VT configuration change)
  switchModeVT2004( 4, VoltageGenerator );
  // Send setting from the panel to the VT module
  @sysvar::VTS::Stimulus_Ch4::Voltage = @sysvar::VT2004::Ch4_Voltage;
}
/*@@end*/

/*@@sysvarChange:VT2004::Ch1_Frequency:*/
on sysvar sysvar::VT2004::Ch1_Frequency
{
  // Go to PWM output mode on this channel (switchMode function handles the VT configuration change)
  switchModeVT2004( 1, PWMGenerator );
  // Send setting from the panel to the VT module
  @sysvar::VTS::Stimulus_Ch1::PWMFreq  = @sysvar::VT2004::Ch1_Frequency;
}
/*@@end*/

/*@@sysvarChange:VT2004::Ch2_Frequency:*/
on sysvar sysvar::VT2004::Ch2_Frequency
{
  // Go to PWM output mode on this channel (switchMode function handles the VT configuration change)
  switchModeVT2004( 2, PWMGenerator );
  // Send setting from the panel to the VT module
  @sysvar::VTS::Stimulus_Ch2::PWMFreq  = @sysvar::VT2004::Ch2_Frequency;
}
/*@@end*/

/*@@sysvarChange:VT2004::Ch3_Frequency:*/
on sysvar sysvar::VT2004::Ch3_Frequency
{
  // Go to PWM output mode on this channel (switchMode function handles the VT configuration change)
  switchModeVT2004( 3, PWMGenerator );
  // Send setting from the panel to the VT module
  @sysvar::VTS::Stimulus_Ch3::PWMFreq  = @sysvar::VT2004::Ch3_Frequency;
}
/*@@end*/

/*@@sysvarChange:VT2004::Ch4_Frequency:*/
on sysvar sysvar::VT2004::Ch4_Frequency
{
  // Go to PWM output mode on this channel (switchMode function handles the VT configuration change)
  switchModeVT2004( 4, PWMGenerator );
  // Send setting from the panel to the VT module
  @sysvar::VTS::Stimulus_Ch4::PWMFreq  = @sysvar::VT2004::Ch4_Frequency;
}
/*@@end*/

