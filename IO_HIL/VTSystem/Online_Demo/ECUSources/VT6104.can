/*@@var:*/
variables
{
}
/*@@end*/

/*@@sysvarChange:VT6104::Ch1_ShortCircuit:*/
on sysvar sysvar::VT6104::Ch1_ShortCircuit
{
  // Send setting from the panel to the VT module
  @sysvar::VTS::Network_Ch1::RelayShortCircuit = @sysvar::VT6104::Ch1_ShortCircuit;

  // Change LED accordingly
  UpdateFaultLEDs();
}
/*@@end*/

/*@@sysvarChange:VT6104::Ch1_OpenHigh:*/
on sysvar sysvar::VT6104::Ch1_OpenHigh
{
  // Send setting from the panel to the VT module
  @sysvar::VTS::Network_Ch1::RelayOpenHigh = @sysvar::VT6104::Ch1_OpenHigh;

  // Change LED accordingly
  UpdateFaultLEDs();
}
/*@@end*/

/*@@sysvarChange:VT6104::Ch1_OpenLow:*/
on sysvar sysvar::VT6104::Ch1_OpenLow
{
  // Send setting from the panel to the VT module
  @sysvar::VTS::Network_Ch1::RelayOpenLow = @sysvar::VT6104::Ch1_OpenLow;

  // Change LED accordingly
  UpdateFaultLEDs();
}
/*@@end*/

/*@@sysvarChange:VT6104::Ch1_ToGndHigh:*/
on sysvar sysvar::VT6104::Ch1_ToGndHigh
{
  // Open high line first
  @sysvar::VT6104::Ch1_OpenHigh = 1;

  // Send setting from the panel to the VT module
  @sysvar::VTS::Network_Ch1::RelayHighToGnd = @sysvar::VT6104::Ch1_ToGndHigh;

  // Change LED accordingly
  UpdateFaultLEDs();
}
/*@@end*/

/*@@sysvarChange:VT6104::Ch1_ToGndLow:*/
on sysvar sysvar::VT6104::Ch1_ToGndLow
{
  // Open high line first
  @sysvar::VT6104::Ch1_OpenLow = 1;

  // Send setting from the panel to the VT module
  @sysvar::VTS::Network_Ch1::RelayLowToGnd = @sysvar::VT6104::Ch1_ToGndLow;

  // Change LED accordingly
  UpdateFaultLEDs();
}
/*@@end*/

/*@@sysvarChange:VT6104::Ch1_ToUbatLow:*/
on sysvar sysvar::VT6104::Ch1_ToUbatLow
{
  // Open high line first
  @sysvar::VT6104::Ch1_OpenLow = 1;

  // Send setting from the panel to the VT module
  @sysvar::VTS::Network_Ch1::RelayLowToVBatt = @sysvar::VT6104::Ch1_ToUbatLow;

  // Change LED accordingly
  UpdateFaultLEDs();
}
/*@@end*/

/*@@sysvarChange:VT6104::Ch1_ToUbatHigh:*/
on sysvar sysvar::VT6104::Ch1_ToUbatHigh
{
  // Open high line first
  @sysvar::VT6104::Ch1_OpenHigh = 1;

  // Send setting from the panel to the VT module
  @sysvar::VTS::Network_Ch1::RelayHighToVBatt = @sysvar::VT6104::Ch1_ToUbatHigh;

  // Change LED accordingly
  UpdateFaultLEDs();
}
/*@@end*/

/*@@sysvarChange:VT6104::Ch2_ShortCircuit:*/
on sysvar sysvar::VT6104::Ch2_ShortCircuit
{
  // Send setting from the panel to the VT module
  @sysvar::VTS::Network_Ch2::RelayShortCircuit = @sysvar::VT6104::Ch2_ShortCircuit;

  // Change LED accordingly
  UpdateFaultLEDs();
}
/*@@end*/

/*@@sysvarChange:VT6104::Ch2_OpenHigh:*/
on sysvar sysvar::VT6104::Ch2_OpenHigh
{
  // Send setting from the panel to the VT module
  @sysvar::VTS::Network_Ch2::RelayOpenHigh = @sysvar::VT6104::Ch2_OpenHigh;

  // Change LED accordingly
 UpdateFaultLEDs();
}
/*@@end*/

/*@@sysvarChange:VT6104::Ch2_OpenLow:*/
on sysvar sysvar::VT6104::Ch2_OpenLow
{
  // Send setting from the panel to the VT module
  @sysvar::VTS::Network_Ch2::RelayOpenLow = @sysvar::VT6104::Ch2_OpenLow;

  // Change LED accordingly
  UpdateFaultLEDs();
}
/*@@end*/

/*@@sysvarChange:VT6104::Ch2_ToGndHigh:*/
on sysvar sysvar::VT6104::Ch2_ToGndHigh
{
  // Open high line first
  @sysvar::VT6104::Ch2_OpenHigh = 1;

  // Send setting from the panel to the VT module
  @sysvar::VTS::Network_Ch2::RelayHighToGnd = @sysvar::VT6104::Ch2_ToGndHigh;

  // Change LED accordingly
  UpdateFaultLEDs();
}
/*@@end*/

/*@@sysvarChange:VT6104::Ch2_ToGndLow:*/
on sysvar sysvar::VT6104::Ch2_ToGndLow
{
  // Open high line first
  @sysvar::VT6104::Ch2_OpenLow = 1;

  // Send setting from the panel to the VT module
  @sysvar::VTS::Network_Ch2::RelayLowToGnd = @sysvar::VT6104::Ch2_ToGndLow;

  // Change LED accordingly
 UpdateFaultLEDs();
}
/*@@end*/

/*@@sysvarChange:VT6104::Ch2_ToUbatLow:*/
on sysvar sysvar::VT6104::Ch2_ToUbatLow
{
  // Open high line first
  @sysvar::VT6104::Ch2_OpenLow = 1;

  // Send setting from the panel to the VT module
  @sysvar::VTS::Network_Ch2::RelayLowToVBatt = @sysvar::VT6104::Ch2_ToUbatLow;

  // Change LED accordingly
  UpdateFaultLEDs();
}
/*@@end*/

/*@@sysvarChange:VT6104::Ch2_ToUbatHigh:*/
on sysvar sysvar::VT6104::Ch2_ToUbatHigh
{
  // Open high line first
  @sysvar::VT6104::Ch2_OpenHigh = 1;

  // Send setting from the panel to the VT module
  @sysvar::VTS::Network_Ch2::RelayHighToVBatt = @sysvar::VT6104::Ch2_ToUbatHigh;

  // Change LED accordingly
  UpdateFaultLEDs();
}
/*@@end*/

/*@@sysvarChange:VT6104::Ch3_ShortCircuit:*/
on sysvar sysvar::VT6104::Ch3_ShortCircuit
{
  // Send setting from the panel to the VT module
  @sysvar::VTS::Network_Ch3::RelayShortCircuit = @sysvar::VT6104::Ch3_ShortCircuit;

  // Change LED accordingly
  UpdateFaultLEDs();
}
/*@@end*/

/*@@sysvarChange:VT6104::Ch3_OpenHigh:*/
on sysvar sysvar::VT6104::Ch3_OpenHigh
{
  // Send setting from the panel to the VT module
  @sysvar::VTS::Network_Ch3::RelayOpenHigh = @sysvar::VT6104::Ch3_OpenHigh;

  // Change LED accordingly
  UpdateFaultLEDs();
}
/*@@end*/

/*@@sysvarChange:VT6104::Ch3_OpenLow:*/
on sysvar sysvar::VT6104::Ch3_OpenLow
{
  // Send setting from the panel to the VT module
  @sysvar::VTS::Network_Ch3::RelayOpenLow = @sysvar::VT6104::Ch3_OpenLow;

  // Change LED accordingly
  UpdateFaultLEDs();
}
/*@@end*/

/*@@sysvarChange:VT6104::Ch3_ToGndHigh:*/
on sysvar sysvar::VT6104::Ch3_ToGndHigh
{
  // Open high line first
  @sysvar::VT6104::Ch3_OpenHigh = 1;

  // Send setting from the panel to the VT module
  @sysvar::VTS::Network_Ch3::RelayHighToGnd = @sysvar::VT6104::Ch3_ToGndHigh;

  // Change LED accordingly
  UpdateFaultLEDs();
}
/*@@end*/

/*@@sysvarChange:VT6104::Ch3_ToGndLow:*/
on sysvar sysvar::VT6104::Ch3_ToGndLow
{
  // Open high line first
  @sysvar::VT6104::Ch3_OpenLow = 1;

  // Send setting from the panel to the VT module
  @sysvar::VTS::Network_Ch3::RelayLowToGnd = @sysvar::VT6104::Ch3_ToGndLow;

  // Change LED accordingly
  UpdateFaultLEDs();
}
/*@@end*/

/*@@sysvarChange:VT6104::Ch3_ToUbatLow:*/
on sysvar sysvar::VT6104::Ch3_ToUbatLow
{
  // Open high line first
  @sysvar::VT6104::Ch3_OpenLow = 1;

  // Send setting from the panel to the VT module
  @sysvar::VTS::Network_Ch3::RelayLowToVBatt = @sysvar::VT6104::Ch3_ToUbatLow;

  // Change LED accordingly
  UpdateFaultLEDs();
}
/*@@end*/

/*@@sysvarChange:VT6104::Ch3_ToUbatHigh:*/
on sysvar sysvar::VT6104::Ch3_ToUbatHigh
{
  // Open high line first
  @sysvar::VT6104::Ch3_OpenHigh = 1;

  // Send setting from the panel to the VT module
  @sysvar::VTS::Network_Ch3::RelayHighToVBatt = @sysvar::VT6104::Ch3_ToUbatHigh;

  // Change LED accordingly
  UpdateFaultLEDs();
}
/*@@end*/

/*@@sysvarChange:VT6104::Ch4_ShortCircuit:*/
on sysvar sysvar::VT6104::Ch4_ShortCircuit
{
  // Send setting from the panel to the VT module
  @sysvar::VTS::Network_Ch4::RelayShortCircuit = @sysvar::VT6104::Ch4_ShortCircuit;

  // Change LED accordingly
  UpdateFaultLEDs();
}
/*@@end*/

/*@@sysvarChange:VT6104::Ch4_OpenHigh:*/
on sysvar sysvar::VT6104::Ch4_OpenHigh
{
  // Send setting from the panel to the VT module
  @sysvar::VTS::Network_Ch4::RelayOpenHigh = @sysvar::VT6104::Ch4_OpenHigh;

  // Change LED accordingly
  UpdateFaultLEDs();
}
/*@@end*/

/*@@sysvarChange:VT6104::Ch4_OpenLow:*/
on sysvar sysvar::VT6104::Ch4_OpenLow
{
  // Send setting from the panel to the VT module
  @sysvar::VTS::Network_Ch4::RelayOpenLow = @sysvar::VT6104::Ch4_OpenLow;

  // Change LED accordingly
  UpdateFaultLEDs();
}
/*@@end*/

/*@@sysvarChange:VT6104::Ch4_ToGndHigh:*/
on sysvar sysvar::VT6104::Ch4_ToGndHigh
{
  // Open high line first
  @sysvar::VT6104::Ch4_OpenHigh = 1;

  // Send setting from the panel to the VT module
  @sysvar::VTS::Network_Ch4::RelayHighToGnd = @sysvar::VT6104::Ch4_ToGndHigh;

  // Change LED accordingly
  UpdateFaultLEDs();
}
/*@@end*/

/*@@sysvarChange:VT6104::Ch4_ToGndLow:*/
on sysvar sysvar::VT6104::Ch4_ToGndLow
{
  // Open high line first
  @sysvar::VT6104::Ch4_OpenLow = 1;

  // Send setting from the panel to the VT module
  @sysvar::VTS::Network_Ch4::RelayLowToGnd = @sysvar::VT6104::Ch4_ToGndLow;

  // Change LED accordingly
  UpdateFaultLEDs();
}
/*@@end*/

/*@@sysvarChange:VT6104::Ch4_ToUbatLow:*/
on sysvar sysvar::VT6104::Ch4_ToUbatLow
{
  // Open high line first
  @sysvar::VT6104::Ch4_OpenLow = 1;

  // Send setting from the panel to the VT module
  @sysvar::VTS::Network_Ch4::RelayLowToVBatt = @sysvar::VT6104::Ch4_ToUbatLow;

  // Change LED accordingly
  UpdateFaultLEDs();
}
/*@@end*/

/*@@sysvarChange:VT6104::Ch4_ToUbatHigh:*/
on sysvar sysvar::VT6104::Ch4_ToUbatHigh
{
  // Open high line first
  @sysvar::VT6104::Ch4_OpenHigh = 1;

  // Send setting from the panel to the VT module
  @sysvar::VTS::Network_Ch4::RelayHighToVBatt = @sysvar::VT6104::Ch4_ToUbatHigh;

  // Change LED accordingly
  UpdateFaultLEDs();
}
/*@@end*/

/*@@sysvarChange:VTS::Network_Ch1::RelayTermination:*/
on sysvar sysvar::VTS::Network_Ch1::RelayTermination

{
  UpdateFaultLEDs();
}
/*@@end*/

/*@@sysvarChange:VTS::Network_Ch4::RelayTermination:*/
on sysvar sysvar::VTS::Network_Ch4::RelayTermination
{
  UpdateFaultLEDs();
}
/*@@end*/

/*@@sysvarChange:VTS::Network_Ch3::RelayTermination:*/
on sysvar sysvar::VTS::Network_Ch3::RelayTermination
{
  UpdateFaultLEDs();
}
/*@@end*/

/*@@sysvarChange:VTS::Network_Ch2::RelayTermination:*/
on sysvar sysvar::VTS::Network_Ch2::RelayTermination
{
  UpdateFaultLEDs();
}
/*@@end*/

/*@@caplFunc:UpdateFaultLEDs():*///function
UpdateFaultLEDs ()
{
  if( @sysvar::VT6104::Ch1_OpenHigh == 1 || @sysvar::VT6104::Ch1_OpenLow == 1 || @sysvar::VT6104::Ch1_ShortCircuit == 1 ||
  @sysvar::VT6104::Ch1_ToGndHigh == 1 || @sysvar::VT6104::Ch1_ToGndLow || @sysvar::VT6104::Ch1_ToUbatHigh || @sysvar::VT6104::Ch1_ToUbatLow ||
  @sysvar::VTS::Network_Ch1::RelayTermination )
  {
    @sysvar::VT6104::Ch1_LEDDisturbed = 1;
  }
  else
  {
    @sysvar::VT6104::Ch1_LEDDisturbed = 0;
  }//end if

  if( @sysvar::VT6104::Ch2_OpenHigh == 1 || @sysvar::VT6104::Ch2_OpenLow == 1 || @sysvar::VT6104::Ch2_ShortCircuit == 1 ||
  @sysvar::VT6104::Ch2_ToGndHigh == 1 || @sysvar::VT6104::Ch2_ToGndLow || @sysvar::VT6104::Ch2_ToUbatHigh || @sysvar::VT6104::Ch2_ToUbatLow ||
  @sysvar::VTS::Network_Ch2::RelayTermination )
  {
    @sysvar::VT6104::Ch2_LEDDisturbed = 1;
  }
  else
  {
    @sysvar::VT6104::Ch2_LEDDisturbed = 0;
  }//end if

  if( @sysvar::VT6104::Ch3_OpenHigh == 1 || @sysvar::VT6104::Ch3_OpenLow == 1 || @sysvar::VT6104::Ch3_ShortCircuit == 1 ||
  @sysvar::VT6104::Ch3_ToGndHigh == 1 || @sysvar::VT6104::Ch3_ToGndLow || @sysvar::VT6104::Ch3_ToUbatHigh || @sysvar::VT6104::Ch3_ToUbatLow ||
  @sysvar::VTS::Network_Ch3::RelayTermination )
  {
    @sysvar::VT6104::Ch3_LEDDisturbed = 1;
  }
  else
  {
    @sysvar::VT6104::Ch3_LEDDisturbed = 0;
  }//end if

  if( @sysvar::VT6104::Ch4_OpenHigh == 1 || @sysvar::VT6104::Ch4_OpenLow == 1 || @sysvar::VT6104::Ch4_ShortCircuit == 1 ||
  @sysvar::VT6104::Ch4_ToGndHigh == 1 || @sysvar::VT6104::Ch4_ToGndLow || @sysvar::VT6104::Ch4_ToUbatHigh || @sysvar::VT6104::Ch4_ToUbatLow ||
  @sysvar::VTS::Network_Ch4::RelayTermination )
  {
    @sysvar::VT6104::Ch4_LEDDisturbed = 1;
  }
  else
  {
    @sysvar::VT6104::Ch4_LEDDisturbed = 0;
  }//end if
}
/*@@end*/

