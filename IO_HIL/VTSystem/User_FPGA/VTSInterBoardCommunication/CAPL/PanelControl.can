/*@!Encoding:1252*/
includes
{
}

variables
{
  const dword MaxModuleNumber = 7;
  const dword MaxBoxNumber = 8; // modules + status
  char ModuleName[7][25] = {"VT1004", "VT1104", "VT2004", "VT2516", "VT2710", "VT2816", "VT2848"};
}

// VT1004: 0
// VT1104: 1
// VT2004: 2
// VT2516: 3
// VT2710: 4
// VT2816: 5
// VT2848: 6

void OfflineBehaviour(dword ModuleNumber)
{
  char BufferColumn[25], BufferGroupBox[25], BufferLine[12][25];
  dword NumberIndex, NameIndex;
  
  // channel group box
  snprintf(BufferGroupBox, elCount(BufferGroupBox), "Group Box %s", ModuleName[ModuleNumber]);
  setControlBackColor("IBCDemoControl", BufferGroupBox, makeRGB(240, 240, 240));
  
  // line
  for(NumberIndex = 0; NumberIndex < MaxModuleNumber; NumberIndex++)
  {
    snprintf(BufferLine[NumberIndex], elCount(BufferLine[NumberIndex]), "Input/Output %s_%d", ModuleName[NumberIndex], ModuleNumber + 1);
    setControlColors("IBCDemoControl", BufferLine[NumberIndex], makeRGB(240, 240, 240), makeRGB(240, 240, 240));
  }
  
  // column
  for(NameIndex = 0; NameIndex < MaxBoxNumber; NameIndex++)
  {
    snprintf(BufferColumn, elCount(BufferColumn), "Input/Output %s_%d", ModuleName[ModuleNumber], NameIndex + 1);
    setControlColors("IBCDemoControl", BufferColumn, makeRGB(240, 240, 240), makeRGB(240, 240, 240));
  }
}


on start
{
  if(1 == @sysvar::VTS::VT1004::IsOffline)
  {
    OfflineBehaviour(0);
  }
  
  if(1 == @sysvar::VTS::VT1104::IsOffline)
  {
    OfflineBehaviour(1);
  }
  
  if(1 == @sysvar::VTS::VT2004::IsOffline)
  {
    OfflineBehaviour(2);
  }
  
  if(1 == @sysvar::VTS::VT2516::IsOffline)
  {
    OfflineBehaviour(3);
  }
  
  if(1 == @sysvar::VTS::VT2710::IsOffline)
  {
    OfflineBehaviour(4);
  }
  
  if(1 == @sysvar::VTS::VT2816::IsOffline)
  {
    OfflineBehaviour(5);
  }
  
  if(1 == @sysvar::VTS::VT2848::IsOffline)
  {
    OfflineBehaviour(6);
  }
}

