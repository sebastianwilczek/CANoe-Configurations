includes
{
}

variables
{ 
}

/* 
Calculation of the frequency:
F [Hz] = 1 / (2 * 100 ns * 2^n)
*/

on sysvar sysvar::VTS::VT1004::var_Toggle_Bit_Select
{
	@sysvar::Control::var_frequency = 1/(2*0.0000001* _pow(2.0, @this));
}


on start
{
	@sysvar::Control::var_frequency = 1/(2*0.0000001* _pow(2.0, @sysvar::VTS::VT1004::var_Toggle_Bit_Select));
}
