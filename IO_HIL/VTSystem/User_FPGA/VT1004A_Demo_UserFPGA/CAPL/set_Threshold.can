includes
{
}

variables
{
}

on sysvar sysvar::Control::var_threshold
{
	sysvar::VTS::VT1004_Ch1.SetPWMThreshold(@this);
}


on start
{
	sysvar::VTS::VT1004_Ch1.SetPWMThreshold(@sysvar::Control::var_threshold);
}
