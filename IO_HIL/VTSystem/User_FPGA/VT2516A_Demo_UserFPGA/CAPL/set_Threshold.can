includes
{
}

variables
{
}

on sysvar sysvar::Control::var_threshold
{
	sysvar::VTS::VT2516.SetThreshold1_8(@this);
}


on start
{
	sysvar::VTS::VT2516.SetThreshold1_8(@sysvar::Control::var_threshold);
}
