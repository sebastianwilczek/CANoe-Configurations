/*@!Encoding:1252*/
includes
{
}

variables
{
  dword CogwheelTeeth = 60;
  float LowVoltage = -10.0;
  float HighVoltage = 10.0;
  
  dword WaitTimeLED = 2000;
}  
  
void MainTest ()
{
  // panel border
  setControlVisibility("Initialization", "Border", 0);
  testWaitForTimeout(2000);
  setControlVisibility("Initialization", "Border", 1);
  testWaitForTimeout(2000);
  
  InitPanel();
  
  testWaitForTimeout(2000);
  
  write("Cogwheel initialization with 60 teeth starting.");
  InitCogwheel();
  
  write("Voltage initialization with ±10V starting.");
  InitVoltage();
  
  testWaitForTimeout(1000);
  
  write("Initialization complete.");
  
  // panel border
  testWaitForTimeout(2000);
  setControlVisibility("Initialization", "Border", 0);
  
  testWaitForTimeout(2000);
  
  StartDriving();
}


void InitPanel()
{
  // all arrows set to grey
  ColorRed("InitializationLED.NumberOfTeeth");
  ColorRed("InitializationLED.CreateTeeth");
  ColorRed("InitializationLED.LowVoltage");
  ColorRed("InitializationLED.HighVoltage");
  ColorRed("InitializationLED.RelaySwitch");
  ColorRed("InitializationLED.OutputType");
  ColorRed("InitializationLED.SensorSelect");
  ColorRed("InitializationLED.ActivateOutput");
  ColorRed("InitializationLED.RelaySim");
}


void InitCogwheel()
{
  // Set number of teeth to 60
  ColorGreen("InitializationLED.NumberOfTeeth");
  @sysvar::VTS::VT7820_Channel1::NumberOfTeeth = CogwheelTeeth;
  @sysvar::VTS::VT7820_Channel2::NumberOfTeeth = CogwheelTeeth;
  @sysvar::VTS::VT7820_Channel3::NumberOfTeeth = CogwheelTeeth;
  @sysvar::VTS::VT7820_Channel4::NumberOfTeeth = CogwheelTeeth;
  testWaitForTimeout(WaitTimeLED);
  ColorGrey("InitializationLED.NumberOfTeeth");
}


void InitVoltage()
{
  // Low set to -10V
  ColorGreen("InitializationLED.LowVoltage");
  @sysvar::VTS::VT7820_Channel1::LowVoltage = LowVoltage;
  @sysvar::VTS::VT7820_Channel2::LowVoltage = LowVoltage;
  @sysvar::VTS::VT7820_Channel3::LowVoltage = LowVoltage;
  @sysvar::VTS::VT7820_Channel4::LowVoltage = LowVoltage;
  testWaitForTimeout(WaitTimeLED);
  ColorGrey("InitializationLED.LowVoltage");
  
  // High set to 10V
  ColorGreen("InitializationLED.HighVoltage");
  @sysvar::VTS::VT7820_Channel1::HighVoltage = HighVoltage;
  @sysvar::VTS::VT7820_Channel2::HighVoltage = HighVoltage;
  @sysvar::VTS::VT7820_Channel3::HighVoltage = HighVoltage;
  @sysvar::VTS::VT7820_Channel4::HighVoltage = HighVoltage;
  testWaitForTimeout(WaitTimeLED);
  ColorGrey("InitializationLED.HighVoltage");
  
  // change output to voltage
  ColorGreen("InitializationLED.RelaySwitch");
  ColorGreen("InitializationLED.OutputType");
  @sysvar::VTS::VT7820_Channel1::RelaySwitch = 1;
  @sysvar::VTS::VT7820_Channel2::RelaySwitch = 1;
  @sysvar::VTS::VT7820_Channel3::RelaySwitch = 1;
  @sysvar::VTS::VT7820_Channel4::RelaySwitch = 1;
  @sysvar::VTS::VT7820_Channel1::OutputType = 1;
  @sysvar::VTS::VT7820_Channel2::OutputType = 1;
  @sysvar::VTS::VT7820_Channel3::OutputType = 1;
  @sysvar::VTS::VT7820_Channel4::OutputType = 1;
  testWaitForTimeout(WaitTimeLED);
  ColorGrey("InitializationLED.RelaySwitch");
  ColorGrey("InitializationLED.OutputType");
  
  // s-Sensor
  ColorGreen("InitializationLED.SensorSelect");
  @sysvar::Demo::SensorSelect = 1;
  testWaitForTimeout(WaitTimeLED);
  ColorGrey("InitializationLED.SensorSelect");
  
  // output
  ColorGreen("InitializationLED.ActivateOutput");
  @sysvar::VTS::VT7820_Channel1::ActivateOutput = 1;
  @sysvar::VTS::VT7820_Channel2::ActivateOutput = 1;
  @sysvar::VTS::VT7820_Channel3::ActivateOutput = 1;
  @sysvar::VTS::VT7820_Channel4::ActivateOutput = 1;
  testWaitForTimeout(WaitTimeLED);
  ColorGrey("InitializationLED.ActivateOutput");
  
  // output relais
  ColorGreen("InitializationLED.RelaySim");
  @sysvar::VTS::VT7820_Channel1::RelayBreak = 1;
  @sysvar::VTS::VT7820_Channel2::RelayBreak = 1;
  @sysvar::VTS::VT7820_Channel3::RelayBreak = 1;
  @sysvar::VTS::VT7820_Channel4::RelayBreak = 1;
  ColorGrey("InitializationLED.RelaySim");
}


void StartDriving()
{
  @sysvar::Demo::StartDriving = 1;
  testWaitForTimeout(1000);
  @sysvar::Demo::StartDriving = 0;
}


void ColorGrey(char LED[])
{
  sysSetVariableInt("Demo", LED, 1);
  setControlForeColor("Initialization", LED, MakeRGB(177, 182, 186));
}

void ColorRed(char LED[])
{
  sysSetVariableInt("Demo", LED, 1);
  setControlForeColor("Initialization", LED, MakeRGB(255, 0, 0));
}

void ColorGreen(char LED[])
{
  sysSetVariableInt("Demo", LED, 1);
  setControlForeColor("Initialization", LED, MakeRGB(0, 255, 0));
}