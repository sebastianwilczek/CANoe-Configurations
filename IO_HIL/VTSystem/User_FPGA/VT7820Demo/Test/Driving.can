/*@!Encoding:1252*/
includes
{
}

variables
{
  int64 i;
}


void MainTest ()
{
  Init();
 
  write("Demo drive starting.");
  
  while(1)
  {
    testWaitForTimeout(2000);
    StartEngine(); 
    testWaitForTimeout(2000);
    // normal steering
    DemoDrive(0);
    testWaitForTimeout(3000);
    // understeering
    DemoDrive(1);
    testWaitForTimeout(3000);
    // oversteering
    DemoDrive(2);
    testWaitForTimeout(5000);
    StopEngine();
    testWaitForTimeout(3000);
  }
  
  Reset();
}


void Reset()
{
}


void Init()
{
  Reset();
}


void StartEngine()
{
  @sysvarMember::Demo::Dashboard.EngineActive = 1;
  testWaitForTimeout(1000);
  
  for(i=0; i<=80; i++)
  {
    @sysvarMember::Demo::Dashboard.BatteryPower = i;
    testWaitForTimeout(20);
  }
}


void StopEngine()
{
  @sysvarMember::Demo::Dashboard.EngineActive = 0;
  for(i=@sysvarMember::Demo::Dashboard.BatteryPower; i>=0; i--)
  {
    @sysvarMember::Demo::Dashboard.BatteryPower = i;
    testWaitForTimeout(20);
  }
}


void DemoDrive(dword SteeringBehavior)
{
  @sysvarMember::Demo::VehicleSpeed.SteeringBehavior = SteeringBehavior;
  // acceleration
  @sysvarMember::Demo::VehicleSpeed.IntendedSpeed = 14;
  testWaitForSignalInRange(sysvarMember::Demo::Dashboard.CurrentSpeed, 49.5, 50.5, 30000);
  testWaitForTimeout(5000);
  @sysvarMember::Demo::VehicleSpeed.IntendedSpeed = 22;
  testWaitForSignalInRange(sysvarMember::Demo::Dashboard.CurrentSpeed, 78.5, 79.5, 30000);
  testWaitForTimeout(2000);
  // direction right
  for(i=0; i<=30; i++)
  {
    @sysvarMember::Demo::VehicleSpeed.DirectionAngle = i;
    testWaitForTimeout(100);
  }
  testWaitForTimeout(3000);
  // direction back to center
  for(i; i>=0; i--)
  {
    @sysvarMember::Demo::VehicleSpeed.DirectionAngle = i;
    testWaitForTimeout(100);
  }
  testWaitForTimeout(3000);
  // acceleration
  @sysvarMember::Demo::VehicleSpeed.IntendedSpeed = 56;
  testWaitForTimeout(4000);
  // direction left
  for(i=0; i>=-10; i--)
  {
    @sysvarMember::Demo::VehicleSpeed.DirectionAngle = i;
    testWaitForTimeout(100);
  }
  testWaitForTimeout(1000);
  // direction back to center
  for(i; i<=0; i++)
  {
    @sysvarMember::Demo::VehicleSpeed.DirectionAngle = i;
    testWaitForTimeout(100);
  }
  testWaitForSignalInRange(sysvarMember::Demo::Dashboard.CurrentSpeed, 201, 202, 30000);
  testWaitForTimeout(5000);
  // breaking
  @sysvarMember::Demo::VehicleSpeed.IntendedSpeed = 0;
  testWaitForSignalInRange(sysvarMember::Demo::Dashboard.CurrentSpeed, -0.5, 0.5, 30000);
  testWaitForTimeout(3000);
}