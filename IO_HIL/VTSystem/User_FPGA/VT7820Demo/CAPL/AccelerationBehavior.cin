/*@!Encoding:1252*/


includes
{
  #include "AccelerationValues.cin"
}

variables
{
  double CurrentSpeed;
  double IntendedSpeed;
}


double SpeedChange(double i_CurrentSpeed, double i_IntendedSpeed)
{  
  CurrentSpeed = i_CurrentSpeed;
  IntendedSpeed = i_IntendedSpeed;
  
  // acceleration
  if(CurrentSpeed < IntendedSpeed)
  {
    // prevent overshooting
    if(CurrentSpeed + (TimerValue / 1000) * Acceleration(CurrentSpeed) >= IntendedSpeed)
      CurrentSpeed = IntendedSpeed;
    else
      CurrentSpeed = CurrentSpeed + (TimerValue / 1000) * Acceleration(CurrentSpeed);
  }
  
  // breaking
  else if(CurrentSpeed > IntendedSpeed)
  {
    // prevent overshooting
    if(CurrentSpeed + (TimerValue / 1000) * Deceleration() <= IntendedSpeed)
      CurrentSpeed = IntendedSpeed;
    else
      CurrentSpeed = CurrentSpeed + (TimerValue / 1000) * Deceleration();
  }
  
  return CurrentSpeed;
}
