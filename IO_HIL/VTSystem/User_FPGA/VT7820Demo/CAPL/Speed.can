/*@!Encoding:1252*/
includes
{
  #include "AccelerationBehavior.cin"
}

variables
{
  msTimer SpeedTimer;
  double TimerValue = 10; // ms
}


on start
{
  setTimerCyclic(SpeedTimer, TimerValue);
}


on timer SpeedTimer
{
  SpeedRegulation(@sysvarMember::Demo::VehicleSpeed.IntendedSpeed, @sysvarMember::Demo::VehicleSpeed.DirectionAngle, @sysvarMember::Demo::VehicleSpeed.SteeringBehavior);
}


void SpeedRegulation(double IntendedSpeed, double Angle, dword SteeringBehavior)
{
  // ideal/no steering
  if(@sysvarMember::Demo::VehicleSpeed.SteeringBehavior == 0 || @sysvarMember::Demo::VehicleSpeed.DirectionAngle == 0)
  {
    @sysvarMember::Demo::FrontLeftWheel.CurrentSpeed  = SpeedChange(@sysvarMember::Demo::FrontLeftWheel.CurrentSpeed, IntendedSpeed);
    @sysvarMember::Demo::FrontRightWheel.CurrentSpeed = SpeedChange(@sysvarMember::Demo::FrontRightWheel.CurrentSpeed, IntendedSpeed);
    @sysvarMember::Demo::BackLeftWheel.CurrentSpeed   = SpeedChange(@sysvarMember::Demo::BackLeftWheel.CurrentSpeed, IntendedSpeed);
    @sysvarMember::Demo::BackRightWheel.CurrentSpeed  = SpeedChange(@sysvarMember::Demo::BackRightWheel.CurrentSpeed, IntendedSpeed);
  }
  // understeering & left turn
  else if(@sysvarMember::Demo::VehicleSpeed.SteeringBehavior == 1 && @sysvarMember::Demo::VehicleSpeed.DirectionAngle < 0)
  {
    @sysvarMember::Demo::FrontLeftWheel.CurrentSpeed  = SpeedChange(@sysvarMember::Demo::FrontLeftWheel.CurrentSpeed, IntendedSpeed);
    @sysvarMember::Demo::FrontRightWheel.CurrentSpeed = SpeedChange(@sysvarMember::Demo::FrontRightWheel.CurrentSpeed, IntendedSpeed);
    @sysvarMember::Demo::BackLeftWheel.CurrentSpeed   = (1 - AngleFactor(@sysvarMember::Demo::BackLeftWheel.CurrentSpeed, @sysvarMember::Demo::VehicleSpeed.DirectionAngle)) * SpeedChange(@sysvarMember::Demo::BackLeftWheel.CurrentSpeed, IntendedSpeed);
    @sysvarMember::Demo::BackRightWheel.CurrentSpeed  = SpeedChange(@sysvarMember::Demo::BackRightWheel.CurrentSpeed, IntendedSpeed); 
  }
  // understeering & right turn
  else if(@sysvarMember::Demo::VehicleSpeed.SteeringBehavior == 1 && @sysvarMember::Demo::VehicleSpeed.DirectionAngle > 0)
  {
    @sysvarMember::Demo::FrontLeftWheel.CurrentSpeed  = SpeedChange(@sysvarMember::Demo::FrontLeftWheel.CurrentSpeed, IntendedSpeed);
    @sysvarMember::Demo::FrontRightWheel.CurrentSpeed = SpeedChange(@sysvarMember::Demo::FrontRightWheel.CurrentSpeed, IntendedSpeed);
    @sysvarMember::Demo::BackLeftWheel.CurrentSpeed   = SpeedChange(@sysvarMember::Demo::BackLeftWheel.CurrentSpeed, IntendedSpeed); 
    @sysvarMember::Demo::BackRightWheel.CurrentSpeed  = (1 - AngleFactor(@sysvarMember::Demo::BackRightWheel.CurrentSpeed, @sysvarMember::Demo::VehicleSpeed.DirectionAngle)) * SpeedChange(@sysvarMember::Demo::BackRightWheel.CurrentSpeed, IntendedSpeed);
  }
  // oversteering & left turn
  else if(@sysvarMember::Demo::VehicleSpeed.SteeringBehavior == 2 && @sysvarMember::Demo::VehicleSpeed.DirectionAngle < 0)
  {
    @sysvarMember::Demo::FrontLeftWheel.CurrentSpeed  = SpeedChange(@sysvarMember::Demo::FrontLeftWheel.CurrentSpeed, IntendedSpeed);
    @sysvarMember::Demo::FrontRightWheel.CurrentSpeed = (1 - AngleFactor(@sysvarMember::Demo::FrontRightWheel.CurrentSpeed, @sysvarMember::Demo::VehicleSpeed.DirectionAngle)) * SpeedChange(@sysvarMember::Demo::FrontRightWheel.CurrentSpeed, IntendedSpeed);
    @sysvarMember::Demo::BackLeftWheel.CurrentSpeed   = SpeedChange(@sysvarMember::Demo::BackLeftWheel.CurrentSpeed, IntendedSpeed); 
    @sysvarMember::Demo::BackRightWheel.CurrentSpeed  = SpeedChange(@sysvarMember::Demo::BackRightWheel.CurrentSpeed, IntendedSpeed);
  }
  // oversteering & right turn
  else if(@sysvarMember::Demo::VehicleSpeed.SteeringBehavior == 2 && @sysvarMember::Demo::VehicleSpeed.DirectionAngle > 0)
  {
    @sysvarMember::Demo::FrontLeftWheel.CurrentSpeed  = (1 - AngleFactor(@sysvarMember::Demo::FrontLeftWheel.CurrentSpeed, @sysvarMember::Demo::VehicleSpeed.DirectionAngle)) * SpeedChange(@sysvarMember::Demo::FrontLeftWheel.CurrentSpeed, IntendedSpeed);
    @sysvarMember::Demo::FrontRightWheel.CurrentSpeed = SpeedChange(@sysvarMember::Demo::FrontRightWheel.CurrentSpeed, IntendedSpeed);
    @sysvarMember::Demo::BackLeftWheel.CurrentSpeed   = SpeedChange(@sysvarMember::Demo::BackLeftWheel.CurrentSpeed, IntendedSpeed);
    @sysvarMember::Demo::BackRightWheel.CurrentSpeed  = SpeedChange(@sysvarMember::Demo::BackRightWheel.CurrentSpeed, IntendedSpeed); 
  }
}


double AngleFactor(double CurrentSpeed, double Angle)
{
  double Factor;
  
  Factor = 0.02 * sin(2 * pi * abs(Angle) / 360);
  
  return Factor;
}
