/*@!Encoding:1252*/
variables
{
  double AccelerationConstant = 7.4;  // m/s
  double DecelerationConstant = -5; // -10;  // m/s
  double AccelerationSlope = -0.211;
  double AccelerationOffset = 11.84;
  double AccelerationSectionConstant = 21;
}

double Acceleration(double i_CurrentSpeed)
{
  double AccelerationValue;
  
  // constant part
  if(i_CurrentSpeed <= AccelerationSectionConstant)
    AccelerationValue = AccelerationConstant;
  // decreasing part
  else
    AccelerationValue = i_CurrentSpeed * AccelerationSlope + AccelerationOffset;
  
  return AccelerationValue;
}


double Deceleration()
{
  return DecelerationConstant;
}