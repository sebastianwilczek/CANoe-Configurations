includes
{
}

variables
{
}

on sysvar sysvar::Control::var_threshold
{
	sysvar::VTS::VT2848.SetThreshold(0, @this);
}


on start
{
	sysvar::VTS::VT2848.SetThreshold(0, @sysvar::Control::var_threshold);
}
