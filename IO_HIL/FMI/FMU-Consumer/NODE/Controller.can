/*@!Encoding:1252*/
includes
{
  
}

variables
{
  
}



on preStart
{
  sysSetVariableFloat(sysvar::FMI::BouncingBall2::Parameter::BOUNCE_COF, @sysvar::BouncingBall::BounceCof);
  sysSetVariableFloat(sysvar::FMI::BouncingBall2::Parameter::GRAVITY, -@sysvar::BouncingBall::Gravity);
  sysSetVariableFloat(sysvar::FMI::BouncingBall2::Output::HEIGHT, 1.0);
  sysSetVariableInt(sysvar::FMI::BouncingBall2::Input::BOUNCE, 1);
}



on start
{
  enableControl("BouncingBall", "coeff_rest_up_down", 0);
  enableControl("BouncingBall", "gravity_up_down", 0);
}

on stopMeasurement
{
  enableControl("BouncingBall", "coeff_rest_up_down", 1);
  enableControl("BouncingBall", "gravity_up_down", 1);
}

on sysvar sysvar::BouncingBall::Bounce
{
  if (@this == 0)
  {
    sysSetVariableInt(sysvar::FMI::BouncingBall2::Input::BOUNCE, @sysvar::FMI::BouncingBall2::Input::BOUNCE + 1);
  }
}

