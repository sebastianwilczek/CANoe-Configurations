/*@@var:*/
variables 
{
}
/*@@end*/

/*@@startStart:Start:*/
on start
{
  CallAllOnEnvVar();    // call all envvar procedures of this model and
                        // thus consider the START VALUES of all environment
                        // variables for:  
                        //  - initialization of all message variables
                        //  - starting of any timers
                        //  - sending messages (output) with start values
}
/*@@end*/

/*@@sysvarUpdate:FDX::EngineSpeedEntry:*/
on sysvar_update sysvar::FDX::EngineSpeedEntry
{
  if(@sysvar::FDX::EngineStateSwitch) 
  {
    $EngineState::EngineSpeed = @this;
  }
}
/*@@end*/

/*@@sysvarUpdate:FDX::EngineStateSwitch:*/
on sysvar_update sysvar::FDX::EngineStateSwitch
{
  $EngineState::OnOff = @this;
  if(@this)
    $EngineState::EngineSpeed = @sysvar::FDX::EngineSpeedEntry;
  else
    $EngineState::EngineSpeed = 0;
}
/*@@end*/

