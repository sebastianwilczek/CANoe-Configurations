/*@@var:*/
variables 
{
  const long kOFF = 0;
  const long kON = 1;
}
/*@@end*/

/*@@msg:CAN1.easy::EngineState (0x123):*/
on message EngineState 
{  
  // engine state received
  if (this.dir == RX)
  {
    @sysvar::FDX::EngineStateDsp = this.OnOff;
    @sysvar::FDX::EngineSpeedDspText = this.EngineSpeed;
    @sysvar::FDX::EngineSpeedDspMeter = this.EngineSpeed / 1000.0;
  }
}
/*@@end*/

/*@@msg:CAN1.easy::LightState (0x321):*/
on message LightState 
{
  if (this.dir == RX)
  {
    SetLightDsp(this.HeadLight,this.FlashLight);
  }
}
/*@@end*/

/*@@caplFunc:SetLightDsp(long,long):*///function
SetLightDsp (long headLight, long hazardFlasher)
{
  if(headLight == kON) 
  {
    if(hazardFlasher == kON) {
      @sysvar::FDX::LightDsp = 7;
    } else if(hazardFlasher == kOFF) {
      @sysvar::FDX::LightDsp = 4;
    }
  }
  else if(headLight == kOFF) 
  {
    if(hazardFlasher == kON)  {
      @sysvar::FDX::LightDsp = 3;
    } else if(hazardFlasher == kOFF) {
      @sysvar::FDX::LightDsp = 0; 
    }
  }
}
/*@@end*/

