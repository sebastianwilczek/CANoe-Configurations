/*@@var:*/
variables 
{
   // This CAPL file is empty, because all processing is done in the FDX client program 
}
/*@@end*/

