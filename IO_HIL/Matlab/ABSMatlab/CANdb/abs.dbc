VERSION "DNNBNNNYNNNNNNNNNNNNNNNNNNYYYNNNNNNNNNNNNN/4/%%%/4/'%**4NNN///"

NS_ :

BS_:

BU_: Chassis

BO_ 3221225472 VECTOR__INDEPENDENT_SIG_MSG: 0 Vector__XXX
 SG_ OnOff : 0|2@1+ (1,0) [0|0] "" Vector__XXX

BO_ 0 ModelInfo: 8 Chassis
 SG_ lambda : 16|32@1- (0.01,0) [-3.4E+036|3.4E+036] "" Vector__XXX
 SG_ xF : 0|12@1+ (1,0) [0|4095] "" Vector__XXX

BO_ 292 SpeedInfo: 8 Chassis
 SG_ vF : 32|32@1- (1,0) [0|0] "" Vector__XXX
 SG_ vR : 0|32@1- (1,0) [0|0] "" Vector__XXX

BO_ 291 MotorState: 2 Chassis
 SG_ CarSpeed : 1|15@1- (1,0) [0|220] "km/h" Vector__XXX
 SG_ OnOff : 0|1@1+ (1,0) [0|0] ""  Chassis

CM_ BO_ 3221225472 "This is a message for not used signals, created by Vector CANdb++ DBC OLE DB Provider.";
BA_DEF_ BU_  "ILUsed" ENUM  "Yes","No";
BA_DEF_ SG_  "GenSigStartValue" FLOAT 0 1215752192;
BA_DEF_ SG_  "GenSigSendType" ENUM  "Cyclic","OnWrite","OnWriteWithRepetition","OnChange","OnChangeWithRepetition","IfActive","IfActiveWithRepetition";
BA_DEF_ BO_  "GenMsgDelayTime" INT 1 1000;
BA_DEF_ BO_  "GenMsgCycleTime" INT 2 50000;
BA_DEF_ BO_  "GenMsgSendType" ENUM  "Cyclic","not_used","not_used","not_used","not_used","Cyclic","not_used","IfActive";
BA_DEF_ BO_  "GenMsgCycleTimeFast" INT 2 100000;
BA_DEF_ BO_  "GenMsgILSupport" ENUM  "No","Yes";
BA_DEF_ BU_  "NodeLayerModules" STRING ;
BA_DEF_  "GenEnvVarPrefix" STRING ;
BA_DEF_  "GenEnvVarEndingSnd" STRING ;
BA_DEF_  "GenEnvVarEndingDsp" STRING ;
BA_DEF_DEF_  "ILUsed" "Yes";
BA_DEF_DEF_  "GenSigStartValue" 0;
BA_DEF_DEF_  "GenSigSendType" "Cyclic";
BA_DEF_DEF_  "GenMsgDelayTime" 1;
BA_DEF_DEF_  "GenMsgCycleTime" 2;
BA_DEF_DEF_  "GenMsgSendType" "not_used";
BA_DEF_DEF_  "GenMsgCycleTimeFast" 100;
BA_DEF_DEF_  "GenMsgILSupport" "Yes";
BA_DEF_DEF_  "NodeLayerModules" "CANoeILNLVector.dll";
BA_DEF_DEF_  "GenEnvVarPrefix" "Env";
BA_DEF_DEF_  "GenEnvVarEndingSnd" "_";
BA_DEF_DEF_  "GenEnvVarEndingDsp" "Dsp_";
BA_ "GenMsgSendType" BO_ 0 0;
BA_ "GenMsgCycleTime" BO_ 0 50;
BA_ "GenMsgSendType" BO_ 292 0;
BA_ "GenMsgCycleTime" BO_ 292 50;
BA_ "GenMsgCycleTime" BO_ 291 50;
BA_ "GenMsgSendType" BO_ 291 0;
BA_ "GenSigSendType" SG_ 3221225472 OnOff 3;
BA_ "GenSigStartValue" SG_ 291 CarSpeed 20;
SIG_VALTYPE_ 0 lambda : 1;
SIG_VALTYPE_ 292 vF : 1;
SIG_VALTYPE_ 292 vR : 1;
