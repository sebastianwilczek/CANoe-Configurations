/*@!Encoding:1252*/
includes
{
  #include "CANopenHelper.cin"
}

variables
{
  // ------------------------------------------------
  // File information
  // Copyright         : 2019, Vector Informatik GmbH
  // ------------------------------------------------

  // Globals for "I_O_Device_2" device
  BYTE gNodeId          = 11;
  char gNodeLabel[32]   = "I_O_Device_2";
  
  sysvarInt * gRunLEDVar;
  sysvarInt * gErrLEDVar;
}

on preStart
{
  gRunLEDVar = sysvar::GUIControls::Node11_State;
  gErrLEDVar = sysvar::GUIControls::Node11_ErrLed;
  @sysvar::GUIControls::Node11_ID = 11;
}

on sysvar CANopen::CAN::I_O_Device_2::Control::CommunicationState
{
  CANopenUpdateState(@this);
}

on sysvar CANopen::CAN::I_O_Device_2::Write_Output_8_Bit::Write_Output_8_Bit1
{
  DWORD value;
  value = @this;
  @sysvar::GUIControls::N11_6200_1_1 = (value & 0x01) ? 1 : 0;
  @sysvar::GUIControls::N11_6200_1_2 = (value & 0x02) ? 1 : 0;
  @sysvar::GUIControls::N11_6200_1_3 = (value & 0x04) ? 1 : 0;
  @sysvar::GUIControls::N11_6200_1_4 = (value & 0x08) ? 1 : 0;
  @sysvar::GUIControls::N11_6200_1_5 = (value & 0x10) ? 1 : 0;
  @sysvar::GUIControls::N11_6200_1_6 = (value & 0x20) ? 1 : 0;
  @sysvar::GUIControls::N11_6200_1_7 = (value & 0x40) ? 1 : 0;
  @sysvar::GUIControls::N11_6200_1_8 = (value & 0x80) ? 1 : 0;
}

on sysvar CANopen::CAN::I_O_Device_2::Write_Output_8_Bit::Write_Output_8_Bit2
{
  DWORD value;
  value = @this;
  @sysvar::GUIControls::N11_6200_2_1 = (value & 0x01) ? 1 : 0;
  @sysvar::GUIControls::N11_6200_2_2 = (value & 0x02) ? 1 : 0;
  @sysvar::GUIControls::N11_6200_2_3 = (value & 0x04) ? 1 : 0;
  @sysvar::GUIControls::N11_6200_2_4 = (value & 0x08) ? 1 : 0;
  @sysvar::GUIControls::N11_6200_2_5 = (value & 0x10) ? 1 : 0;
  @sysvar::GUIControls::N11_6200_2_6 = (value & 0x20) ? 1 : 0;
  @sysvar::GUIControls::N11_6200_2_7 = (value & 0x40) ? 1 : 0;
  @sysvar::GUIControls::N11_6200_2_8 = (value & 0x80) ? 1 : 0;
}