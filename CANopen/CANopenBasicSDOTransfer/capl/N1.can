/*@!Encoding:1252*/
includes
{
  #include "CANopenHelper.cin"
}

variables
{
  // ------------------------------------------------
  // File information
  // Copyright         : 2019, Vector Informatik GmbH
  // ------------------------------------------------

  // Globals for "Master" device
  BYTE gNodeId          = 1;
  char gNodeLabel[32]   = "Master";

  sysvarInt * gRunLEDVar;
  sysvarInt * gErrLEDVar;
}

on preStart
{
  gRunLEDVar = sysvar::GUIControls::Node1_State;
  gErrLEDVar = sysvar::GUIControls::Node1_ErrLed;
  @sysvar::GUIControls::Node1_ID = gNodeId;
}

on sysvar CANopen::CAN::Master::Control::CommunicationState
{
  CANopenUpdateState(@this);
}
