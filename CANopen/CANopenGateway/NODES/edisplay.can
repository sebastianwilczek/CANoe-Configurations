/*@@var:*/
variables{
}
/*@@end*/

/*@@msg:WheelSpeedInfo 65215X:*/
on PG WheelSpeedInfo
{
	int speed;
	speed = this.FrontAxleSpeed.phys;
   putValue(evShowSpeed,speed);
	
}
/*@@end*/

/*@@msg:EEC1 61444X:*/
on PG  EEC1
{
	putValue(evShowEngSpeed,this.EngineSpeed.phys);
//   putValue(evShowTemp,this.EngTemp.phys);
//   putValue(evShowIdle,this.IdleRunning);

	
	
}
/*@@end*/

/*@@pg:ETC2 61445X:*/
on pg ETC2
{
   putValue(evShowGear,this.CurrentGear);
}
/*@@end*/

/*@@pg:EngineTemp 65262X:*/
on pg EngineTemp
{
   putValue(evShowTemp,this.EngineCoolantTemperature.phys);
}
/*@@end*/

/*@@pg:PropGateway 61184X:*/
on PG PropGateway
{
	putvalue(evShowIdle,this.EngineRunning.phys); 
}
/*@@end*/

