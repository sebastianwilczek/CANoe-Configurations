/*@@var:*/
variables {
//	pg EEC2 msgEec2;
//	pg EBC1 msgEbc1;
//	pg ETC2 msgEtc2;
   pg EEC2 msgEec2 = { DLC=8, SA = 3};
	pg EBC1 msgEbc1 = { DLC=8,  SA = 3};
	pg ETC2 msgEtc2 = { DLC=8,  SA = 3};
	pg Brakes msgBrakes = {sa=3};
   mstimer etc2Timer;
   const int etc2Cycle = 100;
   mstimer ebc1Timer;
   const int ebc1Cycle = 40;
   mstimer brakeTimer;
   const int brakeCycle=100;
   
   int gGear = 0;         // 0 == neutral; 1- 5
}
/*@@end*/

/*@@envVar:evPedalPosition:*/
on envVar evPedalPosition
{
   int pedal;

   pedal =  GetValue(this);
   msgEec2.AcceleratorPedalPosition = pedal;
   output(msgEec2);
}
/*@@end*/

/*@@envVar:evBreakActive:*/
on envVar evBreakActive
{
	int breakPosition;
	breakPosition = getValue(this);
	breakPosition = breakPosition * 100;

   // this has to be modelled more accurately
   msgEbc1.BrakePedalPosition.phys = breakPosition;
  // output(ebc1);
}
/*@@end*/

/*@@envVar:evGear:*/
on envVar evGear
{
//  if (GetValue(this)>5) putValue(this,5);
// if (GetValue(this)<=0) putValue(this,0);

  gGear = GetValue(this);
  msgEtc2.CurrentGear = gGear;
  output(msgEtc2);
}
/*@@end*/

/*@@envVar:evGearDown:*/
on envVar evGearDown
{
	if (!getValue(this)) return;
   gGear = getValue(evGear);
   if (gGear == 0) { return; }
   gGear--;

   putValue(evGear,gGear);
}
/*@@end*/

/*@@envVar:evGearUp:*/
on envVar evGearUp
{
	if (!getValue(this)) return;
   gGear = getValue(evGear);
   if (gGear == 5) { return; }
   gGear++;
   putValue(evGear,gGear);
}
/*@@end*/

/*@@startStart:Start:*/
on start
{
   CallAllOnEnvVar();
   settimer(etc2Timer,etc2Cycle);
   settimer(ebc1Timer,ebc1Cycle);
   settimer(brakeTimer,brakeCycle);
   
}
/*@@end*/

/*@@timer:etc2Timer:*/
on timer etc2Timer
{
   settimer(etc2Timer,etc2Cycle);
   output(msgEtc2);
}
/*@@end*/

/*@@timer:ebc1Timer:*/
on timer ebc1Timer
{
   settimer(ebc1Timer,ebc1Cycle);
   output(msgEbc1);
}
/*@@end*/

/*@@envVar:evParkBrake:*/
on envVar evParkBrake
{
  msgBrakes.ParkingBrakeActuator.phys = getvalue(this);
  output(msgBrakes);
}
/*@@end*/

/*@@timer:brakeTimer:*/
on timer brakeTimer
{
   settimer(brakeTimer,brakeCycle);
   output(msgBrakes);
}
/*@@end*/

