/*@@var:*/
variables{
}
/*@@end*/

/*@@msg:PropGateway 61184X:*/
on PG PropGateway
{

	int engBenzinDisc;
	int engBenzinCont;

	putValue(evDispStarter,this.StarterKey);
	putValue(evDispIg15r,this.Ig_15R);
	putValue(evDispIg15,this.Ig_15);
	
	if(!this.EngineRunning.phys) 
	{
		engBenzinDisc= 0;
		engBenzinCont = 0;
	}
	else{
		engBenzinDisc= 3;
		engBenzinCont = 1;
	}
   putValue(evDispBenzin,engBenzinDisc);
	putValue(evKombiBenzin,engBenzinCont);
}
/*@@end*/

/*@@msg:WheelSpeedInfo 65215X:*/
on PG WheelSpeedInfo
{
	int dispSpeed = 0;

	if(this.FrontAxleSpeed.phys < 25) dispSpeed= 0;
	if(this.FrontAxleSpeed.phys >= 25) dispSpeed=1;
	if(this.FrontAxleSpeed.phys > 35) dispSpeed= 2;
	if(this.FrontAxleSpeed.phys  > 42) dispSpeed= 3;
	if(this.FrontAxleSpeed.phys  > 52) dispSpeed= 4;
	if(this.FrontAxleSpeed.phys  > 65) dispSpeed= 5;
	if(this.FrontAxleSpeed.phys  > 80) dispSpeed= 6;
	if(this.FrontAxleSpeed.phys  > 95) dispSpeed= 7;
	if(this.FrontAxleSpeed.phys  > 100) dispSpeed= 8;
	if(this.FrontAxleSpeed.phys  > 110) dispSpeed= 9;
	if(this.FrontAxleSpeed.phys  > 120) dispSpeed= 10;
	if(this.FrontAxleSpeed.phys  > 135) dispSpeed= 11;
	if(this.FrontAxleSpeed.phys  > 140) dispSpeed= 12;
	if(this.FrontAxleSpeed.phys  > 145) dispSpeed= 13;
	if(this.FrontAxleSpeed.phys  > 158) dispSpeed= 14;
	
	putValue(evDispSpeed,dispSpeed);
}
/*@@end*/

/*@@msg:EEC1 61444X:*/
on PG  EEC1
{
	int engSpeed;
	int engTemp;
	
	if(this.EngineSpeed.phys < 500) engSpeed = 0;
	if(this.EngineSpeed.phys >= 500) engSpeed = 1;
	if(this.EngineSpeed.phys > 1000) engSpeed = 2;
	if(this.EngineSpeed.phys > 1200) engSpeed = 3;
	if(this.EngineSpeed.phys > 1800) engSpeed = 4;
	if(this.EngineSpeed.phys > 2500) engSpeed = 5;	
	if(this.EngineSpeed.phys > 3000) engSpeed = 6;
	if(this.EngineSpeed.phys > 3500) engSpeed = 7;
	if(this.EngineSpeed.phys > 4000) engSpeed = 8;
	if(this.EngineSpeed.phys > 4500) engSpeed = 9;
	if(this.EngineSpeed.phys > 5000) engSpeed = 10;
	if(this.EngineSpeed.phys > 5500) engSpeed = 11;
	if(this.EngineSpeed.phys > 6000) engSpeed = 12;
	if(this.EngineSpeed.phys > 7000) engSpeed = 13;
	if(this.EngineSpeed.phys > 7500) engSpeed = 14;
   putValue(evDispEngSpeed,engSpeed);
}
/*@@end*/

/*@@pg:EngineTemp 65262X:*/
on pg EngineTemp
{
	int engTemp = 0;

	if(this.EngineCoolantTemperature.phys < 0) engTemp = 0;
	if(this.EngineCoolantTemperature.phys >= 0) engTemp = 1;
	if(this.EngineCoolantTemperature.phys > 80) engTemp = 2;
	if(this.EngineCoolantTemperature.phys > 110) engTemp = 3;
   putValue(evDispEngTemp,engTemp);
}
/*@@end*/

