/*@@var:*/
variables{
}
/*@@end*/

/*@@msg:PropGateway 61184X:*/
on PG PropGateway
{

	int engBenzinDisc;
	int engBenzinCont;

	putValue(evDispStarter,this.StarterKey);
	putValue(evDispIg15r,this.Ig_15R);
	putValue(evDispIg15,this.Ig_15);
	
	if(!this.EngineRunning.phys) 
	{
		engBenzinDisc= 0;
		engBenzinCont = 0;
	}
	else{
		engBenzinDisc= 3;
		engBenzinCont = 1;
	}
   putValue(evDispBenzin,engBenzinDisc);
	putValue(evKombiBenzin,engBenzinCont);

}
/*@@end*/

/*@@msg:WheelSpeedInfo 65215X:*/
on PG WheelSpeedInfo
{
	float speed;
	speed = this.FrontAxleSpeed.phys;
	putValue(evKombiSpeed,speed);
	
}
/*@@end*/

/*@@msg:EEC1 61444X:*/
on PG  EEC1
{
	putValue(evKombiEngSpeed,this.EngineSpeed.phys);
//	putValue(evKombiEngTemp,this.EngTemp.phys);

	
	
}
/*@@end*/

/*@@pg:EngineTemp 65262X:*/
on pg EngineTemp
{
   putValue(evKombiEngTemp,this.EngineCoolantTemperature.phys);
}
/*@@end*/

