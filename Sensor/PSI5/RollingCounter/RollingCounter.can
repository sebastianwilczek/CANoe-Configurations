/*@!Encoding:1252*/
includes
{
  #include "RollingCounter.cin" 
}

variables
{
  //size of the value array
  const int gValueArraySize = 25;
  //value array to prepare the data for the queueing
  float gValueArray[gValueArraySize];
  //timer intervall to queue the values in ms
  const int gQueueTimerInterval = 25;
}

//Sets the system variable to use 
void SetSensor()
{
  //sensor variable initialization
  gSensor = sysvar::SENSOR::PSI5::SENSORSIM::Sensor1::TimeSlot1::Signals::RollingCounter_Stim;
}