/*@!Encoding:1252*/
includes
{
  
}

variables
{
  mstimer PSI5CommunicationUpdateTimer;
  mstimer PSI5AnimationTimer;
  byte gAnimationCounter = 0;
  
}

on start
{
  setTimerCyclic(PSI5CommunicationUpdateTimer,1);
  setTimerCyclic(PSI5AnimationTimer,250);
  
  // The PSI5 demo cn only be used with real hardware
  write("\n");
  writeDbgLevel(15,"PSI5Basic Demo has to use VTSystem with VT2710 module\nand real wired PSI5 ports including PSI5 Piggies");
  write("\n");
  
  // to run that configuration, a real VTSystem with additional VT2710 module is necessary at least.
  if (isSimulated())
  {
    writeDbgLevel(15,"!!! Demo can't run in simulated mode!, Simulation stopped !!!\n");
    StopCANoe();    
  }  
}

on preStart
{
  // start condition
  @sysvar::PSI_Communication::sysvarSensorSliderSignal1 = 511;
}

on timer PSI5CommunicationUpdateTimer
{
  // transfer simulation data to PSI variables
  @SENSOR::PSI5::Sensor::Sensor1::TimeSlot1::Signals::Signal1_Stim = @sysvar::PSI_Communication::sysvarSensorSliderSignal1;
  @SENSOR::PSI5::Sensor::Sensor1::TimeSlot1::Signals::Signal2_Stim = @sysvar::PSI_Communication::sysvarSensorSliderSignal2;

}

on timer PSI5AnimationTimer
{  
  // data are animated each 250 ms
  @sysvar::PSI_Communication::sysvarSensorSliderSignal1 = @sysvar::PSI_Communication::sysvarSensorSliderSignal1 + 4;
  
  // check current value to order to stay in data type range
  if (@sysvar::PSI_Communication::sysvarSensorSliderSignal1 > 1023)
    @sysvar::PSI_Communication::sysvarSensorSliderSignal1 = 0; 
  
}

void StopCANoe()
{
  stop();
}

