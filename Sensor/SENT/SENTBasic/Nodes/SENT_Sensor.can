/*@!Encoding:1252*/variables
{
  msTimer CommunicationUpdateTimer;
  byte gAnimationValue = 0;
  byte gFirstValidFlag = 0;
}

on start
{
  write("\n");
  writeDbgLevel(15,"SENTBasic Demo has to use VTSystem with VT2710 module \nand real wired SENT ports");
  write("\n");
  
  if (isSimulated())
  {
    write("\n");
    writeDbgLevel(15,"!!! Demo can't run in simulated mode!, Simulation stopped !!!");
    write("\n");
    StopCANoe();    
  }
  
  SetTimerCyclic(CommunicationUpdateTimer,20);    
}

on timer CommunicationUpdateTimer
{
  // animate at least one signal in panel
  gAnimationValue = gAnimationValue+ 1;
  
  // limit data range 
  if ( 64 > (@sysvar::SENT_Communication::sysvarSensorSignal1 + gAnimationValue) )
  {
    ; // signal does not exceed data range  
  }
  else
  {
    gAnimationValue = 0;
    
    if ( 0 == gFirstValidFlag )
    {
      write("Ramp Signal is always limited to 63 to fit into one single nibble for SENT communication");
      gFirstValidFlag = 1;
    }
  }  
  
  // call function to transfer data into objects to be transferred by SENT communication
  SensorSignalUpdate();  
}


void SensorSignalUpdate()
{
  // transfer actual values into signals, defined by SENSOR::SENT menue
  @sysvar::SENSOR::SENT::Sensor::Sensor::Signals::VariableSignal_Stim = @sysvar::SENT_Communication::sysvarSensorSignal2;
  @sysvar::SENSOR::SENT::Sensor::Sensor::Signals::RampSignal_Stim = (@sysvar::SENT_Communication::sysvarSensorSignal1 + gAnimationValue);

}
void StopCANoe()
{
  stop();
}

