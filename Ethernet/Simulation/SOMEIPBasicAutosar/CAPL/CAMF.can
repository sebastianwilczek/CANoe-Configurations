/*@!Encoding:1252*/
includes
{
  
}

variables
{
  
}



on sysvar sysvar::CAMF::EnableService
{
  char  serviceName[20] = "sif_2001";
  char  text[200];
  long  result;
  dword csi;
  
  csi = AREthGetProvidedObjectHandle( serviceName );
  
  if (csi == 0)
  {
    AREthGetLastErrorText( elcount(text), text );
    writeLineEx( 0, 3, "<%NODE_NAME%> AREthGetProvidedObjectHandle(%s) failed: %s", serviceName, text );
    return;
  }
  
  result = AREthSDSetServiceStatus( csi, @this );

  if (result != 0)
  {
    AREthGetLastErrorText( elcount(text), text );
    writeLineEx( 0, 3, "<%NODE_NAME%> AREthSDSetServiceStatus( 0x%X, 0) failed: %s", csi, text );
    return;
  }
}

