AUTOSAR XML (schema 4-2-2)
package /Vector
  ethernet cluster Vehicle_Ethernet: baudrate=100000000, protocol-name=ETHERNET, speed=100
    ethernet physical channel adas_channel: comm-connectors=[adas_adas_connector, camf_adas_connector]
      pdu triggering pdu_triggering_TrafficSignDetectionPDU: pdu=TrafficSignDetectionPDU, from CAMF, to ADAS
      network endpoint adas_adas_nep: network-endpoint-addresses=ipv-4-configuration={ipv-4-address=192.168.3.4, ipv-4-address-source=FIXED, network-mask=255.255.255.0}
      network endpoint camf_adas_nep: network-endpoint-addresses=ipv-4-configuration={ipv-4-address=192.168.3.6, ipv-4-address-source=FIXED, network-mask=255.255.255.0}
      so-ad-config:
        socket connection bundle ID3: socket-connection=socket_address_adas_adas_aep, pdus=socket-connection-ipdu-identifier={header-id=131170404, pdu-triggering=pdu_triggering_TrafficSignDetectionPDU, routing-group=adas_adas_display_info_ceg}, server-port=socket_address_camf_adas_aep
        socket address socket_address_adas_adas_aep: connector=adas_adas_connector
          application endpoint adas_adas_aep: network-endpoint=adas_adas_nep, tp-configuration=udp-tp=udp-tp-port=port-number=30500
            consumed service instance adas_adas_display_info_csi: routing-group=CameraObjectDetection, provided-service-instance=ADASDisplayInfo, sd-client-config={client-service-major-version=1, client-service-minor-version=0, initial-find-behavior={initial-delay-max-value=0.05, initial-delay-min-value=0.05, initial-repetitions-base-delay=0.1, initial-repetitions-max=3}, ttl=3}
              consumed event group adas_adas_display_info_ceg: application-endpoint=adas_adas_aep, event-group-identifier=1, routing-group=adas_adas_display_info_ceg
        socket address socket_address_camf_adas_aep: connector=camf_adas_connector
          application endpoint camf_adas_aep: network-endpoint=camf_adas_nep, tp-configuration=udp-tp=udp-tp-port=port-number=30500
            provided service instance ADASDisplayInfo: routing-group=CameraObjectDetection, instance-identifier=1, sd-server-config={initial-offer-behavior={initial-delay-max-value=0.05, initial-delay-min-value=0.05, initial-repetitions-base-delay=0.1, initial-repetitions-max=3}, offer-cyclic-delay=2.0, server-service-major-version=1, server-service-minor-version=0, ttl=3}, service-identifier=2001
              event handler ADASDisplayInfo_eh: application-endpoint=camf_adas_aep, consumed-event-group=adas_adas_display_info_ceg
      vlan VLAN_ADAS: vlan-identifier=3
package /Vector/ECUs
  ecu instance ADAS
    ethernet communication controller adas_controller: mac-unicast-address=02:00:00:00:01:04
    ethernet communication connector adas_adas_connector: comm-controller=adas_controller, network-endpoint=adas_adas_nep
  ecu instance CAMF
    ethernet communication controller camf_controller: mac-unicast-address=02:00:00:00:01:06
    ethernet communication connector camf_adas_connector: comm-controller=camf_controller, network-endpoint=camf_adas_nep
package /Vector/PDUs
  pdu TrafficSignDetectionPDU: length=18, unused-bit-pattern=0
    signal TrafficSignDetectionSerialized: start 0, little-endian, data-transformations=SOMEIP, someip-transformation-i-signal-props{transformer=someip_transformer, interface-version=1}, to ADAS
package /Vector/CompuMethods
  compu method Temperature: phys=raw*0.1-273.15; unit °C
  compu method Speed: phys=raw*0.1; unit km/h
  compu method Current: phys=raw*0.001-1000; unit A
  compu method Power: phys=raw*0.001-1000; unit kW
  compu method Capacity: phys=raw*0.001; unit kWh
  compu method frame_rate_cm: ; unit fr/sec
package /Vector/Units
  8 x unit:
    degree: display-name=°C
    kmh: display-name=km/h
    meter: display-name=m
    ampere: display-name=A
    kw: display-name=kW
    kwh: display-name=kWh
    detectionReliability_unit: display-name=%
    frsec: display-name=fr/sec
package /Vector/RoutingGroups
  so ad routing group adas_adas_display_info_ceg: event-group-control-type=ACTIVATION-UNICAST
  so ad routing group CameraObjectDetection: event-group-control-type=ACTIVATION-UNICAST
package /Vector/ApplicationDataTypes
  application array data type DetectedTrafficSigns: category=ARRAY
    element DetectedTrafficSign: category=STRUCTURE, type=DetectedTrafficSign, array-size-semantics=FIXED-SIZE, max-number-of-elements=3
  application record data type DetectedTrafficSign: category=STRUCTURE
    application record element SignType: category=VALUE, type=signType_dt
    application record element DistanceToSign: category=VALUE, type=signDistance_dt
    application record element Reliability: category=VALUE, type=detectionReliability_dt
  5 x app type, all with category=VALUE:
    signType_dt
    signDistance_dt
    detectionReliability_dt
    activate_dt
    activate_result_dt
  application record data type TrafficSignDetection: category=STRUCTURE
    application record element DetectedTrafficSign: category=STRUCTURE, type=DetectedTrafficSigns
package /Vector/ImplementationDataTypes
  8 x impl type:
    DetectedTrafficSigns: category=ARRAY
      element DetectedTrafficSigns: array-size=3, array-size-semantics=FIXED-SIZE, implementation-data-type=DetectedTrafficSign
    DetectedTrafficSign: category=STRUCTURE
      element SignType: implementation-data-type=signType_dt
      element DistanceToSign: implementation-data-type=signDistance_dt
      element Reliability: implementation-data-type=detectionReliability_dt
    signType_dt: category=VALUE, base-type=A_UINT8, compu {0=NoObject, 1=SpeedLimit30Sign, 2=SpeedLimit50Sign, 3=SpeedLimit60Sign, 4=SpeedLimit70Sign, 5=SpeedLimit80Sign, 6=SpeedLimit100Sign, 7=NoLimit80Sign, 8=NoPassingZoneSign, 9=NoPassingZoneEndSign, 10=HazardSign, 11=HazardEndSign, 12=RoadworkSign, 13=RoadworkEndSign}
    signDistance_dt: category=VALUE, base-type=A_UINT32, compu {phys=raw*0.1-1000000, 0=NoDistance; unit m}
    detectionReliability_dt: category=VALUE, base-type=A_UINT8, compu {; unit %}
    activate_dt: category=VALUE, base-type=A_BOOL, compu {0=Deactivate, 1=Activate}
    activate_result_dt: category=VALUE, base-type=A_BOOL, compu {0=Failed, 1=Success}
    TrafficSignDetection: category=STRUCTURE
      element DetectedTrafficSign: implementation-data-type=DetectedTrafficSigns
package /Vector/DataTypeMappings
  data type mapping set DATA_TYPE_MAPPING_SET
    data-type-maps:
      application-data-type=TrafficSignDetection, implementation-data-type=TrafficSignDetection
      application-data-type=DetectedTrafficSigns, implementation-data-type=DetectedTrafficSigns
      application-data-type=DetectedTrafficSign, implementation-data-type=DetectedTrafficSign
      application-data-type=signType_dt, implementation-data-type=signType_dt
      application-data-type=signDistance_dt, implementation-data-type=signDistance_dt
      application-data-type=detectionReliability_dt, implementation-data-type=detectionReliability_dt
      application-data-type=activate_dt, implementation-data-type=activate_dt
      application-data-type=activate_result_dt, implementation-data-type=activate_result_dt
package /Vector/PortInterfaces
  sender receiver interface SenderReceiver
    data TrafficSignDetection: type=TrafficSignDetection
  client server interface CameraObjectDetection: category=CONTROL, is-service=true
    operation StartStop
      arg Activate: type=activate_dt, direction=IN
      arg Result: type=activate_result_dt, direction=OUT
package /Vector/SystemsMappings
  system System
    system mapping SystemMapping: sender-receiver-to-signal-mapping{data-element=TrafficSignDetection, system-signal=TrafficSignDetectionSerialized}
package /Vector/Transformer
  data transformation set transformation_set
    data transformation SOMEIP: transformer-chain=someip_transformer
    transformation technology someip_transformer: buffer-properties={header-length=64, in-place=false}, protocol=SOMEIP, someip-transformation-description{alignment=8, byte-order=little-endian, interface-version=1}, transformer-class=SERIALIZER, version=1
package /AUTOSAR/BaseTypes
  5 x base type:
    A_BOOL: base-type-size=8, base-type-encoding=BOOLEAN
    A_UINT8: base-type-size=8, base-type-encoding=NONE
    A_UINT16: base-type-size=16, base-type-encoding=NONE
    A_UINT32: base-type-size=32, base-type-encoding=NONE
    A_FLOAT64: base-type-size=64, base-type-encoding=IEEE754
