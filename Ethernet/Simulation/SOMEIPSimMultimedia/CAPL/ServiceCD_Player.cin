/*@!Encoding:1252*/
variables
{  
  //
  // Service "CDPlayer"
  //
  const word kCDPlayerServiceId = 10;
    
  char kTimePositionDiskTime[1024] = "diskTime";
  char kTimePositionTrackTime[1024] = "trackTime";
  char kTimePositionTitleTime[1024] = "titleTime";
      
  char kMediaInfoMediaTitle[1024] = "mediaTitle";
  char kMediaInfoMediaType[1024] = "mediaType";
  char kMediaInfoMediaFileSystem[1024] = "mediaFileSystem";
  char kMediaInfoFirstTrack[1024] = "firstTrack";
  char kMediaInfoLastTrack[1024] = "lastTrack";
  char kMediaInfoPlayTime[1024] = "playTime";
  
  char kPeakLevelLevelLeft[1024] = "levelLeft";
  char kPeakLevelLevelRight[1024] = "levelRight";
  
  char kAudioDiskInfoAudioTitle[1024] = "audioTitle";
  char kAudioDiskInfoAudioTime[1024] = "audioTime";
  char kAudioDiskInfoTrackNo[1024] = "trackNo";
  char kAudioDiskInfoAudioFilename[1024] = "audioFilename";
  
  char kCDPlayerParameterNSteps[9] = "NSteps";
  
  enum DeckStatus
  {
    kDeckStatusPlay = 0,
    kDeckStatusStop = 1,
    kDeckStatusPause = 2,
    kDeckStatusLoad = 3,
    kDeckStatusUnload = 4,
    kDeckStatusSearch_Forward = 5,
    kDeckStatusSearch_Backward = 6 
  };
    
  enum MagazineStatus
  {
    kMagazineStatusNoMagazine = 0,
    kMagazineStatusMagazineLoaded = 1,
    kMagazineStatusDiskCheck = 2,
    kMagazineStatusDiskChange = 3
  };
  
  enum MediaType
  {
    kMediaTypeNoDiskUnknown = 0,
    kMediaTypeAudio = 1,
    kMediaTypeVideo = 2,
    kMediaTypeROM = 3,
    kMediaTypeMixed = 4 
  };
  
  enum MediaFileSystem
  {
    kMediaFileSystemNoDiskUnknown = 0,
    kMediaFileSystemCDDA = 1,
    kMediaFileSystemBridgeDisc = 2,
    kMediaFileSystemISO9660 = 3,
    kMediaFileSystemJoliet = 4,
    kMediaFileSystemPhotoCD = 5,
    kMediaFileSystemHFS = 6,
    kMediaFileSystemCDi = 7,
    kMediaFileSystemCDExtra = 8,
    kMediaFileSystemCDXA = 9,
    kMediaFileSystemUDF = 10    
  };
}
