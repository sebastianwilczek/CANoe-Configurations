/*@!Encoding:1252*/
includes
{
  
}

variables
{ 
  const dword kAvbOK = 0;
  const dword kAvbIoPending = 460609;
  const dword kAvbInsufficientBuffer = 460607;
  const dword kAvbDataOmmitted = 460611;
  const dword kAvbPresentationTimeLessThanPacketTime = 460618;
   
  const dword kInvalidHandle = 0;
}

long CheckHandleAndStopIfError(dword handle, char function[])
{
  char text[256];
  
  if (handle == kInvalidHandle)
  {
    strncpy(text, function, elCount(text));
    strncat(text, " returned 0, AvbGetLastError", elCount(text));
    
    return StopIfError(AvbGetLastError(), text);
  }
  
  return kAvbOK;
}

long StopIfError(long returnCode, char function[])
{
  if (returnCode != kAvbOK && returnCode != kAvbIoPending)
  {
    WriteErrorAndStop(returnCode, function);
    return returnCode;
  }
  
  return kAvbOK;
}

void WriteErrorAndStop(long errorCode, char function[])
{
  char text[256];
  
  snprintf(text, elCount(text), "%s returned ", function);
 
  WriteErrorAndStop(text, errorCode);
}

void WriteErrorAndStop(char text[], long errorCode)
{
  char textOut[256], lastErrorText[256];
  long ret;
    
  ret = AvbGetLastErrorText(elCount(lastErrorText), lastErrorText);
  
  if (ret == 0)
  {
    strncpy(lastErrorText, "AvbGetLastErrorText returned 0", elCount(lastErrorText));
  }
    
  PrependCaplFileName(text, textOut);
  
  snprintf(text, elCount(text), "%d (%s)", errorCode, lastErrorText);
  strncat(textOut, text, elCount(textOut));
  
  write(textOut);
  Stop();
}

void WriteAndStop(char text[])
{
  char textOut[256];
  
  PrependCaplFileName(text, textOut);
  
  write(textOut);
  Stop();
}

void WriteAndStop(char text[], long value)
{
  char textOut[256];
  
  PrependCaplFileName(text, textOut);
  
  snprintf(text, elCount(text), textOut, value);
  
  write(text);
  Stop();
}

void WriteAndStop(char text[], long value1, long value2)
{
  char textOut[256];
  
  PrependCaplFileName(text, textOut);
  
  snprintf(text, elCount(text), textOut, value1, value2);
  
  write(text);
  Stop();
}

void PrependCaplFileName(char inText[], char outText[])
{
  strncpy(outText, "%BASE_FILE_NAME%: ", elCount(outText));
  strncat(outText, inText, elCount(outText));
}