/*@!Encoding:1252*/
void memset(byte dest[], byte value, dword size)
{
  dword i;
  for(i=0; i<size; i++)
  {
    dest[i] = value;
  }
}

void memset(char dest[], char value, dword size)
{
  dword i;
  for(i=0; i<size; i++)
  {
    dest[i] = value;
  }
}