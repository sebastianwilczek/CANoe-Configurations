/*@!Encoding:1252*/
/*
 * DHCP Client
 *
 * Copyright 2015, Vector Informatik GmbH - All right reserved
 *
 * The DHCP client checks cyclic its IP address and the gateway
 * address and writes the result to the panel.
 */
includes
{
  #include "Ethernet.cin"
}

variables
{
  msTimer cyclicCheck; // the timer to check the addresses each second
  char namespace[8] = "Client2";
}

/*
  The on start handler activates the cyclic timer with a period 
  of one second.
*/
on start
{
  setTimerCyclic(cyclicCheck, 0, 1000);
}

/*
  The handler for the Timer
*/
on timer cyclicCheck
{
  UpdatePanel();
}

/*
  Get the addresses, convert them to a string and update the panel
*/
void UpdatePanel()
{
  dword result;
  byte macId[6];
  char macIdStr[18];
  char ipAddr[16];
  char mask[16];
  char gateway[16];
  
  // get mac id and write it to the panel
  result = IpGetAdapterMacId(1, macId);
  if(result == 0)
  {
    EthMacId2Str(macId, 0, macIdStr);   
  }
  else
  {
    strncpy(macIdStr, "-", elcount(macId));
  }
  sysSetVariableString(namespace, "MacId", macIdStr);
 
  // get ip address and write it to the panel
  result = IpGetAdapterAddressAsString(1, ipAddr, elcount(ipAddr));
  if(result != 0)
  {
    strncpy(ipAddr, "-", elcount(macId));
  }
  sysSetVariableString(namespace, "IpAddress", ipAddr);
  
  // get netmask and write it to the panel
  result = IpGetAdapterMaskAsString(1, mask, elcount(mask));
  if(result != 0)
  {
    strncpy(mask, "-", elcount(macId));
  }
  sysSetVariableString(namespace, "Mask", mask);
  
  // get default gateway and write it to the panel
  result = IpGetAdapterGatewayAsString(1, gateway, elcount(gateway));
  if(result != 0)
  {
    strncpy(gateway, "-", elcount(macId));
  }
  sysSetVariableString(namespace, "DefaultGateway", gateway);
}
