/*@!Encoding:1252*/
variables
{
  // udp constants
  const int kUDP_HDR_LEN = 8;
    
  _align(1) struct udp_header
  {
    word uh_sport; /* source port */
	  word uh_dport; /* destination port */
	  word uh_ulen;  /* udp length */
	  word uh_sum;   /* udp checksum */
  };
}

