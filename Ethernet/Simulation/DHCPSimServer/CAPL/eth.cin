/*@!Encoding:1252*/
variables
{
  // ethernet constants and header
  const int kETHER_ADDR_LEN = 6;
  const int kETHER_TYPE_LEN = 2;
  const int kETHER_HDR_LEN = kETHER_ADDR_LEN*2+kETHER_TYPE_LEN;
  const int kETHER_TYPE_OFFSET = kETHER_ADDR_LEN*2;
  
  //ether types
  const int kETHERTYPE_IP = 0x0800;  /* IP protocol */
  const int kETHERTYPE_ARP = 0x0806; /* Address resolution protocol */
  
  _align(1) struct ether_header
  {
    byte ether_dhost[kETHER_ADDR_LEN];
    byte ether_shost[kETHER_ADDR_LEN];
    word ether_type;
  };
}

