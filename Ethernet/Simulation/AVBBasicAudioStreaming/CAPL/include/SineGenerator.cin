/*@!Encoding:1252*/
includes
{
  #include "MediaClock.cin"
}

variables
{  
  const dword kSineGenerator_MaxBuffers = kMediaClock_MaxBuffers;
  
  qword gSineGeneratorStartPtpTime;
  word gSineGeneratorFrequencyHz;
  
  const float kPi = 3.14159265359;
}

void OnMediaClockTimer(qword times[], dword count)
{
  dword i;
  float values[kMediaClock_MaxBuffers];
  
  for (i = 0; i < count; i++)
  {
    values[i] = sin((float)((times[i] - gSineGeneratorStartPtpTime) * 2) * (float)gSineGeneratorFrequencyHz * kPi / 1000000000.);
  }
  
  OnSineGeneratorTimer(values, count);
}

void SineGenerator_Start(word clockRate100Hz, word sineFrequencyHz)
{ 
  gSineGeneratorFrequencyHz = sineFrequencyHz;
  gSineGeneratorStartPtpTime = PtpTimeNow();
  
  MediaClock_Start(clockRate100Hz);
}

void SineGenerator_Stop()
{
  MediaClock_Stop();
}

void SineGenerator_SetFrequency(word sineFrequencyHz)
{
  gSineGeneratorFrequencyHz = sineFrequencyHz;
}