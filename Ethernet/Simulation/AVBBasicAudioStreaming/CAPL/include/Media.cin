/*@!Encoding:1252*/
includes
{
  
}

long MediaCheckHandleAndStopIfError(dword handle, char function[])
{
  char text[256];
  
  if (handle == 0)
  {
    strncpy(text, function, elCount(text));
    strncat(text, " returned 0, MediaGetLastError", elCount(text));
    
    return MediaStopIfError(MediaGetLastError(), text);
  }
  
  return kAvbOK;
}

long MediaStopIfError(long returnCode, char function[])
{
  if (returnCode != kAvbOK && returnCode != kAvbIoPending)
  {
    MediaWriteErrorAndStop(returnCode, function);
    return returnCode;
  }
  
  return kAvbOK;
}

void MediaWriteErrorAndStop(long errorCode, char function[])
{
  char text[256];
  
  snprintf(text, elCount(text), "%s returned ", function);
 
  MediaWriteErrorAndStop(text, errorCode);
}

void MediaWriteErrorAndStop(char text[], long errorCode)
{
  char textOut[256];
  long ret;
    
  PrependCaplFileName(text, textOut);
  
  snprintf(text, elCount(text), "%d", errorCode);
  strncat(textOut, text, elCount(textOut));
  
  write(textOut);
  Stop();
}