/*@!Encoding:1252*/
includes
{
  
}

variables
{
  
}

on *
{
  output( this );
}

on pdu EMotorStatus
{
  int lastCheckOk = 1;
  
  if (this.EMotorTemperature.phys > 150.0)
  {
    // write warning only once
    if (lastCheckOk == 1) 
    {
      dword ipv4SourceAddress;
      dword udpSourcePort;
      char  text[100];
      
      lastCheckOk = 0;
    
      GetPDUsTPIPv4SrcAddr( this, ipv4SourceAddress );
      GetPDUsTPUDPSrcPort(this, udpSourcePort );
      
      snprintf( text, elcount(text), "EMotorTemperature from %d.%d.%d.%d:%d is to high (%f)\n",
                (ipv4SourceAddress & 0xFF), ((ipv4SourceAddress >> 8) & 0xFF), ((ipv4SourceAddress >> 16) & 0xFF), ((ipv4SourceAddress >> 24) & 0xFF),   
                udpSourcePort, this.EMotorTemperature.phys );
     
      putValueToControl( "PDUObserver", "CAPLOutputView", text );
    }
  }
  else
  {
    lastCheckOk = 1;
  }
}
