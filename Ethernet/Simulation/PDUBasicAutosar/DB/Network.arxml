AUTOSAR XML (schema 4-2-2)
package /Vector
  ethernet cluster Vehicle_Ethernet: baudrate=100000000, protocol-name=ETHERNET, speed=100
    ethernet physical channel powertrain_chassis_channel: comm-connectors=[vgw_pt_connector, ic_pt_connector]
      pdu triggering pdu_triggering_EMotorStatus: pdu=EMotorStatus, from VGW, to IC
      network endpoint vgw_pt_nep: network-endpoint-addresses=ipv-4-configuration={ipv-4-address=192.168.2.1, ipv-4-address-source=FIXED, network-mask=255.255.255.0}
      network endpoint ic_pt_nep: network-endpoint-addresses=ipv-4-configuration={ipv-4-address=192.168.2.2, ipv-4-address-source=FIXED, network-mask=255.255.255.0}
      so-ad-config:
        socket connection bundle ID3: socket-connection=socket_address_ic_pt_aep, pdus=socket-connection-ipdu-identifier={header-id=65601636, pdu-triggering=pdu_triggering_EMotorStatus, routing-group=ic_pt_engine_ceg}, server-port=socket_address_vgw_pt_aep
        socket address socket_address_vgw_pt_aep: connector=vgw_pt_connector
          application endpoint vgw_pt_aep: network-endpoint=vgw_pt_nep, tp-configuration=udp-tp=udp-tp-port=port-number=40001
            provided service instance Engine: instance-identifier=1, sd-server-config={initial-offer-behavior={initial-delay-max-value=0.05, initial-delay-min-value=0.05, initial-repetitions-base-delay=0.1, initial-repetitions-max=3}, offer-cyclic-delay=2.0, server-service-major-version=1, server-service-minor-version=0, ttl=3}, service-identifier=1001
              event handler Engine_eh: application-endpoint=vgw_pt_aep, consumed-event-group=ic_pt_engine_ceg
        socket address socket_address_ic_pt_aep: connector=ic_pt_connector
          application endpoint ic_pt_aep: network-endpoint=ic_pt_nep, tp-configuration=udp-tp=udp-tp-port=port-number=40001
            consumed service instance ic_pt_emotor_csi: provided-service-instance=Engine, sd-client-config={client-service-major-version=1, client-service-minor-version=0, initial-find-behavior={initial-delay-max-value=0.05, initial-delay-min-value=0.05, initial-repetitions-base-delay=0.1, initial-repetitions-max=3}, ttl=3}
              consumed event group ic_pt_engine_ceg: application-endpoint=ic_pt_aep, event-group-identifier=1, routing-group=ic_pt_engine_ceg
      vlan VLAN_Powertrain_Chassis: vlan-identifier=2
package /Vector/ECUs
  ecu instance VGW
    ethernet communication controller vgw_controller: mac-unicast-address=02:00:00:00:01:01
    ethernet communication connector vgw_pt_connector: comm-controller=vgw_controller, network-endpoint=vgw_pt_nep
  ecu instance IC
    ethernet communication controller ic_controller: mac-unicast-address=02:00:00:00:01:02
    ethernet communication connector ic_pt_connector: comm-controller=ic_controller, network-endpoint=ic_pt_nep
package /Vector/PDUs
  pdu EMotorStatus: length=12, transmission-mode-true-timing=cyclic-timing=time-period=0.1, unused-bit-pattern=0
    signal EMotorSpeed: start 0, 16 bit, little-endian, data-type-policy=OVERRIDE, base-type=A_UINT16, compu {phys=(0+0.1*raw)/(1); unit rpm}, to IC
    signal EMotorTemperature: start 16, 16 bit, little-endian, data-type-policy=OVERRIDE, base-type=A_UINT16, compu {phys=raw*0.1-273.15; unit °C}, to IC
    signal EMotorCurrent: start 32, 32 bit, little-endian, data-type-policy=OVERRIDE, base-type=A_UINT32, compu {phys=raw*0.001-1000; unit A}, to IC
    signal EMotorPower: start 64, 32 bit, little-endian, data-type-policy=OVERRIDE, base-type=A_UINT32, compu {phys=raw*0.001-1000; unit kW}, to IC
package /Vector/CompuMethods
  compu method Speed: phys=raw*0.1; unit km/h
  compu method Distance: phys=raw*0.1-1000000, 0=NoDistance; unit m
  compu method Capacity: phys=raw*0.001; unit kWh
package /Vector/Units
  7 x unit:
    degree: display-name=°C
    kmh: display-name=km/h
    meter: display-name=m
    ampere: display-name=A
    kw: display-name=kW
    kwh: display-name=kWh
    rpm: display-name=rpm
package /Vector/RoutingGroups
  so ad routing group ic_pt_engine_ceg: event-group-control-type=ACTIVATION-UNICAST
package /AUTOSAR/BaseTypes
  5 x base type:
    A_BOOL: base-type-size=8, base-type-encoding=BOOLEAN
    A_UINT8: base-type-size=8, base-type-encoding=NONE
    A_UINT16: base-type-size=16, base-type-encoding=NONE
    A_UINT32: base-type-size=32, base-type-encoding=NONE
    A_FLOAT64: base-type-size=64, base-type-encoding=IEEE754
