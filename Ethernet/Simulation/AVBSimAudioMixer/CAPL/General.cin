/*@!Encoding:1252*/
includes
{
}

variables
{  
  const word  kMaxInt = 32768;
  
  const dword kOK = 0;
  const dword kInvalidHandle = 0;
  const dword kMacIdSize = 6;
}

void Assert(byte expression, char expressionS[])
{
  char exp[1024] = "Assertion raised: ";
  
  if (expression == 0)
  {
    strncat(exp, expressionS, elCount(exp));
    WriteAndStop(exp);
    return;
  }
}

void WriteAndStop(char text[])
{
  char textOut[256];
  
  PrependCaplFileName(text, textOut);
  
  write(textOut);
  Stop();
}

void WriteAndStop(char text[], long value)
{
  char textOut[256], textOut2[256];
  
  PrependCaplFileName(text, textOut);
  
  snprintf(textOut2, elCount(textOut2), textOut, value);
  
  write(textOut2);
  Stop();
}

void WriteAndStop(char text[], long value1, long value2)
{
  char textOut[256], textOut2[256];
  
  PrependCaplFileName(text, textOut);
  
  snprintf(textOut2, elCount(textOut2), textOut, value1, value2);
  
  write(textOut2);
  Stop();
}

void WriteAndStop(char text[], long value1, long value2, long value3)
{
  char textOut[256], textOut2[256];
  
  PrependCaplFileName(text, textOut);
  
  snprintf(textOut2, elCount(textOut2), textOut, value1, value2, value3);
  
  write(textOut2);
  Stop();
}

void PrependCaplFileName(char inText[], char outText[])
{
  strncpy(outText, "%BASE_FILE_NAME%: ", elCount(outText));
  strncat(outText, inText, elCount(outText));
}