/*@!Encoding:1252*/
includes
{
}

variables
{
  const dword kAvb_OK = kOK;
  const dword kAvb_IoPending = 460609;
  const dword kAvb_InsufficientBuffer = 460607;
  const dword kAvb_DataOmmitted = 460611;
  const dword kAvb_PresentationTimeLessThanPacketTime = 460618;

  const dword kAvb_VerbositySilent  = 0;
  const dword kAvb_VerbosityError   = 1;
  const dword kAvb_VerbosityWarning = 2;
  const dword kAvb_VerbosityInfo    = 3;

  const dword kAvb_InvalidHandle = kInvalidHandle;
}

long Avb_CheckHandleAndStopIfError(dword handle, char function[])
{
  char text[256];
  
  if (handle == kAvb_InvalidHandle)
  {
    strncpy(text, function, elCount(text));
    strncat(text, " returned 0, AvbGetLastError", elCount(text));
    
    return Avb_StopIfError(AvbGetLastError(), text);
  }
  
  return kAvb_OK;
}

long Avb_StopIfError(long returnCode, char function[])
{
  if (returnCode != kAvb_OK && returnCode != kAvb_IoPending)
  {
    Avb_WriteErrorAndStop(returnCode, function);
    return returnCode;
  }
  
  return kAvb_OK;
}

void Avb_WriteErrorAndStop(char text[], long errorCode)
{
  char textOut[256], lastErrorText[256];
  long ret;
    
  ret = AvbGetLastErrorText(elCount(lastErrorText), lastErrorText);
  
  if (ret == 0)
  {
    strncpy(lastErrorText, "AvbGetLastErrorText returned 0", elCount(lastErrorText));
  }
    
  PrependCaplFileName(text, textOut);
  
  snprintf(text, elCount(text), "%d (%s)", errorCode, lastErrorText);
  strncat(textOut, text, elCount(textOut));
  
  write(textOut);
  Stop();
}

void Avb_WriteErrorAndStop(long errorCode, char function[])
{
  char text[256];
  
  snprintf(text, elCount(text), "%s returned ", function);
 
  Avb_WriteErrorAndStop(text, errorCode);
}
