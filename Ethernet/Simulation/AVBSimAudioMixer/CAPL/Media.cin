/*@!Encoding:1252*/
includes
{
}

variables
{
  const dword kMedia_OK = kOK;

  const dword kMedia_InvalidHandle = kInvalidHandle;
}

long Media_CheckHandleAndStopIfError(dword handle, char function[])
{
  char text[256];
  
  if (handle == kMedia_InvalidHandle)
  {
    strncpy(text, function, elCount(text));
    strncat(text, " returned 0, MediaGetLastError", elCount(text));
    
    return Avb_StopIfError(MediaGetLastError(), text);
  }
  
  return kMedia_OK;
}

long Media_StopIfError(long returnCode, char function[])
{
  if (returnCode != kMedia_OK)
  {
    Media_WriteErrorAndStop(returnCode, function);
    return returnCode;
  }
  
  return kMedia_OK;
}

void Media_WriteErrorAndStop(char text[], long errorCode)
{
  char textOut[256];
  long ret;
    
  PrependCaplFileName(text, textOut);
  
  snprintf(text, elCount(text), "%d", errorCode);
  strncat(textOut, text, elCount(textOut));
  
  write(textOut);
  Stop();
}

void Media_WriteErrorAndStop(long errorCode, char function[])
{
  char text[256];
  
  snprintf(text, elCount(text), "%s returned ", function);
 
  Media_WriteErrorAndStop(text, errorCode);
}