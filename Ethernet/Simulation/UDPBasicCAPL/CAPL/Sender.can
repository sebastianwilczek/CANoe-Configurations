/*@!Encoding:1252*/

variables
{
  UdpSocket gSocket;
}

on start
{
  // Open an UDP socket. As source address 0.0.0.0 is used, this means that
  // the configure address of the TCP/IP stack is used. See TCP/IP stack
  // configuration dialog in the simulation setup
  // As port no ist used, this means a source port is dynamically assign
  // by the TCP/IP stack.
  gSocket = UdpSocket::Open( IP_Endpoint(0.0.0.0) );
  
  if (IpGetLastError() != 0)
  {
    // if UdpSocket::Open fails, we print a message to the write window
    write( "<%BASE_FILE_NAME%> UdpSocket::Open failed with result %d", IpGetLastError() );
  }
}

on preStop
{
  // Close socket on measurement stop
  gSocket.Close();
}

on sysvar sysvar::Sender::TxButton
{
  // send on button down
  if (@this == 1)
  {
    char text[200];
    
    // get string from sysvar 
    sysGetVariableString( sysvar::Sender::TxText, text, elcount(text) );
    
    // send text to IP address/UDP port of the receiver
    gSocket.SendTo( IP_Endpoint(192.168.1.2:40001), text, strlen(text) );
  }
}

