/*@!Encoding:1252*/
includes
{
}

variables
{
  
}

on sysvar sysvar::NodeB::OutputBroadcast
{
  char           macAddr[20];
  ethernetPacket txPacket;
  long           i;
  
  if (@this == 1)
  {
    sysGetVariableString( sysvar::NodeB::MacId, macAddr, elcount(macAddr) );
    txPacket.source = ethGetMacAddressAsNumber( macAddr );

    txPacket.msgChannel  = %CHANNEL%;
    txPacket.destination = ethGetMacAddressAsNumber( "FF:FF:FF:FF:FF:FF" );
    txPacket.type        = 0xF123;
    txPacket.length      = 200;
      
    for( i = 0; i < txPacket.length; i++ )
    {
      txPacket.byte(i) = i & 0xFF;
    }

    output( txPacket );
  }
}

on sysvar sysvar::NodeB::OutputUnicast
{
  char           macAddr[20];
  ethernetPacket txPacket;
  long           i;
  
  if (@this == 1)
  {
    sysGetVariableString( sysvar::NodeB::MacId, macAddr, elcount(macAddr) );
    txPacket.source = ethGetMacAddressAsNumber( macAddr );
    sysGetVariableString( sysvar::NodeC::MacId, macAddr, elcount(macAddr) );
    txPacket.destination = ethGetMacAddressAsNumber( macAddr );

    txPacket.msgChannel  = %CHANNEL%;
    txPacket.type        = 0xF123;
    txPacket.length      = 200;
      
    for( i = 0; i < txPacket.length; i++ )
    {
      txPacket.byte(i) = i & 0xFF;
    }

    output( txPacket );
  }
}

