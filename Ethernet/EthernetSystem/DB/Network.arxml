AUTOSAR XML (schema 4-2-2)
package /Vector
  ethernet cluster Vehicle_Ethernet: baudrate=100000000, protocol-name=ETHERNET, speed=100
    4 x ethernet physical channel:
      nm_channel
        comm-connectors:
          vgw_nm_connector
          ic_nm_connector
          hu_nm_connector
          adas_nm_connector
          lrr_nm_connector
          camf_nm_connector
          amp_nm_connector
        pdu triggering pdu_triggering_VGW_UDP_NM: pdu=VGW_UDP_NM, from VGW
        pdu triggering pdu_triggering_IC_UDP_NM: pdu=IC_UDP_NM, from IC
        pdu triggering pdu_triggering_HU_UDP_NM: pdu=HU_UDP_NM, from HU
        pdu triggering pdu_triggering_ADAS_UDP_NM: pdu=ADAS_UDP_NM, from ADAS
        pdu triggering pdu_triggering_LRR_UDP_NM: pdu=LRR_UDP_NM, from LRR
        pdu triggering pdu_triggering_CAMF_UDP_NM: pdu=CAMF_UDP_NM, from CAMF
        pdu triggering pdu_triggering_AMP_UDP_NM: pdu=AMP_UDP_NM, from AMP
        8 x network endpoint:
          nm_multicast_nep: network-endpoint-addresses=ipv-4-configuration={ipv-4-address=192.168.1.255, ipv-4-address-source=FIXED, network-mask=255.255.255.0}
          vgw_nm_nep: network-endpoint-addresses=ipv-4-configuration={ipv-4-address=192.168.1.1, ipv-4-address-source=FIXED, network-mask=255.255.255.0}
          ic_nm_nep: network-endpoint-addresses=ipv-4-configuration={ipv-4-address=192.168.1.2, ipv-4-address-source=FIXED, network-mask=255.255.255.0}
          hu_nm_nep: network-endpoint-addresses=ipv-4-configuration={ipv-4-address=192.168.1.3, ipv-4-address-source=FIXED, network-mask=255.255.255.0}
          adas_nm_nep: network-endpoint-addresses=ipv-4-configuration={ipv-4-address=192.168.1.4, ipv-4-address-source=FIXED, network-mask=255.255.255.0}
          lrr_nm_nep: network-endpoint-addresses=ipv-4-configuration={ipv-4-address=192.168.1.5, ipv-4-address-source=FIXED, network-mask=255.255.255.0}
          camf_nm_nep: network-endpoint-addresses=ipv-4-configuration={ipv-4-address=192.168.1.7, ipv-4-address-source=FIXED, network-mask=255.255.255.0}
          amp_nm_nep: network-endpoint-addresses=ipv-4-configuration={ipv-4-address=192.168.1.8, ipv-4-address-source=FIXED, network-mask=255.255.255.0}
        so-ad-config:
          7 x socket connection bundle, all with socket-connection=socket_address_nm_multicast_aep:
            ID1: pdus=socket-connection-ipdu-identifier=pdu_triggering_VGW_UDP_NM, server-port=socket_address_vgw_nm_aep
            ID3: pdus=socket-connection-ipdu-identifier=pdu_triggering_IC_UDP_NM, server-port=socket_address_ic_nm_aep
            ID5: pdus=socket-connection-ipdu-identifier=pdu_triggering_HU_UDP_NM, server-port=socket_address_hu_nm_aep
            ID7: pdus=socket-connection-ipdu-identifier=pdu_triggering_ADAS_UDP_NM, server-port=socket_address_adas_nm_aep
            ID9: pdus=socket-connection-ipdu-identifier=pdu_triggering_LRR_UDP_NM, server-port=socket_address_lrr_nm_aep
            ID11: pdus=socket-connection-ipdu-identifier=pdu_triggering_CAMF_UDP_NM, server-port=socket_address_camf_nm_aep
            ID13: pdus=socket-connection-ipdu-identifier=pdu_triggering_AMP_UDP_NM, server-port=socket_address_amp_nm_aep
          8 x socket address:
            socket_address_nm_multicast_aep
              application endpoint nm_multicast_aep: network-endpoint=nm_multicast_nep, tp-configuration=udp-tp=udp-tp-port=port-number=50002
            socket_address_vgw_nm_aep: connector=vgw_nm_connector
              application endpoint vgw_nm_aep: network-endpoint=vgw_nm_nep, tp-configuration=udp-tp=udp-tp-port=port-number=50001
            socket_address_ic_nm_aep: connector=ic_nm_connector
              application endpoint ic_nm_aep: network-endpoint=ic_nm_nep, tp-configuration=udp-tp=udp-tp-port=port-number=50001
            socket_address_hu_nm_aep: connector=hu_nm_connector
              application endpoint hu_nm_aep: network-endpoint=hu_nm_nep, tp-configuration=udp-tp=udp-tp-port=port-number=50001
            socket_address_adas_nm_aep: connector=adas_nm_connector
              application endpoint adas_nm_aep: network-endpoint=adas_nm_nep, tp-configuration=udp-tp=udp-tp-port=port-number=50001
            socket_address_lrr_nm_aep: connector=lrr_nm_connector
              application endpoint lrr_nm_aep: network-endpoint=lrr_nm_nep, tp-configuration=udp-tp=udp-tp-port=port-number=50001
            socket_address_camf_nm_aep: connector=camf_nm_connector
              application endpoint camf_nm_aep: network-endpoint=camf_nm_nep, tp-configuration=udp-tp=udp-tp-port=port-number=50001
            socket_address_amp_nm_aep: connector=amp_nm_connector
              application endpoint amp_nm_aep: network-endpoint=amp_nm_nep, tp-configuration=udp-tp=udp-tp-port=port-number=50001
        vlan VLAN_NM: vlan-identifier=1
      powertrain_chassis_channel: comm-connectors=[vgw_pt_connector, ic_pt_connector, hu_pt_connector]
        pdu triggering pdu_triggering_EMotorStatus: pdu=EMotorStatus, from VGW, to IC
        pdu triggering pdu_triggering_VehicleSpeed: pdu=VehicleSpeed, from VGW, to IC
        pdu triggering pdu_triggering_VehicleDistance: pdu=VehicleDistance, from VGW, to IC
        pdu triggering pdu_triggering_BatteryStatus: pdu=BatteryStatus, from VGW, to IC
        pdu triggering pdu_triggering_Time: pdu=Time, from VGW, to HU
        pdu triggering pdu_triggering_ExteriorTemperature: pdu=ExteriorTemperature, from VGW, to HU
        network endpoint vgw_pt_nep: network-endpoint-addresses=ipv-4-configuration={ipv-4-address=192.168.2.1, ipv-4-address-source=FIXED, network-mask=255.255.255.0}
        network endpoint ic_pt_nep: network-endpoint-addresses=ipv-4-configuration={ipv-4-address=192.168.2.2, ipv-4-address-source=FIXED, network-mask=255.255.255.0}
        network endpoint hu_pt_nep: network-endpoint-addresses=ipv-4-configuration={ipv-4-address=192.168.2.3, ipv-4-address-source=FIXED, network-mask=255.255.255.0}
        so-ad-config:
          socket connection bundle ID23: socket-connection=socket_address_ic_pt_aep, server-port=socket_address_vgw_pt_aep
            pdus:
              header-id=65601636, pdu-triggering=pdu_triggering_EMotorStatus, routing-group=ic_pt_engine_ceg
              header-id=65536100, pdu-triggering=powertrain_chassis_channel/pdu_triggering_VehicleSpeed, routing-group=ic_pt_drive_status_ceg
              header-id=65536101, pdu-triggering=powertrain_chassis_channel/pdu_triggering_VehicleDistance, routing-group=ic_pt_drive_status_ceg
              header-id=65667172, pdu-triggering=pdu_triggering_BatteryStatus, routing-group=ic_pt_battery_ceg
          socket connection bundle ID28: socket-connection=socket_address_hu_pt_aep, server-port=socket_address_vgw_pt_aep
            pdus:
              header-id=65732708, pdu-triggering=pdu_triggering_Time, routing-group=hu_pt_information_ceg
              header-id=65732709, pdu-triggering=pdu_triggering_ExteriorTemperature, routing-group=hu_pt_information_ceg
          socket address socket_address_vgw_pt_aep: connector=vgw_pt_connector
            application endpoint vgw_pt_aep: network-endpoint=vgw_pt_nep, tp-configuration=udp-tp=udp-tp-port=port-number=40001
              4 x provided service instance, all with instance-identifier=1, sd-server-config={initial-offer-behavior={initial-delay-max-value=0.05, initial-delay-min-value=0.05, initial-repetitions-base-delay=0.1, initial-repetitions-max=3}, offer-cyclic-delay=2.0, server-service-major-version=1, server-service-minor-version=0, ttl=3}:
                DriveStatus: service-identifier=1000
                  event handler DriveStatus_eh: application-endpoint=vgw_pt_aep, consumed-event-group=ic_pt_drive_status_ceg
                Engine: service-identifier=1001
                  event handler Engine_eh: application-endpoint=vgw_pt_aep, consumed-event-group=ic_pt_engine_ceg
                Battery: service-identifier=1002
                  event handler Battery_eh: application-endpoint=vgw_pt_aep, consumed-event-group=ic_pt_battery_ceg
                Information: service-identifier=1003
                  event handler Information_eh: application-endpoint=vgw_pt_aep, consumed-event-group=hu_pt_information_ceg
          socket address socket_address_ic_pt_aep: connector=ic_pt_connector
            application endpoint ic_pt_aep: network-endpoint=ic_pt_nep, tp-configuration=udp-tp=udp-tp-port=port-number=40001
              consumed service instance ic_pt_drive_status_csi: provided-service-instance=vgw_pt_aep/DriveStatus, sd-client-config={client-service-major-version=1, client-service-minor-version=0, initial-find-behavior={initial-delay-max-value=0.05, initial-delay-min-value=0.05, initial-repetitions-base-delay=0.1, initial-repetitions-max=3}, ttl=3}
                consumed event group ic_pt_drive_status_ceg: application-endpoint=ic_pt_aep, event-group-identifier=1, routing-group=ic_pt_drive_status_ceg
              consumed service instance ic_pt_emotor_csi: provided-service-instance=Engine, sd-client-config={client-service-major-version=1, client-service-minor-version=0, initial-find-behavior={initial-delay-max-value=0.05, initial-delay-min-value=0.05, initial-repetitions-base-delay=0.1, initial-repetitions-max=3}, ttl=3}
                consumed event group ic_pt_engine_ceg: application-endpoint=ic_pt_aep, event-group-identifier=1, routing-group=ic_pt_engine_ceg
              consumed service instance ic_pt_battery_csi: provided-service-instance=Battery, sd-client-config={client-service-major-version=1, client-service-minor-version=0, initial-find-behavior={initial-delay-max-value=0.05, initial-delay-min-value=0.05, initial-repetitions-base-delay=0.1, initial-repetitions-max=3}, ttl=3}
                consumed event group ic_pt_battery_ceg: application-endpoint=ic_pt_aep, event-group-identifier=1, routing-group=ic_pt_battery_ceg
          socket address socket_address_hu_pt_aep: connector=hu_pt_connector
            application endpoint hu_pt_aep: network-endpoint=hu_pt_nep, tp-configuration=udp-tp=udp-tp-port=port-number=40001
              consumed service instance hu_pt_information_csi: provided-service-instance=Information, sd-client-config={client-service-major-version=1, client-service-minor-version=0, initial-find-behavior={initial-delay-max-value=0.05, initial-delay-min-value=0.05, initial-repetitions-base-delay=0.1, initial-repetitions-max=3}, ttl=3}
                consumed event group hu_pt_information_ceg: application-endpoint=hu_pt_aep, event-group-identifier=1, routing-group=hu_pt_information_ceg
        vlan VLAN_Powertrain_Chassis: vlan-identifier=2
      adas_channel: comm-connectors=[vgw_adas_connector, ic_adas_connector, adas_adas_connector, lrr_adas_connector, camf_adas_connector]
        pdu triggering pdu_triggering_VehicleSpeed: pdu=VehicleSpeed, from VGW, to ADAS
        pdu triggering pdu_triggering_VehicleDistance: pdu=VehicleDistance, from VGW, to ADAS
        pdu triggering pdu_triggering_TrafficSignInfoPDU: pdu=TrafficSignInfoPDU, from ADAS, to IC
        pdu triggering pdu_triggering_LaneInfoPDU: pdu=LaneInfoPDU, from ADAS, to IC
        pdu triggering pdu_triggering_TrafficSignDetectionPDU: pdu=TrafficSignDetectionPDU, from CAMF, to ADAS
        pdu triggering pdu_triggering_LaneDetectionPDU: pdu=LaneDetectionPDU, from CAMF, to ADAS
        pdu triggering pdu_triggering_ObstacleDetectionPDU: pdu=ObstacleDetectionPDU, from LRR, to ADAS
        5 x network endpoint:
          vgw_adas_nep: network-endpoint-addresses=ipv-4-configuration={ipv-4-address=192.168.3.1, ipv-4-address-source=FIXED, network-mask=255.255.255.0}
          ic_adas_nep: network-endpoint-addresses=ipv-4-configuration={ipv-4-address=192.168.3.2, ipv-4-address-source=FIXED, network-mask=255.255.255.0}
          adas_adas_nep: network-endpoint-addresses=ipv-4-configuration={ipv-4-address=192.168.3.4, ipv-4-address-source=FIXED, network-mask=255.255.255.0}
          lrr_adas_nep: network-endpoint-addresses=ipv-4-configuration={ipv-4-address=192.168.3.5, ipv-4-address-source=FIXED, network-mask=255.255.255.0}
          camf_adas_nep: network-endpoint-addresses=ipv-4-configuration={ipv-4-address=192.168.3.6, ipv-4-address-source=FIXED, network-mask=255.255.255.0}
        so-ad-config:
          4 x socket connection bundle:
            ID39: socket-connection=socket_address_adas_adas_aep, server-port=socket_address_vgw_adas_aep
              pdus:
                header-id=65536100, pdu-triggering=adas_channel/pdu_triggering_VehicleSpeed, routing-group=adas_adas_drive_status_ceg
                header-id=65536101, pdu-triggering=adas_channel/pdu_triggering_VehicleDistance, routing-group=adas_adas_drive_status_ceg
            ID42: socket-connection=socket_address_ic_adas_aep, server-port=socket_address_adas_adas_aep
              pdus:
                header-id=131072100, pdu-triggering=pdu_triggering_TrafficSignInfoPDU, routing-group=ic_adas_display_info_ceg
                header-id=131072101, pdu-triggering=pdu_triggering_LaneInfoPDU, routing-group=ic_adas_display_info_ceg
            ID45: socket-connection=socket_address_adas_adas_aep, server-port=socket_address_camf_adas_aep
              pdus:
                header-id=131137636, pdu-triggering=pdu_triggering_TrafficSignDetectionPDU, routing-group=adas_adas_display_info_ceg
                header-id=131137637, pdu-triggering=pdu_triggering_LaneDetectionPDU, routing-group=adas_adas_display_info_ceg
            ID48: socket-connection=socket_address_adas_adas_aep, pdus=socket-connection-ipdu-identifier={header-id=131203172, pdu-triggering=pdu_triggering_ObstacleDetectionPDU, routing-group=adas_adas_obstacle_detection_ceg}, server-port=socket_address_lrr_adas_aep
          5 x socket address:
            socket_address_vgw_adas_aep: connector=vgw_adas_connector
              application endpoint vgw_adas_aep: network-endpoint=vgw_adas_nep, tp-configuration=udp-tp=udp-tp-port=port-number=40001
                provided service instance DriveStatus: instance-identifier=1, sd-server-config={initial-offer-behavior={initial-delay-max-value=0.05, initial-delay-min-value=0.05, initial-repetitions-base-delay=0.1, initial-repetitions-max=3}, offer-cyclic-delay=2.0, server-service-major-version=1, server-service-minor-version=0, ttl=3}, service-identifier=1000
                  event handler DriveStatus_eh: application-endpoint=vgw_adas_aep, consumed-event-group=adas_adas_drive_status_ceg
            socket_address_ic_adas_aep: connector=ic_adas_connector
              application endpoint ic_adas_aep: network-endpoint=ic_adas_nep, tp-configuration=udp-tp=udp-tp-port=port-number=40001
                consumed service instance ic_adas_display_info_csi: provided-service-instance=adas_adas_aep/DriveStatus, sd-client-config={client-service-major-version=1, client-service-minor-version=0, initial-find-behavior={initial-delay-max-value=0.05, initial-delay-min-value=0.05, initial-repetitions-base-delay=0.1, initial-repetitions-max=3}, ttl=3}
                  consumed event group ic_adas_display_info_ceg: application-endpoint=ic_adas_aep, event-group-identifier=1, routing-group=ic_adas_display_info_ceg
            socket_address_adas_adas_aep: connector=adas_adas_connector
              application endpoint adas_adas_aep: network-endpoint=adas_adas_nep, tp-configuration=udp-tp=udp-tp-port=port-number=40001
                consumed service instance adas_adas_drive_status_csi: provided-service-instance=vgw_adas_aep/DriveStatus, sd-client-config={client-service-major-version=1, client-service-minor-version=0, initial-find-behavior={initial-delay-max-value=0.05, initial-delay-min-value=0.05, initial-repetitions-base-delay=0.1, initial-repetitions-max=3}, ttl=3}
                  consumed event group adas_adas_drive_status_ceg: application-endpoint=adas_adas_aep, event-group-identifier=1, routing-group=adas_adas_drive_status_ceg
                consumed service instance adas_adas_display_info_csi: routing-group=CameraObjectDetection, provided-service-instance=ADASDisplayInfo, sd-client-config={client-service-major-version=1, client-service-minor-version=0, initial-find-behavior={initial-delay-max-value=0.05, initial-delay-min-value=0.05, initial-repetitions-base-delay=0.1, initial-repetitions-max=3}, ttl=3}
                  consumed event group adas_adas_display_info_ceg: application-endpoint=adas_adas_aep, event-group-identifier=1, routing-group=adas_adas_display_info_ceg
                consumed service instance adas_adas_obstacle_detection_csi: provided-service-instance=ObstacleDetection, sd-client-config={client-service-major-version=1, client-service-minor-version=0, initial-find-behavior={initial-delay-max-value=0.05, initial-delay-min-value=0.05, initial-repetitions-base-delay=0.1, initial-repetitions-max=3}, ttl=3}
                  consumed event group adas_adas_obstacle_detection_ceg: application-endpoint=adas_adas_aep, event-group-identifier=1, routing-group=adas_adas_obstacle_detection_ceg
                provided service instance DriveStatus: instance-identifier=1, sd-server-config={initial-offer-behavior={initial-delay-max-value=0.05, initial-delay-min-value=0.05, initial-repetitions-base-delay=0.1, initial-repetitions-max=3}, offer-cyclic-delay=2.0, server-service-major-version=1, server-service-minor-version=0, ttl=3}, service-identifier=2000
                  event handler DriveStatus_eh: application-endpoint=adas_adas_aep, consumed-event-group=ic_adas_display_info_ceg
            socket_address_lrr_adas_aep: connector=lrr_adas_connector
              application endpoint lrr_adas_aep: network-endpoint=lrr_adas_nep, tp-configuration=udp-tp=udp-tp-port=port-number=40001
                provided service instance ObstacleDetection: instance-identifier=1, sd-server-config={initial-offer-behavior={initial-delay-max-value=0.05, initial-delay-min-value=0.05, initial-repetitions-base-delay=0.1, initial-repetitions-max=3}, offer-cyclic-delay=2.0, server-service-major-version=1, server-service-minor-version=0, ttl=3}, service-identifier=2002
                  event handler ObstacleDetection_eh: application-endpoint=lrr_adas_aep, consumed-event-group=adas_adas_obstacle_detection_ceg
            socket_address_camf_adas_aep: connector=camf_adas_connector
              application endpoint camf_adas_aep: network-endpoint=camf_adas_nep, tp-configuration=udp-tp=udp-tp-port=port-number=40001
                provided service instance ADASDisplayInfo: routing-group=CameraObjectDetection, instance-identifier=1, sd-server-config={initial-offer-behavior={initial-delay-max-value=0.05, initial-delay-min-value=0.05, initial-repetitions-base-delay=0.1, initial-repetitions-max=3}, offer-cyclic-delay=2.0, server-service-major-version=1, server-service-minor-version=0, ttl=3}, service-identifier=2001
                  event handler ADASDisplayInfo_eh: application-endpoint=camf_adas_aep, consumed-event-group=adas_adas_display_info_ceg
        vlan VLAN_ADAS: vlan-identifier=3
      info_channel: comm-connectors=[hu_info_connector, amp_info_connector]
        pdu triggering pdu_triggering_VolumeRequest: pdu=VolumeRequest, from HU, to AMP
        network endpoint hu_info_nep: network-endpoint-addresses=ipv-4-configuration={ipv-4-address=192.168.4.3, ipv-4-address-source=FIXED, network-mask=255.255.255.0}
        network endpoint amp_info_nep: network-endpoint-addresses=ipv-4-configuration={ipv-4-address=192.168.4.8, ipv-4-address-source=FIXED, network-mask=255.255.255.0}
        so-ad-config:
          socket connection bundle ID50: socket-connection=socket_address_amp_info_aep, pdus=socket-connection-ipdu-identifier={header-id=103, pdu-triggering=pdu_triggering_VolumeRequest}, server-port=socket_address_hu_info_aep
          socket address socket_address_hu_info_aep: connector=hu_info_connector
            application endpoint hu_info_aep: network-endpoint=hu_info_nep, tp-configuration=udp-tp=udp-tp-port=port-number=40001
          socket address socket_address_amp_info_aep: connector=amp_info_connector
            application endpoint amp_info_aep: network-endpoint=amp_info_nep, tp-configuration=udp-tp=udp-tp-port=port-number=40001
        vlan VLAN_Infotainment: vlan-identifier=4
package /Vector/ECUs
  7 x ecu instance:
    VGW
      ethernet communication controller vgw_controller: mac-unicast-address=02:00:00:00:01:01
      ethernet communication connector vgw_nm_connector: comm-controller=vgw_controller, network-endpoint=vgw_nm_nep
      ethernet communication connector vgw_pt_connector: comm-controller=vgw_controller, network-endpoint=vgw_pt_nep
      ethernet communication connector vgw_adas_connector: comm-controller=vgw_controller, network-endpoint=vgw_adas_nep
    IC
      ethernet communication controller ic_controller: mac-unicast-address=02:00:00:00:01:02
      ethernet communication connector ic_nm_connector: comm-controller=ic_controller, network-endpoint=ic_nm_nep
      ethernet communication connector ic_pt_connector: comm-controller=ic_controller, network-endpoint=ic_pt_nep
      ethernet communication connector ic_adas_connector: comm-controller=ic_controller, network-endpoint=ic_adas_nep
    HU
      ethernet communication controller hu_controller: mac-unicast-address=02:00:00:00:01:03
      ethernet communication connector hu_nm_connector: comm-controller=hu_controller, network-endpoint=hu_nm_nep
      ethernet communication connector hu_pt_connector: comm-controller=hu_controller, network-endpoint=hu_pt_nep
      ethernet communication connector hu_info_connector: comm-controller=hu_controller, network-endpoint=hu_info_nep
    ADAS
      ethernet communication controller adas_controller: mac-unicast-address=02:00:00:00:01:04
      ethernet communication connector adas_nm_connector: comm-controller=adas_controller, network-endpoint=adas_nm_nep
      ethernet communication connector adas_adas_connector: comm-controller=adas_controller, network-endpoint=adas_adas_nep
    LRR
      ethernet communication controller lrr_controller: mac-unicast-address=02:00:00:00:01:05
      ethernet communication connector lrr_nm_connector: comm-controller=lrr_controller, network-endpoint=lrr_nm_nep
      ethernet communication connector lrr_adas_connector: comm-controller=lrr_controller, network-endpoint=lrr_adas_nep
    CAMF
      ethernet communication controller camf_controller: mac-unicast-address=02:00:00:00:01:06
      ethernet communication connector camf_nm_connector: comm-controller=camf_controller, network-endpoint=camf_nm_nep
      ethernet communication connector camf_adas_connector: comm-controller=camf_controller, network-endpoint=camf_adas_nep
    AMP
      ethernet communication controller amp_controller: mac-unicast-address=02:00:00:00:01:07
      ethernet communication connector amp_nm_connector: comm-controller=amp_controller, network-endpoint=amp_nm_nep
      ethernet communication connector amp_info_connector: comm-controller=amp_controller, network-endpoint=amp_info_nep
package /Vector/PDUs
  pdu VehicleSpeed: length=4, transmission-mode-true-timing=cyclic-timing=time-period=0.1, unused-bit-pattern=0
    signal VehicleSpeed: start 0, 16 bit, little-endian, data-type-policy=OVERRIDE, base-type=A_UINT16, compu {phys=raw*0.1; unit km/h}, to IC ADAS
    signal VehicleDirection: start 16, 8 bit, little-endian, data-type-policy=OVERRIDE, base-type=A_UINT8, compu {}, to IC ADAS
  pdu VehicleDistance: length=8, transmission-mode-true-timing=cyclic-timing=time-period=0.25, unused-bit-pattern=0
    signal VehicleTripDistance: start 0, 32 bit, little-endian, data-type-policy=OVERRIDE, base-type=A_UINT32, compu {phys=raw*0.1-1000000, 0=NoDistance; unit m}, to IC ADAS
    signal VehicleTotalDistance: start 32, 32 bit, little-endian, data-type-policy=OVERRIDE, base-type=A_UINT32, compu {phys=raw*0.1-1000000, 0=NoDistance; unit m}, to IC ADAS
  pdu EMotorStatus: length=12, transmission-mode-true-timing=cyclic-timing=time-period=0.1, unused-bit-pattern=0
    signal EMotorSpeed: start 0, 16 bit, little-endian, data-type-policy=OVERRIDE, base-type=A_UINT16, compu {phys=(0+0.1*raw)/(1); unit rpm}, to IC
    signal EMotorTemperature: start 16, 16 bit, little-endian, data-type-policy=OVERRIDE, base-type=A_UINT16, compu {phys=raw*0.1-273.15; unit °C}, to IC
    signal EMotorCurrent: start 32, 32 bit, little-endian, data-type-policy=OVERRIDE, base-type=A_UINT32, compu {phys=raw*0.001-1000; unit A}, to IC
    signal EMotorPower: start 64, 32 bit, little-endian, data-type-policy=OVERRIDE, base-type=A_UINT32, compu {phys=raw*0.001-1000; unit kW}, to IC
  pdu BatteryStatus: length=10, transmission-mode-true-timing=cyclic-timing=time-period=0.5, unused-bit-pattern=0
    signal BatteryTemperature: start 0, 16 bit, little-endian, data-type-policy=OVERRIDE, base-type=A_UINT16, compu {phys=raw*0.1-273.15; unit °C}, to IC
    signal RemainingCapacity: start 16, 32 bit, little-endian, data-type-policy=OVERRIDE, base-type=A_UINT32, compu {phys=raw*0.001; unit kWh}, to IC
    signal Capacity: start 48, 32 bit, little-endian, data-type-policy=OVERRIDE, base-type=A_UINT32, compu {phys=raw*0.001; unit kWh}, to IC
  pdu Time: length=3, transmission-mode-true-timing=cyclic-timing=time-period=1.0, unused-bit-pattern=0
    signal Hour: start 0, 8 bit, little-endian, data-type-policy=OVERRIDE, base-type=A_UINT8, compu {phys=(0+1*raw)/(1); unit h}, to HU
    signal Minute: start 8, 8 bit, little-endian, data-type-policy=OVERRIDE, base-type=A_UINT8, compu {phys=(0+1*raw)/(1); unit min}, to HU
    signal Second: start 16, 8 bit, little-endian, data-type-policy=OVERRIDE, base-type=A_UINT8, compu {phys=(0+1*raw)/(1); unit sec}, to HU
  pdu ExteriorTemperature: length=2, transmission-mode-true-timing=cyclic-timing=time-period=2.0, unused-bit-pattern=0
    signal ExteriorTemperature: start 0, 16 bit, little-endian, data-type-policy=OVERRIDE, base-type=A_UINT16, compu {phys=raw*0.1-273.15; unit °C}, to HU
  pdu TrafficSignInfoPDU: length=6, unused-bit-pattern=0
    signal TrafficSignInfoSerialized: start 0, little-endian, data-transformations=SOMEIP, someip-transformation-i-signal-props{transformer=someip_transformer, interface-version=1}, to IC
  pdu LaneInfoPDU: length=6, unused-bit-pattern=0
    signal LaneInfoSerialized: start 0, little-endian, data-transformations=SOMEIP, someip-transformation-i-signal-props{transformer=someip_transformer, interface-version=1}, to IC
  pdu TrafficSignDetectionPDU: length=18, unused-bit-pattern=0
    signal TrafficSignDetectionSerialized: start 0, little-endian, data-transformations=SOMEIP, someip-transformation-i-signal-props{transformer=someip_transformer, interface-version=1}, to ADAS
  pdu LaneDetectionPDU: length=18, unused-bit-pattern=0
    signal LaneDetectionSerialized: start 0, little-endian, data-transformations=SOMEIP, someip-transformation-i-signal-props{transformer=someip_transformer, interface-version=1}, to ADAS
  pdu ObstacleDetectionPDU: length=25, unused-bit-pattern=0
    signal ObstacleDetectionPDUSerialized: start 0, little-endian, data-transformations=SOMEIP, someip-transformation-i-signal-props{transformer=someip_transformer, interface-version=1}, to ADAS
  pdu VolumeRequest: length=8, transmission-mode-true-timing=event-controlled-timing=number-of-repetitions=0, unused-bit-pattern=0
    signal VolumeRequest: start 0, 8 bit, little-endian, data-type-policy=OVERRIDE, base-type=A_UINT8, compu {phys=raw*0.5; unit %}, to AMP
  nm pdu VGW_UDP_NM: length=8, unused-bit-pattern=0
    signal RepeatMessageRequest: start 0, 1 bit, little-endian, data-type-policy=OVERRIDE, base-type=A_BOOL, compu {}
    signal NMCoordinatorSleeptReadyBit: start 3, 1 bit, little-endian, data-type-policy=OVERRIDE, base-type=A_BOOL, compu {}
    signal ActiveWakeupBit: start 4, 1 bit, little-endian, data-type-policy=OVERRIDE, base-type=A_BOOL, compu {}
    signal PartialNetworkInformationBit: start 6, 1 bit, little-endian, data-type-policy=OVERRIDE, base-type=A_BOOL, compu {}
    signal NodeId: start 8, 8 bit, little-endian, data-type-policy=OVERRIDE, base-type=A_UINT8, compu {}
    signal PNCVector: start 16, 16 bit, little-endian, data-type-policy=OVERRIDE, base-type=A_UINT16, compu {}
  nm pdu HU_UDP_NM: length=8, unused-bit-pattern=0
    signal RepeatMessageRequest: start 0, 1 bit, little-endian, data-type-policy=OVERRIDE, base-type=A_BOOL, compu {}
    signal NMCoordinatorSleeptReadyBit: start 3, 1 bit, little-endian, data-type-policy=OVERRIDE, base-type=A_BOOL, compu {}
    signal ActiveWakeupBit: start 4, 1 bit, little-endian, data-type-policy=OVERRIDE, base-type=A_BOOL, compu {}
    signal PartialNetworkInformationBit: start 6, 1 bit, little-endian, data-type-policy=OVERRIDE, base-type=A_BOOL, compu {}
    signal NodeId: start 8, 8 bit, little-endian, data-type-policy=OVERRIDE, base-type=A_UINT8, compu {}
    signal PNCVector: start 16, 16 bit, little-endian, data-type-policy=OVERRIDE, base-type=A_UINT16, compu {}
  nm pdu IC_UDP_NM: length=8, unused-bit-pattern=0
    signal RepeatMessageRequest: start 0, 1 bit, little-endian, data-type-policy=OVERRIDE, base-type=A_BOOL, compu {}
    signal NMCoordinatorSleeptReadyBit: start 3, 1 bit, little-endian, data-type-policy=OVERRIDE, base-type=A_BOOL, compu {}
    signal ActiveWakeupBit: start 4, 1 bit, little-endian, data-type-policy=OVERRIDE, base-type=A_BOOL, compu {}
    signal PartialNetworkInformationBit: start 6, 1 bit, little-endian, data-type-policy=OVERRIDE, base-type=A_BOOL, compu {}
    signal NodeId: start 8, 8 bit, little-endian, data-type-policy=OVERRIDE, base-type=A_UINT8, compu {}
    signal PNCVector: start 16, 16 bit, little-endian, data-type-policy=OVERRIDE, base-type=A_UINT16, compu {}
  nm pdu ADAS_UDP_NM: length=8, unused-bit-pattern=0
    signal RepeatMessageRequest: start 0, 1 bit, little-endian, data-type-policy=OVERRIDE, base-type=A_BOOL, compu {}
    signal NMCoordinatorSleeptReadyBit: start 3, 1 bit, little-endian, data-type-policy=OVERRIDE, base-type=A_BOOL, compu {}
    signal ActiveWakeupBit: start 4, 1 bit, little-endian, data-type-policy=OVERRIDE, base-type=A_BOOL, compu {}
    signal PartialNetworkInformationBit: start 6, 1 bit, little-endian, data-type-policy=OVERRIDE, base-type=A_BOOL, compu {}
    signal NodeId: start 8, 8 bit, little-endian, data-type-policy=OVERRIDE, base-type=A_UINT8, compu {}
    signal PNCVector: start 16, 16 bit, little-endian, data-type-policy=OVERRIDE, base-type=A_UINT16, compu {}
  nm pdu LRR_UDP_NM: length=8, unused-bit-pattern=0
    signal RepeatMessageRequest: start 0, 1 bit, little-endian, data-type-policy=OVERRIDE, base-type=A_BOOL, compu {}
    signal NMCoordinatorSleeptReadyBit: start 3, 1 bit, little-endian, data-type-policy=OVERRIDE, base-type=A_BOOL, compu {}
    signal ActiveWakeupBit: start 4, 1 bit, little-endian, data-type-policy=OVERRIDE, base-type=A_BOOL, compu {}
    signal PartialNetworkInformationBit: start 6, 1 bit, little-endian, data-type-policy=OVERRIDE, base-type=A_BOOL, compu {}
    signal NodeId: start 8, 8 bit, little-endian, data-type-policy=OVERRIDE, base-type=A_UINT8, compu {}
    signal PNCVector: start 16, 16 bit, little-endian, data-type-policy=OVERRIDE, base-type=A_UINT16, compu {}
  nm pdu CAMF_UDP_NM: length=8, unused-bit-pattern=0
    signal RepeatMessageRequest: start 0, 1 bit, little-endian, data-type-policy=OVERRIDE, base-type=A_BOOL, compu {}
    signal NMCoordinatorSleeptReadyBit: start 3, 1 bit, little-endian, data-type-policy=OVERRIDE, base-type=A_BOOL, compu {}
    signal ActiveWakeupBit: start 4, 1 bit, little-endian, data-type-policy=OVERRIDE, base-type=A_BOOL, compu {}
    signal PartialNetworkInformationBit: start 6, 1 bit, little-endian, data-type-policy=OVERRIDE, base-type=A_BOOL, compu {}
    signal NodeId: start 8, 8 bit, little-endian, data-type-policy=OVERRIDE, base-type=A_UINT8, compu {}
    signal PNCVector: start 16, 16 bit, little-endian, data-type-policy=OVERRIDE, base-type=A_UINT16, compu {}
  nm pdu AMP_UDP_NM: length=8, unused-bit-pattern=0
    signal RepeatMessageRequest: start 0, 1 bit, little-endian, data-type-policy=OVERRIDE, base-type=A_BOOL, compu {}
    signal NMCoordinatorSleeptReadyBit: start 3, 1 bit, little-endian, data-type-policy=OVERRIDE, base-type=A_BOOL, compu {}
    signal ActiveWakeupBit: start 4, 1 bit, little-endian, data-type-policy=OVERRIDE, base-type=A_BOOL, compu {}
    signal PartialNetworkInformationBit: start 6, 1 bit, little-endian, data-type-policy=OVERRIDE, base-type=A_BOOL, compu {}
    signal NodeId: start 8, 8 bit, little-endian, data-type-policy=OVERRIDE, base-type=A_UINT8, compu {}
    signal PNCVector: start 16, 16 bit, little-endian, data-type-policy=OVERRIDE, base-type=A_UINT16, compu {}
package /Vector/CompuMethods
  compu method frame_rate_cm: ; unit fr/sec
package /Vector/Units
  13 x unit:
    degree: display-name=°C
    kmh: display-name=km/h
    meter: display-name=m
    ampere: display-name=A
    kw: display-name=kW
    kwh: display-name=kWh
    rpm: display-name=rpm
    hour_unit: display-name=h
    minute_unit: display-name=min
    second_unit: display-name=sec
    detectionReliability_unit: display-name=%
    frsec: display-name=fr/sec
    audio_volume: display-name=%
package /Vector/RoutingGroups
  9 x so ad routing group, all with event-group-control-type=ACTIVATION-UNICAST:
    ic_pt_drive_status_ceg
    ic_pt_engine_ceg
    ic_pt_battery_ceg
    hu_pt_information_ceg
    ic_adas_display_info_ceg
    adas_adas_drive_status_ceg
    adas_adas_display_info_ceg
    adas_adas_obstacle_detection_ceg
    CameraObjectDetection
package /Vector/ApplicationDataTypes
  8 x app type, all with category=VALUE:
    SpeedLimit
    NoPassingZone
    RoadWork
    Hazard
    LaneReliabilityLeft
    LaneReliabilityRight
    LaneDeparture
    CollisionWarning
  application array data type DetectedTrafficSigns: category=ARRAY
    element DetectedTrafficSign: category=STRUCTURE, type=DetectedTrafficSign, array-size-semantics=FIXED-SIZE, max-number-of-elements=3
  application record data type DetectedTrafficSign: category=STRUCTURE
    application record element SignType: category=VALUE, type=signType_dt
    application record element DistanceToSign: category=VALUE, type=signDistance_dt
    application record element Reliability: category=VALUE, type=detectionReliability_dt
  app type signType_dt: category=VALUE
  app type signDistance_dt: category=VALUE
  app type detectionReliability_dt: category=VALUE
  application array data type DetectedLane: category=ARRAY
    element DetectedLaneBorder: category=STRUCTURE, type=DetectedLaneBorder, array-size-semantics=FIXED-SIZE, max-number-of-elements=3
  application record data type DetectedLaneBorder: category=STRUCTURE
    5 x application record element, all with category=VALUE:
      LaneSegmentX: type=lane_segment_x_dt
      BorderLeft: type=laneBorderLeft_dt
      BorderRight: type=laneBorderRight_dt
      ReliabilityLeft: type=detectionReliability_dt
      ReliabilityRight: type=detectionReliability_dt
  5 x app type, all with category=VALUE:
    lane_segment_x_dt
    laneBorderLeft_dt
    laneBorderRight_dt
    activate_dt
    activate_result_dt
  application array data type Segments: category=ARRAY
    element Segment: category=STRUCTURE, type=Segment, array-size-semantics=FIXED-SIZE, max-number-of-elements=5
  application record data type Segment: category=STRUCTURE
    application record element Distance: category=VALUE, type=obstacleDistance_dt
    application record element Reliability: category=VALUE, type=obstacleReliability_dt
  app type obstacleDistance_dt: category=VALUE
  app type obstacleReliability_dt: category=VALUE
  5 x application record data type, all with category=STRUCTURE:
    TrafficSignInfo
      4 x application record element, all with category=VALUE:
        SpeedLimit: type=SpeedLimit
        NoPassingZone: type=NoPassingZone
        RoadWork: type=RoadWork
        Hazard: type=Hazard
    LaneInfo
      4 x application record element, all with category=VALUE:
        LaneReliabilityLeft: type=LaneReliabilityLeft
        LaneReliabilityRight: type=LaneReliabilityRight
        LaneDeparture: type=LaneDeparture
        CollisionWarning: type=CollisionWarning
    TrafficSignDetection
      application record element DetectedTrafficSign: category=STRUCTURE, type=DetectedTrafficSigns
    LaneDetection
      application record element DetectedLaneBorder: category=STRUCTURE, type=DetectedLane
    ObstacleDetection
      application record element Segment: category=STRUCTURE, type=Segments
package /Vector/ImplementationDataTypes
  29 x impl type:
    SpeedLimit: category=VALUE, base-type=A_UINT8, compu {}
    NoPassingZone: category=VALUE, base-type=A_UINT8, compu {}
    RoadWork: category=VALUE, base-type=A_UINT8, compu {}
    Hazard: category=VALUE, base-type=A_UINT8, compu {}
    LaneReliabilityLeft: category=VALUE, base-type=A_UINT8, compu {}
    LaneReliabilityRight: category=VALUE, base-type=A_UINT8, compu {}
    LaneDeparture: category=VALUE, base-type=A_UINT8, compu {}
    CollisionWarning: category=VALUE, base-type=A_UINT8, compu {}
    DetectedTrafficSigns: category=ARRAY
      element DetectedTrafficSigns: array-size=3, array-size-semantics=FIXED-SIZE, implementation-data-type=DetectedTrafficSign
    DetectedTrafficSign: category=STRUCTURE
      element SignType: implementation-data-type=signType_dt
      element DistanceToSign: implementation-data-type=signDistance_dt
      element Reliability: implementation-data-type=detectionReliability_dt
    signType_dt: category=VALUE, base-type=A_UINT8, compu {0=NoObject, 1=SpeedLimit30Sign, 2=SpeedLimit50Sign, 3=SpeedLimit60Sign, 4=SpeedLimit70Sign, 5=SpeedLimit80Sign, 6=SpeedLimit100Sign, 7=NoLimit80Sign, 8=NoPassingZoneSign, 9=NoPassingZoneEndSign, 10=HazardSign, 11=HazardEndSign, 12=RoadworkSign, 13=RoadworkEndSign}
    signDistance_dt: category=VALUE, base-type=A_UINT32, compu {phys=raw*0.1-1000000, 0=NoDistance; unit m}
    detectionReliability_dt: category=VALUE, base-type=A_UINT8, compu {; unit %}
    DetectedLane: category=ARRAY
      element DetectedLane: array-size=3, array-size-semantics=FIXED-SIZE, implementation-data-type=DetectedLaneBorder
    DetectedLaneBorder: category=STRUCTURE
      5 x element, all with category=TYPE_REFERENCE:
        LaneSegmentX: implementation-data-type=lane_segment_x_dt
        BorderLeft: implementation-data-type=laneBorderLeft_dt
        BorderRight: implementation-data-type=laneBorderRight_dt
        ReliabilityLeft: implementation-data-type=detectionReliability_dt
        ReliabilityRight: implementation-data-type=detectionReliability_dt
    lane_segment_x_dt: category=VALUE, base-type=A_UINT32, compu {phys=raw*0.1-1000000, 0=NoDistance; unit m}
    laneBorderLeft_dt: category=VALUE, base-type=A_UINT32, compu {phys=raw*0.1-1000000, 0=NoDistance; unit m}
    laneBorderRight_dt: category=VALUE, base-type=A_UINT32, compu {phys=raw*0.1-1000000, 0=NoDistance; unit m}
    activate_dt: category=VALUE, base-type=A_BOOL, compu {0=Deactivate, 1=Activate}
    activate_result_dt: category=VALUE, base-type=A_BOOL, compu {0=Failed, 1=Success}
    Segments: category=ARRAY
      element Segments: array-size=5, array-size-semantics=FIXED-SIZE, implementation-data-type=Segment
    Segment: category=STRUCTURE
      element Distance: implementation-data-type=obstacleDistance_dt
      element Reliability: implementation-data-type=obstacleReliability_dt
    obstacleDistance_dt: category=VALUE, base-type=A_UINT32, compu {phys=raw*0.1-1000000, 0=NoDistance; unit m}
    obstacleReliability_dt: category=VALUE, base-type=A_UINT8, compu {}
    TrafficSignInfo: category=STRUCTURE
      4 x element, all with category=TYPE_REFERENCE:
        SpeedLimit: implementation-data-type=SpeedLimit
        NoPassingZone: implementation-data-type=NoPassingZone
        RoadWork: implementation-data-type=RoadWork
        Hazard: implementation-data-type=Hazard
    LaneInfo: category=STRUCTURE
      4 x element, all with category=TYPE_REFERENCE:
        LaneReliabilityLeft: implementation-data-type=LaneReliabilityLeft
        LaneReliabilityRight: implementation-data-type=LaneReliabilityRight
        LaneDeparture: implementation-data-type=LaneDeparture
        CollisionWarning: implementation-data-type=CollisionWarning
    TrafficSignDetection: category=STRUCTURE
      element DetectedTrafficSign: implementation-data-type=DetectedTrafficSigns
    LaneDetection: category=STRUCTURE
      element DetectedLaneBorder: implementation-data-type=DetectedLane
    ObstacleDetection: category=STRUCTURE
      element Segment: implementation-data-type=Segments
package /Vector/DataTypeMappings
  data type mapping set DATA_TYPE_MAPPING_SET
    data-type-maps:
      application-data-type=TrafficSignInfo, implementation-data-type=TrafficSignInfo
      application-data-type=LaneInfo, implementation-data-type=LaneInfo
      application-data-type=TrafficSignDetection, implementation-data-type=TrafficSignDetection
      application-data-type=LaneDetection, implementation-data-type=LaneDetection
      application-data-type=ObstacleDetection, implementation-data-type=ObstacleDetection
      application-data-type=SpeedLimit, implementation-data-type=SpeedLimit
      application-data-type=NoPassingZone, implementation-data-type=NoPassingZone
      application-data-type=RoadWork, implementation-data-type=RoadWork
      application-data-type=Hazard, implementation-data-type=Hazard
      application-data-type=LaneReliabilityLeft, implementation-data-type=LaneReliabilityLeft
      application-data-type=LaneReliabilityRight, implementation-data-type=LaneReliabilityRight
      application-data-type=LaneDeparture, implementation-data-type=LaneDeparture
      application-data-type=CollisionWarning, implementation-data-type=CollisionWarning
      application-data-type=DetectedTrafficSigns, implementation-data-type=DetectedTrafficSigns
      application-data-type=DetectedTrafficSign, implementation-data-type=DetectedTrafficSign
      application-data-type=signType_dt, implementation-data-type=signType_dt
      application-data-type=signDistance_dt, implementation-data-type=signDistance_dt
      application-data-type=detectionReliability_dt, implementation-data-type=detectionReliability_dt
      application-data-type=DetectedLane, implementation-data-type=DetectedLane
      application-data-type=DetectedLaneBorder, implementation-data-type=DetectedLaneBorder
      application-data-type=lane_segment_x_dt, implementation-data-type=lane_segment_x_dt
      application-data-type=laneBorderLeft_dt, implementation-data-type=laneBorderLeft_dt
      application-data-type=laneBorderRight_dt, implementation-data-type=laneBorderRight_dt
      application-data-type=activate_dt, implementation-data-type=activate_dt
      application-data-type=activate_result_dt, implementation-data-type=activate_result_dt
      application-data-type=Segments, implementation-data-type=Segments
      application-data-type=Segment, implementation-data-type=Segment
      application-data-type=obstacleDistance_dt, implementation-data-type=obstacleDistance_dt
      application-data-type=obstacleReliability_dt, implementation-data-type=obstacleReliability_dt
package /Vector/PortInterfaces
  sender receiver interface SenderReceiver
    5 x data:
      TrafficSignInfo: type=TrafficSignInfo
      LaneInfo: type=LaneInfo
      TrafficSignDetection: type=TrafficSignDetection
      LaneDetection: type=LaneDetection
      ObstacleDetection: type=ObstacleDetection
  client server interface CameraObjectDetection: category=CONTROL, is-service=true
    operation StartStop
      arg Activate: type=activate_dt, direction=IN
      arg Result: type=activate_result_dt, direction=OUT
package /Vector/SystemsMappings
  system System
    system mapping SystemMapping
      data-mappings:
        data-element=TrafficSignInfo, system-signal=TrafficSignInfoSerialized
        data-element=LaneInfo, system-signal=LaneInfoSerialized
        data-element=TrafficSignDetection, system-signal=TrafficSignDetectionSerialized
        data-element=LaneDetection, system-signal=LaneDetectionSerialized
        data-element=ObstacleDetection, system-signal=ObstacleDetectionPDUSerialized
package /Vector/Transformer
  data transformation set transformation_set
    data transformation SOMEIP: transformer-chain=someip_transformer
    transformation technology someip_transformer: buffer-properties={header-length=64, in-place=false}, protocol=SOMEIP, someip-transformation-description{alignment=8, byte-order=little-endian, interface-version=1}, transformer-class=SERIALIZER, version=1
package /AUTOSAR/BaseTypes
  5 x base type:
    A_BOOL: base-type-size=8, base-type-encoding=BOOLEAN
    A_UINT8: base-type-size=8, base-type-encoding=NONE
    A_UINT16: base-type-size=16, base-type-encoding=NONE
    A_UINT32: base-type-size=32, base-type-encoding=NONE
    A_FLOAT64: base-type-size=64, base-type-encoding=IEEE754
