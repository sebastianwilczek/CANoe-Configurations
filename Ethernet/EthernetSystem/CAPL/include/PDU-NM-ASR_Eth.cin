/*@!Encoding:UTF-8*/

on preStart
{
  // disables the automatic IL start
  ILControlInit();
  UdpNm_SetAutoStartParam(0);
}

//void UdpNm_StateChangeNotification(long previousState, long currentState)
//{
//  Write( "Nm_StateChangeNotification: From %d to %d", previousState, currentState);
//}

