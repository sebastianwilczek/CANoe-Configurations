/*@!Encoding:1252*/

variables
{
  // top/left reference coordinate of grid
  const double kVCC_LongitudeWest  =  9.068139;
  const double kVCC_LatitudeNorth  = 48.848545;
  const double kVCC_LongitudeEast  =  9.099066;
  const double kVCC_LatitudeSouth  = 48.817470;
  const double kVCC_ScaleLongitude = (kVCC_LongitudeEast - kVCC_LongitudeWest) / kVCC_GridWidthMeter;
  const double kVCC_ScaleLatitude  = (kVCC_LatitudeNorth - kVCC_LatitudeSouth) / kVCC_GridHeightMeter;

  
  
  
  
  
  
  
  
  
  
  char VCC_TrackGrid1[kVCC_GridHeight][kVCC_GridWidth] = {                                                                                                
"                                                                                                                                                                                                                                                                                                               ",
"                                                                                                                                                                                                                                                                                                               ",
"                                                                                                                                                                                                                                                                                                               ",
"                                                                                                                                                                                                                                                                                                               ",
"                                                                                                                                                                ..                                                                                                                                             ",
"                                                                                                                                                                 ..                                                                                                                                            ",
"                                                                                                                                                                  ..                                                                                                                                           ",
"                                                                                                                                                                   ...                                                                                                                                         ",
"                                                                                                                                                                  .x...                                                                                                                                        ",                  
"                                                                                                                                                                 .... ..x                                                                                                                                      ",
"                                                                                                                                                                x..     ...                                                                                                                                    ",
"                                                                                                                                                              ...         ...                                                                                                                                  ",
"                                                                                                                                                             ..             ..                                                                                                                                 ",
"                                                                                                                                                           0..                ..                                                                                                                               ",
"                                                                                                                                                           ..                   ..                                                                                                                             ",
"                                                                                                                                                         ..                       ..                                                                                                                           ",
"                                                                                                                                                        ..                          ..                                                                                                                         ",
"                                                                                                                                                       ..                             ..                                                                                                                       ",
"                                                                                                                                                      ..x                               .x                                                                                                                     ",
"                                                                                                                                                     ..                                  ..                                                                                                                    ",
"                                                                                                                                                    ..                                     ..                                                                                                                  ",
"                                                                                                                                                   ..                                        ..                                                                                                                ",
"                                                                                                                                                  ..                                           ..                                                                                                              ",
"                                                                                                                                                 ..                                              .x.                                                                                                           ",
"                                                                                                                                                ..                                                 .. .                                                                                                        ",
"                                                                                                                                                ..                                                .. x..x                                                                                                      ",
"                                                                                                                                               ..                                                 ..  ..                                                                                                       ",
"                                                                                                                                             ..                                                    .....x                                                                                                      ",
"                                                                                                                                            ..                                                          ..                                                                                                     ",
"                                                                                                                                            ..                                                           ..5                                                                                                   ",
"                                                                                                                                           ..                                                             ..                                                                                                   ",
"                                                                                                                                          ..                                                               ..                                                                                                  ",
"                                                                                                                                         ..                                                                 ..                                                                                                 ",
"                                                                                                                                        ..x                                                                  ..                                                                                                ",
"                                                                                                                                       ..                                                                     ..                                                                                               ",
"                                                                                                                                      ..                                                                       ..                                                                                              ",
"                                                                                                                                     ..                                                                         ..                                                                                             ",
"                                                                                                                                    ..                                                                           .x                                                                                            ",
"                                                                                                                                  ..                                                                              ..                                                                                           ",
"                                                                                                                                 1.                                                                                ..                                                                                          ",
"                                                                                                                                ..                                                                                  ..                                                                                         ",
"                                                                                                                               ..                                                                                    ..                                                                                        ",
"                                                                                                                             ..                                                                                       ..                                                                                       ",
"                                                                                                                            ..                                                                                         ..                                                                                      ",
"                                                                                                                          ..                                                                                           ..                                                                                      ",
"                                                                                                                         ..                                                                                            ..                                                                                      ",
"                                                                                                                       ..x                                                                                              ..                                                                                     ",
"                                                                                                                      ..                                                                                                 ..                                                                                    ",
"                                                                                                                     ..                                                                                                   ..x                                                                                  ",
"                                                                                                                   ..                                                                                                      ..                                                                                  ",
"                                                                                                                  ..                                                                                                        ..                                                                                 ",
"                                                                                                                 P.                                                                                                          ..                                                                                ",
"                                                                                                                ..                                                                                                           ..                                                                                ",
"                                                                                                               ..                                                                                                             .x                                                                               ",
"                                                                                                              ..                                                                                                              ..                                                                               ",
"                                                                                                             ..                                                                                                                ..                                                                              ",
"                                                                                                            ..                                                                                                                 ..                                                                              ",
"                                                                                                           ..                                                                                                                   ..                                                                             ",
"                                                                                                          ..                                                                                                                    ..                                                                             ",
"                                                                                                         ..                                                                                                                     ..                                                                             ",
"                                                                                                        ..                                                                                                                       .x                                                                            ",
"                                                                                                       ..                                                                                                                         ..                                                                           ",
"                                                                                                      ...x                                                                                                                        ..                                                                           ",
"                                                                                                     ..                                                                                                                            ..                                                                          ",
"                                                                                                     ..                                                                                                                            ..                                                                          ",
"                                                                                                   ....                                                                                                                            ..                                                                          ",
"                                                                                                   p.                                                                                                                               ..                                                                         ",
"                                                                                                  0.                                                                                                                                ..                                                                         ",
"                                                                                                 ..                                                                                                                                 ..                                                                         ",
"                                                                                                ..                                                                                                                                   ..                                                                        ",
"                                                                                               ..                                                                                                                                    ..x                                                                       ",
"                                                                                              ..                                                                                                                                      ..                                                                       ",
"                                                                                             ..                                                                                                                                       ..                                                                       ",
"                                                                                            ..                                                                                                                                         ..                                                                      ",
"                                                                                           ..x                                                                                                                                         ..                                                                      ",
"                                                                                          ..                                                                                                                                            ..                                                                     ",
"                                                                                         ..                                                                                                                                             ..                                                                     ",
"                                                                                        ..                                                                                                                                               ..                                                                    ",
"                                                                                      ...                                                                                                                                                ..                                                                    ",
"                                                                                       .                                                                                                                                                  ..                                                                   ",
"                                                                                      ..                                                                                                                                                  ..                                                                 . ",
"                                                                                    ..                                                                                                                                                     ..x                                                             ... ",
"                                                                                   ..x                                                                                                                                                     ..                                                           .....  ",
"                                                                                   ..                                                                                                                                                       ..                                                       ......    ",
"                                                                                  ..                                                                                                                                                         ..                                                   ......       ",
"                                                                                 ..                                                                                                                                                          ..                                               ......           ",
"                                                                                ..                                                                                                                                                            ..                                           .....               ",
"                                                                               ..                                                                                                                                                              .x                                       .....                  ",
"                                                                              ..x                                                                                                                                                               ..                                   ......                    ",
"                                                                             ..                                                                                                                                                                  ..                               .....                        ",
"                                                                            ..                                                                                                                                                                    ..                           ......                          ",
"                                                                           ..                                                                                                                                                                      .x                        ......                            ",
"                                                                          ..                                                                                                                                                                        ..                   ......                                ",
"                                                                         ..                                                                                                                                                                          ..               ......                                   ",
"                                                                       ...x                                                                                                                                                                           ..            .....                                      ",
"                                                                      ..                                                                                                                                                                               ..       ......                                         ",
"                                                                     ..                                                                                                                                                                                  ..  ......                                            ",
"                                                                    ..                                                                                                                                                                                   ......                                                ",
"                                                                  ..                                                                                                                                                                                   ...  .x                                                 ",
"                                                                 ..                                                                                                                                                                                 .....    ..                                                ",
"                                                                ..                                                                                                                                                                              ......         ..                                              ",
"                                                              ..5x                                                                                                                                                                           .....              ..                                             ",
"                                                            ...                                                                                                                                                                           ......                  ..                                           ",
"                                                            ..                                                                                                                                                                           .....                     ..                                          ",
"                                                          ..                                                                                                                                                                          .....                         ..                                         ",
"                                                         ..                                                                                                                                                                        .....                             ..                                        ",
"                                                       ...                                                                                                                                                                      .....                                 x.                                       ",
"                                                      ...                                                                                                                                                                    ......                                    ..p                                     ",
"                                                     ..x                                                                                                                                                                   ....                                         ..                                     ",
"                                                   ...                                                                                                                                                                   .....                                          ..                                     ",
"                                                  ..                                                                                                                                                                 ......                                             ..                                     ",
"                                                 ..                                                                                                                                                                 .....                                               ..                                     ",
"                                               ..                                                                                                                                                                 ....                                                  .x0                                    ",
"                                               ..                                                                                                                                                              ....                                                     ..                                     ",
"                                              ..x                                                                                                                                                            ...                                                        ..                                     ",
"                                             ..                                                                                                                                                            ....                                                        ..                                      ",
"                                             ..                                                                                                                                                          ....                                                          ..                                      ",
"                                            ..                                                                                                                                                         ....                                                           ..                                       ",
"                                            ..                                                                                                                                                       ...                                                              .x                                       ",
"                                           ..                                                                                                                                                      ...                                                               ..                                        ",
"                                          ..                                                                                                                                                    ....                                                                ..                                         ",
"                                          ..                                                                                                                                                   ....                                                                ..                                          ",
"                                         ...x                                                                                                                                                ...                                                                   ..                                          ",
"                                        ..                                                                                                                                                 ....                                                                    ..                                          ",
"                                       ..                                                                                                                                                 ...                                                                     ..                                           ",
"                                     ..                                                                                                                                                 ...                                                                       ..                                           ",
"                                    ...                                                                                                                                               ....                                                                       ..                                            ",
"                                  ..                                                                                                                                                ...                                                                          ..                                            ",
"                                  ..x                                                                                                                                                 .                                                                         ..                                             ",
"                                 ..                                                                                                                                                ..                                                                           ..x                                            ",
"                                ..                                                                                                                                                .                                                                            ..                                              ",
"                                ..                                                                                                                                              .                                                                              ..                                              ",
"                               ..                                                                                                                                              .                                                                               ..                                              ",
"                              ..                                                                                                                                             .                                                                                 ..                                              ",
"                             ..                                                                                                                                            ..                                                                                  .x                                              ",
"                             ..                                                                                                                                         . .                                                                                    ..                                              ",
"                            .x                                                                                                                                          .                                                                                      ..                                              ",
"                           ..                                                                                                                                         .                                                                                        ..                                              ",
"                          ..                                                                                                                                          .                                                                                         ..                                             ",
"                          ..                                                                                                                                        .                                                                                           ..                                             ",
"                          ..                                                                                                                                       .                                                                                             .x                                            ",
"                          .x                                                                                                                                     . .                                                                                             ..                                            ",
"                         ..                                                                                                                                     .                                                                                                ..                                            ",
"                         ..                                                                                                                                    ..                                                                                                ..                                            ",
"                         ..                                                                                                                                   .                                                                                                   ..                                           ",
"                         ..                                                                                                                                  ..                                                                                                    ..                                          ",
"                         ..                                                                                                                                .                                                                                                        ..x                                        ",
"                         .x                                                                                                                               .                                                                                                          ..                                        ",
"                       ...                                                                                                                               .                                                                                                            ..                                       ",
"                      ...                                                                                                                                .                                                                                                             ..                                      ",
"                    ....                                                                                                                               .                                                                                                                ..                                     ",
"                  ...x                                                                                                                                .                                                                                                                  ..                                    ",
"               ....                                                                                                                                 .                                                                                                                     .x                                   ",
"            ....                                                                                                                                  ..                                                                                                                       ..                                  ",
"         ....x                                                                                                                                  . ..                                                                                                                        ..                                 ",
"     .....                                                                                                                                     ..                                                                                                                            ..                                ",
"    ...x                                                                                                                                      ..                                                                                                                             ..                                ",
"     ..                                                                                                                                      .                                                                                                                               ..                                ",
"       ..                                                                                                                                   .                                                                                                                                .x                                ",
"        x.                                                                                                                                . .                                                                                                                                 ..P                              ",
"        ..                                                                                                                               .                                                                                                                                    ..                               ",
"         ..                                                                                                                             .                                                                                                                                     ..7                              ",
"         ..x                                                                                                                           .                                                                                                                                      ..                               ",
"          ..                                                                                                                          .                                                                                                                                       .x                               ",
"          ..                                                                                                                         .                                                                                                                                        ..                               ",
"           ..                                                                                                                      .                                                                                                                                           ..                              ",
"           ..                                                                                                                     .                                                                                                                                            ..                              ",
"            .x                                                                                                                   .                                                                                                                                             ..                           .  ",
"            ..                                                                                                                  .                                                                                                                                              .xr                       ..    ",
"            ..                                                                                                                 .                                                                                                                                               ..                      .       ",
"            ...                                                                                                               .                                                                                                                                                ..                  ...         ",
"            . .                                                                                                              .                                                                                                                                                 ..R               .             ",
"             .x.                                                                                                            .                                                                                                                                                  .x            ...               ",
"              ..                                                                                                           .                                                                                                                     ............................................                  ",
"              ..                                                                                                          .                                                                                                                      .            .              ...X                              ",
"               x.          ...........                                                                                  .                                                                                                                        .            .               ...                              ",
"               ..     ..........x.......                                                                               .                                                                                                                         .            .               ...                              ",
"               3.. .....              x...                                                                           ...                                                                                                                         .            .               ..x                              ",
"                 x.     x               ...                                                                         ...                                                                                                                          .            .               ...                              ",
"                 ..                      .x.                                                                      ....                                                                                                                           .            .               ...                              ",
"                  ..                       ..                                                                    ...                                                                                                                             .            .               ...                              ",
"                  ..                       ..x                                                                  ...                                                                                                                              .            .               ...                              ",
"                  ..                       ..                                                                  ....                                                                                                                              .             .              ...                              ",
"                  ..                       ..                                                                ....                                                                                                                                .             .              ...                              ",
"                 ..                        ..                                                               ....                                                                                                                                 .             .              ..x                              ",
"                ..                         ..x                                                             ....                                                                                                                                  .             .              ...                              ",
"              . ..                         ..                                                             ....                                                                                                                                    .            .              ...     .......... ............. ",
"          ......                          ..                                                            .....                                                                                                                                   .  .............              ..........................       ",
"       ...                                ...............................                              .....                                                                                                                                     ...          .               ......                           ",
"     ..            ........................x............................ ...................          ....                                                                                                                                        .          .                 . .                             ",
"   .. ...............................     ..     .5        x           ........................................                                                                                                                                   .         .                  ...                             ",
"..... ...                                  .                                        x      ................................                                                                                                                      .          .               ......                             ",
"..                                                                                                                         .......                                                                                                               .          .              .     .x                            ",
"                                                                                                                      x  7        ........                                                                                                      .           .             .      ...                           ",
"                                                                                                                                    .     ......                                                                                                .           .            .        ..                           ",
"                                                                                                                                    x           .....                                                                                          .              .  ........          ..                          ",
"                                                                                                                                                     ........                                                                                 .                                    ...                         ",
"                                                                                                                                                             ......                                                                           .                                     ..                         ",
"                                                                                                                                                                   ......                                                                    .                                       .x                        ",
"                                                                                                                                                                         .....                                                              .                                         ..                       ",
"                                                                                                                                                                              ......                                                        .                                          ..                      ",
"                                                                                                                                                                              x     ......                                                .                                             ..                     ",
"                                                                                                                                                                                          ......                                          .                                              ..                    ",
"                                                                                                                                                                                                ......                                   .                                               ..                    ",
"                                                                                                                                                                                                      ......                            .                                                 ..x                  ",
"                                                                                                                                                                                                        .   .....                      .                                                   ...                 ",
"                                                                                                                                                                                                        x        ......               .                                                     ....               ",
"                                                                                                                                                                                                                       .....         .                                                       ...               ",
"                                                                                                                                                                                                                       5  .....      .                                                        ...              ",
"                                                                                                                                                                                                                               ......                                                          ...             ",
"                                                                                                                                                                                                                                  ......                                                        ....           ",
"                                                                                                                                                                                                                                       .......                                                   ...           ",
"                                                                                                                                                                                                                                             ......                                               ..x          ",
"                                                                                                                                                                                                                                                  .......                                          ..          ",
"                                                                                                                                                                                                                                                   ...........                                     ...         ",
"                                                                                                                                                                                                                                                         .........                                 ...x        ",
"                                                                                                                                                                                                                                                          x ..........                             ........... ",
"                                                                                                                                                                                                                                                                 ...........                       .....       ",
"                                                                                                                                                                                                                                                                          ......                  .....        ",
"                                                                                                                                                                                                                                                                           x   ......            .....x        ",
"                                                                                                                                                                                                                                                                                    ....        .....          ",
"                                                                                                                                                                                                                                                                                       ......  ......x         ",
"                                                                                                                                                                                                                                                                                            .......            ",
"                                                                                                                                                                                                                                                                                           x .....x            ",
"                                                                                                                                                                                                                                                                                          ...........          ",
"                                                                                                                                                                                                                                                                                          .....    ....        ",
"                                                                                                                                                                                                                                                                                        ....         .....     ",
"                                                                                                                                                                                                                                                                                        ....             ..... ",
"                                                                                                                                                                                                                                                                                      ....                 ... ",
"                                                                                                                                                                                                                                                                                     ....                    . ",
"                                                                                                                                                                                                                                                                                    ....                       ",
"                                                                                                                                                                                                                                                                                  ....                         ",
"                                                                                                                                                                                                                                                                                                               "
  };

  char VCC_TrackGrid2[kVCC_GridHeight][kVCC_GridWidth] = {                                                                                                
"                                                                                                                                                                                                                                                                                                               ",
"                                                                                                                                                                                                                                                                                                               ",
"                                                                                                                                                                                                                                                                                                               ",
"                                                                                                                                                                                                                                                                                                               ",
"                                                                                                                                                                                                                                                                                                               ",
"                                                                                                                                                                                                                                                                                                               ",
"                                                                                                                                                                                                                                                                                                               ",
"                                                                                                                                                                                                                                                                                                               ",
"                                                                                                                                                                 .... .                                                                                                                                        ",                  
"                                                                                                                                                                 ..    ..                                                                                                                                      ",
"                                                                                                                                                               .          .                                                                                                                                    ",
"                                                                                                                                                             .             .                                                                                                                                   ",
"                                                                                                                                                            .                .                                                                                                                                 ",
"                                                                                                                                                           .                  .                                                                                                                                ",
"                                                                                                                                                          .                     .                                                                                                                              ",
"                                                                                                                                                         .                        .                                                                                                                            ",
"                                                                                                                                                        .                           .                                                                                                                          ",
"                                                                                                                                                       .                              .                                                                                                                        ",
"                                                                                                                                                      .                                 .                                                                                                                      ",
"                                                                                                                                                     .                                    .                                                                                                                    ",
"                                                                                                                                                    .                                       .                                                                                                                  ",
"                                                                                                                                                   .                                         .                                                                                                                 ",
"                                                                                                                                                  .                                            .                                                                                                               ",
"                                                                                                                                                 .                                               .                                                                                                             ",
"                                                                                                                                                .                                                  . ..                                                                                                        ",
"                                                                                                                                                ..                                                .    .                                                                                                       ",
"                                                                                                                                               ..                                                 .    .                                                                                                       ",
"                                                                                                                                             ..                                                     . . .                                                                                                      ",
"                                                                                                                                            ..                                                           .                                                                                                     ",
"                                                                                                                                            ..                                                            .                                                                                                    ",
"                                                                                                                                           ..                                                              .                                                                                                   ",
"                                                                                                                                          ..                                                                .                                                                                                  ",
"                                                                                                                                         ..                                                                  .                                                                                                 ",
"                                                                                                                                        ..                                                                    .                                                                                                ",
"                                                                                                                                       ..                                                                      .                                                                                               ",
"                                                                                                                                     . .                                                                       .                                                                                               ",
"                                                                                                                                     ..                                                                          .                                                                                             ",
"                                                                                                                                    ..                                                                           .                                                                                             ",
"                                                                                                                                  ..                                                                              .                                                                                            ",
"                                                                                                                                 ..                                                                                .                                                                                           ",
"                                                                                                                                ..                                                                                  .                                                                                          ",
"                                                                                                                               ..                                                                                    .                                                                                         ",
"                                                                                                                             ..                                                                                       .                                                                                        ",
"                                                                                                                            ..                                                                                         .                                                                                       ",
"                                                                                                                          ..                                                                                           .                                                                                       ",
"                                                                                                                         ..                                                                                            .                                                                                       ",
"                                                                                                                       ..                                                                                               .                                                                                      ",
"                                                                                                                      ..                                                                                                 .                                                                                     ",
"                                                                                                                     ..                                                                                                   .                                                                                    ",
"                                                                                                                   ..                                                                                                      .                                                                                   ",
"                                                                                                                  ..                                                                                                        .                                                                                  ",
"                                                                                                                 ..                                                                                                          .                                                                                 ",
"                                                                                                                ..                                                                                                            .                                                                                ",
"                                                                                                               ..                                                                                                              .                                                                               ",
"                                                                                                              ..                                                                                                               .                                                                               ",
"                                                                                                             ..                                                                                                                 .                                                                              ",
"                                                                                                            ..                                                                                                                  .                                                                              ",
"                                                                                                           ..                                                                                                                    .                                                                             ",
"                                                                                                          ..                                                                                                                     .                                                                             ",
"                                                                                                         ..                                                                                                                      .                                                                             ",
"                                                                                                        ..                                                                                                                        .                                                                            ",
"                                                                                                       ..                                                                                                                          .                                                                           ",
"                                                                                                      ..                                                                                                                           .                                                                           ",
"                                                                                                     ..                                                                                                                             .                                                                          ",
"                                                                                                     ..                                                                                                                             .                                                                          ",
"                                                                                                   ....                                                                                                                             .                                                                          ",
"                                                                                                   ..                                                                                                                                .                                                                         ",
"                                                                                                  ..                                                                                                                                 .                                                                         ",
"                                                                                                 ..                                                                                                                                  .                                                                         ",
"                                                                                                ..                                                                                                                                    .                                                                        ",
"                                                                                               ..                                                                                                                                     .                                                                        ",
"                                                                                              ..                                                                                                                                       .                                                                       ",
"                                                                                             ..                                                                                                                                        .                                                                       ",
"                                                                                            ..                                                                                                                                          .                                                                      ",
"                                                                                           ..                                                                                                                                           .                                                                      ",
"                                                                                          ..                                                                                                                                             .                                                                     ",
"                                                                                         ..                                                                                                                                              .                                                                     ",
"                                                                                        ..                                                                                                                                                .                                                                    ",
"                                                                                      ...                                                                                                                                                 .                                                                    ",
"                                                                                       .                                                                                                                                                   .                                                                   ",
"                                                                                      ..                                                                                                                                                   .                                                                 . ",
"                                                                                    ..                                                                                                                                                      .                                                              ... ",
"                                                                                   ..                                                                                                                                                       .                                                           .....  ",
"                                                                                   ..                                                                                                                                                       .                                                        ......    ",
"                                                                                  ..                                                                                                                                                         .                                                    ......       ",
"                                                                                 ..                                                                                                                                                          .                                                ......           ",
"                                                                                ..                                                                                                                                                            .                                            .....               ",
"                                                                               ..                                                                                                                                                              .                                        .....                  ",
"                                                                              ..                                                                                                                                                                .                                    ......                    ",
"                                                                             ..                                                                                                                                                                  .                                .....                        ",
"                                                                            ..                                                                                                                                                                    .                            ......                          ",
"                                                                           ..                                                                                                                                                                      .                         ......                            ",
"                                                                          ..                                                                                                                                                                         .                   ......                                ",
"                                                                         ..                                                                                                                                                                           .               ......                                   ",
"                                                                       ..                                                                                                                                                                              .            .....                                      ",
"                                                                      ..                                                                                                                                                                                .       ......                                        ",
"                                                                     ..                                                                                                                                                                                   .  ......                                            ",
"                                                                    ..                                                                                                                                                                                   ......                                                ",
"                                                                  ..                                                                                                                                                                                   ...  .                                                  ",
"                                                                 ..                                                                                                                                                                                 .....    .                                                 ",
"                                                                ..                                                                                                                                                                              ......         .                                               ",
"                                                              ..                                                                                                                                                                             .....              .                                              ",
"                                                            ...                                                                                                                                                                           ......                  .                                            ",
"                                                            ..                                                                                                                                                                           .....                     .                                           ",
"                                                          ..                                                                                                                                                                          .....                         .                                          ",
"                                                         ..                                                                                                                                                                        .....                              .                                        ",
"                                                       ..                                                                                                                                                                       .....                                 .                                        ",
"                                                      ..                                                                                                                                                                     ......                                    .                                       ",
"                                                     ..                                                                                                                                                                    ....                                         .                                      ",
"                                                   ..                                                                                                                                                                    .....                                          .                                      ",
"                                                  ..                                                                                                                                                                 ......                                             .                                      ",
"                                                 ..                                                                                                                                                                 .....                                               .                                      ",
"                                               ..                                                                                                                                                                 ....                                                  .                                      ",
"                                               ..                                                                                                                                                              ....                                                     .                                      ",
"                                              ..                                                                                                                                                             ...                                                        .                                      ",
"                                             ..                                                                                                                                                            ....                                                        .                                       ",
"                                             ..                                                                                                                                                          ....                                                          .                                       ",
"                                            ..                                                                                                                                                         ....                                                           .                                        ",
"                                            ..                                                                                                                                                       ...                                                              .                                        ",
"                                           ..                                                                                                                                                      ...                                                               .                                         ",
"                                          ..                                                                                                                                                    ....                                                                .                                          ",
"                                          ..                                                                                                                                                   ....                                                                 .                                          ",
"                                          ..                                                                                                                                                 ...                                                                    .                                          ",
"                                        ..                                                                                                                                                 ....                                                                     .                                          ",
"                                       ..                                                                                                                                                 ...                                                                      .                                           ",
"                                     ..                                                                                                                                                 ...                                                                        .                                           ",
"                                    ...                                                                                                                                               ....                                                                        .                                            ",
"                                  ..                                                                                                                                                ...                                                                           .                                            ",
"                                  ..                                                                                                                                                  .                                                                          .                                             ",
"                                 ..                                                                                                                                                ..                                                                           .                                              ",
"                                ..                                                                                                                                                .                                                                             .                                              ",
"                                ..                                                                                                                                              .                                                                               .                                              ",
"                               ..                                                                                                                                              .                                                                                .                                              ",
"                              ..                                                                                                                                             .                                                                                 .                                               ",
"                             ..                                                                                                                                            ..                                                                                  .                                               ",
"                             ..                                                                                                                                         . .                                                                                    .                                               ",
"                            ..                                                                                                                                          .                                                                                      .                                               ",
"                           ..                                                                                                                                         .                                                                                        .                                               ",
"                          ..                                                                                                                                          .                                                                                        ..                                              ",
"                          ..                                                                                                                                        .                                                                                           .                                              ",
"                          ..                                                                                                                                       .                                                                                             .                                             ",
"                          ..                                                                                                                                     . .                                                                                              .                                            ",
"                         ..                                                                                                                                     .                                                                                                 .                                            ",
"                         ..                                                                                                                                    ..                                                                                                 .                                            ",
"                         ..                                                                                                                                   .                                                                                                    .                                           ",
"                         ..                                                                                                                                  ..                                                                                                     .                                          ",
"                         ..                                                                                                                                .                                                                                                         .                                         ",
"                        ..                                                                                                                                .                                                                                                           .                                        ",
"                       ..                                                                                                                                .                                                                                                             .                                       ",
"                     ..                                                                                                                                  .                                                                                                              .                                      ",
"                    ..                                                                                                                                 .                                                                                                                 .                                     ",
"                  ..                                                                                                                                  .                                                                                                                   .                                    ",
"                ..                                                                                                                                  .                                                                                                                     .                                    ",
"            ..                                                                                                                                    ..                                                                                                                       .                                   ",
"         ..                                                                                                                                     . ..                                                                                                                        .                                  ",
"      ..                                                                                                                                       ..                                                                                                                            .                                 ",
"    ..                                                                                                                                        ..                                                                                                                             .                                 ",
"     ..                                                                                                                                      .                                                                                                                               .                                 ",
"       ..                                                                                                                                   .                                                                                                                                .                                 ",
"        ..                                                                                                                                . .                                                                                                                                 .                                ",
"        ..                                                                                                                               .                                                                                                                                    .                                ",
"         ..                                                                                                                             .                                                                                                                                     .                                ",
"          ..                                                                                                                           .                                                                                                                                      .                                ",
"          ..                                                                                                                          .                                                                                                                                       .                                ",
"          ..                                                                                                                         .                                                                                                                                         .                               ",
"           ..                                                                                                                      .                                                                                                                                           .                               ",
"           ..                                                                                                                     .                                                                                                                                            .                               ",
"            ..                                                                                                                   .                                                                                                                                             .                            .  ",
"            ..                                                                                                                  .                                                                                                                                              .                         ..    ",
"            ..                                                                                                                 .                                                                                                                                               .                       .       ",
"             ..                                                                                                               .                                                                                                                                                .                   ...         ",
"            . .                                                                                                              .                                                                                                                                                 .                 .             ",
"             ..                                                                                                             .                                                                                                                                                  .             ...               ",
"              ..                                                                                                           .                                                                                                                     .......0....7....5.....3....................                  ",
"              ..                                                                                                          .                                                                                                                      ..x    x     .x        x    ....                              ",
"               ..          ...........                                                                                  .                                                                                                                        R            .               ..X                              ",
"               ..     .........     ....                                                                               .                                                                                                                         .            .               ...                              ",
"                .. .....               ...                                                                           ...                                                                                                                         Rx           .               ...                              ",
"                 ..                     ...                                                                         ...                                                                                                                          .            .               ...                              ",
"                 ..                       ...                                                                     ....                                                                                                                           P            .               ...                              ",
"                  ..                       ..                                                                    ...                                                                                                                             .x           .               ...                              ",
"                  ..                       ..                                                                   ...                                                                                                                              .            .               ...                              ",
"                  ..                       ..                                                                  ....                                                                                                                              p             .              ..x                              ",
"                  ..                       ..                                                                ....                                                                                                                                .             .              ...                              ",
"                 ..                        ..                                                               ....                                                                                                                                 .             .              ...                              ",
"                ..                         ..                                                              ....                                                                                                                                  ..            .              ...                              ",
"              . ..                         ..                                                             ....                                                                                                                                    .x           .              ...     .......... ............. ",
"          ......                          ..                                                            .....                                                                                                                                   .  .............              ..........................       ",
"       ...                                ...............................                              .....                                                                                                                                     x..     x  ...x.             ......                           ",
"     ..            ................................                      ...................          ....                                                                                                                                        x   x      .                 . x                             ",
"   .. ...............................                                                       ...................                                                                                                                                   .         .  x               ...                             ",
"..... ...                                                                                                      ............                                                                                                                      .          .               ......                             ",
"..                                                                                                                         .......                                                                                                               .          . x            .     x.                            ",
"                                                                                                                                  ........                                                                                                      .           .             .      ...                           ",
"                                                                                                                                          ......                                                                                                .           .x.          .       ...                           ",
"                                                                                                                                                .....                                                                                          .              ...........         ...                          ",
"                                                                                                                                                     ........                                                                                 .                            x      ...                          ",
"                                                                                                                                                             ......                                                                           .                   x    x           ...                         ",
"                                                                                                                                                                   ......                                                                    .                                      ...                        ",
"                                                                                                                                                                         .....                                                              .                                        ...                       ",
"                                                                                                                                                                              ......                                                        .                                         ...                      ",
"                                                                                                                                                                                    ......                                                .                                            ...                     ",
"                                                                                                                                                                                          ......                                          .                                             ...                    ",
"                                                                                                                                                                                                ......                                   .                                               .. .                  ",
"                                                                                                                                                                                                      ......                            .                                                .....                 ",
"                                                                                                                                                                                                            .....                      .                                                   ....                ",
"                                                                                                                                                                                                                 ......               .                                                     ....               ",
"                                                                                                                                                                                                                       .....         .                                                       ....              ",
"                                                                                                                                                                                                                          .....      .                                                        ....             ",
"                                                                                                                                                                                                                               ......                                                          ....            ",
"                                                                                                                                                                                                                                  ......                                                        .. .           ",
"                                                                                                                                                                                                                                       .......                                                  .. .           ",
"                                                                                                                                                                                                                                             ......                                              ...           ",
"                                                                                                                                                                                                                                                  .......                                         ...          ",
"                                                                                                                                                                                                                                                        ......                                    ....         ",
"                                                                                                                                                                                                                                                            ......                                 ...         ",
"                                                                                                                                                                                                                                                                 .....                             .. . ...... ",
"                                                                                                                                                                                                                                                                     .......                       ........    ",
"                                                                                                                                                                                                                                                                          ......                  .....        ",
"                                                                                                                                                                                                                                                                               ......            .....         ",
"                                                                                                                                                                                                                                                                                    ....        .....          ",
"                                                                                                                                                                                                                                                                                       ......  ....            ",
"                                                                                                                                                                                                                                                                                            .......            ",
"                                                                                                                                                                                                                                                                                          .  .....             ",
"                                                                                                                                                                                                                                                                                           ..........          ",
"                                                                                                                                                                                                                                                                                          .....    ....        ",
"                                                                                                                                                                                                                                                                                        ....         .....     ",
"                                                                                                                                                                                                                                                                                        ....             ..... ",
"                                                                                                                                                                                                                                                                                      ....                 ... ",
"                                                                                                                                                                                                                                                                                     ....                    . ",
"                                                                                                                                                                                                                                                                                    ....                       ",
"                                                                                                                                                                                                                                                                                  ....                         ",
"                                                                                                                                                                                                                                                                                                               "
  };
  
}
