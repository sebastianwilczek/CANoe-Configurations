/*@!Encoding:1252*/
variables
{
  //
  // Message header structure
  //

  _align(1) struct MessageHeader
  {
    dword messageLength;
    dword messageId;
    dword messageCrc;
  };
}

