/*@!Encoding:1252*/
/***************************************************************************************
 * Demo- and Example-Programs
 *
 * Please note: The demo and example programs only show special aspects of the software.
 * With regard to the fact that these programs are meant for demonstration purposes only,
 * Vector Informatik's liability shall be expressly excluded in cases of ordinary
 * negligence, to the extent admissible by law or statute.
 *
 * Beta-Version
 *
 * These programs are fully operative programs. However, they are not thoroughly tested
 * yet (beta-version). With regard to the fact that the programs are a beta-version only,
 * Vector Informatik's liability shall be expressly excluded in cases of ordinary
 * negligence, to the extent admissible by law or statute.
 *
 * DESCRIPTION:
 *
 * Demo test implementation of the 'OPEN Alliance Automotive Ethernet ECU Test
 * Specification - TC8 ECU Test' (Document Version 2.0, August 23, 2017)
 *
 * Copyright (c) Vector Informatik GmbH. All rights reserved.
 ***************************************************************************************/

variables
{
  char gTestCaseName[64];
  word gTestCaseNumber;
  enum Bool gStubFunctionRequired;
}

on preStart
{
  /******************************************************************************************************************/  
  
  @sysvar::Internal::TestabilityServicesUpdPort = syspar::TestabilityServicesUdpPort;   
  sysSetVariableString(sysvar::Internal::DIface0Ip, syspar::DIface0Ip);
  sysSetVariableString(sysvar::Internal::Host1SubnetMaskTester, syspar::Host1SubnetMask);  
  
  /******************************************************************************************************************/
}

void Internal_InitTestFixture(enum TestGroup testGroup, char ethReceivePacketFunctionName[])
{
  Internal_InitTestFixture(testGroup, ethReceivePacketFunctionName, 2);
}

int ConvertSubnetMaskToCidr(char subnetMask[])
{
  long       res;
  ip_Address subnetIp;
  byte       subnetArray[16];
  byte       ipv4Buf[4];
  int        i;
  byte       b;
  
  if(subnetIp.ParseAddressFromString(subnetMask) != 0)
    return -1;
  
  if(subnetIp.GetAddressAsArray(subnetArray) !=0)
  {
    if(subnetIp.GetAddressAsArray(ipv4Buf) == 0)
      memcpy(subnetArray, ipv4Buf, elcount(ipv4Buf));
    else
      return -1;
  }
  
  for(i = 0; i < elcount(subnetArray); i++)
  {
    if(subnetArray[i] != 0xFF)
      break;
  }
  
  b = i < elcount(subnetArray) ? subnetArray[i] : 0;
  i = i * 8;
  while(b >> 7 != 0)
  {
    b = b << 1;
    i++;
  }
  
  return i;
}

void Internal_InitTestFixture(enum TestGroup testGroup, char ethReceivePacketFunctionName[], int numberOfBusses)
{
  int i;  
  long res;
  char tempstr[12];
  
  /******************************************************************************************************************/  
  long resMask;
  IP_Address addr;
  IP_Address mask;

  
  // TODO: configure MAC address of tester
  // TODO: congigure VLAN of tester
  
  res = addr.ParseAddressFromString(syspar::IpAddressTester);
  if (res == 0)
  {
    res = ipAddAdapterAddress(1, addr, ConvertSubnetMaskToCidr(syspar::Host1SubnetMask));
    if(res != 0)
      writeLineEx(4,3,"ipAddAdapterAddress returend error %d", res);
  }
  else
  {
   writeLineEx(4,3,"addr.ParseAddressFromString(%s) returend error %d", syspar::IpAddressTester, res);
  }
  /******************************************************************************************************************/ 
  
  sysSetVariableInt(sysvar::TC8_DUT_Config::TestGroup, (dword)testGroup);
  
  gMaximumChannelNumber = numberOfBusses;
  
    /* store bus contexts */
  for(i = 1; i <= numberOfBusses; i++)
  {
    snprintf(tempstr, elcount(tempstr), "Ethernet_%d", i);
    if (GetBusNameContext(tempstr) == 0)
    {
      write("Failed to get context of bus %s", tempstr);
    }
    SetBusContext(GetBusNameContext(tempstr));
    res = EthReceivePacket(ethReceivePacketFunctionName);
 
    if (res != 0)
    {
     write("Failed to subscribe to EthReceivePacket for Eth 1 (%d)", res);
    }
  }  
  
  StubInitialization();
  testWaitForTimeout(syspar::InitialBootTimeMs);
    
}

void Internal_InitTestCase(char testCaseName[], int testGroup, char testGroupName[], int testCaseNumber, enum Bool stubFunctionRequired)
{
  
  write("===========================================");
  write("Starting Testcase %s", testCaseName);
  write("===========================================");

  strncpy(gTestCaseName, testCaseName, elcount(gTestCaseName));
  gTestCaseNumber = testCaseNumber;
  gStubFunctionRequired = stubFunctionRequired;
  sysSetVariableInt(sysvar::TC8_DUT_Config::RunTestabilityStartAndEndFunctions, syspar::RunTestabilityStartAndEndFunctions);

  sysSetVariableString(sysvar::TC8_DUT_Config::CurrentTestcaseName, testCaseName);
  sysSetVariableInt(sysvar::TC8_DUT_Config::TestcaseNumber, testCaseNumber);
  sysSetVariableInt(sysvar::TC8_DUT_Config::TestGroup, testGroup);
  sysSetVariableString(sysvar::TC8_DUT_Config::TestGroupName, testGroupName);

  if ((syspar::RunTestabilityStartAndEndFunctions == 1 && gStubFunctionRequired == kTrue) || syspar::RunTestabilityStartAndEndFunctions == 2) {
    Stub_GeneralStartTest();
  }
  // Leave the DUT some additional time to prepare the test case
  testWaitForTimeout(syspar::TestCompletionTimeMs);
  
  gExtractingParameters.Clear();
  gExtractingParametersCount = 0;
  
  InternalClearAllParameters();
}

void Internal_EndTestFixture()
{

  sysSetVariableInt(sysvar::TC8_DUT_Config::TestGroup, kNoTestGroup);
  StubCleanup();
}

void Internal_EndTestCase()
{
  if ((syspar::RunTestabilityStartAndEndFunctions == 1 && gStubFunctionRequired == kTrue) || syspar::RunTestabilityStartAndEndFunctions == 2) {
    Stub_GeneralEndTest(gTestCaseNumber, gTestCaseName);
    // leave the test case time to complete
    testWaitForTimeout(syspar::TestCompletionTimeMs);
  }
  
  sysSetVariableString(sysvar::TC8_DUT_Config::CurrentTestcaseName, "");
}

void InternalRemoveHostAddresses()
{
  const dword IPV4_STR_SIZE = 16;    // IPv4 string size
  const dword AF_INET = 2;           // IPv4 adapter family
  const dword BUFSIZE = 10;          // Buffer size of the address-array
  dword i;                           // a loop variable
  dword ipv4Addr[BUFSIZE];           // an array where all ipv4 adapter addresses are stored in
  char ipv4AddrStr[IPV4_STR_SIZE];   // human readable ipv4 string buffer.
  long ipv4AdrCount;                 // IPv4 address count
  dword ifIdx;                       // interface index
  long result;                       // function result.
  dword host1Ip;
  dword host1Subnet;
  
  host1Ip = ipGetAddressAsNumber(syspar::Host1Ip);
  host1Subnet = ipGetAddressAsNumber(syspar::Host1SubnetMask);

  for (ifIdx = 1; ifIdx <= 2; ifIdx++)
  {
    ipv4AdrCount = IpGetAdapterAddressCount( ifIdx, AF_INET );
    if (ipv4AdrCount >= 0)
    {
      result = IpGetAdapterAddress( ifIdx, ipv4Addr, elcount(ipv4Addr) );
      if (result == 0)
      {
        for (i = 0; i < ipv4AdrCount; i++)
        {
          if (ipv4Addr[i] == host1Ip)
          {
            result = IpRemoveAdapterAddress(i, ipGetAddressAsNumber(syspar::Host1Ip), ipGetAddressAsNumber(syspar::Host1SubnetMask));
            if( result != 0 )
            {
              write( "IpRemoveAdapterAddress Host1 failed, error code %d, last error %d", result, IpGetLastError());
            }
          }
        }
      }
    }
  }
}
