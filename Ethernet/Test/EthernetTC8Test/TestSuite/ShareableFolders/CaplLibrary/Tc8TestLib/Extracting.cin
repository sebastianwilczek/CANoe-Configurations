/*@!Encoding:1252*/
/***************************************************************************************
 * Demo- and Example-Programs
 *
 * Please note: The demo and example programs only show special aspects of the software.
 * With regard to the fact that these programs are meant for demonstration purposes only,
 * Vector Informatik's liability shall be expressly excluded in cases of ordinary
 * negligence, to the extent admissible by law or statute.
 *
 * Beta-Version
 *
 * These programs are fully operative programs. However, they are not thoroughly tested
 * yet (beta-version). With regard to the fact that the programs are a beta-version only,
 * Vector Informatik's liability shall be expressly excluded in cases of ordinary
 * negligence, to the extent admissible by law or statute.
 *
 * DESCRIPTION:
 *
 * Demo test implementation of the 'OPEN Alliance Automotive Ethernet ECU Test
 * Specification - TC8 ECU Test' (Document Version 2.0, August 23, 2017)
 *
 * Copyright (c) Vector Informatik GmbH. All rights reserved.
 ***************************************************************************************/

/**
 * Set a parameter to extract the value of a token of an incoming packet that passes CompareParameters.
 * @param protocol The protocol.
 * @param token The token.
 * @param type The extracting type.
 */
void InternalSetExtractedParameter(char protocol[], char token[], enum ExtractingType type)
{
  struct ExtractingParameter param;
  
  strncpy(param.Protocol, protocol, elcount(param.Protocol));
  strncpy(param.Token, token, elcount(param.Token));
  param.Type = type;
  param.Value = 0;
  param.DataValueLength = 0;
  memcpy(gExtractingParameters[gExtractingParametersCount], param);
  gExtractingParametersCount++;
}

/**
 * Extract a parameter from a packet.
 * @param packetHandle The packet.
 */
void ExtractParameter(long packetHandle, long someIpHandle)
{
 long result;
  
 for(int64 akey : gExtractingParameters)
 {
  if (gExtractingParameters[akey].Type == kExtractInt64)
  {
    gExtractingParameters[akey].Value = GetTokenInt64(packetHandle, someIpHandle, gExtractingParameters[akey].Protocol, gExtractingParameters[akey].Token, result);
    if(result != 0) write("Error @ Extracting Data %s->%s %d", gExtractingParameters[akey].Protocol, gExtractingParameters[akey].Token, result);
    write("Extracted parameter from incoming packet %s->%s: %d", gExtractingParameters[akey].Protocol, gExtractingParameters[akey].Token, gExtractingParameters[akey].Value);
  }
  if (gExtractingParameters[akey].Type == kExtractData)
  {
    gExtractingParameters[akey].DataValueLength = GetTokenData(packetHandle, someIpHandle, gExtractingParameters[akey].Protocol, gExtractingParameters[akey].Token, 0,
                                                                  elcount(gExtractingParameters[akey].DataValue), gExtractingParameters[akey].DataValue, result);
    if (result != 0) write("ERROR @ EXTRACTING DATA=%d", result);
  }
 }
}