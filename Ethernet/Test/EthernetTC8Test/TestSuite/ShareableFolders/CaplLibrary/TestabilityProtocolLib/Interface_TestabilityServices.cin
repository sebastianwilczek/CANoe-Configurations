/*@!Encoding:1252*/
/***************************************************************************************
 * Demo- and Example-Programs
 *
 * Please note: The demo and example programs only show special aspects of the software.
 * With regard to the fact that these programs are meant for demonstration purposes only,
 * Vector Informatik's liability shall be expressly excluded in cases of ordinary
 * negligence, to the extent admissible by law or statute.
 *
 * Beta-Version
 *
 * These programs are fully operative programs. However, they are not thoroughly tested
 * yet (beta-version). With regard to the fact that the programs are a beta-version only,
 * Vector Informatik's liability shall be expressly excluded in cases of ordinary
 * negligence, to the extent admissible by law or statute.
 *
 * DESCRIPTION:
 *
 * Demo test implementation of the 'OPEN Alliance Automotive Ethernet ECU Test
 * Specification - TC8 ECU Test' (Document Version 2.0, August 23, 2017)
 *
 * Copyright (c) Vector Informatik GmbH. All rights reserved.
 ***************************************************************************************/

includes
{
  #include "Internal_TestabilityUtils.cin"
}

variables
{
}

/**
 * Function to initialize the Testability Service Client (Tester)
 */
void InitTestabilityServiceClient(dword responseTimeoutMs)
{
  InternalInitTestabilityServiceClient(responseTimeoutMs);
}

/**
 * Function to clean up the Testability Service Client (Tester)
 */
void CleanupTestabilityServiceClient()
{
  InternalCleanupTestabilityServiceClient();
}

/**
 * Service Primitive GetVersion (General)
 */
enum TestabilityMessageResultIds SP_General_GetVersion()
{
  InternalResetTestabilityMessage();
  
  return InternalSendTestabilityRequest_WaitForResponse(kTestabilityGroupGeneral, kTestabilityGroupGeneralGetVersion);
}

/**
 * Service Primitive StartTest (General)
 */
enum TestabilityMessageResultIds SP_General_StartTest()
{
  InternalResetTestabilityMessage();
  return InternalSendTestabilityRequest_WaitForResponse(kTestabilityGroupGeneral, kTestabilityGroupGeneralStartTest);
}

/**
 * Service Primitive End Test (General)
 */
enum TestabilityMessageResultIds SP_General_EndTest(word tcId, char tsName[])
{
  InternalResetTestabilityMessage();
  
  InternalAddParamInt(tcId);
  InternalAddParamText(tsName);
  
  return InternalSendTestabilityRequest_WaitForResponse(kTestabilityGroupGeneral, kTestabilityGroupGeneralEndTest);
}

/**
 * Service Primitive Create And Bind (UDP)
 */
enum TestabilityMessageResultIds SP_Udp_CreateAndBind()
{
  word  anyPort = 0xFFFF;
  dword anyIp   = 0;
  
  return SP_Udp_CreateAndBind(0, anyPort, anyIp);
}

/**
 * Service Primitive Create And Bind (UDP)
 */
enum TestabilityMessageResultIds SP_Udp_CreateAndBind(byte doBind, word localPort, dword localIpv4Address)
{
  InternalResetTestabilityMessage();
  
  InternalAddParamBool(doBind);
  InternalAddParamInt(localPort);
  
  // IP address needs to be swapped, as in CAPL IP addresses are represented in little endian format
  // see help 'IP Address Byte Ordering'
  InternalAddParamVarLength(swapDWord(localIpv4Address));
  
  return InternalSendTestabilityRequest_WaitForResponse(kTestabilityGroupUDP, kTestabilityGroupUDPCreateAndBind);
}

/**
 * Service Primitive Create And Bind (UDP)
 */
enum TestabilityMessageResultIds SP_Udp_CreateAndBind(byte doBind, word localPort, byte localIpAddress[])
{
  InternalResetTestabilityMessage();
  
  InternalAddParamBool(doBind);
  InternalAddParamInt(localPort);
  
  InternalAddParamVarLength(localIpAddress);
  
  return InternalSendTestabilityRequest_WaitForResponse(kTestabilityGroupUDP, kTestabilityGroupUDPCreateAndBind);
}

/**
 * Service Primitive Close Socket (UDP)
 */
enum TestabilityMessageResultIds SP_Udp_CloseSocket(word socketHandle)
{
  InternalResetTestabilityMessage();
  
  InternalAddParamInt(socketHandle);
  
  return InternalSendTestabilityRequest_WaitForResponse(kTestabilityGroupUDP, kTestabilityGroupUDPCloseSocket);
}

/**
 * Service Primitive Send Data (UDP)
 */
enum TestabilityMessageResultIds SP_Udp_SendData(word socketHandle, word dataLength, word destPort, dword destIpv4Address, char data[])
{
  InternalResetTestabilityMessage();
  
  InternalAddParamInt(socketHandle);
  InternalAddParamInt(dataLength);
  InternalAddParamInt(destPort);
  
  // IP address needs to be swapped, as in CAPL IP addresses are represented in little endian format
  // see help 'IP Address Byte Ordering'
  InternalAddParamVarLength(swapDWord(destIpv4Address));
  InternalAddParamVarLength(data);
  
  return InternalSendTestabilityRequest_DontWaitForResponse(kTestabilityGroupUDP, kTestabilityGroupUDPSendData);
}

/**
 * Service Primitive Send Data (UDP)
 */
enum TestabilityMessageResultIds SP_Udp_SendData(word socketHandle, word dataLength, word destPort, byte destIpAddress[], char data[])
{
  InternalResetTestabilityMessage();
  
  InternalAddParamInt(socketHandle);
  InternalAddParamInt(dataLength);
  InternalAddParamInt(destPort);

  InternalAddParamVarLength(destIpAddress);
  InternalAddParamVarLength(data);
  
  return InternalSendTestabilityRequest_DontWaitForResponse(kTestabilityGroupUDP, kTestabilityGroupUDPSendData);
}

/**
 * Service Primitive Receive and Forward (UDP)
 */
enum TestabilityMessageResultIds SP_Udp_ReceiveAndForward(word socketHandle, word maxFwd, word maxLen)
{
  InternalResetTestabilityMessage();
  
  InternalAddParamInt(socketHandle);
  InternalAddParamInt(maxFwd);
  InternalAddParamInt(maxLen);
  
  return InternalSendTestabilityRequest_WaitForResponse(kTestabilityGroupUDP, kTestabilityGroupUDPReceiveAndFwd);
}

/**
 * Service Primitive Configure Socket (UDP)
 */
enum TestabilityMessageResultIds SP_Udp_ConfigureSocket(word socketHandle, word paramId, byte data[])
{
  InternalResetTestabilityMessage();
  
  InternalAddParamInt(socketHandle);
  InternalAddParamInt(paramId);
  InternalAddParamVarLength(elcount(data), data);
  
  return InternalSendTestabilityRequest_WaitForResponse(kTestabilityGroupUDP, kTestabilityGroupUDPConfigureSocket);
}

/**
 * Service Primitive Configure Socket (UDP)
 */
enum TestabilityMessageResultIds SP_Udp_ConfigureSocket(word socketHandle, word paramId, byte data[], word length)
{
  InternalResetTestabilityMessage();
  
  InternalAddParamInt(socketHandle);
  InternalAddParamInt(paramId);
  InternalAddParamVarLength(length, data);
  
  return InternalSendTestabilityRequest_WaitForResponse(kTestabilityGroupUDP, kTestabilityGroupUDPConfigureSocket);
}

/**
 * Service Primitive Shutdown (UDP)
 */
enum TestabilityMessageResultIds SP_Udp_Shutdown(word socketHandle, byte typeId)
{
  InternalResetTestabilityMessage();
  
  InternalAddParamInt(socketHandle);
  InternalAddParamInt(typeId);
  
  return InternalSendTestabilityRequest_WaitForResponse(kTestabilityGroupUDP, kTestabilityGroupUDPShutdown);
}

/// <TestabilityServiceForTcp>
/**
 * Service Primitive Create And Bind (TCP)
 */
enum TestabilityMessageResultIds SP_Tcp_CreateAndBind()
{
  word  anyPort = 0xFFFF;
  dword anyIp   = 0;
  
  return SP_Tcp_CreateAndBind(0, anyPort, anyIp);
}

/// <TestabilityServiceForTcp>
/**
 * Service Primitive Create And Bind (TCP)
 */
enum TestabilityMessageResultIds SP_Tcp_CreateAndBind(byte doBind, word localPort, dword localIpv4Address)
{
  InternalResetTestabilityMessage();
  
  InternalAddParamBool(doBind);
  InternalAddParamInt(localPort);
  
  // IP address needs to be swapped, as in CAPL IP addresses are represented in little endian format
  // see help 'IP Address Byte Ordering'
  InternalAddParamVarLength(swapDWord(localIpv4Address));
  
  return InternalSendTestabilityRequest_WaitForResponse(kTestabilityGroupTCP, kTestabilityGroupTCPCreateAndBind);
}

/// <TestabilityServiceForTcp>
/**
 * Service Primitive Create And Bind (TCP)
 */
enum TestabilityMessageResultIds SP_Tcp_CreateAndBind(byte doBind, word localPort, byte localIpAddress[])
{
  InternalResetTestabilityMessage();
  
  InternalAddParamBool(doBind);
  InternalAddParamInt(localPort);

  InternalAddParamVarLength(localIpAddress);
  
  return InternalSendTestabilityRequest_WaitForResponse(kTestabilityGroupTCP, kTestabilityGroupTCPCreateAndBind);
}

/// <TestabilityServiceForTcp>
/**
 * Service Primitive Connect (TCP)
 */
enum TestabilityMessageResultIds SP_Tcp_Connect(word socketHandle, word dstPort, dword dstIpv4Address)
{
  InternalResetTestabilityMessage();
  
  InternalAddParamInt(socketHandle);
  InternalAddParamInt(dstPort);
  
  // IP address needs to be swapped, as in CAPL IP addresses are represented in little endian format
  // see help 'IP Address Byte Ordering'
  InternalAddParamVarLength(swapDWord(dstIpv4Address));
  
  return InternalSendTestabilityRequest_DontWaitForResponse(kTestabilityGroupTCP, kTestabilityGroupTCPConnect);
}

/// <TestabilityServiceForTcp>
/**
 * Service Primitive Connect (TCP)
 */
enum TestabilityMessageResultIds SP_Tcp_Connect(word socketHandle, word dstPort, byte dstIpAddress[])
{
  InternalResetTestabilityMessage();
  
  InternalAddParamInt(socketHandle);
  InternalAddParamInt(dstPort);
  
  InternalAddParamVarLength(dstIpAddress);
  
  return InternalSendTestabilityRequest_DontWaitForResponse(kTestabilityGroupTCP, kTestabilityGroupTCPConnect);
}

/// <TestabilityServiceForTcp>
/**
 * Service Primitive Connect (TCP)
 */
enum TestabilityMessageResultIds SP_Tcp_Connect_WaitForResponse(word socketHandle, word dstPort, dword dstIpv4Address)
{
  InternalResetTestabilityMessage();
  
  InternalAddParamInt(socketHandle);
  InternalAddParamInt(dstPort);
  
  // IP address needs to be swapped, as in CAPL IP addresses are represented in little endian format
  // see help 'IP Address Byte Ordering'
  InternalAddParamVarLength(swapDWord(dstIpv4Address));
  
  return InternalSendTestabilityRequest_WaitForResponse(kTestabilityGroupTCP, kTestabilityGroupTCPConnect);
}

/// <TestabilityServiceForTcp>
/**
 * Service Primitive Connect (TCP)
 */
enum TestabilityMessageResultIds SP_Tcp_Connect_WaitForResponse(word socketHandle, word dstPort, byte dstIpAddress[])
{
  InternalResetTestabilityMessage();
  
  InternalAddParamInt(socketHandle);
  InternalAddParamInt(dstPort);

  InternalAddParamVarLength(dstIpAddress);
  
  return InternalSendTestabilityRequest_WaitForResponse(kTestabilityGroupTCP, kTestabilityGroupTCPConnect);
}

/// <TestabilityServiceForTcp>
/**
 * Service Listen and Accept (TCP)
 */
enum TestabilityMessageResultIds SP_Tcp_Listen_and_Accept(word socketHandle, word maxCon)
{
  InternalResetTestabilityMessage();
  
  InternalAddParamInt(socketHandle);
  InternalAddParamInt(maxCon);
  
  return InternalSendTestabilityRequest_WaitForResponse(kTestabilityGroupTCP, kTestabilityGroupTCPListenAndAccept);
}

/// <TestabilityServiceForTcp>
/**
 * Service Primitive Close Socket (TCP)
 */
enum TestabilityMessageResultIds SP_Tcp_CloseSocket(word socketHandle, byte abort)
{
  InternalResetTestabilityMessage();
  
  InternalAddParamInt(socketHandle);
  InternalAddParamBool(abort);
  
  return InternalSendTestabilityRequest_DontWaitForResponse(kTestabilityGroupTCP, kTestabilityGroupTCPCloseSocket);
}

/// <TestabilityServiceForTcp>
/**
 * Service Primitive Close Socket (TCP)
 */
enum TestabilityMessageResultIds SP_Tcp_CloseSocket_WaitForResponse(word socketHandle, byte abort)
{
  InternalResetTestabilityMessage();
  
  InternalAddParamInt(socketHandle);
  InternalAddParamBool(abort);
  
  return InternalSendTestabilityRequest_WaitForResponse(kTestabilityGroupTCP, kTestabilityGroupTCPCloseSocket);
}

/// <TestabilityServiceForTcp>
/**
 * Service Primitive Send Data (TCP)
 */
enum TestabilityMessageResultIds SP_Tcp_SendData(word socketHandle, word dataLength, char data[], byte flags)
{
  InternalResetTestabilityMessage();
  
  InternalAddParamInt(socketHandle);
  InternalAddParamInt(dataLength);
  
  InternalAddParamInt(flags);  
  InternalAddParamVarLength(data);
  
  return InternalSendTestabilityRequest_DontWaitForResponse(kTestabilityGroupTCP, kTestabilityGroupTCPSendData);
}

/// <TestabilityServiceForTcp>
/**
 * Service Primitive Send Data (TCP)
 */
enum TestabilityMessageResultIds SP_Tcp_SendData_WaitForResponse(word socketHandle, word dataLength, char data[], byte flags)
{
  InternalResetTestabilityMessage();
  
  InternalAddParamInt(socketHandle);
  InternalAddParamInt(dataLength);
  
  InternalAddParamInt(flags);  
  InternalAddParamVarLength(data);
  
  return InternalSendTestabilityRequest_WaitForResponse(kTestabilityGroupTCP, kTestabilityGroupTCPSendData);
}

/// <TestabilityServiceForTcp>
/**
 * Service Primitive Receive and Forward (TCP)
 */
enum TestabilityMessageResultIds SP_Tcp_ReceiveAndForward(word socketHandle, word maxFwd, word maxLen)
{
  InternalResetTestabilityMessage();
  
  InternalAddParamInt(socketHandle);
  InternalAddParamInt(maxFwd);
  InternalAddParamInt(maxLen);
  
  return InternalSendTestabilityRequest_WaitForResponse(kTestabilityGroupTCP, kTestabilityGroupTCPReceiveAndFwd);
}

/// <TestabilityServiceForTcp>
/**
 * Service Primitive Configure Socket (TCP)
 */
enum TestabilityMessageResultIds SP_Tcp_ConfigureSocket(word socketHandle, word paramId, byte data[])
{ 
  return SP_Tcp_ConfigureSocket(socketHandle, paramId, data, elcount(data));
}

/// <TestabilityServiceForTcp>
/**
 * Service Primitive Configure Socket (TCP)
 */
enum TestabilityMessageResultIds SP_Tcp_ConfigureSocket(word socketHandle, word paramId, byte data[], word dataLength)
{
  InternalResetTestabilityMessage();
  
  InternalAddParamInt(socketHandle);
  InternalAddParamInt(paramId);
  InternalAddParamVarLength(dataLength, data);
  
  return InternalSendTestabilityRequest_WaitForResponse(kTestabilityGroupTCP, kTestabilityGroupTCPConfigureSocket);
}

/// <TestabilityServiceForTcp>
/**
 * Service Primitive Shutdown (TCP)
 */
enum TestabilityMessageResultIds SP_Tcp_Shutdown(word socketHandle, byte typeId)
{
  InternalResetTestabilityMessage();
  
  InternalAddParamInt(socketHandle);
  InternalAddParamInt(typeId);
  
  return InternalSendTestabilityRequest_WaitForResponse(kTestabilityGroupTCP, kTestabilityGroupTCPShutdown);
}

/// <TestabilityServiceForARP>
/**
 * Service Primitive Clear Arp Table (ARP)
 */
enum TestabilityMessageResultIds SP_Arp_ClearArpTable()
{
  InternalResetTestabilityMessage();
  testStep("SP_Arp_ClearArpTable","Clear Arp Table (ARP) with PID=0xFF.");
  return InternalSendTestabilityRequest_WaitForResponse(kTestabilityGroupARP, 0xFF);
}

/// <TestabilityServiceForARP>
/**
 * Service Primitive Add Static Arp Table Entry (ARP)
 */
enum TestabilityMessageResultIds SP_Arp_AddStaticArpTableEntry(dword ipAddr, qword macAddress)
{
  byte data[6];

  InternalResetTestabilityMessage();

  // Set IP address
  InternalAddParamVarLength(swapDWord(ipAddr));

  // Set MAC address
  data[5] = (macAddress >> 40) & 0xFF;
  data[4] = (macAddress >> 32) & 0xFF;
  data[3] = (macAddress >> 24) & 0xFF;
  data[2] = (macAddress >> 16) & 0xFF;
  data[1] = (macAddress >> 8)  & 0xFF;
  data[0] =  macAddress        & 0xFF;
  InternalAddParamVarLength(elcount(data),data);
  testStep("SP_Arp_AddStaticArpTableEntry","Add Static Arp Table Entry (ARP) with PID=0xFD.");
  return InternalSendTestabilityRequest_WaitForResponse(kTestabilityGroupARP, 0xFD);
}
/// <TestabilityServiceForARP>
/**
 * Service Primitive Delete Static Arp Table Entry (ARP)
 */
enum TestabilityMessageResultIds SP_Arp_DeleteStaticArpTableEntry(dword ipAddr, qword macAddress)
{
  byte data[6];

  InternalResetTestabilityMessage();

  // Set IP address
  InternalAddParamVarLength(swapDWord(ipAddr));

  // Set MAC address
  data[5] = (macAddress >> 40) & 0xFF;
  data[4] = (macAddress >> 32) & 0xFF;
  data[3] = (macAddress >> 24) & 0xFF;
  data[2] = (macAddress >> 16) & 0xFF;
  data[1] = (macAddress >> 8)  & 0xFF;
  data[0] =  macAddress        & 0xFF;
  InternalAddParamVarLength(elcount(data),data);
  testStep("SP_Arp_DeleteStaticArpTableEntry","Delete Static Arp Table Entry (ARP) with PID=0xFC.");
  return InternalSendTestabilityRequest_WaitForResponse(kTestabilityGroupARP, 0xFC);
}

/// <TestabilityServiceForARP>
/**
 * Service Primitive Set Timeout for Dynamic Arp Table Entry (ARP)
 */
enum TestabilityMessageResultIds SP_Arp_SetTimeoutForDynamicArpTableEntry(dword timeout)
{
  InternalResetTestabilityMessage();

  // Set timeout
  InternalAddParamVarLength(timeout);

  testStep("SP_Arp_SetTimeoutForDynamicArpTableEntry","Set Timeout for Dynamic Arp Table Entry (ARP) with PID=0xFB.");
  return InternalSendTestabilityRequest_WaitForResponse(kTestabilityGroupARP, 0xFB);
}

/// <TestabilityServiceForARP>
/**
 * Service Primitive Clear Timeout for Dynamic Arp Table Entry (ARP)
 */
enum TestabilityMessageResultIds SP_Arp_ClearTimeoutForDynamicArpTableEntry()
{
  InternalResetTestabilityMessage();

  testStep("SP_Arp_ClearTimeoutForDynamicArpTableEntry","Clear Timeout for Dynamic Arp Table Entry (ARP) with PID=0xFA.");
  return InternalSendTestabilityRequest_WaitForResponse(kTestabilityGroupARP, 0xFA);
}

/// <TestabilityServiceForICMPv4>
/**
 * Service Primitive Echo Request (ICMPv4)
 */
enum TestabilityMessageResultIds SP_Icmp_EchoRequest(char ifName[], dword ipAddr, byte data[], word dataLen)
{
  InternalResetTestabilityMessage();

  // Set ifName
  InternalAddParamText(ifName);
  // Set IP address
  InternalAddParamVarLength(swapDWord(ipAddr));
  // Set data
  InternalAddParamVarLength(dataLen, data);

  return InternalSendTestabilityRequest_DontWaitForResponse(kTestabilityGroupICMP, 0x00);
}


/// <TestabilityServiceForTcp>
/**
 * Service Primitive get state (TCP)
 */
enum TestabilityMessageResultIds SP_Tcp_GetState(word socketHandle)
{
  InternalResetTestabilityMessage();
  
  InternalAddParamInt(socketHandle);
  
  return InternalSendTestabilityRequest_WaitForResponse(kTestabilityGroupTCP, kTestabilityGroupTCPGetState);
}


/// <TestabilityServiceForICMPv4>
/**
 * Service Primitive ICMP receive and forward (ICMPv4)
 */
enum TestabilityMessageResultIds SP_ICMP_ReceiveAndForward(word wMaxFwd, word wMaxLen)
{
  
  
  InternalResetTestabilityMessage();

  // Set wMaxFwd
  InternalAddParamInt(wMaxFwd);
  // Set wMaxLen
  InternalAddParamInt(wMaxLen);

  return InternalSendTestabilityRequest_WaitForResponse(kTestabilityGroupICMP, kTestabilityGroupICMPv4ReceiveAndFwd);
}

/**
 * Service Primitive Start Service (SOMEIP)
 */
enum TestabilityMessageResultIds SP_SomeIp_Start_Service(word wServiceID, word wNumberOfInst)
{
  InternalResetTestabilityMessage();
  
  InternalAddParamInt(wServiceID);
  InternalAddParamInt(wNumberOfInst);
    
  return InternalSendTestabilityRequest_WaitForResponse(kTestabilityGroupSOMEIP, kTestabilityGroupSOMEIPStartService);
}

/**
 * Service Primitive Start Service (SOMEIP)
 */
enum TestabilityMessageResultIds SP_SomeIp_Start_Service(word wServiceID, word wNumberOfInst, dword dwCycle, dword dwTTL)
{
  InternalResetTestabilityMessage();
  
  InternalAddParamInt(wServiceID);   //Service ID
  InternalAddParamInt(wNumberOfInst); //Number of Instance
  InternalAddParamInt(dwCycle);       //SD cyclic offer delay
  InternalAddParamInt(dwTTL);         //SD time to live
    
  return InternalSendTestabilityRequest_WaitForResponse(kTestabilityGroupSOMEIP, kTestabilityGroupSOMEIPStartService);
}


/**
 * Service Primitive Stop Service (SOMEIP)
 */
enum TestabilityMessageResultIds SP_SomeIp_Stop_Service(word wServiceID)
{
  InternalResetTestabilityMessage();
  
  InternalAddParamInt(wServiceID);
    
  return InternalSendTestabilityRequest_DontWaitForResponse(kTestabilityGroupSOMEIP, kTestabilityGroupSOMEIPStopService);
}

/**
 * Service Primitive Start Service (SOMEIP)
 */
enum TestabilityMessageResultIds SP_SomeIp_Trigger_Event(word wServiceID, word wEventGID, word wEventID)
{
  InternalResetTestabilityMessage();
  
  InternalAddParamInt(wServiceID);   //Service ID
  InternalAddParamInt(wEventGID);    //Event group ID
  InternalAddParamInt(wEventID);     //Event ID
    
  return InternalSendTestabilityRequest_WaitForResponse(kTestabilityGroupSOMEIP, kTestabilityGroupSOMEIPTriggerEvent);
}

/// <TestabilityServiceForTcp>
/**
 * Service Primitive call receive (TCP)
 */
enum TestabilityMessageResultIds SP_Tcp_Call_Receive(word socketHandle, word dataLength)
{
  InternalResetTestabilityMessage();
  
  InternalAddParamInt(socketHandle);
  InternalAddParamInt(dataLength);
    
  return InternalSendTestabilityRequest_WaitForResponse(kTestabilityGroupTCP, kTestabilityGroupTCPCallReceive);
}

/**
 * Service Primitive init dhcp client (DHCP)
 */
enum TestabilityMessageResultIds SP_Dhcp_Init_Client(char ifName[])
{
  InternalResetTestabilityMessage();
  InternalAddParamText(ifName);
  return InternalSendTestabilityRequest_WaitForResponse(kTestabilityGroupDHCP, kTestabilityGroupDhcpInitialiazeClient);
}

/**
 * Service Primitive stop dhcp client (DHCP)
 */
enum TestabilityMessageResultIds SP_Dhcp_Stop_Client(char ifName[])
{
  InternalResetTestabilityMessage();
  InternalAddParamText(ifName);
  return InternalSendTestabilityRequest_WaitForResponse(kTestabilityGroupDHCP, kTestabilityGroupDhcpStopClient);
}

/**
 * Service Primitive set dhcp option (DHCP)
 */
enum TestabilityMessageResultIds SP_Dhcp_Set_Option(char ifName[], byte code, byte value[])
{
  InternalResetTestabilityMessage();
  InternalAddParamText(ifName);
  InternalAddParamInt(code);
  InternalAddParamVarLength(elcount(value), value);
  return InternalSendTestabilityRequest_WaitForResponse(kTestabilityGroupDHCP, kTestabilityGroupDhcpInitialiazeClient);
}

/**
 * Service Primitive Interface Up (ETH)
 */
enum TestabilityMessageResultIds SP_Eth_InterfaceUp(char ifName[])
{
  InternalResetTestabilityMessage();
  InternalAddParamText(ifName);
  return InternalSendTestabilityRequest_WaitForResponse(kTestabilityGroupETH, kTestabilityGroupEthInterfaceUp);
}

/**
 * Service Primitive Interface Down (ETH)
 */
enum TestabilityMessageResultIds SP_Eth_InterfaceDown(char ifName[])
{
  InternalResetTestabilityMessage();
  InternalAddParamText(ifName);
  return InternalSendTestabilityRequest_DontWaitForResponse(kTestabilityGroupETH, kTestabilityGroupEthInterfaceDown);
}

/**
 * Service Primitive Read Signal Quality (PHY)
 */
enum TestabilityMessageResultIds SP_Phy_ReadSignalQuality(char ifName[])
{
  InternalResetTestabilityMessage();
  InternalAddParamText(ifName);
  return InternalSendTestabilityRequest_WaitForResponse(kTestabilityGroupPHY, kTestabilityGroupPhyReadSignalQuality);
}

/**
 * Service Primitive Read Cable Diagnostics Result (PHY)
 */
enum TestabilityMessageResultIds SP_Phy_ReadCableDiagnosticsResult(char ifName[])
{
  InternalResetTestabilityMessage();
  InternalAddParamText(ifName);
  return InternalSendTestabilityRequest_WaitForResponse(kTestabilityGroupPHY, kTestabilityGroupPhyReadDiagResult);
}

/**
 * Service Primitive Activate PHY Test Mode (PHY)
 */
enum TestabilityMessageResultIds SP_Phy_ActivatePhyTestMode(char ifName[], byte testMode)
{
  InternalResetTestabilityMessage();
  InternalAddParamText(ifName);
  InternalAddParamInt(testMode);
  return InternalSendTestabilityRequest_WaitForResponse(kTestabilityGroupPHY, kTestabilityGroupPhyActivateTestMode);
}

/**
 * Service Primitive Set PHY Tx Mode (PHY)
 */
enum TestabilityMessageResultIds SP_Phy_SetPhyTxMode(char ifName[], byte txMode)
{
  InternalResetTestabilityMessage();
  InternalAddParamText(ifName);
  InternalAddParamInt(txMode);
  return InternalSendTestabilityRequest_WaitForResponse(kTestabilityGroupPHY, kTestabilityGroupPhySetPhyTxMode);
}