/*@!Encoding:1252*/
/***************************************************************************************
 * Demo- and Example-Programs
 *
 * Please note: The demo and example programs only show special aspects of the software.
 * With regard to the fact that these programs are meant for demonstration purposes only,
 * Vector Informatik's liability shall be expressly excluded in cases of ordinary
 * negligence, to the extent admissible by law or statute.
 *
 * Beta-Version
 *
 * These programs are fully operative programs. However, they are not thoroughly tested
 * yet (beta-version). With regard to the fact that the programs are a beta-version only,
 * Vector Informatik's liability shall be expressly excluded in cases of ordinary
 * negligence, to the extent admissible by law or statute.
 *
 * DESCRIPTION:
 *
 * Demo test implementation of the 'OPEN Alliance Automotive Ethernet ECU Test
 * Specification - TC8 ECU Test' (Document Version 2.0, August 23, 2017)
 *
 * Copyright (c) Vector Informatik GmbH. All rights reserved.
 ***************************************************************************************/

includes
{
  #include "../StubFunctionLib/StubFunctions.cin"
}

/**
* Clear the ARL table on the DUT.
*/
export testfunction Stub_ClearArlTable()
{
  long stubResult;

  stubResult = Internal_Stub_ClearArlTable();

  switch (stubResult) {
  case 0:
    testStepPass("Stub_ClearArlTable", "Cleared ARL table on DUT.");
    break;
  case -1:
    testStepFail("Stub_ClearArlTable", "Internal stub function handling error.");
    break;
  case -2:
    testStepFail("Stub_ClearArlTable", "Stub function parse error.");
    break;
  default:
    if (kStubErrorMessages.containsKey(stubResult))
      testStepFail("Stub_ClearArlTable", kStubErrorMessages[stubResult]);
    else
      testStepFail("Stub_ClearArlTable", "Unknown error.");
    break;
  }  
}

/**
 * Add an entry to the ARL table
 * @param channel The name of the channel on the DUT
 * @param macAddress The MAC address of the entry
 */
export testfunction Stub_AddEntryToArlTable(char channel[], char macAddress[])
{
    long stubResult;

  stubResult = Internal_Stub_AddEntryToArlTable(channel, macAddress);

  switch (stubResult) {
  case 0:
    testStepPass("Stub_AddEntryToArlTable", "Added entry to ARL table on DUT.");
    break;
  case -1:
    testStepFail("Stub_AddEntryToArlTable", "Internal stub function handling error.");
    break;
  case -2:
    testStepFail("Stub_AddEntryToArlTable", "Stub function parse error.");
    break;
  default:
    if (kStubErrorMessages.containsKey(stubResult))
      testStepFail("Stub_AddEntryToArlTable", kStubErrorMessages[stubResult]);
    else
      testStepFail("Stub_AddEntryToArlTable", "Unknown error.");
    break;
  }  
}

/**
* Read the ARL table of the DUT and compare it to the expected ARL table.
* @param outChannel The comma separated channel numbers in the same order as the corresponding MAC addresses.
* @param outMac The comma separated MAC addresses in the same order as the correspoding channels.
*/
export testfunction Stub_ReadArlTable()
{
  char outChannel[10000];
  char outMac[10000];
  long stubResult;

  stubResult = Internal_Stub_ReadArlTable(outChannel, outMac);

  switch (stubResult) {
  case 0:
      CheckReadArlTableParameters(outChannel, outMac);
    break;
  case -1:
    testStepFail("Stub_ReadArlTable", "Internal stub function handling error.");
    break;
  case -2:
    testStepFail("Stub_ReadArlTable", "Stub function parse error.");
    break;
  default:
    if (kStubErrorMessages.containsKey(stubResult))
      testStepFail("Stub_ReadArlTable", kStubErrorMessages[stubResult]);
    else
      testStepFail("Stub_ReadArlTable", "Unknown error.");
    break;
  }    
}


/**
* Compare the ARL table to the expected ARL table
* @param outChannel The comma separated channel numbers in the same order as the corresponding MAC addresses.
* @param outMac The comma separated MAC addresses in the same order as the correspoding channels.
*/
void CheckReadArlTableParameters(char outChannel[], char outMac[])
{
  char channels[1000][30];
  int channelCounter = 0;
  char macs[1000][20];
  int macCounter = 0;
  int i, j;
  enum Bool containsFrame = kFalse;
  
  SplitString(outChannel, channels, channelCounter);
  SplitString(outMac, macs, macCounter);
  
  if(channelCounter != macCounter)
  {
    testStepFail("CheckReadArlTableParameters", "Invalid return parameters");
    return;
  }
  //Check if ARL table contains the routing information from each sent frame.
  for(i = 0; i < gSentFramesIndex; i++)
  {
    containsFrame = kFalse;
    for(j = 0; j < channelCounter; j++)
    {
      if(strncmp(gSentFrames[i].channel, channels[j], elcount(gSentFrames[i].channel)) == 0
         && ConvertMacAddressStringToInt64(gSentFrames[i].macAddress) == ConvertMacAddressStringToInt64(macs[j]))
      {
        //matched Frame
        containsFrame = kTrue;
        break;
      }
    }
    if(containsFrame == kFalse)
    {
      testStepFail("CheckReadArlTableParameters", "The read ARL table does not contain the routing information from sent frame with channel \"%s\" and mac \"%s\"", gSentFrames[i].channel, gSentFrames[i].macAddress);
      return;
    }
  }
  testStepPass("CheckReadArlTableParameters", "The read ARL table contains the routing information from all sent frames");
}

/**
 * Resets the traffic counter
 * @param channel The channel on which the traffic counter should be reset
 */
export testfunction Stub_ResetTrafficCounter(int channel)
{
  long stubResult;
  
  stubResult = Internal_Stub_ResetTrafficCounter(channel);
  switch (stubResult)
  {
  case 0:
    testStepPass("Stub_ResetTrafficCounter", "Successfully reset the traffic counter.");
    break;
  case -1:
    testStepFail("Stub_ResetTrafficCounter", "Internal stub function handling error.");
    break;
  case -2:
    testStepFail("Stub_ResetTrafficCounter", "Stub function parse error.");
    break;
  default:
    if (kStubErrorMessages.containsKey(stubResult))
      testStepFail("Stub_ResetTrafficCounter", kStubErrorMessages[stubResult]);
    else
      testStepFail("Stub_ResetTrafficCounter", "Unknown error.");
    break;
  }
}

/**
 * Reads out the traffic counter and compares it with a given value
 * @param channel The channel on which the traffic counter should be read
 * @param expectedValue The expected value of the channel
 * @param displayWarnings If this is true, a warning instead of a fail will be dispalyed
 */
export testfunction Stub_CheckTrafficCounter(int channel, int expectedValue, enum Bool displayWarnings)
{
  long stubResult;
  int counter;
  
  stubResult = Internal_Stub_ReadTrafficCounter(channel, counter);
  switch (stubResult)
  {
  case 0:
      if(counter == expectedValue)
        testStepPass("Stub_CheckTrafficCounter", "Sucessfully read out traffic counter. Expected = %d, Observed = %d", expectedValue, counter);
      else
        if(displayWarnings)
          testStepWarning("Stub_CheckTrafficCounter", "Sucessfully read out traffic counter. Expected = %d, Observed = %d", expectedValue, counter);
        else
          testStepFail("Stub_CheckTrafficCounter", "Sucessfully read out traffic counter. Expected = %d, Observed = %d", expectedValue, counter);
    break;
  case -1:
    testStepFail("Stub_CheckTrafficCounter", "Internal stub function handling error.");
    break;
  case -2:
    testStepFail("Stub_CheckTrafficCounter", "Stub function parse error.");
    break;
  default:
    if (kStubErrorMessages.containsKey(stubResult))
      testStepFail("Stub_CheckTrafficCounter", kStubErrorMessages[stubResult]);
    else
      testStepFail("Stub_ResetTrafficCounter", "Unknown error.");
    break;
  }
}

/**
 * Disables a port on the DUT
 * @param channel The channel on which the port should be disabled
 */
export testfunction Stub_DisablePort(int channel)
{
  long stubResult;
  
  stubResult = Internal_Stub_DisablePort(channel);
  switch (stubResult)
  {
  case 0:
    testStepPass("Stub_DisablePort", "Successfully disabled port on channel %d.", channel);
    break;
  case -1:
    testStepFail("Stub_DisablePort", "Internal stub function handling error.");
    break;
  case -2:
    testStepFail("Stub_DisablePort", "Stub function parse error.");
    break;
  default:
    if (kStubErrorMessages.containsKey(stubResult))
      testStepFail("Stub_DisablePort", kStubErrorMessages[stubResult]);
    else
      testStepFail("Stub_DisablePort", "Unknown error.");
    break;
  }
}

/**
 * Authenticates the port on the DUT (e.g. via EAPoL)
 * @param channel The channel on which the port should be authenticated
 */
export testfunction Stub_AuthenticatePort(int channel)
{
  long stubResult;
  
  stubResult = Internal_Stub_AuthenticatePort(channel);
  switch (stubResult)
  {
  case 0:
    testStepPass("Stub_AuthenticatePort", "Successfully authenticated port on channel %d.", channel);
    break;
  case -1:
    testStepFail("Stub_AuthenticatePort", "Internal stub function handling error.");
    break;
  case -2:
    testStepFail("Stub_AuthenticatePort", "Stub function parse error.");
    break;
  default:
    if (kStubErrorMessages.containsKey(stubResult))
      testStepFail("Stub_AuthenticatePort", kStubErrorMessages[stubResult]);
    else
      testStepFail("Stub_AuthenticatePort", "Unknown error.");
    break;
  }
}

/**
 * Tries to authenticate a port with invalid authentication information (e.g. via EAPoL)
 * Note: Usage of non-standard Service Primitive 
 * @param channel The channel on which the port should be authenticated
 */
export testfunction Stub_TryToAuthenticatePortWithInvalidInformation(int channel)
{
  long stubResult;
  
  stubResult = Internal_Stub_TryToAuthenticatePortWithInvalidInformation(channel);
  switch (stubResult)
  {
  case 0:
    testStepPass("Stub_TryToAuthenticatePortWithInvalidInformation", "Successfully authenticated port on channel %d.", channel);
    break;
  case -1:
    testStepFail("Stub_TryToAuthenticatePortWithInvalidInformation", "Internal stub function handling error.");
    break;
  case -2:
    testStepFail("Stub_TryToAuthenticatePortWithInvalidInformation", "Stub function parse error.");
    break;
  default:
    if (kStubErrorMessages.containsKey(stubResult))
      testStepFail("Stub_TryToAuthenticatePortWithInvalidInformation", kStubErrorMessages[stubResult]);
    else
      testStepFail("Stub_TryToAuthenticatePortWithInvalidInformation", "Unknown error.");
    break;
  }
}

/**
 * Checks whether a packet is correctly encrypted via MACsec
 * Note: This stub function does not work via the testability protocol. It directly investigates the received packet.
 * @param packetHandle The handle of the packet
 * @returns kTrue if packet is correctly encrypted, kFalse otherwise
 */
enum Bool Stub_CheckMacSec(long packetHandle)
{
  return Internal_Stub_CheckMacSec(packetHandle);
}