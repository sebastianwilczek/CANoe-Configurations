/*@!Encoding:1252*/
/***************************************************************************************
 * Demo- and Example-Programs
 *
 * Please note: The demo and example programs only show special aspects of the software.
 * With regard to the fact that these programs are meant for demonstration purposes only,
 * Vector Informatik's liability shall be expressly excluded in cases of ordinary
 * negligence, to the extent admissible by law or statute.
 *
 * Beta-Version
 *
 * These programs are fully operative programs. However, they are not thoroughly tested
 * yet (beta-version). With regard to the fact that the programs are a beta-version only,
 * Vector Informatik's liability shall be expressly excluded in cases of ordinary
 * negligence, to the extent admissible by law or statute.
 *
 * DESCRIPTION:
 *
 * Demo test implementation of the 'OPEN Alliance Automotive Ethernet ECU Test
 * Specification - TC8 ECU Test' (Document Version 2.0, August 23, 2017)
 *
 * Copyright (c) Vector Informatik GmbH. All rights reserved.
 ***************************************************************************************/

/* Change this include block to use the testability protocol instead */
includes
{
  #include "TestabilityStubFunctions/All_StubFunctions.cin" // Testability Protocol Stub Functions
  // #include "OwnStubFunctions/All_StubFunctions.cin" // Here you can add your own Stub Functions and comment out the Stub Function Vector has implemented
}

/* Stubfunction error message map */
variables
{
  long gSocketId[10]; // socket id. -1 if socket is not open
  qword gLastReceivedTestabilityReply; // in contrast to its name, this is the timestamp of the last sent testability request
}

enum Bool ComparePayload(char payload[], word payloadLength, byte outPayload[], word outPayloadLength)
{
  dword i;
  byte b1, b2;
  if (payloadLength != outPayloadLength)
  {
    //write("Payload length missmatch. expected=%d, observed=%d",payloadLength, outPayloadLength);
    return kFalse;
  }
  
  for(i = 0; i < payloadLength; i++)
  {
    b1 = (byte) payload[i];
    b2 = (byte) outPayload[i];
    //write("string=%02X, byte=%02X", b1, b2);
    if(b1 != b2)
    {
      return kFalse;
    }
  }
  return kTrue;
}

byte ConvertSubnetMaskFromStringToCiddr(char netMask[])
{
  byte netMaskCidr;
  dword netMaskRaw;
  int i;
  
   netMaskRaw = IpGetAddressAsNumber(netMask);
   netMaskCidr = 0;
   i = 1;
   while((i & netMaskRaw) > 0)
   {
    i *= 2;
    netMaskCidr++;
   }
  return netMaskCidr;
}
