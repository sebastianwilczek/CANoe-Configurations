/*@!Encoding:1252*/
/***************************************************************************************
 * Demo- and Example-Programs
 *
 * Please note: The demo and example programs only show special aspects of the software.
 * With regard to the fact that these programs are meant for demonstration purposes only,
 * Vector Informatik's liability shall be expressly excluded in cases of ordinary
 * negligence, to the extent admissible by law or statute.
 *
 * Beta-Version
 *
 * These programs are fully operative programs. However, they are not thoroughly tested
 * yet (beta-version). With regard to the fact that the programs are a beta-version only,
 * Vector Informatik's liability shall be expressly excluded in cases of ordinary
 * negligence, to the extent admissible by law or statute.
 *
 * DESCRIPTION:
 *
 * Demo test implementation of the 'OPEN Alliance Automotive Ethernet ECU Test
 * Specification - TC8 ECU Test' (Document Version 2.0, August 23, 2017)
 *
 * Copyright (c) Vector Informatik GmbH. All rights reserved.
 ***************************************************************************************/

/**
 * Get the current TCP state.
 * @param socketId Socket that should be getting the TCP state
 */
long Internal_Stub_TcpGetTcpState(word socketId, byte& tcpStateId)
{
  long result;
  result = SP_Tcp_GetState(socketId);
  tcpStateId = gInternalServicePrimitiveResponseParameters.TcpGetStateResponse.tcpState;
  return result;
}

/**
 * Check if the DUT has issued an urgent signal to its applications.
 * Note: Usage of non-standard Service Primitive
 */
long Internal_Stub_TcpCheckUrgentSignal(word socketId, word& hasIssued)
{
  return -1;
}
