/*@!Encoding:1252*/
/***************************************************************************************
 * Demo- and Example-Programs
 *
 * Please note: The demo and example programs only show special aspects of the software.
 * With regard to the fact that these programs are meant for demonstration purposes only,
 * Vector Informatik's liability shall be expressly excluded in cases of ordinary
 * negligence, to the extent admissible by law or statute.
 *
 * Beta-Version
 *
 * These programs are fully operative programs. However, they are not thoroughly tested
 * yet (beta-version). With regard to the fact that the programs are a beta-version only,
 * Vector Informatik's liability shall be expressly excluded in cases of ordinary
 * negligence, to the extent admissible by law or statute.
 *
 * DESCRIPTION:
 *
 * Demo test implementation of the 'OPEN Alliance Automotive Ethernet ECU Test
 * Specification - TC8 ECU Test' (Document Version 2.0, August 23, 2017)
 *
 * Copyright (c) Vector Informatik GmbH. All rights reserved.
 ***************************************************************************************/

/**
 * This SP will return the testability protocol version of the used protocol and service primitive implementation.
 * @param majorVer Major version
 * @param minorVer Minor version
 * @param patchVer Patch version
 */
long Internal_Stub_GeneralGetVersion(word& majorVer, word& minorVer, word& patchVer)
{
  return -1;
}

/**
 * The purpose of this SP is to have a defined entry tag in trace at the point in time the test case was started.
 */
long Stub_GeneralStartTest()
{
  // Call the UDP Service Primitive 'StartTest'
    return SP_General_StartTest();
}

/**
 * The purpose of this SP is to reset the Upper Tester.
 * @param tcId The test case ID going to be terminated
 * @param tsName The test suite name
 */
long Stub_GeneralEndTest(word tcId, char tsName[])
{
  return SP_General_EndTest(tcId, tsName);
}