/*@!Encoding:1252*/
/***************************************************************************************
 * Demo- and Example-Programs
 *
 * Please note: The demo and example programs only show special aspects of the software.
 * With regard to the fact that these programs are meant for demonstration purposes only,
 * Vector Informatik's liability shall be expressly excluded in cases of ordinary
 * negligence, to the extent admissible by law or statute.
 *
 * Beta-Version
 *
 * These programs are fully operative programs. However, they are not thoroughly tested
 * yet (beta-version). With regard to the fact that the programs are a beta-version only,
 * Vector Informatik's liability shall be expressly excluded in cases of ordinary
 * negligence, to the extent admissible by law or statute.
 *
 * DESCRIPTION:
 *
 * Demo test implementation of the 'OPEN Alliance Automotive Ethernet ECU Test
 * Specification - TC8 ECU Test' (Document Version 2.0, August 23, 2017)
 *
 * Copyright (c) Vector Informatik GmbH. All rights reserved.
 ***************************************************************************************/

/**
 * Verfifies that DUT has correctly logged that initialization process has failed and is restarting for
 * Note: Usage of non-standard Service Primitive
 * Needed for testcase DHCPv4_CLIENT_ALLOCATING_11
 */
long Internal_Stub_VerfiyDutHasLoggedFailingInitProcess()
{
  return -1;
}

/**
 * Shutdown the DHCP Client by use of network interface and port.
 * Note: Usage of non-standard Service Primitive
 * @param ifName The name of the network interface
 */
long Internal_Stub_Reboot()
{
  return -1;
}

/**
 * Reboots the network
 * Note: Usage of non-standard Service Primitive
 */
long Internal_Stub_RenewNetwork(char ifName[])
{
  return -1;
}
