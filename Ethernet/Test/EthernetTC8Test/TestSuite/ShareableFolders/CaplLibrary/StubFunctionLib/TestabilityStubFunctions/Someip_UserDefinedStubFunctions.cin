/*@!Encoding:1252*/
/***************************************************************************************
 * Demo- and Example-Programs
 *
 * Please note: The demo and example programs only show special aspects of the software.
 * With regard to the fact that these programs are meant for demonstration purposes only,
 * Vector Informatik's liability shall be expressly excluded in cases of ordinary
 * negligence, to the extent admissible by law or statute.
 *
 * Beta-Version
 *
 * These programs are fully operative programs. However, they are not thoroughly tested
 * yet (beta-version). With regard to the fact that the programs are a beta-version only,
 * Vector Informatik's liability shall be expressly excluded in cases of ordinary
 * negligence, to the extent admissible by law or statute.
 *
 * DESCRIPTION:
 *
 * Demo test implementation of the 'OPEN Alliance Automotive Ethernet ECU Test
 * Specification - TC8 ECU Test' (Document Version 2.0, August 23, 2017)
 *
 * Copyright (c) Vector Informatik GmbH. All rights reserved.
 ***************************************************************************************/

/**
* Start a SOME/IP service on the DUT.
* Note: Usage of non-standard Service Primitive
* @param serviceId The service ID.
* @param numInstances The number of service instances.
*/
long Internal_Stub_StartSomeIpService(word serviceId, word numInstances)
{
  return SP_SomeIp_Start_Service(serviceId, numInstances);
}

/**
* Stop a SOME/IP service on the DUT.
* Note: Usage of non-standard Service Primitive
* @param serviceId The service ID.
*/
long Internal_Stub_StopSomeIpService(word serviceId)
{
  return SP_SomeIp_Stop_Service(serviceId);
}

/**
 * Trigger a SOME/IP event on the DUT.
 * Note: Usage of non-standard Service Primitive
 * @param serviceId The service ID
 * @param eventGroupId The event group ID
 * @param eventId The event ID
 */
long Internal_Stub_TriggerSomeIpEvent(word serviceId, word eventGroupId, word eventId)
{
  return SP_SomeIp_Trigger_Event(serviceId, eventGroupId, eventId);
}