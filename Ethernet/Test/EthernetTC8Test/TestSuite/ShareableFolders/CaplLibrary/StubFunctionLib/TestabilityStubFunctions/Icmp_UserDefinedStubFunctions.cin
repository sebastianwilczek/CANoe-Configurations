/*@!Encoding:1252*/
/***************************************************************************************
 * Demo- and Example-Programs
 *
 * Please note: The demo and example programs only show special aspects of the software.
 * With regard to the fact that these programs are meant for demonstration purposes only,
 * Vector Informatik's liability shall be expressly excluded in cases of ordinary
 * negligence, to the extent admissible by law or statute.
 *
 * Beta-Version
 *
 * These programs are fully operative programs. However, they are not thoroughly tested
 * yet (beta-version). With regard to the fact that the programs are a beta-version only,
 * Vector Informatik's liability shall be expressly excluded in cases of ordinary
 * negligence, to the extent admissible by law or statute.
 *
 * DESCRIPTION:
 *
 * Demo test implementation of the 'OPEN Alliance Automotive Ethernet ECU Test
 * Specification - TC8 ECU Test' (Document Version 2.0, August 23, 2017)
 *
 * Copyright (c) Vector Informatik GmbH. All rights reserved.
 ***************************************************************************************/

/**
 * Data that will be received after the call of this SP will be forwarded to the test system.
 * Note: Usage of non-standard Service Primitive
 * @param maxFwd Maximum length of payload to be forwarded per event
 * @param MaxLen Maximum count of bytes to receive over all
 */
long Internal_Stub_IcmpReceiveAndForward(word maxFwd, word maxLen)
{
  return SP_ICMP_ReceiveAndForward(maxFwd, maxLen);
}

/**
 * Data that will be received after the call of this SP will be forwarded to the test system.
 * Note: Usage of non-standard Service Primitive
 * @param timeoutMilliseconds Listen timeout in milliseconds
 * @param srcAddr Output: Source address of the received datagram
 * @param destAddr Output: Destination address of the received datagramm
 * @param ttl Output: Time to live of the received datagramm
 * @param options Output: Options of the received datagramm
 * @param payload Output: The payload of the IP frame that was received
 * @param payloadLength Output: The length of the payload that was received
 */
long Internal_Stub_IcmpReceiveAndForwardEvent(long timeoutMilliseconds, char srcAddr[], char destAddr[], byte& type, byte& code, word checksum, byte payload[], word& payloadLength)
{
  long result;
  int bytesToCopy;
  result = testWaitForTextEvent(kInternalEventReceiveAndForward, timeoutMilliseconds);
  if(result == 1) // event occured
  {
    snprintf(srcAddr, elcount(srcAddr), "%d.%d.%d.%d",
             gInternalServicePrimitiveEventParameters.ReceiveAndForwardICMPEvent.bSrcIpAddress[0],
             gInternalServicePrimitiveEventParameters.ReceiveAndForwardICMPEvent.bSrcIpAddress[1],
             gInternalServicePrimitiveEventParameters.ReceiveAndForwardICMPEvent.bSrcIpAddress[2],
             gInternalServicePrimitiveEventParameters.ReceiveAndForwardICMPEvent.bSrcIpAddress[3]);
    snprintf(destAddr, elcount(destAddr), "%d.%d.%d.%d",
             gInternalServicePrimitiveEventParameters.ReceiveAndForwardICMPEvent.bDstIpAddress[0],
             gInternalServicePrimitiveEventParameters.ReceiveAndForwardICMPEvent.bDstIpAddress[1],
             gInternalServicePrimitiveEventParameters.ReceiveAndForwardICMPEvent.bDstIpAddress[2],
             gInternalServicePrimitiveEventParameters.ReceiveAndForwardICMPEvent.bDstIpAddress[3]);
    type = gInternalServicePrimitiveEventParameters.ReceiveAndForwardICMPEvent.bType;
    code = gInternalServicePrimitiveEventParameters.ReceiveAndForwardICMPEvent.bCode;
    checksum = gInternalServicePrimitiveEventParameters.ReceiveAndForwardICMPEvent.wChecksum;
    payloadLength = gInternalServicePrimitiveEventParameters.ReceiveAndForwardICMPEvent.payloadByteLength;
    memcpy(payload, gInternalServicePrimitiveEventParameters.ReceiveAndForwardICMPEvent.payload,
           _min(elcount(payloadLength), payloadLength));
    return 0;
  }
  else if(result == 0) // event did not occur
  {
    return -1;
  }
  else //error during wait
  {
    return -1;
  }
}