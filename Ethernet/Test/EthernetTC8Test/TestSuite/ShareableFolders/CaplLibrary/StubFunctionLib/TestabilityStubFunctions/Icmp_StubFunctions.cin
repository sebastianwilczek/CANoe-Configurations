/*@!Encoding:1252*/
/***************************************************************************************
 * Demo- and Example-Programs
 *
 * Please note: The demo and example programs only show special aspects of the software.
 * With regard to the fact that these programs are meant for demonstration purposes only,
 * Vector Informatik's liability shall be expressly excluded in cases of ordinary
 * negligence, to the extent admissible by law or statute.
 *
 * Beta-Version
 *
 * These programs are fully operative programs. However, they are not thoroughly tested
 * yet (beta-version). With regard to the fact that the programs are a beta-version only,
 * Vector Informatik's liability shall be expressly excluded in cases of ordinary
 * negligence, to the extent admissible by law or statute.
 *
 * DESCRIPTION:
 *
 * Demo test implementation of the 'OPEN Alliance Automotive Ethernet ECU Test
 * Specification - TC8 ECU Test' (Document Version 2.0, August 23, 2017)
 *
 * Copyright (c) Vector Informatik GmbH. All rights reserved.
 ***************************************************************************************/

/**
 * Issues the transmission of an ICMP Echo Request.
 * @param destAddr The destination address
 * @param data Payload to transmit
 */
long Internal_Stub_IcmpEchoRequest(char destAddr[], byte data[], word dataLength)
{
  char ifName[1];
  return SP_Icmp_EchoRequest(ifName, ipGetAddressAsNumber(destAddr), data, dataLength);
}

/**
 * Issues the transmission of an ICMP Echo Request.
 * @param ifName The name of the network interface
 * @param destAddr The destination address
 * @param data Payload to transmit
 */
long Internal_Stub_IcmpEchoRequest(char ifName[], char destAddr[], byte data[], word dataLength)
{
  return SP_Icmp_EchoRequest(ifName, ipGetAddressAsNumber(destAddr), data, dataLength);
}
