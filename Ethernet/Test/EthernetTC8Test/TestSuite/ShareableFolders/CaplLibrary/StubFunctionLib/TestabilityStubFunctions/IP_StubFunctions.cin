/*@!Encoding:1252*/
/***************************************************************************************
 * Demo- and Example-Programs
 *
 * Please note: The demo and example programs only show special aspects of the software.
 * With regard to the fact that these programs are meant for demonstration purposes only,
 * Vector Informatik's liability shall be expressly excluded in cases of ordinary
 * negligence, to the extent admissible by law or statute.
 *
 * Beta-Version
 *
 * These programs are fully operative programs. However, they are not thoroughly tested
 * yet (beta-version). With regard to the fact that the programs are a beta-version only,
 * Vector Informatik's liability shall be expressly excluded in cases of ordinary
 * negligence, to the extent admissible by law or statute.
 *
 * DESCRIPTION:
 *
 * Demo test implementation of the 'OPEN Alliance Automotive Ethernet ECU Test
 * Specification - TC8 ECU Test' (Document Version 2.0, August 23, 2017)
 *
 * Copyright (c) Vector Informatik GmbH. All rights reserved.
 ***************************************************************************************/

/**
 * Assigns a static IP address and Netmask to the given network interface.
 * @param ifName The name of the network interface
 * @param addr The subnet for the route
 * @param netMask The subnet mask for the route in CIDR-notation
 */
long Internal_Stub_IpStaticAddress(char ifName[], char addr[], byte netMask)
{
  return -1;
}

/**
 * Adds a static route for the network. This SP is not affecting the persistent configuration.
 * @param ifName The name of the network interface
 * @param subNet The subnet for the route
 * @param netMask The subnet mask for the route in CIDR-notation
 * @param gateway The gateway IP address for the route
 */
long Internal_Stub_IpStaticRoute(char ifName[], char subNet[], byte netMask, char gateway[])
{
  return -1;
}