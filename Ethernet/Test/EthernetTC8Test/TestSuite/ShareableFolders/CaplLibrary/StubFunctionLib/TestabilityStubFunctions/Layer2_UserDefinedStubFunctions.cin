/*@!Encoding:1252*/
/***************************************************************************************
 * Demo- and Example-Programs
 *
 * Please note: The demo and example programs only show special aspects of the software.
 * With regard to the fact that these programs are meant for demonstration purposes only,
 * Vector Informatik's liability shall be expressly excluded in cases of ordinary
 * negligence, to the extent admissible by law or statute.
 *
 * Beta-Version
 *
 * These programs are fully operative programs. However, they are not thoroughly tested
 * yet (beta-version). With regard to the fact that the programs are a beta-version only,
 * Vector Informatik's liability shall be expressly excluded in cases of ordinary
 * negligence, to the extent admissible by law or statute.
 *
 * DESCRIPTION:
 *
 * Demo test implementation of the 'OPEN Alliance Automotive Ethernet ECU Test
 * Specification - TC8 ECU Test' (Document Version 2.0, August 23, 2017)
 *
 * Copyright (c) Vector Informatik GmbH. All rights reserved.
 ***************************************************************************************/

/**
 * Clear the ARL table.
* Note: Usage of non-standard Service Primitive
 */
long Internal_Stub_ClearArlTable()
{
  return -1;
}

/**
* Read the ARL table of the DUT.
* Note: Usage of non-standard Service Primitive
* @param outChannel The comma separated channel numbers in the same order as the corresponding MAC addresses.
* @param outMac The comma separated MAC addresses in the same order as the correspoding channels.
*/
long Internal_Stub_ReadArlTable(char outChannel[], char outMac[])
{
  return -1;  
}

/**
 * Resets the traffic counter
 * Note: Usage of non-standard Service Primitive
 * @param channel The channel on which the traffic counter should be reset
 */
long Internal_Stub_ResetTrafficCounter(int channel)
{
  return -1;
}

/**
 * Reads out the traffic counter
 * Note: Usage of non-standard Service Primitive
 * @param channel The channel on which the traffic counter should be read
 * @param counter (out parameter) the value of the traffic counter
 */
long Internal_Stub_ReadTrafficCounter(int channel, int& counter)
{
  return -1;  
}

/**
 * Disables a port on the DUT
 * Note: Usage of non-standard Service Primitive
 * @param channel The channel on which the port should be disabled
 */
long Internal_Stub_DisablePort(int channel)
{
  return -1;
}

/**
 * Add an entry to the ARL table
 * Note: Usage of non-standard Service Primitive
 * @param channel The name of the channel on the DUT
 * @param macAddress The MAC address of the entry
 */
long Internal_Stub_AddEntryToArlTable(char channel[], char macAddress[])
{
  return -1;
}

/**
 * Authenticates the port on the DUT (e.g. via EAPoL)
 * Note: Usage of non-standard Service Primitive
 * @param channel The channel on which the port should be authenticated
 */
long Internal_Stub_AuthenticatePort(int channel)
{
   return -1;
}

/**
 * Tries to authenticate a port with invalid authentication information (e.g. via EAPoL)
 * Note: Usage of non-standard Service Primitive 
 * @param channel The channel on which the port should be authenticated
 */
long Internal_Stub_TryToAuthenticatePortWithInvalidInformation(int channel)
{
   return -1;
}

/**
 * Checks whether a packet is correctly encrypted via MACsec
 * Note: This stub function does not work via the testability protocol. It directly investigates the received packet.
 * @param packetHandle The handle of the packet
 * @returns kTrue if packet is correctly encrypted, kFalse otherwise
 */
enum Bool Internal_Stub_CheckMacSec(long packetHandle)
{
  return kFalse;
}