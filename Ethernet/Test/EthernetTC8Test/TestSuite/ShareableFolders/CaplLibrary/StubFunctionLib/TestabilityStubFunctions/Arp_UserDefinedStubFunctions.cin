/*@!Encoding:1252*/
/***************************************************************************************
 * Demo- and Example-Programs
 *
 * Please note: The demo and example programs only show special aspects of the software.
 * With regard to the fact that these programs are meant for demonstration purposes only,
 * Vector Informatik's liability shall be expressly excluded in cases of ordinary
 * negligence, to the extent admissible by law or statute.
 *
 * Beta-Version
 *
 * These programs are fully operative programs. However, they are not thoroughly tested
 * yet (beta-version). With regard to the fact that the programs are a beta-version only,
 * Vector Informatik's liability shall be expressly excluded in cases of ordinary
 * negligence, to the extent admissible by law or statute.
 *
 * DESCRIPTION:
 *
 * Demo test implementation of the 'OPEN Alliance Automotive Ethernet ECU Test
 * Specification - TC8 ECU Test' (Document Version 2.0, August 23, 2017)
 *
 * Copyright (c) Vector Informatik GmbH. All rights reserved.
 ***************************************************************************************/

/**
 * Clear the ARP Table.
 * Note: Usage of non-standard Service Primitive
 */
long Internal_Stub_ClearArpTable()
{
  return SP_Arp_ClearArpTable();
}

/**
 * Add a static ARP entry into ARP Table.
 * Note: Usage of non-standard Service Primitive
 * @param ipAddr IP Address
 * @param macAddress MAC Address
 */
long Internal_Stub_AddStaticArpTableEntry(char ipAddr[], char macAddress[])
{
  return SP_Arp_AddStaticArpTableEntry(IpGetAddressAsNumber(ipAddr), ethGetMacAddressAsNumber(macAddress));
}

/**
 * Delete a static ARP entry into ARP Table.
 * Note: Usage of non-standard Service Primitive
 * @param ipAddr IP Address
 * @param macAddress MAC Address
 */
long Internal_Stub_DeleteStaticArpTableEntry(char ipAddr[], char macAddress[])
{
  return SP_Arp_DeleteStaticArpTableEntry(IpGetAddressAsNumber(ipAddr), ethGetMacAddressAsNumber(macAddress));
}

/**
 * Set Timeout for Dynamic ARP Table entries.
 * Note: Usage of non-standard Service Primitive
 * @param timeout The Timeout for the dynamic ARP Table entries
 */
long Internal_Stub_SetTimeoutForDynamicArpTableEntry(dword timeout)
{
  return SP_Arp_SetTimeoutForDynamicArpTableEntry(timeout);
}

/**
 * Reset Timeout for Dynamic ARP Table entries.
 * Note: Usage of non-standard Service Primitive
 */
long Internal_Stub_ClearTimeoutForDynamicArpTableEntry()
{
  return SP_Arp_ClearTimeoutForDynamicArpTableEntry();
}
