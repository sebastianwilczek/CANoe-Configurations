/*@!Encoding:1252*/
/***************************************************************************************
 * Demo- and Example-Programs
 *
 * Please note: The demo and example programs only show special aspects of the software.
 * With regard to the fact that these programs are meant for demonstration purposes only,
 * Vector Informatik's liability shall be expressly excluded in cases of ordinary
 * negligence, to the extent admissible by law or statute.
 *
 * Beta-Version
 *
 * These programs are fully operative programs. However, they are not thoroughly tested
 * yet (beta-version). With regard to the fact that the programs are a beta-version only,
 * Vector Informatik's liability shall be expressly excluded in cases of ordinary
 * negligence, to the extent admissible by law or statute.
 *
 * DESCRIPTION:
 *
 * Demo test implementation of the 'OPEN Alliance Automotive Ethernet ECU Test
 * Specification - TC8 ECU Test' (Document Version 2.0, August 23, 2017)
 *
 * Copyright (c) Vector Informatik GmbH. All rights reserved.
 ***************************************************************************************/

/**
 * Initialize the DHCP Client by use of network interface and port.
 * @param ifName The name of the network interface
 */
long Internal_Stub_InitDhcpClient(char ifName[])
{
 return SP_Dhcp_Init_Client(ifName);
}

/**
 * Shutdown the DHCP Client by use of network interface and port.
 * @param ifName The name of the network interface
 */
long Internal_Stub_StopDhcpClient(char ifName[])
{
  return SP_Dhcp_Stop_Client(ifName);
}

/**
 * Sets DHCP Client options.
 * @param ifName The name of the network interface
 * @param code DHCP option code
 * @param value DHCP option value selected by the code parameter using the corresponding byte size
 */
long Internal_Stub_SET_DHCP_OPTION(char ifName[], byte code, byte value[])
{
  return SP_Dhcp_Set_Option(ifName, code, value);
}