/*@!Encoding:1252*/
/***************************************************************************************
 * Demo- and Example-Programs
 *
 * Please note: The demo and example programs only show special aspects of the software.
 * With regard to the fact that these programs are meant for demonstration purposes only,
 * Vector Informatik's liability shall be expressly excluded in cases of ordinary
 * negligence, to the extent admissible by law or statute.
 *
 * Beta-Version
 *
 * These programs are fully operative programs. However, they are not thoroughly tested
 * yet (beta-version). With regard to the fact that the programs are a beta-version only,
 * Vector Informatik's liability shall be expressly excluded in cases of ordinary
 * negligence, to the extent admissible by law or statute.
 *
 * DESCRIPTION:
 *
 * Demo test implementation of the 'OPEN Alliance Automotive Ethernet ECU Test
 * Specification - TC8 ECU Test' (Document Version 2.0, August 23, 2017)
 *
 * Copyright (c) Vector Informatik GmbH. All rights reserved.
 ***************************************************************************************/

includes
{
  #include "../StubFunctionLib/StubFunctions.cin"
}

variables
{
  
}

/**
* Externally configure DHCP Client.
* @param ifName The interface name.
*/
export testfunction Stub_InitDhcpClient(char ifName[])
{
  long stubResult;

  stubResult = Internal_Stub_InitDhcpClient(ifName);

  switch (stubResult) {
  case 0:
    testStepPass("Stub_InitDhcpClient", "Configure DHCP client on DUT succeeded.");
    break;
  case -1:
    testStepFail("Stub_InitDhcpClient", "Internal stub function handling error.");
    break;
  case -2:
    testStepFail("Stub_InitDhcpClient", "Stub function parse error.");
    break;
  default:
    if (kStubErrorMessages.containsKey(stubResult))
      testStepFail("Stub_InitDhcpClient", kStubErrorMessages[stubResult]);
    else
      testStepFail("Stub_InitDhcpClient", "Unknown error.");
    break;
  } 
}

/**
* Externally cause DUT to bring up <DIface-0>
* @param ifName The interface name.
*/
export testfunction Stub_InterfaceUp(char ifName[])
{
   long stubResult;

  stubResult = Internal_Stub_InterfaceUp(ifName);

  switch (stubResult) {
  case 0:
    testStepPass("Stub_InterfaceUp", "Bring Up Network on DUT succeeded.");
    break;
  case -1:
    testStepFail("Stub_InterfaceUp", "Internal stub function handling error.");
    break;
  case -2:
    testStepFail("Stub_InterfaceUp", "Stub function parse error.");
    break;
  default:
    if (kStubErrorMessages.containsKey(stubResult))
      testStepFail("Stub_InterfaceUp", kStubErrorMessages[stubResult]);
    else
      testStepFail("Stub_InterfaceUp", "Unknown error.");
    break;
  }  
}


/**
* Externally cause DUT to bring down <DIface-0>
* @param ifName The interface name.
*/
export testfunction Stub_InterfaceDown(char ifName[])
{
   long stubResult;

  stubResult = Internal_Stub_InterfaceDown(ifName);

  switch (stubResult) {
  case 0:
    testStepPass("Stub_InterfaceDown", "Bring Down Network on DUT succeeded.");
    break;
  case -1:
    testStepFail("Stub_InterfaceDown", "Internal stub function handling error.");
    break;
  case -2:
    testStepFail("Stub_InterfaceDown", "Stub function parse error.");
    break;
  default:
    if (kStubErrorMessages.containsKey(stubResult))
      testStepFail("Stub_InterfaceDown", kStubErrorMessages[stubResult]);
    else
      testStepFail("Stub_InterfaceDown", "Unknown error.");
    break;
  }  
}


/**
* Add a static route to the DUT.
* @param ifName The interface name.
* @param subNet The sub net.
* @param netMask The net mask.
* @param gateway The gateway.
*/
export testfunction Stub_StaticRoute(
  char ifName[],
  char subNet[],
  char netMask[],
  char gateway[]
  )
{
  long stubResult;

   //Replace the dut local address placeholder
  ReplaceDUTLinkLocalAddress(gateway);
  
  stubResult = Internal_Stub_IpStaticRoute(ifName, subNet, ConvertSubnetMaskFromStringToCiddr(netMask), gateway);
  
  switch (stubResult) {
  case 0:
    testStepPass("Stub_StaticRoute", "Static route added.");
    break;
  case -1:
    testStepFail("Stub_StaticRoute", "Internal stub function handling error.");
    break;
  case -2:
    testStepFail("Stub_StaticRoute", "Stub function parse error.");
    break;
  default:
    if (kStubErrorMessages.containsKey(stubResult))
      testStepFail("Stub_StaticRoute", kStubErrorMessages[stubResult]);
    else
      testStepFail("Stub_StaticRoute", "Unknown error.");
    break;
  }  
}


/**
* Externally cause DUT to shutdown.
* @param ifName The interface name.
*/
export testfunction Stub_StopDhcpClient(char ifName[])
{
  long stubResult;

  stubResult = Internal_Stub_StopDhcpClient(ifName);  
  switch (stubResult) {
  case 0:
    testStepPass("Stub_StopDhcpClient", "Shutdown DHCP Client on DUT succeeded.");
    break;
  case -1:
    testStepFail("Stub_StopDhcpClient", "Internal stub function handling error.");
    break;
  case -2:
    testStepFail("Stub_StopDhcpClient", "Stub function parse error.");
    break;
  default:
    if (kStubErrorMessages.containsKey(stubResult))
      testStepFail("Stub_StopDhcpClient", kStubErrorMessages[stubResult]);
    else
      testStepFail("Stub_StopDhcpClient", "Unknown error.");
    break;
  }  
}

/**
* Remove a static IP address from the DUT.
* @param ifName The interface name.
*/
export testfunction Stub_RemoveStaticIp(char ifName[])
{
   long stubResult;

  stubResult = Internal_Stub_IpRemoveStaticIp(ifName);

  switch (stubResult) {
  case 0:
    testStepPass("Stub_RemoveStaticIp", "Removed Static IP on DUT.");
    break;
  case -1:
    testStepFail("Stub_RemoveStaticIp", "Internal stub function handling error.");
    break;
  case -2:
    testStepFail("Stub_RemoveStaticIp", "Stub function parse error.");
    break;
  default:
    if (kStubErrorMessages.containsKey(stubResult))
      testStepFail("Stub_RemoveStaticIp", kStubErrorMessages[stubResult]);
    else
      testStepFail("Stub_RemoveStaticIp", "Unknown error.");
    break;
  }  
}

/**
* Remove a static Route from the DUT.
* @param ifName The interface name.
*/
export testfunction Stub_RemoveStaticRoute(char ifName[])
{
   long stubResult;

  stubResult = Internal_Stub_IpRemoveStaticRoute(ifName);

  switch (stubResult) {
  case 0:
    testStepPass("Stub_RemoveStaticRoute", "Removed Static Route on DUT.");
    break;
  case -1:
    testStepFail("Stub_RemoveStaticRoute", "Internal stub function handling error.");
    break;
  case -2:
    testStepFail("Stub_RemoveStaticRoute", "Stub function parse error.");
    break;
  default:
    if (kStubErrorMessages.containsKey(stubResult))
      testStepFail("Stub_RemoveStaticRoute", kStubErrorMessages[stubResult]);
    else
      testStepFail("Stub_RemoveStaticRoute", "Unknown error.");
    break;
  }  
}