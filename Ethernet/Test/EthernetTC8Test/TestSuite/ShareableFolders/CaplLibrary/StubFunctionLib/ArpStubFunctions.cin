/*@!Encoding:1252*/
/***************************************************************************************
 * Demo- and Example-Programs
 *
 * Please note: The demo and example programs only show special aspects of the software.
 * With regard to the fact that these programs are meant for demonstration purposes only,
 * Vector Informatik's liability shall be expressly excluded in cases of ordinary
 * negligence, to the extent admissible by law or statute.
 *
 * Beta-Version
 *
 * These programs are fully operative programs. However, they are not thoroughly tested
 * yet (beta-version). With regard to the fact that the programs are a beta-version only,
 * Vector Informatik's liability shall be expressly excluded in cases of ordinary
 * negligence, to the extent admissible by law or statute.
 *
 * DESCRIPTION:
 *
 * Demo test implementation of the 'OPEN Alliance Automotive Ethernet ECU Test
 * Specification - TC8 ECU Test' (Document Version 2.0, August 23, 2017)
 *
 * Copyright (c) Vector Informatik GmbH. All rights reserved.
 ***************************************************************************************/

includes
{
  #include "../StubFunctionLib/StubFunctions.cin"
}

variables
{
  
}


/**
 * Makes DUT clear its ARP table.
 */
export testfunction Stub_ClearArpTable()
{
  long stubResult;

  stubResult = Internal_Stub_ClearArpTable();

  switch (stubResult) {
  case 0:
    testStepPass("Stub_ClearArpTable", "Clear ARP Table of DUT succeeded.");
    break;
  case -1:
    testStepFail("Stub_ClearArpTable", "Internal stub function handling error.");
    break;
  case -2:
    testStepFail("Stub_ClearArpTable", "Stub function parse error.");
    break;
  default:
    if (kStubErrorMessages.containsKey(stubResult))
      testStepFail("Stub_ClearArpTable", kStubErrorMessages[stubResult]);
    else
      testStepFail("Stub_ClearArpTable", "Unknown error.");
    break;
  }
}

/**
 * Makes DUT add a static ARP entry.
 * @param idAddress The IP address of the ARP entry.
 * @param macAddress The MAC address of the ARP entry.
 */
export testfunction Stub_AddStaticArpTableEntry(char ipAddr[], char macAddress[])
{
  long stubResult;

  stubResult = Internal_Stub_AddStaticArpTableEntry(ipAddr, macAddress);

  switch (stubResult) {
  case 0:
    testStepPass("Stub_AddStaticArpTableEntry", "Add static ARP table entry to DUT succeeded.");
    break;
  case -1:
    testStepFail("Stub_AddStaticArpTableEntry", "Internal stub function handling error.");
    break;
  case -2:
    testStepFail("Stub_AddStaticArpTableEntry", "Stub function parse error.");
    break;
  default:
    if (kStubErrorMessages.containsKey(stubResult))
      testStepFail("Stub_AddStaticArpTableEntry", kStubErrorMessages[stubResult]);
    else
      testStepFail("Stub_AddStaticArpTableEntry", "Unknown error.");
    break;
  }
}

/**
 * Makes DUT delete a static ARP entry.
 * @param ipAddr The IP address of the ARP entry.
 * @param macAddress The MAC address of the ARP entry.
 */
export testfunction Stub_DeleteStaticArpTableEntry(char ipAddr[], char macAddress[])
{
  long stubResult;

  stubResult = Internal_Stub_DeleteStaticArpTableEntry(ipAddr, macAddress);

  switch (stubResult) {
  case 0:
    testStepPass("Stub_DeleteStaticArpTableEntry", "Delete static ARP entry from DUT succeeded.");
    break;
  case -1:
    testStepFail("Stub_DeleteStaticArpTableEntry", "Internal stub function handling error.");
    break;
  case -2:
    testStepFail("Stub_DeleteStaticArpTableEntry", "Stub function parse error.");
    break;
  default:
    if (kStubErrorMessages.containsKey(stubResult))
      testStepFail("Stub_DeleteStaticArpTableEntry", kStubErrorMessages[stubResult]);
    else
      testStepFail("Stub_DeleteStaticArpTableEntry", "Unknown error.");
    break;
  }
}

/**
 * Makes DUT set a defined timeout for dynamic ARP table entries.
 * @param timeout The Timeout for the dynamic ARP table entries.
 */
export testfunction Stub_SetTimeoutForDynamicArpTableEntry(dword timeout)
{
  long stubResult;

  stubResult = Internal_Stub_SetTimeoutForDynamicArpTableEntry(timeout);

  switch (stubResult) {
  case 0:
    testStepPass("Stub_SetTimeoutForDynamicArpTableEntry", "Set timeout for dynamic Arp Table entries on DUT succeeded.");
    break;
  case -1:
    testStepFail("Stub_SetTimeoutForDynamicArpTableEntry", "Internal stub function handling error.");
    break;
  case -2:
    testStepFail("Stub_SetTimeoutForDynamicArpTableEntry", "Stub function parse error.");
    break;
  default:
    if (kStubErrorMessages.containsKey(stubResult))
      testStepFail("Stub_SetTimeoutForDynamicArpTableEntry", kStubErrorMessages[stubResult]);
    else
      testStepFail("Stub_SetTimeoutForDynamicArpTableEntry", "Unknown error.");
    break;
  }
}

/**
 * Makes DUT reset a defined timeout for dynamic ARP table entries.
 */
export testfunction Stub_ClearTimeoutForDynamicArpTableEntry()
{
  long stubResult;

  stubResult = Internal_Stub_ClearTimeoutForDynamicArpTableEntry();

  switch (stubResult) {
  case 0:
    testStepPass("Stub_ClearTimeoutForDynamicArpTableEntry", "Clear timeout for dynamic Arp Table entries on DUT succeeded.");
    break;
  case -1:
    testStepFail("Stub_ClearTimeoutForDynamicArpTableEntry", "Internal stub function handling error.");
    break;
  case -2:
    testStepFail("Stub_ClearTimeoutForDynamicArpTableEntry", "Stub function parse error.");
    break;
  default:
    if (kStubErrorMessages.containsKey(stubResult))
      testStepFail("Stub_ClearTimeoutForDynamicArpTableEntry", kStubErrorMessages[stubResult]);
    else
      testStepFail("Stub_ClearTimeoutForDynamicArpTableEntry", "Unknown error.");
    break;
  }
}
