/*@!Encoding:1252*/
/***************************************************************************************
 * Demo- and Example-Programs
 *
 * Please note: The demo and example programs only show special aspects of the software.
 * With regard to the fact that these programs are meant for demonstration purposes only,
 * Vector Informatik's liability shall be expressly excluded in cases of ordinary
 * negligence, to the extent admissible by law or statute.
 *
 * Beta-Version
 *
 * These programs are fully operative programs. However, they are not thoroughly tested
 * yet (beta-version). With regard to the fact that the programs are a beta-version only,
 * Vector Informatik's liability shall be expressly excluded in cases of ordinary
 * negligence, to the extent admissible by law or statute.
 *
 * DESCRIPTION:
 *
 * Demo test implementation of the 'OPEN Alliance Automotive Ethernet ECU Test
 * Specification - TC8 ECU Test' (Document Version 2.0, August 23, 2017)
 *
 * Copyright (c) Vector Informatik GmbH. All rights reserved.
 ***************************************************************************************/

includes
{
  #include "../StubFunctionLib/StubFunctions.cin"
}

variables
{
  
}

export testfunction Stub_ConfigureDhcpClient(char ifName[])
{
  long stubResult;

  stubResult = Internal_Stub_InitDhcpClient(ifName);

  switch (stubResult) {
  case 0:
    testStepPass("Stub_ConfigureDhcpClient", "Configure DHCP client on DUT succeeded.");
    break;
  case -1:
    testStepFail("Stub_ConfigureDhcpClient", "Internal stub function handling error.");
    break;
  case -2:
    testStepFail("Stub_ConfigureDhcpClient", "Stub function parse error.");
    break;
  default:
    if (kStubErrorMessages.containsKey(stubResult))
      testStepFail("Stub_ConfigureDhcpClient", kStubErrorMessages[stubResult]);
    else
      testStepFail("Stub_ConfigureDhcpClient", "Unknown error.");
    break;
  } 
}

export testfunction Stub_BringUpNetwork(char ifName[])
{
   long stubResult;

  stubResult = Internal_Stub_InterfaceUp(ifName);

  switch (stubResult) {
  case 0:
    testStepPass("Stub_BringUpNetwork", "Bring Up Network on DUT succeeded.");
    break;
  case -1:
    testStepFail("Stub_BringUpNetwork", "Internal stub function handling error.");
    break;
  case -2:
    testStepFail("Stub_BringUpNetwork", "Stub function parse error.");
    break;
  default:
    if (kStubErrorMessages.containsKey(stubResult))
      testStepFail("Stub_BringUpNetwork", kStubErrorMessages[stubResult]);
    else
      testStepFail("Stub_BringUpNetwork", "Unknown error.");
    break;
  }  
}

export testfunction Stub_ReleaseNetwork(char ifName[])
{
   long stubResult;

  stubResult = Internal_Stub_InterfaceDown(ifName);

  switch (stubResult) {
  case 0:
    testStepPass("Stub_ReleaseNetwork", "Release Network on DUT succeeded.");
    break;
  case -1:
    testStepFail("Stub_ReleaseNetwork", "Internal stub function handling error.");
    break;
  case -2:
    testStepFail("Stub_ReleaseNetwork", "Stub function parse error.");
    break;
  default:
    if (kStubErrorMessages.containsKey(stubResult))
      testStepFail("Stub_ReleaseNetwork", kStubErrorMessages[stubResult]);
    else
      testStepFail("Stub_ReleaseNetwork", "Unknown error.");
    break;
  }  
}

export testfunction Stub_RenewNetwork(char ifName[])
{
  long stubResult;

  stubResult = Internal_Stub_RenewNetwork(ifName);  
  switch (stubResult) {
  case 0:
    testStepPass("Stub_RenewNetwork", "Renewing Network %s on DUT succeeded.", ifName);
    break;
  case -1:
    testStepFail("Stub_RenewNetwork", "Internal stub function handling error.");
    break;
  case -2:
    testStepFail("Stub_RenewNetwork", "Stub function parse error.");
    break;
  default:
    if (kStubErrorMessages.containsKey(stubResult))
      testStepFail("Stub_RenewNetwork", kStubErrorMessages[stubResult]);
    else
      testStepFail("Stub_RenewNetwork", "Unknown error.");
    break;
  }  
}

export testfunction Stub_Reboot(char ifName[])
{
  long stubResult;

  stubResult = Internal_Stub_Reboot();  
  switch (stubResult) {
  case 0:
    testStepPass("Stub_Reboot", "Reboot Network on DUT succeeded.");
    break;
  case -1:
    testStepFail("Stub_Reboot", "Internal stub function handling error.");
    break;
  case -2:
    testStepFail("Stub_Reboot", "Stub function parse error.");
    break;
  default:
    if (kStubErrorMessages.containsKey(stubResult))
      testStepFail("Stub_Reboot", kStubErrorMessages[stubResult]);
    else
      testStepFail("Stub_Reboot", "Unknown error.");
    break;
  }  
}

export testfunction Stub_AdditionalOptionLeaseTime(char ifName[], dword leaseTimeSeconds)
{
  long stubResult;
  byte data[4];
  
  data.Dword(0) = leaseTimeSeconds;
  stubResult = Internal_Stub_SET_DHCP_OPTION(ifName, 51, data);

  switch (stubResult) {
  case 0:
    testStepPass("Stub_AdditionalOptionLeaseTime", "Configure lease time option on DUT succeeded.");
    break;
  case -1:
    testStepFail("Stub_AdditionalOptionLeaseTime", "Internal stub function handling error.");
    break;
  case -2:
    testStepFail("Stub_AdditionalOptionLeaseTime", "Stub function parse error.");
    break;
  default:
    if (kStubErrorMessages.containsKey(stubResult))
      testStepFail("Stub_AdditionalOptionLeaseTime", kStubErrorMessages[stubResult]);
    else
      testStepFail("Stub_AdditionalOptionLeaseTime", "Unknown error.");
    break;
  }  
}

export testfunction Stub_AdditionalOptionClientIdentifier(char ifName[], char clientIdentifier[])
{
  long stubResult;
  byte data[17];
  
  memcpy(data,clientIdentifier,elcount(data));

  stubResult = Internal_Stub_SET_DHCP_OPTION(ifName, 61, data);

  switch (stubResult) {
  case 0:
    testStepPass("Stub_AdditionalOptionLeaseTime", "Configure lease time option on DUT succeeded.");
    break;
  case -1:
    testStepFail("Stub_AdditionalOptionLeaseTime", "Internal stub function handling error.");
    break;
  case -2:
    testStepFail("Stub_AdditionalOptionLeaseTime", "Stub function parse error.");
    break;
  default:
    if (kStubErrorMessages.containsKey(stubResult))
      testStepFail("Stub_AdditionalOptionLeaseTime", kStubErrorMessages[stubResult]);
    else
      testStepFail("Stub_AdditionalOptionLeaseTime", "Unknown error.");
    break;
  }  
}

export testfunction Stub_AdditionalOptionMaximumSize(char ifName[], word maximumSize)
{
  long stubResult;
  byte data[2];
  
  data.Word(0) = maximumSize;

  stubResult = Internal_Stub_SET_DHCP_OPTION(ifName, 57, data);

  switch (stubResult) {
  case 0:
    testStepPass("Stub_AdditionalOptionLeaseTime", "Configure lease time option on DUT succeeded.");
    break;
  case -1:
    testStepFail("Stub_AdditionalOptionLeaseTime", "Internal stub function handling error.");
    break;
  case -2:
    testStepFail("Stub_AdditionalOptionLeaseTime", "Stub function parse error.");
    break;
  default:
    if (kStubErrorMessages.containsKey(stubResult))
      testStepFail("Stub_AdditionalOptionLeaseTime", kStubErrorMessages[stubResult]);
    else
      testStepFail("Stub_AdditionalOptionLeaseTime", "Unknown error.");
    break;
  }  
}

/**
 * Makes DUT send an ICMP echo request.
 * @param ifName The name if the interface to send the echo request from.
 * @paramm destAddr The destination IP address of to send the echo request to.
 * @param data The data payload of the echo request.
 */
export testfunction Stub_IcmpEchoRequest(char ifName[], char destAddr[], byte data[])
{
  long stubResult;

  stubResult = Internal_Stub_IcmpEchoRequest(ifName, destAddr, data, elcount(data));

  switch (stubResult) {
  case 0:
    testStepPass("Stub_IcmpEchoRequest", "Send ICMP echo request from DUT succeeded.");
    break;
  case -1:
    testStepFail("Stub_IcmpEchoRequest", "Internal stub function handling error.");
    break;
  case -2:
    testStepFail("Stub_IcmpEchoRequest", "Stub function parse error.");
    break;
  default:
    if (kStubErrorMessages.containsKey(stubResult))
      testStepFail("Stub_IcmpEchoRequest", kStubErrorMessages[stubResult]);
    else
      testStepFail("Stub_IcmpEchoRequest", "Unknown error.");
    break;
  }
}

/**
 * Resets all client configurations for all configured interfaces on the DUT.
 * Needed for testcase DHCPv4_CLIENT_CONSTRUCTING_MESSAGES_07
 */
export testfunction Stub_ResetAllClientConfigurations()
{
  long stubResult;

  stubResult = Internal_Stub_StopDhcpClient(syspar::DIface0Name);

  switch (stubResult) {
  case 0:
    testStepPass("Stub_ResetAllClientConfigurations", "DuT has reset all client configurations for all configured interfaces on the DUT");
    break;
  case -1:
    testStepFail("Stub_ResetAllClientConfigurations", "Internal stub function handling error.");
    break;
  case -2:
    testStepFail("Stub_ResetAllClientConfigurations", "Stub function parse error.");
    break;
  default:
    if (kStubErrorMessages.containsKey(stubResult))
      testStepFail("Stub_ResetAllClientConfigurations", kStubErrorMessages[stubResult]);
    else
      testStepFail("Stub_ResetAllClientConfigurations", "Unknown error.");
    break;
  }  
}

/**
  * Verfifies that DUT has correctly logged that initialization process has failed and is restarting for
  * Needed for testcase DHCPv4_CLIENT_ALLOCATING_11
 */
export testfunction Stub_VerfiyDutHasLoggedFailingInitProcess()
{
  long stubResult;

  stubResult = Internal_Stub_VerfiyDutHasLoggedFailingInitProcess();

  switch (stubResult) {
  case 0:
    testStepPass("Stub_VerfiyDutHasLoggedFailingInitProcess", "DuT has correctly logged that initialization process has failed and is restarting for");
    break;
  case -1:
    testStepFail("Stub_VerfiyDutHasLoggedFailingInitProcess", "Internal stub function handling error.");
    break;
  case -2:
    testStepFail("Stub_VerfiyDutHasLoggedFailingInitProcess", "Stub function parse error.");
    break;
  default:
    if (kStubErrorMessages.containsKey(stubResult))
      testStepFail("Stub_VerfiyDutHasLoggedFailingInitProcess", kStubErrorMessages[stubResult]);
    else
      testStepFail("Stub_VerfiyDutHasLoggedFailingInitProcess", "Unknown error.");
    break;
  }  
}