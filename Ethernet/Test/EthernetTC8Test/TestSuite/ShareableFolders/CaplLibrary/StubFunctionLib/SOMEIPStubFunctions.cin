/*@!Encoding:1252*/
/***************************************************************************************
 * Demo- and Example-Programs
 *
 * Please note: The demo and example programs only show special aspects of the software.
 * With regard to the fact that these programs are meant for demonstration purposes only,
 * Vector Informatik's liability shall be expressly excluded in cases of ordinary
 * negligence, to the extent admissible by law or statute.
 *
 * Beta-Version
 *
 * These programs are fully operative programs. However, they are not thoroughly tested
 * yet (beta-version). With regard to the fact that the programs are a beta-version only,
 * Vector Informatik's liability shall be expressly excluded in cases of ordinary
 * negligence, to the extent admissible by law or statute.
 *
 * DESCRIPTION:
 *
 * Demo test implementation of the 'OPEN Alliance Automotive Ethernet ECU Test
 * Specification - TC8 ECU Test' (Document Version 2.0, August 23, 2017)
 *
 * Copyright (c) Vector Informatik GmbH. All rights reserved.
 ***************************************************************************************/

includes
{
  #include "../StubFunctionLib/StubFunctions.cin"
}

variables
{
  
}


/**
* Start a SOME/IP service on the DUT.
* @param serviceId The service ID.
* @param numInstances The number of service instances.
*/
export testfunction Stub_StartSomeIpService(word serviceId, word numInstances)
{ 
   long stubResult;

  stubResult = Internal_Stub_StartSomeIpService(serviceId, numInstances);

  switch (stubResult) {
  case 0:
    testStepPass("Stub_StartSomeIpService", "Started SOME/IP Service on DUT.");
    break;
  case -1:
    testStepFail("Stub_StartSomeIpService", "Internal stub function handling error.");
    break;
  case -2:
    testStepFail("Stub_StartSomeIpService", "Stub function parse error.");
    break;
  default:
    if (kStubErrorMessages.containsKey(stubResult))
      testStepFail("Stub_StartSomeIpService", kStubErrorMessages[stubResult]);
    else
      testStepFail("Stub_StartSomeIpService", "Unknown error.");
    break;
  }  
}

/**
* Stop a SOME/IP service on the DUT.
* @param serviceId The service ID.
*/
export testfunction Stub_StopSomeIpService(word serviceId)
{ 
   long stubResult;

  stubResult = Internal_Stub_StopSomeIpService(serviceId);

  switch (stubResult) {
  case 0:
    testStepPass("Stub_StopSomeIpService", "Stopped SOME/IP Service on DUT.");
    break;
  case -1:
    testStepFail("Stub_StopSomeIpService", "Internal stub function handling error.");
    break;
  case -2:
    testStepFail("Stub_StopSomeIpService", "Stub function parse error.");
    break;
  default:
    if (kStubErrorMessages.containsKey(stubResult))
      testStepFail("Stub_StopSomeIpService", kStubErrorMessages[stubResult]);
    else
      testStepFail("Stub_StopSomeIpService", "Unknown error.");
    break;
  }  
}

/**
* Trigger a SOME/IP event.
* @param serviceId The service ID.
* @param eventGroupId The event group ID.
* @param eventId The event ID.
*/
export testfunction Stub_TriggerSomeIpEvent(word serviceId, word eventGroupId, word eventId)
{
  long stubResult;

  stubResult = Internal_Stub_TriggerSomeIpEvent(serviceId, eventGroupId, eventId);
  switch (stubResult) {
  case 0:
    testStepPass("Stub_TriggerSomeIpEvent", "SOME/IP event was triggered on DUT.");
    break;
  case -1:
    testStepFail("Stub_TriggerSomeIpEvent", "Internal stub function handling error.");
    break;
  case -2:
    testStepFail("Stub_TriggerSomeIpEvent", "Stub function parse error.");
    break;
  default:
    if (kStubErrorMessages.containsKey(stubResult))
      testStepFail("Stub_TriggerSomeIpEvent", kStubErrorMessages[stubResult]);
    else
      testStepFail("Stub_TriggerSomeIpEvent", "Unknown error.");
    break;
  }  
}