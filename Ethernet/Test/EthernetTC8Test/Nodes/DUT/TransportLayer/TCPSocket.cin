/*@!Encoding:1252*/
/***************************************************************************************
 * Demo- and Example-Programs
 *
 * Please note: The demo and example programs only show special aspects of the software.
 * With regard to the fact that these programs are meant for demonstration purposes only,
 * Vector Informatik's liability shall be expressly excluded in cases of ordinary
 * negligence, to the extent admissible by law or statute.
 *
 * Beta-Version
 *
 * These programs are fully operative programs. However, they are not thoroughly tested
 * yet (beta-version). With regard to the fact that the programs are a beta-version only,
 * Vector Informatik's liability shall be expressly excluded in cases of ordinary
 * negligence, to the extent admissible by law or statute.
 *
 * DESCRIPTION:
 *
 * Demo test implementation of the 'OPEN Alliance Automotive Ethernet ECU Test
 * Specification - TC8 ECU Test' (Document Version 2.0, August 23, 2017)
 *
 * Copyright (c) Vector Informatik GmbH. All rights reserved.
 ***************************************************************************************/

//
// TCP socket handling and socket information management
//

variables
{  
  const word kTCP_MAX_SOCKET_NUM = 20;
  const word  kINVALID_TCP_SOCKET_INDEX = -1;
        
  enum AF_INET_IPADDRESS
  {
    AF_INET = 0x02,
    AF_INET6 = 28
  };
  
  struct _TCP_Recv_Fwd
  {
    byte bEnable;   // flag if forwarding is enable
    word wMaxFwd;     // Maximum length of payload to be forwarded per event
    word wMaxLen;     // Maximum count of bytes to receive over all 
    word wDropCount;  //##### counting is not implemented yet #####
    word wFwdCount;   // forward count bytes of over all
  };

  struct _TCP_Call_Receive_Info
  {    
    struct _vINT8 data;  // for TCP only
    word callReceiveQueue[20];    // call receive queue for before connection established(info is datalength)
  };
  
  // for socket identify in CAPL code
  struct _TCP_Socket_Identify
  {
    word srcPort;         // source port
    word dstPort;         // destination port
    struct _IPxADDR dstIp; // destination IP
  };  
    
  // socket info array
  struct _TCP_Socket_Info
  {
    dword dwHandle;               //Socket Handle
    struct _TCP_Recv_Fwd fwdInfo; //Information regarding receive and forward
    struct _TCP_Socket_Identify identifyInfo;
    struct _TCP_Call_Receive_Info callRecvInfo;
    
    byte bReConnectedFlag;      // socket reconnected flag for TCP_CLOSING_05
  } gTCPSocketInfo[kTCP_MAX_SOCKET_NUM];
    
  // to change sending tcp flag
  struct _SET_TCPFLAGS_INFO 
  {
    byte bEnable;     // enabled flag
    byte bFlags;      // tcp send flag
    word wDataLength; // sending data length
    dword dwAck;      // sending tcp ack number
    word wCount;
  } gTcpSetFlags;
  
  ethernetPacket gSendTcpPacket;
}

/// <SocketInfo/get>
// get socket address type(IPv4/IPv6)
enum Address_Type getTCPSocketAddrType(word wIdx)
{
  long lRet;
  
  if(wIdx < 0 || elCount(gTCPSocketInfo) <= wIdx)
  {
    return ADDR_INVALID;
  }
  
  lRet = IpGetSocketAddressFamily(gTCPSocketInfo[wIdx].dwHandle);
  
  switch(lRet)
  {
    case AF_INET:
      return ADDR_IPV4;
      break;
    case AF_INET6:
      return ADDR_IPV6;
      break;
    default:
      break;
  }
  
  return ADDR_INVALID;
}

/// <SocketInfo/init>
//initialize TCP socket handle array
void initTCPSocketArray(void)
{
  word i;
  for(i = 0; i < kTCP_MAX_SOCKET_NUM; i++)
  {
    initTCPSocketInfo(i);
  }
}

/// <SocketInfo/init>
//initialize TCP socket handle array
void initTCPSocketInfo(word wIdx)
{
  if(0 <= wIdx && wIdx < kTCP_MAX_SOCKET_NUM)
  {
    gTCPSocketInfo[wIdx].dwHandle = kINVALID_SOCKET;
    gTCPSocketInfo[wIdx].fwdInfo.bEnable = kFalse;
    gTCPSocketInfo[wIdx].fwdInfo.wDropCount = 0;
    gTCPSocketInfo[wIdx].fwdInfo.wMaxFwd = 0;
    gTCPSocketInfo[wIdx].fwdInfo.wMaxLen = 0;
    gTCPSocketInfo[wIdx].fwdInfo.wFwdCount = 0;
    initData(gTCPSocketInfo[wIdx].callRecvInfo.data);
    
    gTCPSocketInfo[wIdx].identifyInfo.srcPort = 0;
    gTCPSocketInfo[wIdx].identifyInfo.dstPort = 0;
    initIpxAddr(gTCPSocketInfo[wIdx].identifyInfo.dstIp);
    
    setTCPSocketReConnectedFlag(wIdx, 0);
    
  }
  else
  {
    outputErrorMsg("initTCPSocketInfo() index is out of bound ");
  }
}

/// <SocketInfo/get>
//get avialable TCP socket index from TCP socket handle array
int getTCPBlankSocketId(void)
{
  word i;
  for(i = 0; i < kTCP_MAX_SOCKET_NUM; i++)
  {
    if(gTCPSocketInfo[i].dwHandle == kINVALID_SOCKET)
    {
      return i;
    }
  }
  // no free 
  return kINVALID_TCP_SOCKET_INDEX;
}

/// <SocketInfo/set>
// this function is called the socket is opened
int saveTCPSocketHandle(word wIdx, dword dwHandle)
{  
  if(wIdx < kTCP_MAX_SOCKET_NUM)
  {
    if(gTCPSocketInfo[wIdx].dwHandle == kINVALID_SOCKET)
    {
      gTCPSocketInfo[wIdx].dwHandle = dwHandle;
      gTCPSocketInfo[wIdx].fwdInfo.bEnable = kFalse;
      gTCPSocketInfo[wIdx].fwdInfo.wMaxFwd = 0;
      gTCPSocketInfo[wIdx].fwdInfo.wMaxLen = 0;
      gTCPSocketInfo[wIdx].fwdInfo.wDropCount = 0;
      gTCPSocketInfo[wIdx].fwdInfo.wFwdCount = 0;
      
      setTCPSocketSrcIpPort(dwHandle);
      
      return kTrue;
    }
  }
  return kFalse;
}

/// <SocketInfo/set>
void setTCPSocketSrcIpPort(dword handle)
{
  word i;
  for(i=0; i<elCount(gTCPSocketInfo); i++)
  {
    dword ipv4Address;
    byte ipv6Address[kIPv6_ADDRESS_LENGTH_SIZE];
    dword _port;
    
    if(gTCPSocketInfo[i].dwHandle != handle)
    {
      continue;
    }
    
    // set port and ip   
    if(getTCPSocketAddrType(i) == ADDR_IPV4)
    {
      ipGetSocketName(handle, ipv4Address, _port);  // get port
      ipv4Address = TcpGetRemoteAddress(handle);    // get IP
      
      // set port and ip 
      gTCPSocketInfo[i].identifyInfo.srcPort = _port;
      gTCPSocketInfo[i].identifyInfo.dstIp.wAddrLength = kIPv4_ADDRESS_LENGTH_SIZE;
      gTCPSocketInfo[i].identifyInfo.dstIp.dwIpv4Addr = ipv4Address;
    }
    else
    {
      ipGetSocketName(handle, ipv6Address, _port);  // get port
      TcpGetRemoteAddress(handle, ipv6Address);     // get IP
      
      // set port and ip 
      gTCPSocketInfo[i].identifyInfo.srcPort = _port;
      gTCPSocketInfo[i].identifyInfo.dstIp.wAddrLength = kIPv6_ADDRESS_LENGTH_SIZE;
      memcpy(gTCPSocketInfo[i].identifyInfo.dstIp.Ipv6Addr, ipv6Address, kIPv6_ADDRESS_LENGTH_SIZE);
    }
    break;
  }
}

/// <SocketInfo/set>
void setTCPSocketDstPort(dword handle, word _dstPort)
{
  word i;
  for(i=0; i<elCount(gTCPSocketInfo); i++)
  {    
    if(gTCPSocketInfo[i].dwHandle != handle)
    {
      continue;
    }
    
    gTCPSocketInfo[i].identifyInfo.dstPort = _dstPort;    
    break;
  }
}

/// <SocketInfo/get>
//
// get socket handele from socket ID(index)
//
dword getTCPSocketHandle(word wIdx)
{
  if(wIdx < kTCP_MAX_SOCKET_NUM)
  {
    if(gTCPSocketInfo[wIdx].dwHandle != kINVALID_SOCKET)
    {
      return gTCPSocketInfo[wIdx].dwHandle;
    }
  }
  return kINVALID_SOCKET;
}

/// <SocketInfo/get>
// get tcp socket from handle
dword getTCPSocketHandleFromSrcPort(word port)
{
  int i;
  dword _srcPort;
  dword ipv4Address;
  
  // serch index from socket array
  for(i = 0; i<elCount(gTCPSocketInfo); i++)
  {
    // get port of socket array
    _srcPort = gTCPSocketInfo[i].identifyInfo.srcPort;
    if(_srcPort == 0 && ipGetSocketName(gTCPSocketInfo[i].dwHandle, ipv4Address, _srcPort) != 0)
    {
      continue;
    }
      
    // compare
    if(_srcPort == port)
    {
      return gTCPSocketInfo[i].dwHandle;
    }
  }
  
  // assigned port not find
  return kINVALID_SOCKET;
}

/// <SocketInfo/set>
// 
// set RECEIVE_AND_FORWARD information and reset drop counter
//
int setTCPSocketInfoRecvFwd(word wIdx, byte bEnable, word wMaxFwd, word wMaxLen)
{  
  if(wIdx < kTCP_MAX_SOCKET_NUM)
  {
    if(gTCPSocketInfo[wIdx].dwHandle != kINVALID_SOCKET)
    {
      gTCPSocketInfo[wIdx].fwdInfo.bEnable = bEnable; 
      gTCPSocketInfo[wIdx].fwdInfo.wMaxFwd = wMaxFwd; 
      gTCPSocketInfo[wIdx].fwdInfo.wMaxLen = wMaxLen;
      gTCPSocketInfo[wIdx].fwdInfo.wDropCount = 0;
      gTCPSocketInfo[wIdx].fwdInfo.wFwdCount = 0;
      return kTrue;
    }
  }
  return kFalse;
}

/// <SocketInfo/set>
int setTCPCallRecvData(word wIdx, byte data[], word dataLength, word offset)
{  
  if(wIdx < kTCP_MAX_SOCKET_NUM)
  {
    if(gTCPSocketInfo[wIdx].dwHandle != kINVALID_SOCKET)
    {
      // data size is too large
      if(elCount(gTCPSocketInfo[wIdx].callRecvInfo.data.bData) - gTCPSocketInfo[wIdx].callRecvInfo.data.wLength <= dataLength)
      {
        return kFalse;
      }
      
      // set
      memcpy_off(gTCPSocketInfo[wIdx].callRecvInfo.data.bData, gTCPSocketInfo[wIdx].callRecvInfo.data.wLength, data, offset, dataLength);
      gTCPSocketInfo[wIdx].callRecvInfo.data.wLength += dataLength;
      return kTrue;
    }
  }
  return kFalse;
}

/// <SocketInfo/get>
// return code:data length
word getTCPCallRecvData(word wIdx, byte data[])
{  
  if(wIdx < kTCP_MAX_SOCKET_NUM)
  {
    if(gTCPSocketInfo[wIdx].dwHandle != kINVALID_SOCKET)
    {
      memcpy_off(data, 0, gTCPSocketInfo[wIdx].callRecvInfo.data.bData, 0, gTCPSocketInfo[wIdx].callRecvInfo.data.wLength);
      return gTCPSocketInfo[wIdx].callRecvInfo.data.wLength;
    }
  }
  return kFalse;
}

/// <SocketInfo/init>
int initTCPCallRecvData(word wIdx)
{  
  if(wIdx < kTCP_MAX_SOCKET_NUM)
  {
    if(gTCPSocketInfo[wIdx].dwHandle != kINVALID_SOCKET)
    {
      byte blanck[kTESTABILITY_PARAMETER_MAX_SIZE];
      memcpy(gTCPSocketInfo[wIdx].callRecvInfo.data.bData, blanck, elCount(blanck));
      gTCPSocketInfo[wIdx].callRecvInfo.data.wLength = 0;
      return kTrue;
    }
  }
  return kFalse;
}

/// <Debug>
// get drop count info
word getTCPSocketInfoDropCnt(word wIdx)
{  
  if(wIdx < kTCP_MAX_SOCKET_NUM)
  {
    if(gTCPSocketInfo[wIdx].dwHandle != kINVALID_SOCKET)
    {
      return gTCPSocketInfo[wIdx].fwdInfo.wDropCount;
    }
  }
  return 0;
}

/// <SocketInfo>
// get drop count info
void resetTCPSocketInfoDropCnt(word wIdx)
{  
  if(wIdx < kTCP_MAX_SOCKET_NUM)
  {
    if(gTCPSocketInfo[wIdx].dwHandle != kINVALID_SOCKET)
    {
      gTCPSocketInfo[wIdx].fwdInfo.wDropCount = 0;
    }
  }
}



/// <SocketInfo/is>
//
// check if recv and forward is enabled
//
byte isTCPSocketRecvFwdEnabled(word wSocketIdx)
{
  if(wSocketIdx < kTCP_MAX_SOCKET_NUM)
  {
    return gTCPSocketInfo[wSocketIdx].fwdInfo.bEnable;
  }
  return kFalse;
}

/// <SocketInfo/add>
//
// add drop count to TCP socket info 
//
void addTCPSocketInfoDropCount(word wSocketIdx, word wLen)
{
  if(wSocketIdx < kTCP_MAX_SOCKET_NUM)
  {
    gTCPSocketInfo[wSocketIdx].fwdInfo.wDropCount += wLen;
  }  
}

/// <SocketInfo/add>
//
// add forward count to TCP socket info 
//
void addTCPSocketInfoFwdCount(word wSocketIdx, word wLen)
{
  if(wSocketIdx < kTCP_MAX_SOCKET_NUM)
  {
    gTCPSocketInfo[wSocketIdx].fwdInfo.wFwdCount += wLen;
  }  
}

/// <SocketInfo/get>
//
// get forward count from TCP socket info 
//
word getTCPSocketInfoFwdCount(word wSocketIdx)
{
  if(wSocketIdx < kTCP_MAX_SOCKET_NUM)
  {
    return gTCPSocketInfo[wSocketIdx].fwdInfo.wFwdCount;
  }
  return 0;
}

/// <SocketInfo/get>
//
// get max forward from TCP socket info 
//
word getTCPSocketInfoMaxFwd(word wSocketIdx)
{
  if(wSocketIdx < kTCP_MAX_SOCKET_NUM)
  {
    return gTCPSocketInfo[wSocketIdx].fwdInfo.wMaxFwd;
  }
  return 0;
}

/// <SocketInfo/get>
//
// get max forward from TCP socket info 
//
word getTCPSocketInfoMaxLen(word wSocketIdx)
{
  if(wSocketIdx < kTCP_MAX_SOCKET_NUM)
  {
    return gTCPSocketInfo[wSocketIdx].fwdInfo.wMaxLen;
  }
  return 0;
}

/// <SocketInfo>
void closeTCPSocketArray()
{
  int i;
  
  for(i = 0; i < kTCP_MAX_SOCKET_NUM; i++)
  {
    if(gTCPSocketInfo[i].dwHandle != kINVALID_SOCKET)
    {
      tcpClose(gTCPSocketInfo[i].dwHandle);
    }
  }
  
  // init
  initTCPSocketArray();
}

/// <SocketOptions>
// set socket MSS(mas segment size)
// return value 0 : success, other : fail
long setSocketMSS(dword dwSocketHandle, long value)
{
  long lResult;
  char errMsg[255];
  dword dwIfIndex;
  long lAfInet;  
  
  //change MTU to configure MSS
  lAfInet = ipGetSocketAddressFamily(dwSocketHandle);
  if(lAfInet == AF_INET)
  {
    dwIfIndex = kdwIPV4_INTERFACE_INDEX;
  }
  else if(lAfInet == AF_INET6)
  {
    dwIfIndex = kdwIPV6_INTERFACE_INDEX;    
  }
  lResult = ipSetStackParameter(dwIfIndex, "canoe.interface.mtu", value+40);  
  if(lResult != 0) {
    writeLineEx(1, 3, "Failed to set Inteface[%d] of MTU[%d] byte. Result: %d", dwIfIndex, value, lResult);
  }  
  
  return lResult;
  
}

/// <SocketOptions>
// set socket tx buffer
long setSocketTxBuff(dword dwSocketHandle, long dwBuffSize)
{
  long lResult;
  
  lResult = IpSetSocketOption(dwSocketHandle, "SOL_SOCKET", "SO_SNDBUF", dwBuffSize);
  if(lResult != 0)
  {
    writeLineEx(1, 3, "Failed calling IpSetSocketOption(handle[%x], SOL_SOCKET, SO_SNDBUF, wBuffSize[%x]), result[%d]", dwSocketHandle, dwBuffSize, lResult);
  }
  return lResult;
}

/// <SocketOptions>
// set socket Rx buffer
long setSocketRxBuff(dword dwSocketHandle, long dwBuffSize)
{
  long lResult;
  
  lResult = IpSetSocketOption(dwSocketHandle, "SOL_SOCKET", "SO_RCVBUF", dwBuffSize);
  if(lResult != 0)
  {
    writeLineEx(1, 3, "Failed calling IpSetSocketOption(handle[%x], SOL_SOCKET, SO_RCVBUF, wBuffSize[%x]), result[%d]", dwSocketHandle, dwBuffSize, lResult);
  }
  return lResult;
}


/// <SocketOptions>
// set socket nagle algorithm
long setSocketNagleArg(dword dwSocketHandle, long enabled)
{
  long lResult;
  
  if(enabled == 0)
  {
    enabled = 1;
  }
  else
  {
    enabled = 0;
  }
  
  // set
  lResult = ipSetSocketOption(dwSocketHandle, "IPPROTO_TCP", "TCP_NODELAY", enabled);
  
  // check
  if(lResult != 0)
  {
    writeLineEx(1, 3, "<%FILE_NAME%>: set nagle error! error code:%d ", lResult);
  }  
  return lResult;
}

/// <SocketOptions>
// set socket no push
long setSocketNoPush(dword dwSocketHandle, byte enabled)
{
  // set
  return ipSetSocketOption(dwSocketHandle, "IPPROTO_TCP", "TCP_NOPUSH", enabled);
}


/// <SocketInfo/get>
// get tcp socket from handle
word getTCPSocketId(word handle)
{
  word wRet;
  int i;
  
  // set invalid value
  wRet = kINVALID_TCP_SOCKET_INDEX;
  
  // argument check
  if(handle == kINVALID_SOCKET)
  {
    return kINVALID_TCP_SOCKET_INDEX;
  }
  
  // serch index from socket array
  for(i = 0; i<elCount(gTCPSocketInfo); i++)
  {
    if(gTCPSocketInfo[i].dwHandle == handle)
    {
      wRet = i;
      break;
    }
  }
  
  return wRet;
}

/// <SocketInfo/get>
// get tcp socket from port
word getTCPSocketIdFromPort(word port)
{
  word wRet;
  int i;
  
  // set invalid value
  wRet = kINVALID_TCP_SOCKET_INDEX;
    
  // serch index from socket array
  for(i = 0; i<elCount(gTCPSocketInfo); i++)
  {
    if(gTCPSocketInfo[i].identifyInfo.srcPort == port)
    {
      return i;
    }
  }
  
  return wRet;
}

/// <SocketInfo/get>
// get socket index from Ipv4 address
word getTCPSocketIdFromIp(dword ipaddr)
{
  int i;  
    
  // serch index from socket array
  for(i = 0; i<elCount(gTCPSocketInfo); i++)
  {
    if(gTCPSocketInfo[i].identifyInfo.dstIp.wAddrLength == kIPv4_ADDRESS_LENGTH_SIZE)
    {
      if(gTCPSocketInfo[i].identifyInfo.dstIp.dwIpv4Addr == ipaddr)
      {
        return i;
      }
    }
  }
  
  return kINVALID_TCP_SOCKET_INDEX;
}

/// <SocketInfo/get>
// get socket index from Ipv6 address
word getTCPSocketIdFromIp(byte ipaddr[])
{
  int i;
    
  // serch index from socket array
  for(i = 0; i<elCount(gTCPSocketInfo); i++)
  {
    if(gTCPSocketInfo[i].identifyInfo.dstIp.wAddrLength == kIPv6_ADDRESS_LENGTH_SIZE)
    {
      word wRet;
      wRet = memcmp(gTCPSocketInfo[i].identifyInfo.dstIp.Ipv6Addr, ipaddr, kIPv6_ADDRESS_LENGTH_SIZE);
      if(wRet == 0)
      {
        return i;
      }
    }
  }
  
  return kINVALID_TCP_SOCKET_INDEX;
}

/// <callback>
// for TC8 TCP_CLOSING_05
// If state arrives TIME-WAIT and receives syn, sends syn/ack(simulate socket connection)
long sendReConnectionPacket(ethernetPacket *packet, word socketIndex)
{
  enum TcpStateId _state;
  long lRet;
  
  lRet = 1;
  
  // check if reconnection flags valid
  if(@sysvar::TC8_DUT_Config::tcpRecconetion == 0)
  {
    // continue "prepare" function
    return lRet;
  }
  
  // get state
  _state = getTcpState(socketIndex);
  
  // check state
  if(_state != TcpStateIdTimeWait && _state != 0xFF)   
  {
    // continue "prepare" function
    return lRet;
  }
  
  switch(/*TCPGetFlags(packet)*/packet.tcp.flags)
  {
    // recv syn
    case TcpFlagSyn:
      // send syn,ack
      gSendTcpPacket.tcp.flags = TcpFlagSynAck;
      gSendTcpPacket.tcp.sequence++;
      gSendTcpPacket.tcp.ackNumber++;
      sendTcpRaw(gSendTcpPacket); // send      
      return 0; // don't process using TCP/IP stack
      break;
    // recv ack
    case TcpFlagAck:
      setTCPSocketReConnectedFlag(socketIndex, 1); // set reconnected flag
      return 0; // don't process anything
      break;
      
    case TcpFlagRst:
    case TcpFlagFin:
      setTCPSocketReConnectedFlag(socketIndex, 0); // reset reconnected flag
      break;
      
    default:
      break;
  }
  
  return lRet;
}

/// <que>
void enqueueRecvData(ethernetPacket *packet, word socketIndex)
{
  enum TcpStateId _state;
  byte data[1500];
  word length;
  
  // get state
  _state = getTcpState(socketIndex);
    
  // check state
  if(_state != TcpStateIdEstablished && 
    _state != TcpStateIdCloseWait && 
    _state != TcpStateIdFinWait1 &&  // for TCP_CALL_RECEIVE_04
    _state != TcpStateIdFinWait2)    // for TCP_CALL_RECEIVE_04
  {
    return;
  }
  
  length = TcpGetData(packet, data);
  if(length > 0)
  {
    word _offset;
    if(isTcpFlagUrg(packet.tcp.flags) == 1)
    {
      _offset = TCPgetPointer(packet);
    }
    else
    {
      _offset = 0;
    }
    setTCPCallRecvData(socketIndex, data, length - _offset, _offset);
  }
}

/// <callback>
// send evt of Testability's "Receive and forward"
void sendRecvAndFwdForRst(word socketIndex)
{
  // send "receive and forward" failed
  struct _EVENT_RECV_FWD eventRecvFwd;      
  
  const kLEN_FORWARD_PARAMS_HEADER = 2 + SIZE_LENGTH;
                             //fullLen(uint16) + srcPort(uint16) + srcAdr(2+4) + VINT8 length(2)
  byte bPacketData[kTESTABILITY_HEADER_SIZE + kMAX_TESTABILITY_PARAM_LENGTH];

  long lResult;
  struct _Testabilty_Message_Header msgHeader;
  dword dwLength;
  
  enum TcpStateId _state;
  
  lResult = 0;
  
  // check if forwarding enabled
  if(isTCPSocketRecvFwdEnabled(socketIndex) == kFalse)
  {
    return;
  }
  
  // get state
  _state = getTcpState(socketIndex);
    
  // check state
  if((_state != TcpStateIdFinWait1 && 
    _state != TcpStateIdFinWait2 && 
    _state != TcpStateIdCloseWait))
  {
    return;
  }
  
  //calculate packet size and check it
  dwLength = kTESTABILITY_HEADER_SIZE; //testability header size  
  
  //make testability message header and write it to buffer
  InitEventMsgHeader(msgHeader, GID_TCP, PID_RECEIVE_AND_FORWARD, RID_E_TCP_CRE);
  SetMsgHeaderLen(msgHeader, kLEN_FORWARD_PARAMS_HEADER + eventRecvFwd.payload.wLength);
  makeTestAbilityHeader(msgHeader, bPacketData);

  //write RECEIVE_AND_FORWARD parameters
  makeTestabilityForwardParams(eventRecvFwd, bPacketData, (dword)kTESTABILITY_HEADER_SIZE, IPv4_Prot_TCP);

  //send packet
  lResult = sendPacketTestabilityUDPSocket(gdwTesterIPv4Addr,  gdwTesterIPv4Port,  bPacketData, dwLength);
}

/// <SocketInfo/get>
enum TcpStateId getTcpState(word socketId)
{
  dword handle;
  long _state = 0;
  long retCode;
  
  if(socketId < 0 || elCount(gTCPSocketInfo) <= socketId)
  {
    writeLineEx(1, 3, "<%FILE_NAME%>: TCP get state out of order in socket id:%d!!", socketId);
    return TcpStateIdClosed;
  }
    
  handle = gTCPSocketInfo[socketId].dwHandle;
  if(handle == kINVALID_SOCKET)
  {  
    writeLineEx(1, 3, "<%FILE_NAME%>: TCP socket is invalid in socket id:%d handle:%d!!", socketId, handle);
    return TcpStateIdClosed;
  }
  
  retCode = ipGetSocketOption(handle, "IPPROTO_TCP", "TCP_INFO", _state);
  if(retCode != 0)
    return TcpStateIdClosed;
  
  return (enum TcpStateId)(_state & 0xFF);
}

/// <MSS>
// return 1: invalid, 0: valid
word checkIfMSSOptionIsInvalid(ethernetPacket * packet)
{
  byte bDataOffset;
  byte bHeaderOffset;
  word offset;
  
  //check if MSS exist
  bDataOffset = TcpGetDataOffset(packet);
  if(bDataOffset < 24)
  {
    // no MSS
    return 0;
  }
  //get IPv4 header length
  bHeaderOffset = TCPGetHeaderOffset(packet);
  if(bHeaderOffset < 20)
  {
    //Invalid IPv4 header size
    return 0;
  }
  offset = bHeaderOffset + 20;
  
  //
  //check MSS option ID and length
  // not considering the multiple IP option for now
  //
  if( (packet.byte(offset) == 0x02) && (packet.byte(offset+1) != 4))
  {
    return 1;
  }
  return 0;
}

// send Reset Flag
void sendResetFlagPacket(ethernetPacket *packet)
{
  ethernetPacket p;
  byte ipv6Addr[16];
  
  if(!packet.tcp.IsAvailable())
    return;
  
  p = packet;
  
  p.source      = packet.destination;
  p.destination = packet.source;
 
  
  if(packet.ipv4.IsAvailable())
  {
    p.ipv4.source      = packet.ipv4.destination;
    p.ipv4.destination = packet.ipv4.source;
  }
  else
  {
    packet.ipv6.source.GetData(0, ipv6Addr, elcount(ipv6Addr));
    p.ipv6.destination.SetData(0, ipv6Addr, elcount(ipv6Addr));
    packet.ipv6.destination.GetData(0, ipv6Addr, elcount(ipv6Addr));
    p.ipv6.source.SetData(0, ipv6Addr, elcount(ipv6Addr));
  }
  p.tcp.Init();
  p.tcp.source      = packet.tcp.destination;
  p.tcp.destination = packet.tcp.source;
  p.tcp.ackNumber   = packet.tcp.sequence;
  
  p.tcp.ResizeData(0);
  p.tcp.flags = TcpFlagRst|TcpFlagAck;
  p.CompletePacket();
  output(p);
}

/// <SocketInfo/is>
// input value:socket id
//return 1:socket   0:socket 
byte isTCPSocketClosing(word socketIndex)
{
  // array check
  if(socketIndex == kINVALID_TCP_SOCKET_INDEX || socketIndex < 0 || kTCP_MAX_SOCKET_NUM <= socketIndex)
  {
    return 0;
  }
  
  // state check
  switch(getTcpState(socketIndex))
  {
    case TcpStateIdFinWait1:
    case TcpStateIdFinWait2:
    case TcpStateIdClosing:
    case TcpStateIdTimeWait:
    case TcpStateIdLastAck:
    case 0xFF:
      return 1;
      break;

    case TcpStateIdCloseWait: // in CLOSE-WAIT the socket received a FIN but is not yet closing. It still may send data.
    default:
      break;
  }
    
  return 0;
}

/// <SocketInfo/is>
// input value:socket id
//return 1:socket is connecting 0:socket isn't connecting
byte isTCPSocketConnecting(word socketIndex)
{
  // array check
  if(socketIndex == kINVALID_TCP_SOCKET_INDEX || socketIndex < 0 || kTCP_MAX_SOCKET_NUM <= socketIndex)
  {
    return 0;
  }
  
  // state check
  switch(getTcpState(socketIndex))
  {
    case TcpStateIdListen:
    case TcpStateIdSynReceived:
    case TcpStateIdSynSent:
      return 1;
      break;
    default:
      break;
  }
    
  return 0;
}


/// <que>
word enqueueCallReceiveData(word socketIndex, word setQueueData)
{
  word i;
  
  // array check
  if(socketIndex == kINVALID_TCP_SOCKET_INDEX || socketIndex < 0 || kTCP_MAX_SOCKET_NUM <= socketIndex)
  {
    // failed
    return 0;
  }
  
  for(i=0; i<elCount(gTCPSocketInfo); i++)
  {
    // search blank data
    if(gTCPSocketInfo[socketIndex].callRecvInfo.callReceiveQueue[i] != 0)
    {
      continue;
    }
    
    // set queue
    gTCPSocketInfo[socketIndex].callRecvInfo.callReceiveQueue[i] = setQueueData;
    // succeed
    return 1;
  }
  
  // failed
  return 0;
}

/// <que>
word dequeueCallReceiveData(word socketIndex)
{
  word i;
  word wRet;
  
  // array check
  if(socketIndex == kINVALID_TCP_SOCKET_INDEX || socketIndex < 0 || kTCP_MAX_SOCKET_NUM <= socketIndex)
  {
    return 0;
  }
    
  // set response
  wRet = gTCPSocketInfo[socketIndex].callRecvInfo.callReceiveQueue[0];
  
  // rearray queue
  for(i=0; i<elCount(gTCPSocketInfo[socketIndex].callRecvInfo.callReceiveQueue) - 2; i++)
  {
    gTCPSocketInfo[socketIndex].callRecvInfo.callReceiveQueue[i] = gTCPSocketInfo[socketIndex].callRecvInfo.callReceiveQueue[i+1];
  }
  
  // reset last data que
  gTCPSocketInfo[socketIndex].callRecvInfo.callReceiveQueue[elCount(gTCPSocketInfo[socketIndex].callRecvInfo.callReceiveQueue) - 1] = 0;
  
  return wRet;
}

/// <callback>
// for ipv4
word isSocketInfoMatch(word socketIndex, dword _dstIpv4, word _srcPort, word _dstPort)
{
  // check target IP
  switch(getTCPSocketAddrType(socketIndex))
  {
    case ADDR_IPV4:
      if(gTCPSocketInfo[socketIndex].identifyInfo.dstIp.dwIpv4Addr != 0
         && gTCPSocketInfo[socketIndex].identifyInfo.dstIp.dwIpv4Addr != _dstIpv4)
      {
        return kFalse;
      }
      break;
    case ADDR_IPV6:
    default:
      return kFalse;
  }    
  
  // check destination port
  if(gTCPSocketInfo[socketIndex].identifyInfo.dstPort != _dstPort)
  {
    return kFalse;
  }
  
  // check source port
  if(gTCPSocketInfo[socketIndex].identifyInfo.srcPort != _srcPort)
  {
    return kFalse;
  }
    
  return kTrue;
}

/// <callback>
// for ipv6
word isSocketInfoMatch(word socketIndex, byte _dstIpv6[], word _srcPort, word _dstPort)
{
  byte _buff[kIPv6_ADDRESS_LENGTH_SIZE];
  
  // check target IP
  switch(getTCPSocketAddrType(socketIndex))
  {
    case ADDR_IPV6:
      if(memcmp(gTCPSocketInfo[socketIndex].identifyInfo.dstIp.ipv6Addr, _buff, elCount(gTCPSocketInfo[socketIndex].identifyInfo.dstIp.ipv6Addr))
         && memcmp(gTCPSocketInfo[socketIndex].identifyInfo.dstIp.ipv6Addr, _dstIpv6, elCount(gTCPSocketInfo[socketIndex].identifyInfo.dstIp.ipv6Addr)))
      {
        return kFalse;
      }
      break;
    case ADDR_IPV4:
    default:
    return kFalse;
  }
  
  // check destination port
  if(gTCPSocketInfo[socketIndex].identifyInfo.dstPort != _dstPort)
  {
    return kFalse;
  }
  
  // check source port
  if(gTCPSocketInfo[socketIndex].identifyInfo.srcPort != _srcPort)
  {
    return kFalse;
  }
    
  return kTrue;
}

/// <Debug>
void outputSocketErrorInfoTcp(dword dwSocket)
{
  char errMsg[255];                // error message buffer.

  IpGetLastSocketErrorAsString( dwSocket, errMsg, elcount(errMsg) );
  writeLineEx(1, 3, "<%FILE_NAME%> [%f] Socker Error. Socket handle number:[0x%X] ErrorAsString:%s", timeNow()/100000.0, dwSocket, errMsg);
}

/// <callback>
long OnTcpSendPrepare(ethernetPacket *packet, dword socketHandle)
{
  byte flag;
  dword ip;
  long lRet;
  int i;
  
  lRet = 1;

  // check protocol and direction
  if(isTcp(packet) == 0 || packet.source != kDIface_0_MAC_ADDR)
  {
    return 1;
  }

  gSendTcpPacket = packet;
  
  // set tcp flags to send
  if(gTcpSetFlags.bEnable == 1)
  {
    // set flags
    setTcpFlags(packet, gTcpSetFlags);
    
    // set pointer
    setTcpPointer(packet, @sysvar::TC8_DUT_Config::tcpUrgentDataSize);
    if(gTcpSetFlags.wCount == 0)
    {
      gTcpSetFlags.dwAck = TCPgetSequence(packet) + gTcpSetFlags.wDataLength;
    }
    gTcpSetFlags.wCount++;
    
    // send data length is 0(such as flag only)
    if(gTcpSetFlags.wDataLength == 0)
    {
      // disenable flags
      gTcpSetFlags.bEnable = 0;
      gTcpSetFlags.wCount = 0;
    }
  }
      
  return lRet;
}

/// <callback>
// return code are bellow:
// 0: Block the Ethernet packet.
// 1: Pass the Ethernet packet to the TCP/IP stack.
 long OnTcpReceivePrepare(ethernetPacket *packet)
{
  word dstSocket;
  dword socketHandle;
  byte flag;
  word socketIndex;
  long lRet;
  
  lRet = 1;
  
  // check protocol and direction
  if(isTcp(packet) == 0 || packet.source == kDIface_0_MAC_ADDR)
  {
    return 1;
  }
  
  // check if all the data which sent in testability received
  if(gTcpSetFlags.bEnable == 1)
  {
    // received ack for last sent data
    if(TCPgetAckNumber(packet) >= gTcpSetFlags.dwAck)
    {
      // if ack number isn't fit
      if(TCPgetAckNumber(packet) > gTcpSetFlags.dwAck)
      {
        writeLineEx(1, 2, "<%FILE_NAME%> [%0.6f] warning in set flag function");
      }
      
      // disenable flags
      gTcpSetFlags.bEnable = 0;
      gTcpSetFlags.wCount = 0;
      gTcpSetFlags.dwAck = 0;      
    }
  }
    
  // get socket handle from received packet
  dstSocket = TCPgetPortDst(packet);
  socketHandle = getTCPSocketHandleFromSrcPort(dstSocket);
  
  // get socket array index
  if(socketHandle == kINVALID_SOCKET)
  {
    // TCP socket is closing
    socketIndex = getTCPSocketIdFromPort(dstSocket);
  }
  else
  {
    // TCP socket established
    socketIndex = getTCPSocketId(socketHandle);
  }
  
  // check socket index
  if(socketIndex == kINVALID_TCP_SOCKET_INDEX)
  {
    // socket index is invalid
    return 1;
  }
  
  // if the socket received data segments in some states, discards data segments.
  // for TCP_BASICS_16
  if(packet.tcp.byteLength > 0 && isTcpFlagRst(packet.tcp.flags) != 1)
  {
    switch(getTcpState(socketIndex))
    {
      case TcpStateIdCloseWait:
      case TcpStateIdClosing:
      case TcpStateIdLastAck:
      case TcpStateIdTimeWait:
        return 0;
        break;
        default:
        break;
    }
  }
  
  // get flags
  flag = packet.tcp.flags;
    
  // check recv syn
  if(flag == TcpFlagSyn)
  {
    // set port to socket array
    setTCPSocketDstPort(socketHandle, packet.tcp.source);
  }
  
  // check received packet's ip
  if(gTCPSocketInfo[socketIndex].identifyInfo.dstPort != 0)
  {
    switch(getTCPSocketAddrType(socketIndex))
    {
      case ADDR_IPV4:
        if(packet.type == Eth_Type_IPv4 && isSocketInfoMatch(socketIndex, packet.ipv4.source, packet.tcp.destination, packet.tcp.source) == kFalse)
        {
          return 1;
        }
        break;
      case ADDR_IPV6:
//        if(packet.type == Eth_Type_IPv6 && isSocketInfoMatch(socketIndex, packet.ipv6.source, packet.tcp.destination, packet.tcp.source) == kFalse)
//        {
//          return 1;
//        }
        break;
      default:
        break;
    }
  }
  
  // check if recv rst flag
  if(isTcpFlagRst(flag) == 1)
  {
    // send evt of Receive and forward
    sendRecvAndFwdForRst(socketIndex);
  }
  
  // enqueue receive data for testability's "CALL_RECEIVE"
  enqueueRecvData(packet, socketIndex);

  // send ack/sin packet for TCP_CLOSING_05
  lRet = sendReConnectionPacket(packet, socketIndex);
  
  return lRet;
}

/// <callback>
// set tcp flags to send
void setTcpFlags(ethernetPacket *packet, struct _SET_TCPFLAGS_INFO flagsInfo)
{  

  if(isTcp(packet) == 0)
  {
    return;
  }

  // check setting flags
  if(flagsInfo.bEnable != 1)
    return;

  // specification allows to set the PSH and URG flags 
  tcpSetFlagsPsh(packet, flagsInfo.bFlags & TcpFlagPsh);
  tcpSetFlagsUrg(packet, flagsInfo.bFlags & TcpFlagUrg);
}

/// <SocketOptions>
long setSocketFinwait2TimeOut(long value)
{
  long lResult;
    
  lResult = ipSetStackParameter("net.inet.tcp.finwait2_timeout", value);
  
  if(lResult != 0)
  { 
    writeLineEx(1, 3, "Failed to set FINWAIT-2 timeout to %d. Result:%d ErrorCode:%d", value, lResult, IpGetLastError());
  }  
  
  return lResult;
}

/// <SocketOptions>
long setSocketMsl(long value)
{
  long lResult;
    
  lResult = ipSetStackParameter("net.inet.tcp.msl", value);
  
  if(lResult != 0)
  { 
    writeLineEx(1, 3, "Failed to set MSL to %d. Result:%d ErrorCode:%d", value, lResult, IpGetLastError());
  }  
  
  return lResult;
}

/// <SocketInfo/set>
// set recconected flag(connected through TIME-WAIT state)
void setTCPSocketReConnectedFlag(word socketIndex, byte value)
{
  if(socketIndex < 0 || elCount(gTCPSocketInfo) <= socketIndex)
  {
    writeLineEx(1, 3, "<%FILE_NAME%>: Error in TCP set socket reconnected flag. sokcet id:%d!!", socketIndex);
    return;
  }
  
  if(value >= 1)
  {
    value = kTrue;
  }
  else
  {
    value = kFalse;
  }
  
  gTCPSocketInfo[socketIndex].bReConnectedFlag = value;
}

/// <SocketInfo/is>
// check if socket is recconected
// 1:socket is reconnected(connected through TIME-WAIT state)  0:socket isn't reconnected
byte isTCPSocketReConnected(word socketIndex)
{
  if(socketIndex < 0 || elCount(gTCPSocketInfo) <= socketIndex)
  {
    writeLineEx(1, 3, "<%FILE_NAME%>: Error in TCP get socket reconnected flag. sokcet id:%d!!", socketIndex);
    return 0;
  }
  
  return gTCPSocketInfo[socketIndex].bReConnectedFlag;
}
