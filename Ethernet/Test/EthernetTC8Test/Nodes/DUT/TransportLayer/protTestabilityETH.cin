/*@!Encoding:1252*/
/***************************************************************************************
 * Demo- and Example-Programs
 *
 * Please note: The demo and example programs only show special aspects of the software.
 * With regard to the fact that these programs are meant for demonstration purposes only,
 * Vector Informatik's liability shall be expressly excluded in cases of ordinary
 * negligence, to the extent admissible by law or statute.
 *
 * Beta-Version
 *
 * These programs are fully operative programs. However, they are not thoroughly tested
 * yet (beta-version). With regard to the fact that the programs are a beta-version only,
 * Vector Informatik's liability shall be expressly excluded in cases of ordinary
 * negligence, to the extent admissible by law or statute.
 *
 * DESCRIPTION:
 *
 * Demo test implementation of the 'OPEN Alliance Automotive Ethernet ECU Test
 * Specification - TC8 ECU Test' (Document Version 2.0, August 23, 2017)
 *
 * Copyright (c) Vector Informatik GmbH. All rights reserved.
 ***************************************************************************************/

int interfaceUpETH(struct _Token_Testabilty recvData, struct _Token_Testabilty sendData)
{
  int iRet = 0;
  struct _ETH_INTERFACE_UP_DOWN interfaceUpDown;
  
  getETHInterfaceUpDown( interfaceUpDown, kTESTABILITY_HEADER_SIZE );

  if (gDHCPenabled > 0)
  {
    ipSetStackParameter(1, "canoe.dhcpv4.enable", 1);
  }
  
  sendData.TestabilityMsg.Header.rid = RID_E_OK;

  return iRet;  
}

int interfaceDownETH(struct _Token_Testabilty recvData, struct _Token_Testabilty sendData)
{
  int iRet = 0;
  struct _ETH_INTERFACE_UP_DOWN interfaceUpDown;
  
  getETHInterfaceUpDown( interfaceUpDown, kTESTABILITY_HEADER_SIZE );

  if (gDHCPenabled > 0)
  {
    ipSetStackParameter(1, "canoe.dhcpv4.enable", 0);
    ipSetStackParameter(1, "canoe.dhcpv4.delete_preferred_address", 1);
  }

  sendData.TestabilityMsg.Header.rid = RID_E_OK;

  return iRet;  
}