/*@!Encoding:1252*/
/***************************************************************************************
 * Demo- and Example-Programs
 *
 * Please note: The demo and example programs only show special aspects of the software.
 * With regard to the fact that these programs are meant for demonstration purposes only,
 * Vector Informatik's liability shall be expressly excluded in cases of ordinary
 * negligence, to the extent admissible by law or statute.
 *
 * Beta-Version
 *
 * These programs are fully operative programs. However, they are not thoroughly tested
 * yet (beta-version). With regard to the fact that the programs are a beta-version only,
 * Vector Informatik's liability shall be expressly excluded in cases of ordinary
 * negligence, to the extent admissible by law or statute.
 *
 * DESCRIPTION:
 *
 * Demo test implementation of the 'OPEN Alliance Automotive Ethernet ECU Test
 * Specification - TC8 ECU Test' (Document Version 2.0, August 23, 2017)
 *
 * Copyright (c) Vector Informatik GmbH. All rights reserved.
 ***************************************************************************************/

/// <Services>
int startServiceSOMEIP(struct _Token_Testabilty recvData, struct _Token_Testabilty sendData)
{
  int iRet = 0;
  word wServiceId;
  word wNumberOfInst;
  dword dwSDCyclicOfferDelay;
  dword dwTTL;
  long lParameterLen = 0;
  
  //get parameters, service id and number of instance
  wServiceId    = getWordData(recvData.TestabilityMsg.bParameters, 0);
  wNumberOfInst = getWordData(recvData.TestabilityMsg.bParameters, 2);

  //Set SD Cyclic Offer Delay and TTL, default
  //If the optional parmeters exist, get parameters 
  dwSDCyclicOfferDelay  = kSOMEIP_SD_CYCLIC_OFFER_DELAY;
  dwTTL = kSOMEIP_SD_DEFAULT_TTL;
  
  lParameterLen = recvData.TestabilityMsg.Header.dwLen - kTESTABILITY_PARAMETER_SIZE_OFFSET;
  if(lParameterLen > 4)
  {
    dwSDCyclicOfferDelay =  getDWordData(recvData.TestabilityMsg.bParameters, 4);
    if(lParameterLen > 8)
    {
      dwTTL =  getDWordData(recvData.TestabilityMsg.bParameters, 8);
    }
  }
  
  //Start SOMEIP Service
  iRet = startService(wServiceId, wNumberOfInst, dwSDCyclicOfferDelay, dwTTL);
  if(iRet != kTrue)
  {
    sendData.TestabilityMsg.Header.rid = RID_E_NOK;
  }
  else
  {
    sendData.TestabilityMsg.Header.rid = RID_E_OK;
  }
  return iRet;  
}

/// <Services>
int stopServiceSOMEIP(struct _Token_Testabilty recvData, struct _Token_Testabilty sendData)
{
  int iRet = 0;
  word wServiceId;
  
  //get parameters, service id
  wServiceId = getWordData(recvData.TestabilityMsg.bParameters, 0);
  
  //Stop SOMEIP Service
  iRet = stopService(wServiceId);
  
  if(iRet != kTrue)
  {
    sendData.TestabilityMsg.Header.rid = RID_E_NOK;
  }
  else
  {
    sendData.TestabilityMsg.Header.rid = RID_E_OK;
  }
  return iRet;  
}

/// <Services>
int triggerEventSOMEIP(struct _Token_Testabilty recvData, struct _Token_Testabilty sendData)
{
  int iRet = 0;
  word wServiceId;
  word wEventGId;
  word wEventId;

  //get parameters, service id
  wServiceId    = getWordData(recvData.TestabilityMsg.bParameters, 0);
  wEventGId  = getWordData(recvData.TestabilityMsg.bParameters, 2);
  wEventId   = getWordData(recvData.TestabilityMsg.bParameters, 4);
  
  iRet = triggerEvent(wServiceId, wEventGId, wEventId);
  if(iRet != kTrue)
  {
    sendData.TestabilityMsg.Header.rid = RID_E_NOK;
  }
  else
  {
    sendData.TestabilityMsg.Header.rid = RID_E_OK;
  }
  return iRet;  
}

