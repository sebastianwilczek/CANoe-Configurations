/*@!Encoding:1252*/
/***************************************************************************************
 * Demo- and Example-Programs
 *
 * Please note: The demo and example programs only show special aspects of the software.
 * With regard to the fact that these programs are meant for demonstration purposes only,
 * Vector Informatik's liability shall be expressly excluded in cases of ordinary
 * negligence, to the extent admissible by law or statute.
 *
 * Beta-Version
 *
 * These programs are fully operative programs. However, they are not thoroughly tested
 * yet (beta-version). With regard to the fact that the programs are a beta-version only,
 * Vector Informatik's liability shall be expressly excluded in cases of ordinary
 * negligence, to the extent admissible by law or statute.
 *
 * DESCRIPTION:
 *
 * Demo test implementation of the 'OPEN Alliance Automotive Ethernet ECU Test
 * Specification - TC8 ECU Test' (Document Version 2.0, August 23, 2017)
 *
 * Copyright (c) Vector Informatik GmbH. All rights reserved.
 ***************************************************************************************/

int initClientDHCP(struct _Token_Testabilty recvData, struct _Token_Testabilty sendData)
{
  int iRet = 0;
  struct _DHCP_INIT_CLIENT initClient;
  
  getDHCPInitOrStopClient( initClient, kTESTABILITY_HEADER_SIZE );
  
  // DHCP on
  gDHCPenabled = 1;

  sendData.TestabilityMsg.Header.rid = RID_E_OK;

  return iRet;  
}

int stopClientDHCP(struct _Token_Testabilty recvData, struct _Token_Testabilty sendData)
{
  int iRet = 0;
  struct _DHCP_INIT_CLIENT initClient;
  
  getDHCPInitOrStopClient( initClient, kTESTABILITY_HEADER_SIZE );

  // DHCP off
  gDHCPenabled = 0;

  sendData.TestabilityMsg.Header.rid = RID_E_OK;
  
  return iRet;  
}

int setOptionDHCP(struct _Token_Testabilty recvData, struct _Token_Testabilty sendData)
{
  int iRet = 0;
  struct _DHCP_SET_OPTION setOption;
  
  getDHCPSetOption( setOption, kTESTABILITY_HEADER_SIZE );
  
  sendData.TestabilityMsg.Header.rid = RID_E_OK;
  
  return iRet;  
}
