/*@!Encoding:1252*/
/***************************************************************************************
 * Demo- and Example-Programs
 *
 * Please note: The demo and example programs only show special aspects of the software.
 * With regard to the fact that these programs are meant for demonstration purposes only,
 * Vector Informatik's liability shall be expressly excluded in cases of ordinary
 * negligence, to the extent admissible by law or statute.
 *
 * Beta-Version
 *
 * These programs are fully operative programs. However, they are not thoroughly tested
 * yet (beta-version). With regard to the fact that the programs are a beta-version only,
 * Vector Informatik's liability shall be expressly excluded in cases of ordinary
 * negligence, to the extent admissible by law or statute.
 *
 * DESCRIPTION:
 *
 * Demo test implementation of the 'OPEN Alliance Automotive Ethernet ECU Test
 * Specification - TC8 ECU Test' (Document Version 2.0, August 23, 2017)
 *
 * Copyright (c) Vector Informatik GmbH. All rights reserved.
 ***************************************************************************************/

variables
{
  enum Bool {
    kFalse,
    kTrue
  };

  enum TestGroup {
    kNoTestGroup																= 0,
    kInteropTests																= 1,
    kPMA																				= 2,
    kVlanTesting																= 3,
    kGeneral																		= 4,
    kAddressLearning														= 5,
    kFilteringOfIncomingFrames									= 6,
    kTc11																				= 7,
    kArp																				= 8,
    kIcmpv4																			= 9,
    kIpv4																				= 10,
    kDynamicConfigurationOfIpv4LinkLocalAddress = 11,
    kUdp																				= 12,
    kDhcpv4																			= 13,
    kTcp																				= 14,
    kSomeIpEts																	= 15,
    kSomeIpServer																= 16
  };
  
  enum TcpFlag
  {
    TcpFlagUndefined = -1,
    TcpFlagNone = 0x00,
    TcpFlagFin = 0x01,
    TcpFlagSyn = 0x02,
    TcpFlagRst = 0x04,
    TcpFlagSynRst = 0x06,
    TcpFlagPsh = 0x08,
    TcpFlagAck = 0x10,
    TcpFlagFinAck = 0x11,
    TcpFlagSynAck = 0x12,
    TcpFlagRstAck = 0x14,
    TcpFlagSynAckRst = 0x16,
    TcpFlagPshAck = 0x18,
    TcpFlagUrg = 0x20,
    TcpFlagUrgPsh = 0x28,
    TcpFlagUrgAck = 0x30,
    TcpFlagUrgPshAck = 0x38,
    TcpFlagEce = 0x40,
    TcpFlagCwr = 0x80
  };
  
  enum TcpStateId
  {
    TcpStateWorkaround    = -1,
    TcpStateIdClosed      = 0x00,
    TcpStateIdListen      = 0x01,
    TcpStateIdSynSent     = 0x02,
    TcpStateIdSynReceived = 0x03,
    TcpStateIdEstablished = 0x04,
    TcpStateIdCloseWait   = 0x05,
    TcpStateIdFinWait1    = 0x06,
    TcpStateIdClosing     = 0x07,
    TcpStateIdLastAck     = 0x08,
    TcpStateIdFinWait2    = 0x09,
    TcpStateIdTimeWait    = 0x0A,
    TcpStateIdInvalid     = 0xFF
  };
}
