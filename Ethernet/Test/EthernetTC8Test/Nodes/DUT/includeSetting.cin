/*@!Encoding:1252*/
/***************************************************************************************
 * Demo- and Example-Programs
 *
 * Please note: The demo and example programs only show special aspects of the software.
 * With regard to the fact that these programs are meant for demonstration purposes only,
 * Vector Informatik's liability shall be expressly excluded in cases of ordinary
 * negligence, to the extent admissible by law or statute.
 *
 * Beta-Version
 *
 * These programs are fully operative programs. However, they are not thoroughly tested
 * yet (beta-version). With regard to the fact that the programs are a beta-version only,
 * Vector Informatik's liability shall be expressly excluded in cases of ordinary
 * negligence, to the extent admissible by law or statute.
 *
 * DESCRIPTION:
 *
 * Demo test implementation of the 'OPEN Alliance Automotive Ethernet ECU Test
 * Specification - TC8 ECU Test' (Document Version 2.0, August 23, 2017)
 *
 * Copyright (c) Vector Informatik GmbH. All rights reserved.
 ***************************************************************************************/

variables
{  
  // DUT's mac address
  const qword kDIface_0_MAC_ADDR = 0x680000000002LL;

  // DUT interface index
  const dword kdwIPV4_INTERFACE_INDEX = 1;
  const dword kdwIPV6_INTERFACE_INDEX = 2;

  // broadcast mac address
  const qword kBROADCAST_MAC_ADDRESS = 0xFFFFFFFFFFFFLL;
  // broadcast IP address
  const dword kBROADCAST_IP_ADDRESS = 0xFFFFFFFF;
  
// DUT's IPv4 multi cast address
  char kstrIPv4Multicast_IP[16] = "239.192.255.251";
  
  // byte order
  const byte kBYTE_ORDER_MOT = 1;
  const byte kBYTE_ORDER_INTEL = 0;
  
  const int kBYTE_OFFSET = 0;
  const int kBYTE_LENGTH_HWADDRESS = 6;
  const int kBYTE_LENGTH_IP = 4;
  
  //Default fragment reassembly timeout
  const long kIPV4_DEF_FRAG_REASSEMBLY_TIMEOUT = 15;  // sec
  
  //Default MSS(Maximum Segment Size)
  const long kIPV4_DEF_MSS = 536;
  const long kIPV6_DEF_MSS = 536;
  
  //Retransmit Slop
  const long kTCP_RETRANSMIT_SLOP = 10;
  const long kTCP_RETRANSMIT_MIN = 100;
  const long kTCP_DELAY_ACK_TIME = 200;
  
  const long kTCP_FINWAIT2_TIMEOUT = 100;
  const long kTCP_MSL              = 32000;
  
  const long kDEF_TCP_RFC3390_SETTING = 1; //1:Enable, 0:Disable
  const long kDEF_TCP_SLOW_START_FLIGHT_SIZE = 1;
  const long kDEF_TCP_LOCAL_SLOW_START_FLIGHT_SIZE = 4;
  
  long kDEF_UDP_DELAY_SEND_DATA_TIME = 1000; // 5msec
}

dword GetDutIpAsNummer()
{  
  dword ipAsNum = 0;
  
  if(ipAsNum == 0)
  {
   char buf[100];
   sysGetVariableString(sysvar::Internal::DIface0Ip, buf, elcount(buf));  
   ipAsNum = ipGetAddressAsNumber(buf); 
  }
  
  return ipAsNum;
}

dword GetDutSubnetMask()
{
  dword maskAsNum = 0;
  
  if(maskAsNum == 0)
  {
    char buff[100];
    sysGetVariableString(sysvar::Internal::Host1SubnetMaskTester, buff, elcount(buff));
    maskAsNum = ipGetAddressAsNumber(buff);
  }
  
  return maskAsNum;
}
