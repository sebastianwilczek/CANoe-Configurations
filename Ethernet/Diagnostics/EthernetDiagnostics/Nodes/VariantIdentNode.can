/*@@includes:*/
includes
{
  #include "Diagnostics\CCI_CanTP.cin"
}
/*@@end*/

/*@@var:*/
variables
{
  const cIsTester = 0;     // set to 0 in ECU simulation
  byte  gSeedArray[2];
  int   gSeedArraySize      = 2;
  int   gSecurityLevel      = 0x20;
  char  gVariant[200]       = "Common";
  char  gOption[200]        = "";  
  byte  gKeyArray[255];
  int   gMaxKeyArraySize    = 255;  
  DWORD gActualSize         = 0;
  WORD  gDiagnosticVersion  = 0x2; 
  char  gDebugBuffer[2000];
  //--------------------------------------------------------------------------//

  char gECU[17] = "VariantIdentNode";
}
/*@@end*/

/*@@startStart:Start:*/
on start
{
}
/*@@end*/

/*@@diagRequest:DiagnosticVersion_Read:*/
on diagRequest DiagnosticVersion_Read
{
  diagResponse this resp;

  // Set the parameters in the response.
  DiagSetParameter( resp, "Diagnostic_Version_dump", gDiagnosticVersion);
  DiagSendResponse( resp);
}
/*@@end*/

/*@@caplFunc:_Diag_GetError(char[]):*///callback
_Diag_GetError (char buffer[])
{
  //called if error in DiagGenerateKeyFromSeed occurs
  snprintf(gDebugBuffer,elcount(gDebugBuffer),"%s", buffer);
  write("Diagnostic Error %s", gDebugBuffer);
}
/*@@end*/

