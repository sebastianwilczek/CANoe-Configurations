/*@!Encoding:1252*/
/*
 * Simple ECU simulation for the BasicDiagostics device
 * Only a subset of services will be answered with a positive response, for the rest
 * a negative response "Service not supported" will be returned.
 */

includes
{
  #include "Diagnostics\CCI_CanTP.cin"
}

variables
{
  char gECU[15] = "BasicDiagEmu";
  const cIsTester = 0;
}

on preStart
{
  DiagInitEcuSimulation( "BasicDiagECU");
}

on diagRequest *
{
  if( this.IsRaw())
  {
    // respond to anything not defined as "Service not supported"
    this.SendNegativeResponse( 0x11);
  }
  else
  {
    // Send default response
    DiagResponse this resp;
    resp.SendResponse();
  }
}

on diagRequest ProgrammingSession_Start
{
  // Send "General reject" since this shall not be supported here
  this.SendNegativeResponse( 0x33);
}

on diagRequest AD_Values_Read
{
  // DID 0040
  DiagResponse this resp;
  resp.SetParameter( "Voltage", 200);
  resp.SetParameter( "Current", 2);
  resp.SetParameter( "Resistance", 100);
  resp.SendResponse();
}

on diagRequest WindowLifterSpeed_Read
{
  // DID 0041
  // send pos. response with sine wave output value
  DiagResponse this resp;
  resp.SetParameter( "LifterSpeed", abs(255*sin(2*PI*1/5000000*timenow())));
  resp.SendResponse();
}

on diagRequest DoorStatus_Read
{
  // DID 0080
  // Send "Security access denied" since this shall not be supported here
  this.SendNegativeResponse( 0x33);
}

on diagRequest SerialNumber_Read
{
  // DID 0092
  DiagResponse this resp;
  resp.SetParameter( "SerialNumber", 0x00029B45);
  resp.SendResponse();
}

on diagRequest EcuIdentification_Read
{
  // DID 009F
  DiagResponse this resp;
  resp.SetParameter( "PartNumber", "BasicDiagEcu");
  resp.SendResponse();
}