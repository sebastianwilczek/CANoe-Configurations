/*@@includes:*/
includes
{
  #include "Download.cin"
}
/*@@end*/

/*@@var:*/
variables
{
}
/*@@end*/

/*@@mainTest:MainTest():*/
void MainTest()
{
  strncpy( target, "GW", elcount( target));
  strncpy( tester, "Flash GW", elcount( tester));
  downloadSize = 0x00100000;
  Download();
}
/*@@end*/

