/*@@includes:*/
includes
{
  #include "Download.cin"
}
/*@@end*/

/*@@var:*/
variables
{
}
/*@@end*/

/*@@mainTest:MainTest():*/
void MainTest()
{
  strncpy( target, "Door", elcount( target));
  strncpy( tester, "Flash ECU", elcount( tester));
  downloadSize = 0x00004000;
  Download();
}
/*@@end*/

