// -------------------------------------------------------------------------
// Module: ColorSettings.can
// Interfaces: -
// -------------------------------------------------------------------------
// Implementation of the Class ColorSettings
// -------------------------------------------------------------------------
// Copyright (c) Vector Informatik GmbH. All rights reserved.
// -------------------------------------------------------------------------


// The class is used to set the background color of the analog gauges depending on the signal status.
// If the state of the signal changes, the background color of the analog gauge is adjusted with the same color as in the trace window.
includes
{
  #include "AFDX/Utils.cin"
}

variables
{
  // Color constants:
  LONG blue   = 0;
  LONG red    = 0;
  LONG white  = 0;
  LONG yellow = 0;
}

on preStart
{
  LONG result = 0;
  blue   = MakeRGB(225, 239, 255); // A very light blue
  red    = MakeRGB(255, 227, 221); // A very light red
  white  = MakeRGB(255, 255, 255); 
  yellow = MakeRGB(255, 255, 201); // A very light yellow
}

on start 
{
  // To set the status of the analog gauge during startup, it is necessary to create a packet
  LONG packet  = 0;
  LONG status1 = 0;
  LONG status2 = 0;
  LONG status3 = 0;
  
  // creates a new AFDX packet to initialize the background color of analog gauge.
  // msgID == 0 -> use the message name to generate a packet handle
  packet = AfdxInitPacket(0, "DEMOMSG_INT3", 0);
  
  status1 = AfdxGetSignalStatus(packet , "IOM_DEMO_VFG_OIL_TEMP_A_31");
  status2 = AfdxGetSignalStatus(packet , "IOM_DEMO_VFG_OIL_TEMP_A_32");
  status3 = AfdxGetSignalStatus(packet , "IOM_DEMO_VFG_OIL_TEMP_A_33");
  
  setTemperatureBackGroundColor(status1, "Analog Gauge1");
  setTemperatureBackGroundColor(status2, "Analog Gauge2");
  setTemperatureBackGroundColor(status3, "Analog Gauge3");

  // The function deletes a packet created with AfdxInitPacket. The handle can not be used any longer.
  AfdxReleasePacket(packet);
}

// sets the background color of the first analog gauge if state of the signal has changed
on signal_change FS_FDS_1_HSMU_DEMO_INT3
{
  setTemperatureBackGroundColor(this.raw, "Analog Gauge1");
}

// sets the background color of the second analog gauge if state of the signal has changed
on signal_change FS_FDS_2_HSMU_DEMO_INT3
{
  setTemperatureBackGroundColor(this.raw, "Analog Gauge2");
}

// sets the background color of the third analog gauge if state of the signal has changed
on signal_change FS_FDS_3_HSMU_DEMO_INT3
{
  setTemperatureBackGroundColor(this.raw, "Analog Gauge3");
}

// set the backgroundcolor of the analog gauge
void setTemperatureBackGroundColor(LONG status, char name[])
{
  LONG color = 0;
  
  switch (status)
  {
    case 0: // ND
      color = red; 
      break;
    case 3: // NO
      color = white;
      break;
    case 12: // FT
      color = yellow;
      break;
    case 48: // NCD
      color = blue;
      break;
    default:
      color = white;
      break;
  }

  // Sets the background color of panel elements.
  setControlBackColor("Temperature", name, color);
}
