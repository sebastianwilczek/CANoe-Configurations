VERSION ""

NS_ :

BS_:

BU_: IOM_APP2 IOM_APP1

BO_ 437791610 DEMOMSG20_INT: 1400 IOM_APP1
 SG_ FS_HSMU_DEMO20_1 : 39|8@0+ (1,0) [0|0] "" Vector__XXX
 SG_ IOM_DEMO_VFG_OIL_TEMP20_A_31 : 71|32@0- (1,0) [0|100] "deg C" Vector__XXX
 SG_ FS_HSMU_DEMO20_2 : 47|8@0+ (1,0) [0|0] "" Vector__XXX
 SG_ IOM_DEMO_VFG_OIL_TEMP20_A_32 : 103|32@0- (1,0) [0|100] "deg C" Vector__XXX
 SG_ FS_HSMU_DEMO20_3 : 55|8@0+ (1,0) [0|0] "" Vector__XXX
 SG_ IOM_DEMO_VFG_OIL_TEMP20_A_33 : 135|32@0- (1,0) [0|100] "deg C" Vector__XXX
 SG_ FS_HSMU_DEMO20_4 : 63|8@0+ (1,0) [0|0] "" Vector__XXX
 SG_ IOM_DEMO_VFG_OIL_TEMP20_A_34 : 167|32@0- (1,0) [0|100] "deg C" Vector__XXX
 SG_ FS_HSMU_DEMO20_5 : 199|8@0+ (1,0) [0|0] "" Vector__XXX
 SG_ IOM_DEMO_VFG_OIL_TEMP20_A_35 : 231|32@0- (1,0) [0|100] "deg C" Vector__XXX
 SG_ FS_HSMU_DEMO20_6 : 207|8@0+ (1,0) [0|0] "" Vector__XXX
 SG_ IOM_DEMO_VFG_OIL_TEMP20_A_36 : 263|32@0- (1,0) [0|100] "deg C" Vector__XXX
 SG_ FS_HSMU_DEMO20_7 : 215|8@0+ (1,0) [0|0] "" Vector__XXX
 SG_ IOM_DEMO_VFG_OIL_TEMP20_A_37 : 295|32@0- (1,0) [0|100] "deg C" Vector__XXX
 SG_ FS_HSMU_DEMO20_8 : 223|8@0+ (1,0) [0|0] "" Vector__XXX
 SG_ IOM_DEMO_VFG_OIL_TEMP20_A_38 : 327|32@0- (1,0) [0|100] "deg C" Vector__XXX
 SG_ FS_HSMU_DEMO20_9 : 359|8@0+ (1,0) [0|0] "" Vector__XXX
 SG_ IOM_DEMO_VFG_OIL_TEMP20_A_39 : 391|32@0- (1,0) [0|100] "deg C" Vector__XXX
 SG_ FS_HSMU_DEMO20_10 : 367|8@0+ (1,0) [0|0] "" Vector__XXX
 SG_ IOM_DEMO_VFG_OIL_TEMP20_A_40 : 423|32@0- (1,0) [0|100] "deg C" Vector__XXX
 SG_ FS_HSMU_DEMO20_11 : 375|8@0+ (1,0) [0|0] "" Vector__XXX
 SG_ IOM_DEMO_VFG_OIL_TEMP20_A_41 : 455|32@0- (1,0) [0|100] "deg C" Vector__XXX
 SG_ FS_HSMU_DEMO20_12 : 383|8@0+ (1,0) [0|0] "" Vector__XXX
 SG_ IOM_DEMO_VFG_OIL_TEMP20_A_42 : 487|32@0- (1,0) [0|100] "deg C" Vector__XXX
 SG_ FS_HSMU_DEMO20_13 : 519|8@0+ (1,0) [0|0] "" Vector__XXX
 SG_ IOM_DEMO_VFG_OIL_TEMP20_A_43 : 551|32@0- (1,0) [0|100] "deg C" Vector__XXX
 SG_ FS_HSMU_DEMO20_14 : 527|8@0+ (1,0) [0|0] "" Vector__XXX
 SG_ IOM_DEMO_VFG_OIL_TEMP20_A_44 : 583|32@0- (1,0) [0|100] "deg C" Vector__XXX
 SG_ FS_HSMU_DEMO20_15 : 535|8@0+ (1,0) [0|0] "" Vector__XXX
 SG_ IOM_DEMO_VFG_OIL_TEMP20_A_45 : 615|32@0- (1,0) [0|100] "deg C" Vector__XXX
 SG_ FS_HSMU_DEMO20_16 : 543|8@0+ (1,0) [0|0] "" Vector__XXX
 SG_ IOM_DEMO_VFG_OIL_TEMP20_A_46 : 647|32@0- (1,0) [0|100] "deg C" Vector__XXX
 SG_ FS_HSMU_DEMO20_17 : 679|8@0+ (1,0) [0|0] "" Vector__XXX
 SG_ IOM_DEMO_VFG_OIL_TEMP20_A_47 : 711|32@0- (1,0) [0|100] "deg C" Vector__XXX
 SG_ FS_HSMU_DEMO20_18 : 687|8@0+ (1,0) [0|0] "" Vector__XXX
 SG_ IOM_DEMO_VFG_OIL_TEMP20_A_48 : 743|32@0- (1,0) [0|100] "deg C" Vector__XXX
 SG_ FS_HSMU_DEMO20_19 : 695|8@0+ (1,0) [0|0] "" Vector__XXX
 SG_ IOM_DEMO_VFG_OIL_TEMP20_A_49 : 775|32@0- (1,0) [0|100] "deg C" Vector__XXX
 SG_ FS_HSMU_DEMO20_20 : 703|8@0+ (1,0) [0|0] "" Vector__XXX
 SG_ IOM_DEMO_VFG_OIL_TEMP20_A_50 : 807|32@0- (1,0) [0|100] "deg C" Vector__XXX
 SG_ FS_HSMU_DEMO20_21 : 839|8@0+ (1,0) [0|0] "" Vector__XXX
 SG_ IOM_DEMO_VFG_OIL_TEMP20_A_51 : 871|32@0- (1,0) [0|100] "deg C" Vector__XXX
 SG_ FS_HSMU_DEMO20_22 : 847|8@0+ (1,0) [0|0] "" Vector__XXX
 SG_ IOM_DEMO_VFG_OIL_TEMP20_A_52 : 903|32@0- (1,0) [0|100] "deg C" Vector__XXX
 SG_ FS_HSMU_DEMO20_23 : 855|8@0+ (1,0) [0|0] "" Vector__XXX
 SG_ IOM_DEMO_VFG_OIL_TEMP20_A_53 : 935|32@0- (1,0) [0|100] "deg C" Vector__XXX
 SG_ FS_HSMU_DEMO20_24 : 863|8@0+ (1,0) [0|0] "" Vector__XXX
 SG_ IOM_DEMO_VFG_OIL_TEMP20_A_54 : 967|32@0- (1,0) [0|100] "deg C" Vector__XXX
 SG_ FS_HSMU_DEMO20_25 : 999|8@0+ (1,0) [0|0] "" Vector__XXX
 SG_ IOM_DEMO_VFG_OIL_TEMP20_A_55 : 1031|32@0- (1,0) [0|100] "deg C" Vector__XXX
 SG_ FS_HSMU_DEMO20_26 : 1007|8@0+ (1,0) [0|0] "" Vector__XXX
 SG_ IOM_DEMO_VFG_OIL_TEMP20_A_56 : 1063|32@0- (1,0) [0|100] "deg C" Vector__XXX
 SG_ FS_HSMU_DEMO20_27 : 1015|8@0+ (1,0) [0|0] "" Vector__XXX
 SG_ IOM_DEMO_VFG_OIL_TEMP20_A_57 : 1095|32@0- (1,0) [0|100] "deg C" Vector__XXX
 SG_ FS_HSMU_DEMO20_28 : 1023|8@0+ (1,0) [0|0] "" Vector__XXX
 SG_ IOM_DEMO_VFG_OIL_TEMP20_A_58 : 1127|32@0- (1,0) [0|100] "deg C" Vector__XXX
 SG_ FS_HSMU_DEMO20_29 : 1159|8@0+ (1,0) [0|0] "" Vector__XXX
 SG_ IOM_DEMO_VFG_OIL_TEMP20_A_59 : 1191|32@0- (1,0) [0|100] "deg C" Vector__XXX
 SG_ FS_HSMU_DEMO20_30 : 1167|8@0+ (1,0) [0|0] "" Vector__XXX
 SG_ IOM_DEMO_VFG_OIL_TEMP20_A_60 : 1223|32@0- (1,0) [0|100] "deg C" Vector__XXX
 SG_ FS_HSMU_DEMO20_31 : 1175|8@0+ (1,0) [0|0] "" Vector__XXX
 SG_ IOM_DEMO_VFG_OIL_TEMP20_A_61 : 1255|32@0- (1,0) [0|100] "deg C" Vector__XXX
 SG_ FS_HSMU_DEMO20_32 : 1183|8@0+ (1,0) [0|0] "" Vector__XXX
 SG_ IOM_DEMO_VFG_OIL_TEMP20_A_62 : 1287|32@0- (1,0) [0|100] "deg C" Vector__XXX
 SG_ FS_HSMU_DEMO20_33 : 1319|8@0+ (1,0) [0|0] "" Vector__XXX
 SG_ IOM_DEMO_VFG_OIL_TEMP20_A_63 : 1351|32@0- (1,0) [0|100] "deg C" Vector__XXX
 SG_ FS_HSMU_DEMO20_34 : 1327|8@0+ (1,0) [0|0] "" Vector__XXX
 SG_ IOM_DEMO_VFG_OIL_TEMP20_A_64 : 1383|32@0- (1,0) [0|100] "deg C" Vector__XXX
 SG_ FS_HSMU_DEMO20_35 : 1335|8@0+ (1,0) [0|0] "" Vector__XXX
 SG_ IOM_DEMO_VFG_OIL_TEMP20_A_65 : 1415|32@0- (1,0) [0|100] "deg C" Vector__XXX
 SG_ FS_HSMU_DEMO20_36 : 1343|8@0+ (1,0) [0|0] "" Vector__XXX
 SG_ IOM_DEMO_VFG_OIL_TEMP20_A_66 : 1447|32@0- (1,0) [0|100] "deg C" Vector__XXX
 SG_ FS_HSMU_DEMO20_37 : 1479|8@0+ (1,0) [0|0] "" Vector__XXX
 SG_ IOM_DEMO_VFG_OIL_TEMP20_A_67 : 1511|32@0- (1,0) [0|100] "deg C" Vector__XXX
 SG_ FS_HSMU_DEMO20_38 : 1487|8@0+ (1,0) [0|0] "" Vector__XXX
 SG_ IOM_DEMO_VFG_OIL_TEMP20_A_68 : 1543|32@0- (1,0) [0|100] "deg C" Vector__XXX
 SG_ FS_HSMU_DEMO20_39 : 1495|8@0+ (1,0) [0|0] "" Vector__XXX
 SG_ IOM_DEMO_VFG_OIL_TEMP20_A_69 : 1575|32@0- (1,0) [0|100] "deg C" Vector__XXX
 SG_ FS_HSMU_DEMO20_40 : 1503|8@0+ (1,0) [0|0] "" Vector__XXX
 SG_ IOM_DEMO_VFG_OIL_TEMP20_A_70 : 1607|32@0- (1,0) [0|100] "deg C" Vector__XXX
 SG_ FS_HSMU_DEMO20_41 : 1639|8@0+ (1,0) [0|0] "" Vector__XXX
 SG_ IOM_DEMO_VFG_OIL_TEMP20_A_71 : 1671|32@0- (1,0) [0|100] "deg C" Vector__XXX
 SG_ FS_HSMU_DEMO20_42 : 1647|8@0+ (1,0) [0|0] "" Vector__XXX
 SG_ IOM_DEMO_VFG_OIL_TEMP20_A_72 : 1703|32@0- (1,0) [0|100] "deg C" Vector__XXX
 SG_ FS_HSMU_DEMO20_43 : 1655|8@0+ (1,0) [0|0] "" Vector__XXX
 SG_ IOM_DEMO_VFG_OIL_TEMP20_A_73 : 1735|32@0- (1,0) [0|100] "deg C" Vector__XXX
 SG_ FS_HSMU_DEMO20_44 : 1663|8@0+ (1,0) [0|0] "" Vector__XXX
 SG_ IOM_DEMO_VFG_OIL_TEMP20_A_74 : 1767|32@0- (1,0) [0|100] "deg C" Vector__XXX
 SG_ FS_HSMU_DEMO20_45 : 1799|8@0+ (1,0) [0|0] "" Vector__XXX
 SG_ IOM_DEMO_VFG_OIL_TEMP20_A_75 : 1831|32@0- (1,0) [0|100] "deg C" Vector__XXX
 SG_ FS_HSMU_DEMO20_46 : 1807|8@0+ (1,0) [0|0] "" Vector__XXX
 SG_ IOM_DEMO_VFG_OIL_TEMP20_A_76 : 1863|32@0- (1,0) [0|100] "deg C" Vector__XXX
 SG_ FS_HSMU_DEMO20_47 : 1815|8@0+ (1,0) [0|0] "" Vector__XXX
 SG_ IOM_DEMO_VFG_OIL_TEMP20_A_77 : 1895|32@0- (1,0) [0|100] "deg C" Vector__XXX
 SG_ FS_HSMU_DEMO20_48 : 1823|8@0+ (1,0) [0|0] "" Vector__XXX
 SG_ IOM_DEMO_VFG_OIL_TEMP20_A_78 : 1927|32@0- (1,0) [0|100] "deg C" Vector__XXX
 SG_ FS_HSMU_DEMO20_49 : 1959|8@0+ (1,0) [0|0] "" Vector__XXX
 SG_ IOM_DEMO_VFG_OIL_TEMP20_A_79 : 1991|32@0- (1,0) [0|100] "deg C" Vector__XXX
 SG_ FS_HSMU_DEMO20_50 : 1967|8@0+ (1,0) [0|0] "" Vector__XXX
 SG_ IOM_DEMO_VFG_OIL_TEMP20_A_80 : 2023|32@0- (1,0) [0|100] "deg C" Vector__XXX
 SG_ FS_HSMU_DEMO20_51 : 1975|8@0+ (1,0) [0|0] "" Vector__XXX
 SG_ IOM_DEMO_VFG_OIL_TEMP20_A_81 : 2055|32@0- (1,0) [0|100] "deg C" Vector__XXX
 SG_ FS_HSMU_DEMO20_52 : 1983|8@0+ (1,0) [0|0] "" Vector__XXX
 SG_ IOM_DEMO_VFG_OIL_TEMP20_A_82 : 2087|32@0- (1,0) [0|100] "deg C" Vector__XXX
 SG_ FS_HSMU_DEMO20_53 : 2119|8@0+ (1,0) [0|0] "" Vector__XXX
 SG_ IOM_DEMO_VFG_OIL_TEMP20_A_83 : 2151|32@0- (1,0) [0|100] "deg C" Vector__XXX
 SG_ FS_HSMU_DEMO20_54 : 2127|8@0+ (1,0) [0|0] "" Vector__XXX
 SG_ IOM_DEMO_VFG_OIL_TEMP20_A_84 : 2183|32@0- (1,0) [0|100] "deg C" Vector__XXX
 SG_ FS_HSMU_DEMO20_55 : 2135|8@0+ (1,0) [0|0] "" Vector__XXX
 SG_ IOM_DEMO_VFG_OIL_TEMP20_A_85 : 2215|32@0- (1,0) [0|100] "deg C" Vector__XXX
 SG_ FS_HSMU_DEMO20_56 : 2143|8@0+ (1,0) [0|0] "" Vector__XXX
 SG_ IOM_DEMO_VFG_OIL_TEMP20_A_86 : 2247|32@0- (1,0) [0|100] "deg C" Vector__XXX
 SG_ FS_HSMU_DEMO20_57 : 2279|8@0+ (1,0) [0|0] "" Vector__XXX
 SG_ IOM_DEMO_VFG_OIL_TEMP20_A_87 : 2311|32@0- (1,0) [0|100] "deg C" Vector__XXX
 SG_ FS_HSMU_DEMO20_58 : 2287|8@0+ (1,0) [0|0] "" Vector__XXX
 SG_ IOM_DEMO_VFG_OIL_TEMP20_A_88 : 2343|32@0- (1,0) [0|100] "deg C" Vector__XXX
 SG_ FS_HSMU_DEMO20_59 : 2295|8@0+ (1,0) [0|0] "" Vector__XXX
 SG_ IOM_DEMO_VFG_OIL_TEMP20_A_89 : 2375|32@0- (1,0) [0|100] "deg C" Vector__XXX
 SG_ FS_HSMU_DEMO20_60 : 2303|8@0+ (1,0) [0|0] "" Vector__XXX
 SG_ IOM_DEMO_VFG_OIL_TEMP20_A_90 : 2407|32@0- (1,0) [0|100] "deg C" Vector__XXX
 SG_ FS_HSMU_DEMO20_61 : 2439|8@0+ (1,0) [0|0] "" Vector__XXX
 SG_ IOM_DEMO_VFG_OIL_TEMP20_A_91 : 2471|32@0- (1,0) [0|100] "deg C" Vector__XXX
 SG_ FS_HSMU_DEMO20_62 : 2447|8@0+ (1,0) [0|0] "" Vector__XXX
 SG_ IOM_DEMO_VFG_OIL_TEMP20_A_92 : 2503|32@0- (1,0) [0|100] "deg C" Vector__XXX
 SG_ FS_HSMU_DEMO20_63 : 2455|8@0+ (1,0) [0|0] "" Vector__XXX
 SG_ IOM_DEMO_VFG_OIL_TEMP20_A_93 : 2535|32@0- (1,0) [0|100] "deg C" Vector__XXX
 SG_ FS_HSMU_DEMO20_64 : 2463|8@0+ (1,0) [0|0] "" Vector__XXX
 SG_ IOM_DEMO_VFG_OIL_TEMP20_A_94 : 2567|32@0- (1,0) [0|100] "deg C" Vector__XXX
 SG_ FS_HSMU_DEMO20_65 : 2599|8@0+ (1,0) [0|0] "" Vector__XXX
 SG_ IOM_DEMO_VFG_OIL_TEMP20_A_95 : 2631|32@0- (1,0) [0|100] "deg C" Vector__XXX
 SG_ FS_HSMU_DEMO20_66 : 2607|8@0+ (1,0) [0|0] "" Vector__XXX
 SG_ IOM_DEMO_VFG_OIL_TEMP20_A_96 : 2663|32@0- (1,0) [0|100] "deg C" Vector__XXX
 SG_ FS_HSMU_DEMO20_67 : 2615|8@0+ (1,0) [0|0] "" Vector__XXX
 SG_ IOM_DEMO_VFG_OIL_TEMP20_A_97 : 2695|32@0- (1,0) [0|100] "deg C" Vector__XXX
 SG_ FS_HSMU_DEMO20_68 : 2623|8@0+ (1,0) [0|0] "" Vector__XXX
 SG_ IOM_DEMO_VFG_OIL_TEMP20_A_98 : 2727|32@0- (1,0) [0|100] "deg C" Vector__XXX
 SG_ FS_HSMU_DEMO20_69 : 2759|8@0+ (1,0) [0|0] "" Vector__XXX
 SG_ IOM_DEMO_VFG_OIL_TEMP20_A_99 : 2791|32@0- (1,0) [0|100] "deg C" Vector__XXX
 SG_ FS_HSMU_DEMO20_70 : 2767|8@0+ (1,0) [0|0] "" Vector__XXX
 SG_ IOM_DEMO_VFG_OIL_TEMP20_A_100 : 2823|32@0- (1,0) [0|100] "deg C" Vector__XXX
 SG_ FS_HSMU_DEMO20_71 : 2775|8@0+ (1,0) [0|0] "" Vector__XXX
 SG_ IOM_DEMO_VFG_OIL_TEMP20_A_101 : 2855|32@0- (1,0) [0|100] "deg C" Vector__XXX
 SG_ FS_HSMU_DEMO20_72 : 2783|8@0+ (1,0) [0|0] "" Vector__XXX
 SG_ IOM_DEMO_VFG_OIL_TEMP20_A_102 : 2887|32@0- (1,0) [0|100] "deg C" Vector__XXX
 SG_ FS_HSMU_DEMO20_73 : 2919|8@0+ (1,0) [0|0] "" Vector__XXX
 SG_ IOM_DEMO_VFG_OIL_TEMP20_A_103 : 2951|32@0- (1,0) [0|100] "deg C" Vector__XXX
 SG_ FS_HSMU_DEMO20_74 : 2927|8@0+ (1,0) [0|0] "" Vector__XXX
 SG_ IOM_DEMO_VFG_OIL_TEMP20_A_104 : 2983|32@0- (1,0) [0|100] "deg C" Vector__XXX
 SG_ FS_HSMU_DEMO20_75 : 2935|8@0+ (1,0) [0|0] "" Vector__XXX
 SG_ IOM_DEMO_VFG_OIL_TEMP20_A_105 : 3015|32@0- (1,0) [0|100] "deg C" Vector__XXX
 SG_ FS_HSMU_DEMO20_76 : 2943|8@0+ (1,0) [0|0] "" Vector__XXX
 SG_ IOM_DEMO_VFG_OIL_TEMP20_A_106 : 3047|32@0- (1,0) [0|100] "deg C" Vector__XXX
 SG_ FS_HSMU_DEMO20_77 : 3079|8@0+ (1,0) [0|0] "" Vector__XXX
 SG_ IOM_DEMO_VFG_OIL_TEMP20_A_107 : 3111|32@0- (1,0) [0|100] "deg C" Vector__XXX
 SG_ FS_HSMU_DEMO20_78 : 3087|8@0+ (1,0) [0|0] "" Vector__XXX
 SG_ IOM_DEMO_VFG_OIL_TEMP20_A_108 : 3143|32@0- (1,0) [0|100] "deg C" Vector__XXX
 SG_ FS_HSMU_DEMO20_79 : 3095|8@0+ (1,0) [0|0] "" Vector__XXX
 SG_ IOM_DEMO_VFG_OIL_TEMP20_A_109 : 3175|32@0- (1,0) [0|100] "deg C" Vector__XXX
 SG_ FS_HSMU_DEMO20_80 : 3103|8@0+ (1,0) [0|0] "" Vector__XXX
 SG_ IOM_DEMO_VFG_OIL_TEMP20_A_110 : 3207|32@0- (1,0) [0|100] "deg C" Vector__XXX
 SG_ FS_HSMU_DEMO20_81 : 3239|8@0+ (1,0) [0|0] "" Vector__XXX
 SG_ IOM_DEMO_VFG_OIL_TEMP20_A_111 : 3271|32@0- (1,0) [0|100] "deg C" Vector__XXX
 SG_ FS_HSMU_DEMO20_82 : 3247|8@0+ (1,0) [0|0] "" Vector__XXX
 SG_ IOM_DEMO_VFG_OIL_TEMP20_A_112 : 3303|32@0- (1,0) [0|100] "deg C" Vector__XXX
 SG_ FS_HSMU_DEMO20_83 : 3255|8@0+ (1,0) [0|0] "" Vector__XXX
 SG_ IOM_DEMO_VFG_OIL_TEMP20_A_113 : 3335|32@0- (1,0) [0|100] "deg C" Vector__XXX
 SG_ FS_HSMU_DEMO20_84 : 3263|8@0+ (1,0) [0|0] "" Vector__XXX
 SG_ IOM_DEMO_VFG_OIL_TEMP20_A_114 : 3367|32@0- (1,0) [0|100] "deg C" Vector__XXX
 SG_ FS_HSMU_DEMO20_85 : 3399|8@0+ (1,0) [0|0] "" Vector__XXX
 SG_ IOM_DEMO_VFG_OIL_TEMP20_A_115 : 3431|32@0- (1,0) [0|100] "deg C" Vector__XXX
 SG_ FS_HSMU_DEMO20_86 : 3407|8@0+ (1,0) [0|0] "" Vector__XXX
 SG_ IOM_DEMO_VFG_OIL_TEMP20_A_116 : 3463|32@0- (1,0) [0|100] "deg C" Vector__XXX
 SG_ FS_HSMU_DEMO20_87 : 3415|8@0+ (1,0) [0|0] "" Vector__XXX
 SG_ IOM_DEMO_VFG_OIL_TEMP20_A_117 : 3495|32@0- (1,0) [0|100] "deg C" Vector__XXX
 SG_ FS_HSMU_DEMO20_88 : 3423|8@0+ (1,0) [0|0] "" Vector__XXX
 SG_ IOM_DEMO_VFG_OIL_TEMP20_A_118 : 3527|32@0- (1,0) [0|100] "deg C" Vector__XXX
 SG_ FS_HSMU_DEMO20_89 : 3559|8@0+ (1,0) [0|0] "" Vector__XXX
 SG_ IOM_DEMO_VFG_OIL_TEMP20_A_119 : 3591|32@0- (1,0) [0|100] "deg C" Vector__XXX
 SG_ FS_HSMU_DEMO20_90 : 3567|8@0+ (1,0) [0|0] "" Vector__XXX
 SG_ IOM_DEMO_VFG_OIL_TEMP20_A_120 : 3623|32@0- (1,0) [0|100] "deg C" Vector__XXX
 SG_ FS_HSMU_DEMO20_91 : 3575|8@0+ (1,0) [0|0] "" Vector__XXX
 SG_ IOM_DEMO_VFG_OIL_TEMP20_A_121 : 3655|32@0- (1,0) [0|100] "deg C" Vector__XXX
 SG_ FS_HSMU_DEMO20_92 : 3583|8@0+ (1,0) [0|0] "" Vector__XXX
 SG_ IOM_DEMO_VFG_OIL_TEMP20_A_122 : 3687|32@0- (1,0) [0|100] "deg C" Vector__XXX
 SG_ FS_HSMU_DEMO20_93 : 3719|8@0+ (1,0) [0|0] "" Vector__XXX
 SG_ IOM_DEMO_VFG_OIL_TEMP20_A_123 : 3751|32@0- (1,0) [0|100] "deg C" Vector__XXX
 SG_ FS_HSMU_DEMO20_94 : 3727|8@0+ (1,0) [0|0] "" Vector__XXX
 SG_ IOM_DEMO_VFG_OIL_TEMP20_A_124 : 3783|32@0- (1,0) [0|100] "deg C" Vector__XXX
 SG_ FS_HSMU_DEMO20_95 : 3735|8@0+ (1,0) [0|0] "" Vector__XXX
 SG_ IOM_DEMO_VFG_OIL_TEMP20_A_125 : 3815|32@0- (1,0) [0|100] "deg C" Vector__XXX
 SG_ FS_HSMU_DEMO20_96 : 3743|8@0+ (1,0) [0|0] "" Vector__XXX
 SG_ IOM_DEMO_VFG_OIL_TEMP20_A_126 : 3847|32@0- (1,0) [0|100] "deg C" Vector__XXX
 SG_ FS_HSMU_DEMO20_97 : 3879|8@0+ (1,0) [0|0] "" Vector__XXX
 SG_ IOM_DEMO_VFG_OIL_TEMP20_A_127 : 3911|32@0- (1,0) [0|100] "deg C" Vector__XXX
 SG_ FS_HSMU_DEMO20_98 : 3887|8@0+ (1,0) [0|0] "" Vector__XXX
 SG_ IOM_DEMO_VFG_OIL_TEMP20_A_128 : 3943|32@0- (1,0) [0|100] "deg C" Vector__XXX
 SG_ FS_HSMU_DEMO20_99 : 3895|8@0+ (1,0) [0|0] "" Vector__XXX
 SG_ IOM_DEMO_VFG_OIL_TEMP20_A_129 : 3975|32@0- (1,0) [0|100] "deg C" Vector__XXX
 SG_ FS_HSMU_DEMO20_100 : 3903|8@0+ (1,0) [0|0] "" Vector__XXX
 SG_ IOM_DEMO_VFG_OIL_TEMP20_A_130 : 4007|32@0- (1,0) [0|100] "deg C" Vector__XXX

BO_ 437332851 DEMOMSG_ALLTYPES: 696 IOM_APP2
 SG_ FS_FDS_1_HSMU_DEMO_ALLTYPES : 39|8@0+ (1,0) [0|0] "" Vector__XXX
 SG_ VFG_OIL_TEMP_A_34 : 71|32@0- (1,0) [-30|255] "deg C" Vector__XXX
 SG_ FS_FDS_2_HSMU_DEMO_ALLTYPES : 47|8@0+ (1,0) [0|0] "" Vector__XXX
 SG_ VFG_OIL_TEMP_AB_32 : 103|32@0- (1,0) [0|84] "l" Vector__XXX
 SG_ FS_FDS_3_HSMU_DEMO_ALLTYPES : 55|8@0+ (1,0) [0|0] "" Vector__XXX
 SG_ VFG_OIL_TEMP_A_ON : 158|1@0+ (1,0) [0|1] "" Vector__XXX
 SG_ FS_FDS_4_HSMU_DEMO_ALLTYPES : 63|8@0+ (1,0) [0|0] "" Vector__XXX
 SG_ FLIGHT_GROUND_COND_3 : 167|32@0+ (1,0) [0|0] "" Vector__XXX
 SG_ FS_FDS_5_HSMU_DEMO_ALLTYPES : 207|8@0+ (1,0) [0|0] "" Vector__XXX
 SG_ DEMO_STRING14_CITY : 231|88@0+ (1,0) [0|0] "" Vector__XXX
 SG_ DEMO_OPAQUE14_IDENT : 327|32@0+ (1,0) [0|0] "" Vector__XXX

BO_ 437267314 DEMOMSG_INT3: 696 IOM_APP1
 SG_ FS_FDS_1_HSMU_DEMO_INT3 : 39|8@0+ (1,0) [0|0] "" Vector__XXX
 SG_ IOM_DEMO_VFG_OIL_TEMP_A_31 : 71|32@0- (1,0) [-30|255] "deg C" Vector__XXX
 SG_ FS_FDS_2_HSMU_DEMO_INT3 : 47|8@0+ (1,0) [0|0] "" Vector__XXX
 SG_ IOM_DEMO_VFG_OIL_TEMP_A_32 : 103|32@0- (1,0) [0|100] "deg C" Vector__XXX
 SG_ FS_FDS_3_HSMU_DEMO_INT3 : 55|8@0+ (1,0) [0|0] "" Vector__XXX
 SG_ IOM_DEMO_VFG_OIL_TEMP_A_33 : 135|32@0- (1,0) [20|50] "deg C" Vector__XXX

BO_ 437201777 DEMOMSG_INT2: 696 IOM_APP2
 SG_ FS_FDS_1_HSMU_DEMO_INT2 : 47|8@0+ (1,0) [0|0] "" Vector__XXX
 SG_ IOM_DEMO_VFG_OIL_TEMP_A_2_21 : 71|32@0- (1,0) [-30|255] "deg C"  IOM_APP1
 SG_ IOM_DEMO_VFG_OIL_TEMP_A_2_22 : 103|32@0- (1,0) [-30|255] "deg C"  IOM_APP1

BO_ 437136240 DEMOMSG_INT1: 696 IOM_APP1
 SG_ FS_FDS_1_HSMU_DEMO_INT1 : 39|8@0+ (1,0) [0|0] "" Vector__XXX
 SG_ IOM_DEMO_VFG_OIL_TEMP_A_2_1 : 71|32@0- (1,0) [-30|255] "deg C"  IOM_APP2

BO_ 437070703 DEMOMSG_FLOAT8: 696 IOM_APP1
 SG_ FS_FDS_1_HSMU_DEMO10_FLOAT : 39|8@0+ (1,0) [0|0] "" Vector__XXX
 SG_ IOM_DEMO_SYS_PRESS_2_YY_10 : 71|32@0- (1,0) [0|4000] "psi" Vector__XXX

BO_ 437005166 DEMOMSG_FLOAT7: 696 IOM_APP1
 SG_ FS_FDS_1_HSMU_DEMO9_FLOAT : 39|8@0+ (1,0) [0|0] "" Vector__XXX
 SG_ IOM_DEMO_SYS_PRESS_2_YY_9 : 71|32@0- (1,0) [0|4000] "psi" Vector__XXX

BO_ 436939629 DEMOMSG_FLOAT6: 696 IOM_APP1
 SG_ FS_FDS_1_HSMU_DEMO8_FLOAT : 39|8@0+ (1,0) [0|0] "" Vector__XXX
 SG_ IOM_DEMO_SYS_PRESS_2_YY_8 : 71|32@0- (1,0) [0|4000] "psi" Vector__XXX

BO_ 436874092 DEMOMSG_FLOAT5: 696 IOM_APP1
 SG_ FS_FDS_1_HSMU_DEMO7_FLOAT : 199|8@0+ (1,0) [0|0] "" Vector__XXX
 SG_ IOM_DEMO_SYS_PRESS_2_YY_71 : 71|32@0- (1,0) [0|4000] "psi" Vector__XXX
 SG_ IOM_DEMO_SYS_PRESS_2_YY_72 : 103|32@0- (1,0) [0|40] "psi" Vector__XXX
 SG_ IOM_DEMO_SYS_PRESS_2_YY_73 : 135|32@0- (1,0) [0|400] "psi" Vector__XXX
 SG_ IOM_DEMO_SYS_PRESS_2_YY_74 : 167|32@0- (1,0) [0|4] "psi" Vector__XXX
 SG_ IOM_DEMO_SYS_PRESS_2_YY_75 : 231|32@0- (1,0) [0|10] "psi" Vector__XXX

BO_ 436808555 DEMOMSG_FLOAT4: 696 IOM_APP1
 SG_ FS_FDS_1_HSMU_DEMO6_FLOAT : 63|8@0+ (1,0) [0|0] "" Vector__XXX
 SG_ IOM_DEMO_SYS_PRESS_2_YY_61 : 71|32@0- (1,0) [0|40] "psi" Vector__XXX
 SG_ IOM_DEMO_SYS_PRESS_2_YY_62 : 103|32@0- (1,0) [0|400] "psi" Vector__XXX
 SG_ IOM_DEMO_SYS_PRESS_2_YY_63 : 135|32@0- (1,0) [0|4000] "psi" Vector__XXX
 SG_ IOM_DEMO_SYS_PRESS_2_YY_64 : 167|32@0- (1,0) [0|4] "psi" Vector__XXX

BO_ 436743018 DEMOMSG_FLOAT3: 696 IOM_APP1
 SG_ FS_FDS_1_HSMU_DEMO5_FLOAT : 55|8@0+ (1,0) [0|0] "" Vector__XXX
 SG_ IOM_DEMO_SYS_PRESS_2_YY_51 : 71|32@0- (1,0) [0|4000] "psi" Vector__XXX
 SG_ IOM_DEMO_SYS_PRESS_2_YY_52 : 103|32@0- (1,0) [0|40] "psi" Vector__XXX
 SG_ IOM_DEMO_SYS_PRESS_2_YY_5 : 135|32@0- (1,0) [0|4000] "psi" Vector__XXX

BO_ 436677481 DEMOMSG_FLOAT2: 696 IOM_APP1
 SG_ FS_FDS_1_HSMU_DEMO4_FLOAT : 47|8@0+ (1,0) [0|0] "" Vector__XXX
 SG_ IOM_DEMO_SYS_PRESS_2_YY_41 : 71|32@0- (1,0) [0|4000] "psi" Vector__XXX
 SG_ IOM_DEMO_SYS_PRESS_2_YY_42 : 103|32@0- (1,0) [0|40] "psi" Vector__XXX

BO_ 436611944 DEMOMSG_FLOAT1: 696 IOM_APP1
 SG_ FS_FDS_1_HSMU_DEMO3_FLOAT : 39|8@0+ (1,0) [0|0] "" Vector__XXX
 SG_ IOM_DEMO_SYS_PRESS_2_YY_31 : 71|32@0- (1,0) [0|4000] "psi" Vector__XXX

BO_ 436546407 DEMOSEG_MSG_2: 96 IOM_APP1
 SG_ FS_FDS_1_HSMU_DEMO1_FLOAT : 39|8@0+ (1,0) [0|0] "" Vector__XXX
 SG_ IOM_DEMO_SYS_PRESS_2_YY_3 : 71|32@0- (1,0) [0|4000] "psi" Vector__XXX
 SG_ FS_FDS_2_HSMU_DEMO1_FLOAT : 47|8@0+ (1,0) [0|0] "" Vector__XXX
 SG_ IOM_DEMO_RSVR_LEVEL_YY_3 : 103|32@0- (1,0) [0|84] "l" Vector__XXX
 SG_ FS_FDS_3_HSMU_DEMO1_FLOAT : 55|8@0+ (1,0) [0|0] "" Vector__XXX
 SG_ IOM_DEMO_RSVR_MOVABLE_INDEX_YY_3 : 135|32@0- (1,0) [0|84] "l" Vector__XXX
 SG_ FS_FDS_4_HSMU_DEMO1_FLOAT : 63|8@0+ (1,0) [0|0] "" Vector__XXX
 SG_ IOM_DEMO_NORMAL_BRAKE_PRESSURE_W : 167|32@0- (1,0) [0|3300] "psi" Vector__XXX
 SG_ FS_FDS_5_HSMU_DEMO1_FLOAT : 199|8@0+ (1,0) [0|0] "" Vector__XXX
 SG_ IOM_DEMO_NORMAL_BRAKE_PRESS_0000 : 231|32@0- (1,0) [0|33300] "psi" Vector__XXX
 SG_ FS_FDS_6_HSMU_DEMO1_FLOAT : 207|8@0+ (1,0) [0|0] "" Vector__XXX
 SG_ IOM_DEMO_ACCU_PRESSURE_SGX_1_3 : 263|32@0- (1,0) [0|444] "psi" Vector__XXX

BO_ 436480870 DEMOFLOAT_MSG_1: 96 IOM_APP1
 SG_ FS_FDS_1_HSMU_DEMO1_FLOAT : 39|8@0+ (1,0) [0|0] "" Vector__XXX
 SG_ IOM_DEMO_SYS_PRESS_2_YY_3 : 71|32@0- (1,0) [0|4000] "psi" Vector__XXX
 SG_ FS_FDS_2_HSMU_DEMO1_FLOAT : 47|8@0+ (1,0) [0|0] "" Vector__XXX
 SG_ IOM_DEMO_RSVR_LEVEL_YY_3 : 103|32@0- (1,0) [0|84] "l" Vector__XXX
 SG_ FS_FDS_3_HSMU_DEMO1_FLOAT : 55|8@0+ (1,0) [0|0] "" Vector__XXX
 SG_ IOM_DEMO_RSVR_MOVABLE_INDEX_YY_3 : 135|32@0- (1,0) [0|84] "l" Vector__XXX
 SG_ FS_FDS_4_HSMU_DEMO1_FLOAT : 63|8@0+ (1,0) [0|0] "" Vector__XXX
 SG_ IOM_DEMO_NORMAL_BRAKE_PRESS_0001 : 167|32@0- (1,0) [0|3300] "psi" Vector__XXX
 SG_ FS_FDS_5_HSMU_DEMO1_FLOAT : 199|8@0+ (1,0) [0|0] "" Vector__XXX
 SG_ IOM_DEMO_NORMAL_BRAKE_PRESS_0002 : 231|32@0- (1,0) [0|33300] "psi" Vector__XXX
 SG_ FS_FDS_6_HSMU_DEMO1_FLOAT : 207|8@0+ (1,0) [0|0] "" Vector__XXX
 SG_ IOM_DEMO_ACCU_PRESSURE_SGX_1_3 : 263|32@0- (1,0) [0|444] "psi" Vector__XXX

BA_DEF_ SG_  "AfdxFSaddr" INT 4 8192;
BA_DEF_ SG_  "AfdxFDSaddr" INT 0 8192;
BA_DEF_ SG_  "AfdxFDSlength" INT 0 8192;
BA_DEF_ SG_  "AfdxFDSname" STRING ;
BA_DEF_ SG_  "AfdxSignalType" ENUM  "Boolean","Enumerate","Float","Integer","Opaque","String","Status";
BA_DEF_ BO_  "AfdxTxPortId" INT 1 65535;
BA_DEF_ BO_  "AfdxPortMasterName" STRING ;
BA_DEF_ BO_  "AfdxMsgRefreshDef" INT 0 0;
BA_DEF_ BO_  "AfdxMsgTxRate" INT 0 0;
BA_DEF_ BO_  "AfdxVLbufSize" INT 1 8192;
BA_DEF_ BO_  "AfdxVLdestUDP" INT 0 65535;
BA_DEF_ BO_  "AfdxVLsrcUDP" INT 0 65535;
BA_DEF_ BO_  "AfdxVLdestIP" STRING ;
BA_DEF_ BO_  "AfdxVLsrcIP" STRING ;
BA_DEF_ BO_  "AfdxVLipFrag" ENUM  "True","False";
BA_DEF_ BO_  "AfdxVLportChar" ENUM  "Unknown","SAP","Sampling","Queuing";
BA_DEF_ BO_  "AfdxVLportType" ENUM  "Unknown","SAP","AFDX Communication Port";
BA_DEF_ BO_  "AfdxVLsubVLId" INT 0 4;
BA_DEF_ BO_  "AfdxVLsubVL" INT 0 4;
BA_DEF_ BO_  "AfdxVLskewMax" INT 0 65535;
BA_DEF_ BO_  "AfdxVLintCheck" ENUM  "True","False";
BA_DEF_ BO_  "AfdxVLrma" STRING ;
BA_DEF_ BO_  "AfdxVLmaxFrame" INT 17 1471;
BA_DEF_ BO_  "AfdxVLbag" INT 1 128;
BA_DEF_ BO_  "AfdxVLnetSel" ENUM  "NETWORK_NONE","NETWORK_A","NETWORK_B","NETWORK_AB";
BA_DEF_ BO_  "AfdxVLname" STRING ;
BA_DEF_ BO_  "AfdxVLid" INT 1 65535;
BA_DEF_ BO_  "AfdxVLportSpeed" INT 10 100;
BA_DEF_ SG_  "SignalTypeExt" ENUM  "No","StringType","ByteArray";
BA_DEF_ SG_  "SystemSignalLongSymbol" STRING ;
BA_DEF_DEF_  "AfdxFSaddr" 4;
BA_DEF_DEF_  "AfdxFDSaddr" 0;
BA_DEF_DEF_  "AfdxFDSlength" 0;
BA_DEF_DEF_  "AfdxFDSname" "";
BA_DEF_DEF_  "AfdxSignalType" "Boolean";
BA_DEF_DEF_  "AfdxTxPortId" 1;
BA_DEF_DEF_  "AfdxPortMasterName" "";
BA_DEF_DEF_  "AfdxMsgRefreshDef" 0;
BA_DEF_DEF_  "AfdxMsgTxRate" 0;
BA_DEF_DEF_  "AfdxVLbufSize" 1;
BA_DEF_DEF_  "AfdxVLdestUDP" 0;
BA_DEF_DEF_  "AfdxVLsrcUDP" 0;
BA_DEF_DEF_  "AfdxVLdestIP" "0:0:0:0";
BA_DEF_DEF_  "AfdxVLsrcIP" "0:0:0:0";
BA_DEF_DEF_  "AfdxVLipFrag" "True";
BA_DEF_DEF_  "AfdxVLportChar" "Sampling";
BA_DEF_DEF_  "AfdxVLportType" "AFDX Communication Port";
BA_DEF_DEF_  "AfdxVLsubVLId" 0;
BA_DEF_DEF_  "AfdxVLsubVL" 0;
BA_DEF_DEF_  "AfdxVLskewMax" 0;
BA_DEF_DEF_  "AfdxVLintCheck" "True";
BA_DEF_DEF_  "AfdxVLrma" "";
BA_DEF_DEF_  "AfdxVLmaxFrame" 17;
BA_DEF_DEF_  "AfdxVLbag" 1;
BA_DEF_DEF_  "AfdxVLnetSel" "NETWORK_AB";
BA_DEF_DEF_  "AfdxVLname" "";
BA_DEF_DEF_  "AfdxVLid" 1;
BA_DEF_DEF_  "AfdxVLportSpeed" 10;
BA_DEF_DEF_  "SignalTypeExt" "No";
BA_DEF_DEF_  "SystemSignalLongSymbol" "";
BA_ "AfdxTxPortId" BO_ 437791610 11130;
BA_ "AfdxPortMasterName" BO_ 437791610 "DEMO20_AFDX_PORT_16";
BA_ "AfdxMsgTxRate" BO_ 437791610 1;
BA_ "AfdxVLbufSize" BO_ 437791610 1400;
BA_ "AfdxVLdestUDP" BO_ 437791610 11130;
BA_ "AfdxVLsrcUDP" BO_ 437791610 11130;
BA_ "AfdxVLdestIP" BO_ 437791610 "224.224.26.24";
BA_ "AfdxVLsrcIP" BO_ 437791610 "10.2.38.0";
BA_ "AfdxVLportChar" BO_ 437791610 3;
BA_ "AfdxVLsubVLId" BO_ 437791610 1;
BA_ "AfdxVLsubVL" BO_ 437791610 1;
BA_ "AfdxVLintCheck" BO_ 437791610 1;
BA_ "AfdxVLmaxFrame" BO_ 437791610 100;
BA_ "AfdxVLname" BO_ 437791610 "VL_DEMO20";
BA_ "AfdxVLid" BO_ 437791610 6680;
BA_ "AfdxVLportSpeed" BO_ 437791610 100;
BA_ "AfdxTxPortId" BO_ 437332851 11123;
BA_ "AfdxPortMasterName" BO_ 437332851 "DEMO14_AFDX_PORT_14";
BA_ "AfdxMsgTxRate" BO_ 437332851 1;
BA_ "AfdxVLbufSize" BO_ 437332851 800;
BA_ "AfdxVLdestUDP" BO_ 437332851 11123;
BA_ "AfdxVLsrcUDP" BO_ 437332851 11123;
BA_ "AfdxVLdestIP" BO_ 437332851 "224.224.26.17";
BA_ "AfdxVLsrcIP" BO_ 437332851 "10.2.38.1";
BA_ "AfdxVLportChar" BO_ 437332851 3;
BA_ "AfdxVLsubVLId" BO_ 437332851 1;
BA_ "AfdxVLsubVL" BO_ 437332851 1;
BA_ "AfdxVLintCheck" BO_ 437332851 1;
BA_ "AfdxVLmaxFrame" BO_ 437332851 800;
BA_ "AfdxVLname" BO_ 437332851 "VL_DEMO14";
BA_ "AfdxVLid" BO_ 437332851 6673;
BA_ "AfdxVLportSpeed" BO_ 437332851 100;
BA_ "AfdxVLbag" BO_ 437267314 64;
BA_ "AfdxTxPortId" BO_ 437267314 11122;
BA_ "AfdxPortMasterName" BO_ 437267314 "DEMO13_AFDX_PORT_13";
BA_ "AfdxMsgTxRate" BO_ 437267314 128;
BA_ "AfdxVLbufSize" BO_ 437267314 800;
BA_ "AfdxVLdestUDP" BO_ 437267314 11122;
BA_ "AfdxVLsrcUDP" BO_ 437267314 11122;
BA_ "AfdxVLdestIP" BO_ 437267314 "224.224.26.16";
BA_ "AfdxVLsrcIP" BO_ 437267314 "10.2.38.0";
BA_ "AfdxVLportChar" BO_ 437267314 3;
BA_ "AfdxVLsubVLId" BO_ 437267314 1;
BA_ "AfdxVLsubVL" BO_ 437267314 1;
BA_ "AfdxVLintCheck" BO_ 437267314 1;
BA_ "AfdxVLmaxFrame" BO_ 437267314 800;
BA_ "AfdxVLname" BO_ 437267314 "VL_DEMO13";
BA_ "AfdxVLid" BO_ 437267314 6672;
BA_ "AfdxVLportSpeed" BO_ 437267314 100;
BA_ "AfdxTxPortId" BO_ 437201777 11121;
BA_ "AfdxPortMasterName" BO_ 437201777 "DEMO12_AFDX_PORT_12";
BA_ "AfdxMsgTxRate" BO_ 437201777 80;
BA_ "AfdxVLbufSize" BO_ 437201777 800;
BA_ "AfdxVLdestUDP" BO_ 437201777 11121;
BA_ "AfdxVLsrcUDP" BO_ 437201777 11121;
BA_ "AfdxVLdestIP" BO_ 437201777 "224.224.26.15";
BA_ "AfdxVLsrcIP" BO_ 437201777 "10.2.38.1";
BA_ "AfdxVLportChar" BO_ 437201777 3;
BA_ "AfdxVLsubVLId" BO_ 437201777 1;
BA_ "AfdxVLsubVL" BO_ 437201777 1;
BA_ "AfdxVLskewMax" BO_ 437201777 65500;
BA_ "AfdxVLrma" BO_ 437201777 "Active";
BA_ "AfdxVLmaxFrame" BO_ 437201777 800;
BA_ "AfdxVLname" BO_ 437201777 "VL_DEMO12";
BA_ "AfdxVLid" BO_ 437201777 6671;
BA_ "AfdxVLportSpeed" BO_ 437201777 100;
BA_ "AfdxTxPortId" BO_ 437136240 11120;
BA_ "AfdxPortMasterName" BO_ 437136240 "DEMO11_AFDX_PORT_11";
BA_ "AfdxMsgTxRate" BO_ 437136240 80;
BA_ "AfdxVLbufSize" BO_ 437136240 800;
BA_ "AfdxVLdestUDP" BO_ 437136240 11120;
BA_ "AfdxVLsrcUDP" BO_ 437136240 11120;
BA_ "AfdxVLdestIP" BO_ 437136240 "224.224.26.14";
BA_ "AfdxVLsrcIP" BO_ 437136240 "10.2.38.0";
BA_ "AfdxVLportChar" BO_ 437136240 3;
BA_ "AfdxVLsubVLId" BO_ 437136240 1;
BA_ "AfdxVLsubVL" BO_ 437136240 1;
BA_ "AfdxVLskewMax" BO_ 437136240 65500;
BA_ "AfdxVLrma" BO_ 437136240 "Active";
BA_ "AfdxVLmaxFrame" BO_ 437136240 800;
BA_ "AfdxVLname" BO_ 437136240 "VL_DEMO11";
BA_ "AfdxVLid" BO_ 437136240 6670;
BA_ "AfdxVLportSpeed" BO_ 437136240 100;
BA_ "AfdxTxPortId" BO_ 437070703 11119;
BA_ "AfdxPortMasterName" BO_ 437070703 "DEMO10_AFDX_PORT_10";
BA_ "AfdxMsgTxRate" BO_ 437070703 80;
BA_ "AfdxVLbufSize" BO_ 437070703 800;
BA_ "AfdxVLdestUDP" BO_ 437070703 11119;
BA_ "AfdxVLsrcUDP" BO_ 437070703 11119;
BA_ "AfdxVLdestIP" BO_ 437070703 "224.224.26.13";
BA_ "AfdxVLsrcIP" BO_ 437070703 "10.2.38.0";
BA_ "AfdxVLportChar" BO_ 437070703 3;
BA_ "AfdxVLsubVLId" BO_ 437070703 1;
BA_ "AfdxVLsubVL" BO_ 437070703 1;
BA_ "AfdxVLintCheck" BO_ 437070703 1;
BA_ "AfdxVLmaxFrame" BO_ 437070703 800;
BA_ "AfdxVLname" BO_ 437070703 "VL_DEMO10";
BA_ "AfdxVLid" BO_ 437070703 6669;
BA_ "AfdxVLportSpeed" BO_ 437070703 100;
BA_ "AfdxTxPortId" BO_ 437005166 11118;
BA_ "AfdxPortMasterName" BO_ 437005166 "DEMO9_AFDX_PORT_9";
BA_ "AfdxMsgTxRate" BO_ 437005166 80;
BA_ "AfdxVLbufSize" BO_ 437005166 800;
BA_ "AfdxVLdestUDP" BO_ 437005166 11118;
BA_ "AfdxVLsrcUDP" BO_ 437005166 11118;
BA_ "AfdxVLdestIP" BO_ 437005166 "224.224.26.12";
BA_ "AfdxVLsrcIP" BO_ 437005166 "10.2.38.0";
BA_ "AfdxVLportChar" BO_ 437005166 3;
BA_ "AfdxVLsubVLId" BO_ 437005166 1;
BA_ "AfdxVLsubVL" BO_ 437005166 1;
BA_ "AfdxVLintCheck" BO_ 437005166 1;
BA_ "AfdxVLmaxFrame" BO_ 437005166 800;
BA_ "AfdxVLname" BO_ 437005166 "VL_DEMO9";
BA_ "AfdxVLid" BO_ 437005166 6668;
BA_ "AfdxVLportSpeed" BO_ 437005166 100;
BA_ "AfdxTxPortId" BO_ 436939629 11117;
BA_ "AfdxPortMasterName" BO_ 436939629 "DEMO8_AFDX_PORT_8";
BA_ "AfdxMsgTxRate" BO_ 436939629 80;
BA_ "AfdxVLbufSize" BO_ 436939629 800;
BA_ "AfdxVLdestUDP" BO_ 436939629 11117;
BA_ "AfdxVLsrcUDP" BO_ 436939629 11117;
BA_ "AfdxVLdestIP" BO_ 436939629 "224.224.26.11";
BA_ "AfdxVLsrcIP" BO_ 436939629 "10.2.38.0";
BA_ "AfdxVLportChar" BO_ 436939629 3;
BA_ "AfdxVLsubVLId" BO_ 436939629 1;
BA_ "AfdxVLsubVL" BO_ 436939629 1;
BA_ "AfdxVLintCheck" BO_ 436939629 1;
BA_ "AfdxVLmaxFrame" BO_ 436939629 800;
BA_ "AfdxVLname" BO_ 436939629 "VL_DEMO8";
BA_ "AfdxVLid" BO_ 436939629 6667;
BA_ "AfdxVLportSpeed" BO_ 436939629 100;
BA_ "AfdxTxPortId" BO_ 436874092 11116;
BA_ "AfdxPortMasterName" BO_ 436874092 "DEMO7_AFDX_PORT_7";
BA_ "AfdxMsgTxRate" BO_ 436874092 80;
BA_ "AfdxVLbufSize" BO_ 436874092 800;
BA_ "AfdxVLdestUDP" BO_ 436874092 11116;
BA_ "AfdxVLsrcUDP" BO_ 436874092 11116;
BA_ "AfdxVLdestIP" BO_ 436874092 "224.224.26.10";
BA_ "AfdxVLsrcIP" BO_ 436874092 "10.2.38.0";
BA_ "AfdxVLportChar" BO_ 436874092 3;
BA_ "AfdxVLsubVLId" BO_ 436874092 1;
BA_ "AfdxVLsubVL" BO_ 436874092 1;
BA_ "AfdxVLintCheck" BO_ 436874092 1;
BA_ "AfdxVLmaxFrame" BO_ 436874092 800;
BA_ "AfdxVLname" BO_ 436874092 "VL_DEMO7";
BA_ "AfdxVLid" BO_ 436874092 6666;
BA_ "AfdxVLportSpeed" BO_ 436874092 100;
BA_ "AfdxTxPortId" BO_ 436808555 11115;
BA_ "AfdxPortMasterName" BO_ 436808555 "DEMO6_AFDX_PORT_6";
BA_ "AfdxMsgTxRate" BO_ 436808555 80;
BA_ "AfdxVLbufSize" BO_ 436808555 800;
BA_ "AfdxVLdestUDP" BO_ 436808555 11115;
BA_ "AfdxVLsrcUDP" BO_ 436808555 11115;
BA_ "AfdxVLdestIP" BO_ 436808555 "224.224.26.9";
BA_ "AfdxVLsrcIP" BO_ 436808555 "10.2.38.0";
BA_ "AfdxVLportChar" BO_ 436808555 3;
BA_ "AfdxVLsubVLId" BO_ 436808555 1;
BA_ "AfdxVLsubVL" BO_ 436808555 1;
BA_ "AfdxVLintCheck" BO_ 436808555 1;
BA_ "AfdxVLmaxFrame" BO_ 436808555 800;
BA_ "AfdxVLname" BO_ 436808555 "VL_DEMO6";
BA_ "AfdxVLid" BO_ 436808555 6665;
BA_ "AfdxVLportSpeed" BO_ 436808555 100;
BA_ "AfdxTxPortId" BO_ 436743018 11114;
BA_ "AfdxPortMasterName" BO_ 436743018 "DEMO5_AFDX_PORT_5";
BA_ "AfdxMsgTxRate" BO_ 436743018 80;
BA_ "AfdxVLbufSize" BO_ 436743018 800;
BA_ "AfdxVLdestUDP" BO_ 436743018 11114;
BA_ "AfdxVLsrcUDP" BO_ 436743018 11114;
BA_ "AfdxVLdestIP" BO_ 436743018 "224.224.26.8";
BA_ "AfdxVLsrcIP" BO_ 436743018 "10.2.38.0";
BA_ "AfdxVLportChar" BO_ 436743018 3;
BA_ "AfdxVLsubVLId" BO_ 436743018 1;
BA_ "AfdxVLsubVL" BO_ 436743018 1;
BA_ "AfdxVLintCheck" BO_ 436743018 1;
BA_ "AfdxVLmaxFrame" BO_ 436743018 800;
BA_ "AfdxVLname" BO_ 436743018 "VL_DEMO5";
BA_ "AfdxVLid" BO_ 436743018 6664;
BA_ "AfdxVLportSpeed" BO_ 436743018 100;
BA_ "AfdxTxPortId" BO_ 436677481 11113;
BA_ "AfdxPortMasterName" BO_ 436677481 "DEMO4_AFDX_PORT_4";
BA_ "AfdxMsgTxRate" BO_ 436677481 80;
BA_ "AfdxVLbufSize" BO_ 436677481 800;
BA_ "AfdxVLdestUDP" BO_ 436677481 11113;
BA_ "AfdxVLsrcUDP" BO_ 436677481 11113;
BA_ "AfdxVLdestIP" BO_ 436677481 "224.224.26.7";
BA_ "AfdxVLsrcIP" BO_ 436677481 "10.2.38.0";
BA_ "AfdxVLportChar" BO_ 436677481 3;
BA_ "AfdxVLsubVLId" BO_ 436677481 1;
BA_ "AfdxVLsubVL" BO_ 436677481 1;
BA_ "AfdxVLintCheck" BO_ 436677481 1;
BA_ "AfdxVLmaxFrame" BO_ 436677481 800;
BA_ "AfdxVLname" BO_ 436677481 "VL_DEMO4";
BA_ "AfdxVLid" BO_ 436677481 6663;
BA_ "AfdxVLportSpeed" BO_ 436677481 100;
BA_ "AfdxTxPortId" BO_ 436611944 11112;
BA_ "AfdxPortMasterName" BO_ 436611944 "DEMO3_AFDX_PORT_3";
BA_ "AfdxMsgTxRate" BO_ 436611944 80;
BA_ "AfdxVLbufSize" BO_ 436611944 800;
BA_ "AfdxVLdestUDP" BO_ 436611944 11112;
BA_ "AfdxVLsrcUDP" BO_ 436611944 11112;
BA_ "AfdxVLdestIP" BO_ 436611944 "224.224.26.6";
BA_ "AfdxVLsrcIP" BO_ 436611944 "10.2.38.0";
BA_ "AfdxVLportChar" BO_ 436611944 3;
BA_ "AfdxVLsubVLId" BO_ 436611944 1;
BA_ "AfdxVLsubVL" BO_ 436611944 1;
BA_ "AfdxVLintCheck" BO_ 436611944 1;
BA_ "AfdxVLmaxFrame" BO_ 436611944 800;
BA_ "AfdxVLname" BO_ 436611944 "VL_DEMO3";
BA_ "AfdxVLid" BO_ 436611944 6662;
BA_ "AfdxVLportSpeed" BO_ 436611944 100;
BA_ "AfdxTxPortId" BO_ 436546407 11111;
BA_ "AfdxPortMasterName" BO_ 436546407 "DEMO1_AFDX_PORT_2";
BA_ "AfdxMsgTxRate" BO_ 436546407 320;
BA_ "AfdxVLbufSize" BO_ 436546407 120;
BA_ "AfdxVLdestUDP" BO_ 436546407 11111;
BA_ "AfdxVLsrcUDP" BO_ 436546407 11111;
BA_ "AfdxVLdestIP" BO_ 436546407 "224.224.26.5";
BA_ "AfdxVLsrcIP" BO_ 436546407 "10.2.38.0";
BA_ "AfdxVLportChar" BO_ 436546407 3;
BA_ "AfdxVLsubVLId" BO_ 436546407 1;
BA_ "AfdxVLsubVL" BO_ 436546407 1;
BA_ "AfdxVLintCheck" BO_ 436546407 1;
BA_ "AfdxVLmaxFrame" BO_ 436546407 48;
BA_ "AfdxVLbag" BO_ 436546407 64;
BA_ "AfdxVLname" BO_ 436546407 "VL_DEMO2SEG";
BA_ "AfdxVLid" BO_ 436546407 6661;
BA_ "AfdxVLportSpeed" BO_ 436546407 100;
BA_ "AfdxTxPortId" BO_ 436480870 11110;
BA_ "AfdxPortMasterName" BO_ 436480870 "DEMO1_AFDX_PORT_1";
BA_ "AfdxMsgTxRate" BO_ 436480870 320;
BA_ "AfdxVLbufSize" BO_ 436480870 120;
BA_ "AfdxVLdestUDP" BO_ 436480870 11110;
BA_ "AfdxVLsrcUDP" BO_ 436480870 11110;
BA_ "AfdxVLdestIP" BO_ 436480870 "224.224.26.4";
BA_ "AfdxVLsrcIP" BO_ 436480870 "10.2.38.0";
BA_ "AfdxVLipFrag" BO_ 436480870 1;
BA_ "AfdxVLsubVLId" BO_ 436480870 1;
BA_ "AfdxVLsubVL" BO_ 436480870 1;
BA_ "AfdxVLintCheck" BO_ 436480870 1;
BA_ "AfdxVLmaxFrame" BO_ 436480870 96;
BA_ "AfdxVLbag" BO_ 436480870 64;
BA_ "AfdxVLname" BO_ 436480870 "VL_DEMO1";
BA_ "AfdxVLid" BO_ 436480870 6660;
BA_ "AfdxVLportSpeed" BO_ 436480870 100;
BA_ "AfdxFDSaddr" SG_ 437791610 FS_HSMU_DEMO20_1 8;
BA_ "AfdxFDSlength" SG_ 437791610 FS_HSMU_DEMO20_1 4;
BA_ "AfdxFDSname" SG_ 437791610 FS_HSMU_DEMO20_1 "FDS_HSMU_DEMO20_1";
BA_ "AfdxSignalType" SG_ 437791610 FS_HSMU_DEMO20_1 6;
BA_ "AfdxFDSaddr" SG_ 437791610 IOM_DEMO_VFG_OIL_TEMP20_A_31 8;
BA_ "AfdxFDSlength" SG_ 437791610 IOM_DEMO_VFG_OIL_TEMP20_A_31 4;
BA_ "AfdxFDSname" SG_ 437791610 IOM_DEMO_VFG_OIL_TEMP20_A_31 "FDS_HSMU_DEMO20_1";
BA_ "AfdxSignalType" SG_ 437791610 IOM_DEMO_VFG_OIL_TEMP20_A_31 3;
BA_ "AfdxFSaddr" SG_ 437791610 FS_HSMU_DEMO20_2 5;
BA_ "AfdxFDSaddr" SG_ 437791610 FS_HSMU_DEMO20_2 12;
BA_ "AfdxFDSlength" SG_ 437791610 FS_HSMU_DEMO20_2 4;
BA_ "AfdxFDSname" SG_ 437791610 FS_HSMU_DEMO20_2 "FDS_HSMU_DEMO20_2";
BA_ "AfdxSignalType" SG_ 437791610 FS_HSMU_DEMO20_2 6;
BA_ "AfdxFSaddr" SG_ 437791610 IOM_DEMO_VFG_OIL_TEMP20_A_32 5;
BA_ "AfdxFDSaddr" SG_ 437791610 IOM_DEMO_VFG_OIL_TEMP20_A_32 12;
BA_ "AfdxFDSlength" SG_ 437791610 IOM_DEMO_VFG_OIL_TEMP20_A_32 4;
BA_ "AfdxFDSname" SG_ 437791610 IOM_DEMO_VFG_OIL_TEMP20_A_32 "FDS_HSMU_DEMO20_2";
BA_ "AfdxSignalType" SG_ 437791610 IOM_DEMO_VFG_OIL_TEMP20_A_32 3;
BA_ "AfdxFSaddr" SG_ 437791610 FS_HSMU_DEMO20_3 6;
BA_ "AfdxFDSaddr" SG_ 437791610 FS_HSMU_DEMO20_3 16;
BA_ "AfdxFDSlength" SG_ 437791610 FS_HSMU_DEMO20_3 4;
BA_ "AfdxFDSname" SG_ 437791610 FS_HSMU_DEMO20_3 "FDS_HSMU_DEMO20_3";
BA_ "AfdxSignalType" SG_ 437791610 FS_HSMU_DEMO20_3 6;
BA_ "AfdxFSaddr" SG_ 437791610 IOM_DEMO_VFG_OIL_TEMP20_A_33 6;
BA_ "AfdxFDSaddr" SG_ 437791610 IOM_DEMO_VFG_OIL_TEMP20_A_33 16;
BA_ "AfdxFDSlength" SG_ 437791610 IOM_DEMO_VFG_OIL_TEMP20_A_33 4;
BA_ "AfdxFDSname" SG_ 437791610 IOM_DEMO_VFG_OIL_TEMP20_A_33 "FDS_HSMU_DEMO20_3";
BA_ "AfdxSignalType" SG_ 437791610 IOM_DEMO_VFG_OIL_TEMP20_A_33 3;
BA_ "AfdxFSaddr" SG_ 437791610 FS_HSMU_DEMO20_4 7;
BA_ "AfdxFDSaddr" SG_ 437791610 FS_HSMU_DEMO20_4 20;
BA_ "AfdxFDSlength" SG_ 437791610 FS_HSMU_DEMO20_4 4;
BA_ "AfdxFDSname" SG_ 437791610 FS_HSMU_DEMO20_4 "FDS_HSMU_DEMO20_4";
BA_ "AfdxSignalType" SG_ 437791610 FS_HSMU_DEMO20_4 6;
BA_ "AfdxFSaddr" SG_ 437791610 IOM_DEMO_VFG_OIL_TEMP20_A_34 7;
BA_ "AfdxFDSaddr" SG_ 437791610 IOM_DEMO_VFG_OIL_TEMP20_A_34 20;
BA_ "AfdxFDSlength" SG_ 437791610 IOM_DEMO_VFG_OIL_TEMP20_A_34 4;
BA_ "AfdxFDSname" SG_ 437791610 IOM_DEMO_VFG_OIL_TEMP20_A_34 "FDS_HSMU_DEMO20_4";
BA_ "AfdxSignalType" SG_ 437791610 IOM_DEMO_VFG_OIL_TEMP20_A_34 3;
BA_ "AfdxFSaddr" SG_ 437791610 FS_HSMU_DEMO20_5 24;
BA_ "AfdxFDSaddr" SG_ 437791610 FS_HSMU_DEMO20_5 28;
BA_ "AfdxFDSlength" SG_ 437791610 FS_HSMU_DEMO20_5 4;
BA_ "AfdxFDSname" SG_ 437791610 FS_HSMU_DEMO20_5 "FDS_HSMU_DEMO20_5";
BA_ "AfdxSignalType" SG_ 437791610 FS_HSMU_DEMO20_5 6;
BA_ "AfdxFSaddr" SG_ 437791610 IOM_DEMO_VFG_OIL_TEMP20_A_35 24;
BA_ "AfdxFDSaddr" SG_ 437791610 IOM_DEMO_VFG_OIL_TEMP20_A_35 28;
BA_ "AfdxFDSlength" SG_ 437791610 IOM_DEMO_VFG_OIL_TEMP20_A_35 4;
BA_ "AfdxFDSname" SG_ 437791610 IOM_DEMO_VFG_OIL_TEMP20_A_35 "FDS_HSMU_DEMO20_5";
BA_ "AfdxSignalType" SG_ 437791610 IOM_DEMO_VFG_OIL_TEMP20_A_35 3;
BA_ "AfdxFSaddr" SG_ 437791610 FS_HSMU_DEMO20_6 25;
BA_ "AfdxFDSaddr" SG_ 437791610 FS_HSMU_DEMO20_6 32;
BA_ "AfdxFDSlength" SG_ 437791610 FS_HSMU_DEMO20_6 4;
BA_ "AfdxFDSname" SG_ 437791610 FS_HSMU_DEMO20_6 "FDS_HSMU_DEMO20_6";
BA_ "AfdxSignalType" SG_ 437791610 FS_HSMU_DEMO20_6 6;
BA_ "AfdxFSaddr" SG_ 437791610 IOM_DEMO_VFG_OIL_TEMP20_A_36 25;
BA_ "AfdxFDSaddr" SG_ 437791610 IOM_DEMO_VFG_OIL_TEMP20_A_36 32;
BA_ "AfdxFDSlength" SG_ 437791610 IOM_DEMO_VFG_OIL_TEMP20_A_36 4;
BA_ "AfdxFDSname" SG_ 437791610 IOM_DEMO_VFG_OIL_TEMP20_A_36 "FDS_HSMU_DEMO20_6";
BA_ "AfdxSignalType" SG_ 437791610 IOM_DEMO_VFG_OIL_TEMP20_A_36 3;
BA_ "AfdxFSaddr" SG_ 437791610 FS_HSMU_DEMO20_7 26;
BA_ "AfdxFDSaddr" SG_ 437791610 FS_HSMU_DEMO20_7 36;
BA_ "AfdxFDSlength" SG_ 437791610 FS_HSMU_DEMO20_7 4;
BA_ "AfdxFDSname" SG_ 437791610 FS_HSMU_DEMO20_7 "FDS_HSMU_DEMO20_7";
BA_ "AfdxSignalType" SG_ 437791610 FS_HSMU_DEMO20_7 6;
BA_ "AfdxFSaddr" SG_ 437791610 IOM_DEMO_VFG_OIL_TEMP20_A_37 26;
BA_ "AfdxFDSaddr" SG_ 437791610 IOM_DEMO_VFG_OIL_TEMP20_A_37 36;
BA_ "AfdxFDSlength" SG_ 437791610 IOM_DEMO_VFG_OIL_TEMP20_A_37 4;
BA_ "AfdxFDSname" SG_ 437791610 IOM_DEMO_VFG_OIL_TEMP20_A_37 "FDS_HSMU_DEMO20_7";
BA_ "AfdxSignalType" SG_ 437791610 IOM_DEMO_VFG_OIL_TEMP20_A_37 3;
BA_ "AfdxFSaddr" SG_ 437791610 FS_HSMU_DEMO20_8 27;
BA_ "AfdxFDSaddr" SG_ 437791610 FS_HSMU_DEMO20_8 40;
BA_ "AfdxFDSlength" SG_ 437791610 FS_HSMU_DEMO20_8 4;
BA_ "AfdxFDSname" SG_ 437791610 FS_HSMU_DEMO20_8 "FDS_HSMU_DEMO20_8";
BA_ "AfdxSignalType" SG_ 437791610 FS_HSMU_DEMO20_8 6;
BA_ "AfdxFSaddr" SG_ 437791610 IOM_DEMO_VFG_OIL_TEMP20_A_38 27;
BA_ "AfdxFDSaddr" SG_ 437791610 IOM_DEMO_VFG_OIL_TEMP20_A_38 40;
BA_ "AfdxFDSlength" SG_ 437791610 IOM_DEMO_VFG_OIL_TEMP20_A_38 4;
BA_ "AfdxFDSname" SG_ 437791610 IOM_DEMO_VFG_OIL_TEMP20_A_38 "FDS_HSMU_DEMO20_8";
BA_ "AfdxSignalType" SG_ 437791610 IOM_DEMO_VFG_OIL_TEMP20_A_38 3;
BA_ "AfdxFSaddr" SG_ 437791610 FS_HSMU_DEMO20_9 44;
BA_ "AfdxFDSaddr" SG_ 437791610 FS_HSMU_DEMO20_9 48;
BA_ "AfdxFDSlength" SG_ 437791610 FS_HSMU_DEMO20_9 4;
BA_ "AfdxFDSname" SG_ 437791610 FS_HSMU_DEMO20_9 "FDS_HSMU_DEMO20_9";
BA_ "AfdxSignalType" SG_ 437791610 FS_HSMU_DEMO20_9 6;
BA_ "AfdxFSaddr" SG_ 437791610 IOM_DEMO_VFG_OIL_TEMP20_A_39 44;
BA_ "AfdxFDSaddr" SG_ 437791610 IOM_DEMO_VFG_OIL_TEMP20_A_39 48;
BA_ "AfdxFDSlength" SG_ 437791610 IOM_DEMO_VFG_OIL_TEMP20_A_39 4;
BA_ "AfdxFDSname" SG_ 437791610 IOM_DEMO_VFG_OIL_TEMP20_A_39 "FDS_HSMU_DEMO20_9";
BA_ "AfdxSignalType" SG_ 437791610 IOM_DEMO_VFG_OIL_TEMP20_A_39 3;
BA_ "AfdxFSaddr" SG_ 437791610 FS_HSMU_DEMO20_10 45;
BA_ "AfdxFDSaddr" SG_ 437791610 FS_HSMU_DEMO20_10 52;
BA_ "AfdxFDSlength" SG_ 437791610 FS_HSMU_DEMO20_10 4;
BA_ "AfdxFDSname" SG_ 437791610 FS_HSMU_DEMO20_10 "FDS_HSMU_DEMO20_10";
BA_ "AfdxSignalType" SG_ 437791610 FS_HSMU_DEMO20_10 6;
BA_ "AfdxFSaddr" SG_ 437791610 IOM_DEMO_VFG_OIL_TEMP20_A_40 45;
BA_ "AfdxFDSaddr" SG_ 437791610 IOM_DEMO_VFG_OIL_TEMP20_A_40 52;
BA_ "AfdxFDSlength" SG_ 437791610 IOM_DEMO_VFG_OIL_TEMP20_A_40 4;
BA_ "AfdxFDSname" SG_ 437791610 IOM_DEMO_VFG_OIL_TEMP20_A_40 "FDS_HSMU_DEMO20_10";
BA_ "AfdxSignalType" SG_ 437791610 IOM_DEMO_VFG_OIL_TEMP20_A_40 3;
BA_ "AfdxFSaddr" SG_ 437791610 FS_HSMU_DEMO20_11 46;
BA_ "AfdxFDSaddr" SG_ 437791610 FS_HSMU_DEMO20_11 56;
BA_ "AfdxFDSlength" SG_ 437791610 FS_HSMU_DEMO20_11 4;
BA_ "AfdxFDSname" SG_ 437791610 FS_HSMU_DEMO20_11 "FDS_HSMU_DEMO20_11";
BA_ "AfdxSignalType" SG_ 437791610 FS_HSMU_DEMO20_11 6;
BA_ "AfdxFSaddr" SG_ 437791610 IOM_DEMO_VFG_OIL_TEMP20_A_41 46;
BA_ "AfdxFDSaddr" SG_ 437791610 IOM_DEMO_VFG_OIL_TEMP20_A_41 56;
BA_ "AfdxFDSlength" SG_ 437791610 IOM_DEMO_VFG_OIL_TEMP20_A_41 4;
BA_ "AfdxFDSname" SG_ 437791610 IOM_DEMO_VFG_OIL_TEMP20_A_41 "FDS_HSMU_DEMO20_11";
BA_ "AfdxSignalType" SG_ 437791610 IOM_DEMO_VFG_OIL_TEMP20_A_41 3;
BA_ "AfdxFSaddr" SG_ 437791610 FS_HSMU_DEMO20_12 47;
BA_ "AfdxFDSaddr" SG_ 437791610 FS_HSMU_DEMO20_12 60;
BA_ "AfdxFDSlength" SG_ 437791610 FS_HSMU_DEMO20_12 4;
BA_ "AfdxFDSname" SG_ 437791610 FS_HSMU_DEMO20_12 "FDS_HSMU_DEMO20_12";
BA_ "AfdxSignalType" SG_ 437791610 FS_HSMU_DEMO20_12 6;
BA_ "AfdxFSaddr" SG_ 437791610 IOM_DEMO_VFG_OIL_TEMP20_A_42 47;
BA_ "AfdxFDSaddr" SG_ 437791610 IOM_DEMO_VFG_OIL_TEMP20_A_42 60;
BA_ "AfdxFDSlength" SG_ 437791610 IOM_DEMO_VFG_OIL_TEMP20_A_42 4;
BA_ "AfdxFDSname" SG_ 437791610 IOM_DEMO_VFG_OIL_TEMP20_A_42 "FDS_HSMU_DEMO20_12";
BA_ "AfdxSignalType" SG_ 437791610 IOM_DEMO_VFG_OIL_TEMP20_A_42 3;
BA_ "AfdxFSaddr" SG_ 437791610 FS_HSMU_DEMO20_13 64;
BA_ "AfdxFDSaddr" SG_ 437791610 FS_HSMU_DEMO20_13 68;
BA_ "AfdxFDSlength" SG_ 437791610 FS_HSMU_DEMO20_13 4;
BA_ "AfdxFDSname" SG_ 437791610 FS_HSMU_DEMO20_13 "FDS_HSMU_DEMO20_13";
BA_ "AfdxSignalType" SG_ 437791610 FS_HSMU_DEMO20_13 6;
BA_ "AfdxFSaddr" SG_ 437791610 IOM_DEMO_VFG_OIL_TEMP20_A_43 64;
BA_ "AfdxFDSaddr" SG_ 437791610 IOM_DEMO_VFG_OIL_TEMP20_A_43 68;
BA_ "AfdxFDSlength" SG_ 437791610 IOM_DEMO_VFG_OIL_TEMP20_A_43 4;
BA_ "AfdxFDSname" SG_ 437791610 IOM_DEMO_VFG_OIL_TEMP20_A_43 "FDS_HSMU_DEMO20_13";
BA_ "AfdxSignalType" SG_ 437791610 IOM_DEMO_VFG_OIL_TEMP20_A_43 3;
BA_ "AfdxFSaddr" SG_ 437791610 FS_HSMU_DEMO20_14 65;
BA_ "AfdxFDSaddr" SG_ 437791610 FS_HSMU_DEMO20_14 72;
BA_ "AfdxFDSlength" SG_ 437791610 FS_HSMU_DEMO20_14 4;
BA_ "AfdxFDSname" SG_ 437791610 FS_HSMU_DEMO20_14 "FDS_HSMU_DEMO20_14";
BA_ "AfdxSignalType" SG_ 437791610 FS_HSMU_DEMO20_14 6;
BA_ "AfdxFSaddr" SG_ 437791610 IOM_DEMO_VFG_OIL_TEMP20_A_44 65;
BA_ "AfdxFDSaddr" SG_ 437791610 IOM_DEMO_VFG_OIL_TEMP20_A_44 72;
BA_ "AfdxFDSlength" SG_ 437791610 IOM_DEMO_VFG_OIL_TEMP20_A_44 4;
BA_ "AfdxFDSname" SG_ 437791610 IOM_DEMO_VFG_OIL_TEMP20_A_44 "FDS_HSMU_DEMO20_14";
BA_ "AfdxSignalType" SG_ 437791610 IOM_DEMO_VFG_OIL_TEMP20_A_44 3;
BA_ "AfdxFSaddr" SG_ 437791610 FS_HSMU_DEMO20_15 66;
BA_ "AfdxFDSaddr" SG_ 437791610 FS_HSMU_DEMO20_15 76;
BA_ "AfdxFDSlength" SG_ 437791610 FS_HSMU_DEMO20_15 4;
BA_ "AfdxFDSname" SG_ 437791610 FS_HSMU_DEMO20_15 "FDS_HSMU_DEMO20_15";
BA_ "AfdxSignalType" SG_ 437791610 FS_HSMU_DEMO20_15 6;
BA_ "AfdxFSaddr" SG_ 437791610 IOM_DEMO_VFG_OIL_TEMP20_A_45 66;
BA_ "AfdxFDSaddr" SG_ 437791610 IOM_DEMO_VFG_OIL_TEMP20_A_45 76;
BA_ "AfdxFDSlength" SG_ 437791610 IOM_DEMO_VFG_OIL_TEMP20_A_45 4;
BA_ "AfdxFDSname" SG_ 437791610 IOM_DEMO_VFG_OIL_TEMP20_A_45 "FDS_HSMU_DEMO20_15";
BA_ "AfdxSignalType" SG_ 437791610 IOM_DEMO_VFG_OIL_TEMP20_A_45 3;
BA_ "AfdxFSaddr" SG_ 437791610 FS_HSMU_DEMO20_16 67;
BA_ "AfdxFDSaddr" SG_ 437791610 FS_HSMU_DEMO20_16 80;
BA_ "AfdxFDSlength" SG_ 437791610 FS_HSMU_DEMO20_16 4;
BA_ "AfdxFDSname" SG_ 437791610 FS_HSMU_DEMO20_16 "FDS_HSMU_DEMO20_16";
BA_ "AfdxSignalType" SG_ 437791610 FS_HSMU_DEMO20_16 6;
BA_ "AfdxFSaddr" SG_ 437791610 IOM_DEMO_VFG_OIL_TEMP20_A_46 67;
BA_ "AfdxFDSaddr" SG_ 437791610 IOM_DEMO_VFG_OIL_TEMP20_A_46 80;
BA_ "AfdxFDSlength" SG_ 437791610 IOM_DEMO_VFG_OIL_TEMP20_A_46 4;
BA_ "AfdxFDSname" SG_ 437791610 IOM_DEMO_VFG_OIL_TEMP20_A_46 "FDS_HSMU_DEMO20_16";
BA_ "AfdxSignalType" SG_ 437791610 IOM_DEMO_VFG_OIL_TEMP20_A_46 3;
BA_ "AfdxFSaddr" SG_ 437791610 FS_HSMU_DEMO20_17 84;
BA_ "AfdxFDSaddr" SG_ 437791610 FS_HSMU_DEMO20_17 88;
BA_ "AfdxFDSlength" SG_ 437791610 FS_HSMU_DEMO20_17 4;
BA_ "AfdxFDSname" SG_ 437791610 FS_HSMU_DEMO20_17 "FDS_HSMU_DEMO20_17";
BA_ "AfdxSignalType" SG_ 437791610 FS_HSMU_DEMO20_17 6;
BA_ "AfdxFSaddr" SG_ 437791610 IOM_DEMO_VFG_OIL_TEMP20_A_47 84;
BA_ "AfdxFDSaddr" SG_ 437791610 IOM_DEMO_VFG_OIL_TEMP20_A_47 88;
BA_ "AfdxFDSlength" SG_ 437791610 IOM_DEMO_VFG_OIL_TEMP20_A_47 4;
BA_ "AfdxFDSname" SG_ 437791610 IOM_DEMO_VFG_OIL_TEMP20_A_47 "FDS_HSMU_DEMO20_17";
BA_ "AfdxSignalType" SG_ 437791610 IOM_DEMO_VFG_OIL_TEMP20_A_47 3;
BA_ "AfdxFSaddr" SG_ 437791610 FS_HSMU_DEMO20_18 85;
BA_ "AfdxFDSaddr" SG_ 437791610 FS_HSMU_DEMO20_18 92;
BA_ "AfdxFDSlength" SG_ 437791610 FS_HSMU_DEMO20_18 4;
BA_ "AfdxFDSname" SG_ 437791610 FS_HSMU_DEMO20_18 "FDS_HSMU_DEMO20_18";
BA_ "AfdxSignalType" SG_ 437791610 FS_HSMU_DEMO20_18 6;
BA_ "AfdxFSaddr" SG_ 437791610 IOM_DEMO_VFG_OIL_TEMP20_A_48 85;
BA_ "AfdxFDSaddr" SG_ 437791610 IOM_DEMO_VFG_OIL_TEMP20_A_48 92;
BA_ "AfdxFDSlength" SG_ 437791610 IOM_DEMO_VFG_OIL_TEMP20_A_48 4;
BA_ "AfdxFDSname" SG_ 437791610 IOM_DEMO_VFG_OIL_TEMP20_A_48 "FDS_HSMU_DEMO20_18";
BA_ "AfdxSignalType" SG_ 437791610 IOM_DEMO_VFG_OIL_TEMP20_A_48 3;
BA_ "AfdxFSaddr" SG_ 437791610 FS_HSMU_DEMO20_19 86;
BA_ "AfdxFDSaddr" SG_ 437791610 FS_HSMU_DEMO20_19 96;
BA_ "AfdxFDSlength" SG_ 437791610 FS_HSMU_DEMO20_19 4;
BA_ "AfdxFDSname" SG_ 437791610 FS_HSMU_DEMO20_19 "FDS_HSMU_DEMO20_19";
BA_ "AfdxSignalType" SG_ 437791610 FS_HSMU_DEMO20_19 6;
BA_ "AfdxFSaddr" SG_ 437791610 IOM_DEMO_VFG_OIL_TEMP20_A_49 86;
BA_ "AfdxFDSaddr" SG_ 437791610 IOM_DEMO_VFG_OIL_TEMP20_A_49 96;
BA_ "AfdxFDSlength" SG_ 437791610 IOM_DEMO_VFG_OIL_TEMP20_A_49 4;
BA_ "AfdxFDSname" SG_ 437791610 IOM_DEMO_VFG_OIL_TEMP20_A_49 "FDS_HSMU_DEMO20_19";
BA_ "AfdxSignalType" SG_ 437791610 IOM_DEMO_VFG_OIL_TEMP20_A_49 3;
BA_ "AfdxFSaddr" SG_ 437791610 FS_HSMU_DEMO20_20 87;
BA_ "AfdxFDSaddr" SG_ 437791610 FS_HSMU_DEMO20_20 100;
BA_ "AfdxFDSlength" SG_ 437791610 FS_HSMU_DEMO20_20 4;
BA_ "AfdxFDSname" SG_ 437791610 FS_HSMU_DEMO20_20 "FDS_HSMU_DEMO20_20";
BA_ "AfdxSignalType" SG_ 437791610 FS_HSMU_DEMO20_20 6;
BA_ "AfdxFSaddr" SG_ 437791610 IOM_DEMO_VFG_OIL_TEMP20_A_50 87;
BA_ "AfdxFDSaddr" SG_ 437791610 IOM_DEMO_VFG_OIL_TEMP20_A_50 100;
BA_ "AfdxFDSlength" SG_ 437791610 IOM_DEMO_VFG_OIL_TEMP20_A_50 4;
BA_ "AfdxFDSname" SG_ 437791610 IOM_DEMO_VFG_OIL_TEMP20_A_50 "FDS_HSMU_DEMO20_20";
BA_ "AfdxSignalType" SG_ 437791610 IOM_DEMO_VFG_OIL_TEMP20_A_50 3;
BA_ "AfdxFSaddr" SG_ 437791610 FS_HSMU_DEMO20_21 104;
BA_ "AfdxFDSaddr" SG_ 437791610 FS_HSMU_DEMO20_21 108;
BA_ "AfdxFDSlength" SG_ 437791610 FS_HSMU_DEMO20_21 4;
BA_ "AfdxFDSname" SG_ 437791610 FS_HSMU_DEMO20_21 "FDS_HSMU_DEMO20_21";
BA_ "AfdxSignalType" SG_ 437791610 FS_HSMU_DEMO20_21 6;
BA_ "AfdxFSaddr" SG_ 437791610 IOM_DEMO_VFG_OIL_TEMP20_A_51 104;
BA_ "AfdxFDSaddr" SG_ 437791610 IOM_DEMO_VFG_OIL_TEMP20_A_51 108;
BA_ "AfdxFDSlength" SG_ 437791610 IOM_DEMO_VFG_OIL_TEMP20_A_51 4;
BA_ "AfdxFDSname" SG_ 437791610 IOM_DEMO_VFG_OIL_TEMP20_A_51 "FDS_HSMU_DEMO20_21";
BA_ "AfdxSignalType" SG_ 437791610 IOM_DEMO_VFG_OIL_TEMP20_A_51 3;
BA_ "AfdxFSaddr" SG_ 437791610 FS_HSMU_DEMO20_22 105;
BA_ "AfdxFDSaddr" SG_ 437791610 FS_HSMU_DEMO20_22 112;
BA_ "AfdxFDSlength" SG_ 437791610 FS_HSMU_DEMO20_22 4;
BA_ "AfdxFDSname" SG_ 437791610 FS_HSMU_DEMO20_22 "FDS_HSMU_DEMO20_22";
BA_ "AfdxSignalType" SG_ 437791610 FS_HSMU_DEMO20_22 6;
BA_ "AfdxFSaddr" SG_ 437791610 IOM_DEMO_VFG_OIL_TEMP20_A_52 105;
BA_ "AfdxFDSaddr" SG_ 437791610 IOM_DEMO_VFG_OIL_TEMP20_A_52 112;
BA_ "AfdxFDSlength" SG_ 437791610 IOM_DEMO_VFG_OIL_TEMP20_A_52 4;
BA_ "AfdxFDSname" SG_ 437791610 IOM_DEMO_VFG_OIL_TEMP20_A_52 "FDS_HSMU_DEMO20_22";
BA_ "AfdxSignalType" SG_ 437791610 IOM_DEMO_VFG_OIL_TEMP20_A_52 3;
BA_ "AfdxFSaddr" SG_ 437791610 FS_HSMU_DEMO20_23 106;
BA_ "AfdxFDSaddr" SG_ 437791610 FS_HSMU_DEMO20_23 116;
BA_ "AfdxFDSlength" SG_ 437791610 FS_HSMU_DEMO20_23 4;
BA_ "AfdxFDSname" SG_ 437791610 FS_HSMU_DEMO20_23 "FDS_HSMU_DEMO20_23";
BA_ "AfdxSignalType" SG_ 437791610 FS_HSMU_DEMO20_23 6;
BA_ "AfdxFSaddr" SG_ 437791610 IOM_DEMO_VFG_OIL_TEMP20_A_53 106;
BA_ "AfdxFDSaddr" SG_ 437791610 IOM_DEMO_VFG_OIL_TEMP20_A_53 116;
BA_ "AfdxFDSlength" SG_ 437791610 IOM_DEMO_VFG_OIL_TEMP20_A_53 4;
BA_ "AfdxFDSname" SG_ 437791610 IOM_DEMO_VFG_OIL_TEMP20_A_53 "FDS_HSMU_DEMO20_23";
BA_ "AfdxSignalType" SG_ 437791610 IOM_DEMO_VFG_OIL_TEMP20_A_53 3;
BA_ "AfdxFSaddr" SG_ 437791610 FS_HSMU_DEMO20_24 107;
BA_ "AfdxFDSaddr" SG_ 437791610 FS_HSMU_DEMO20_24 120;
BA_ "AfdxFDSlength" SG_ 437791610 FS_HSMU_DEMO20_24 4;
BA_ "AfdxFDSname" SG_ 437791610 FS_HSMU_DEMO20_24 "FDS_HSMU_DEMO20_24";
BA_ "AfdxSignalType" SG_ 437791610 FS_HSMU_DEMO20_24 6;
BA_ "AfdxFSaddr" SG_ 437791610 IOM_DEMO_VFG_OIL_TEMP20_A_54 107;
BA_ "AfdxFDSaddr" SG_ 437791610 IOM_DEMO_VFG_OIL_TEMP20_A_54 120;
BA_ "AfdxFDSlength" SG_ 437791610 IOM_DEMO_VFG_OIL_TEMP20_A_54 4;
BA_ "AfdxFDSname" SG_ 437791610 IOM_DEMO_VFG_OIL_TEMP20_A_54 "FDS_HSMU_DEMO20_24";
BA_ "AfdxSignalType" SG_ 437791610 IOM_DEMO_VFG_OIL_TEMP20_A_54 3;
BA_ "AfdxFSaddr" SG_ 437791610 FS_HSMU_DEMO20_25 124;
BA_ "AfdxFDSaddr" SG_ 437791610 FS_HSMU_DEMO20_25 128;
BA_ "AfdxFDSlength" SG_ 437791610 FS_HSMU_DEMO20_25 4;
BA_ "AfdxFDSname" SG_ 437791610 FS_HSMU_DEMO20_25 "FDS_HSMU_DEMO20_25";
BA_ "AfdxSignalType" SG_ 437791610 FS_HSMU_DEMO20_25 6;
BA_ "AfdxFSaddr" SG_ 437791610 IOM_DEMO_VFG_OIL_TEMP20_A_55 124;
BA_ "AfdxFDSaddr" SG_ 437791610 IOM_DEMO_VFG_OIL_TEMP20_A_55 128;
BA_ "AfdxFDSlength" SG_ 437791610 IOM_DEMO_VFG_OIL_TEMP20_A_55 4;
BA_ "AfdxFDSname" SG_ 437791610 IOM_DEMO_VFG_OIL_TEMP20_A_55 "FDS_HSMU_DEMO20_25";
BA_ "AfdxSignalType" SG_ 437791610 IOM_DEMO_VFG_OIL_TEMP20_A_55 3;
BA_ "AfdxFSaddr" SG_ 437791610 FS_HSMU_DEMO20_26 125;
BA_ "AfdxFDSaddr" SG_ 437791610 FS_HSMU_DEMO20_26 132;
BA_ "AfdxFDSlength" SG_ 437791610 FS_HSMU_DEMO20_26 4;
BA_ "AfdxFDSname" SG_ 437791610 FS_HSMU_DEMO20_26 "FDS_HSMU_DEMO20_26";
BA_ "AfdxSignalType" SG_ 437791610 FS_HSMU_DEMO20_26 6;
BA_ "AfdxFSaddr" SG_ 437791610 IOM_DEMO_VFG_OIL_TEMP20_A_56 125;
BA_ "AfdxFDSaddr" SG_ 437791610 IOM_DEMO_VFG_OIL_TEMP20_A_56 132;
BA_ "AfdxFDSlength" SG_ 437791610 IOM_DEMO_VFG_OIL_TEMP20_A_56 4;
BA_ "AfdxFDSname" SG_ 437791610 IOM_DEMO_VFG_OIL_TEMP20_A_56 "FDS_HSMU_DEMO20_26";
BA_ "AfdxSignalType" SG_ 437791610 IOM_DEMO_VFG_OIL_TEMP20_A_56 3;
BA_ "AfdxFSaddr" SG_ 437791610 FS_HSMU_DEMO20_27 126;
BA_ "AfdxFDSaddr" SG_ 437791610 FS_HSMU_DEMO20_27 136;
BA_ "AfdxFDSlength" SG_ 437791610 FS_HSMU_DEMO20_27 4;
BA_ "AfdxFDSname" SG_ 437791610 FS_HSMU_DEMO20_27 "FDS_HSMU_DEMO20_27";
BA_ "AfdxSignalType" SG_ 437791610 FS_HSMU_DEMO20_27 6;
BA_ "AfdxFSaddr" SG_ 437791610 IOM_DEMO_VFG_OIL_TEMP20_A_57 126;
BA_ "AfdxFDSaddr" SG_ 437791610 IOM_DEMO_VFG_OIL_TEMP20_A_57 136;
BA_ "AfdxFDSlength" SG_ 437791610 IOM_DEMO_VFG_OIL_TEMP20_A_57 4;
BA_ "AfdxFDSname" SG_ 437791610 IOM_DEMO_VFG_OIL_TEMP20_A_57 "FDS_HSMU_DEMO20_27";
BA_ "AfdxSignalType" SG_ 437791610 IOM_DEMO_VFG_OIL_TEMP20_A_57 3;
BA_ "AfdxFSaddr" SG_ 437791610 FS_HSMU_DEMO20_28 127;
BA_ "AfdxFDSaddr" SG_ 437791610 FS_HSMU_DEMO20_28 140;
BA_ "AfdxFDSlength" SG_ 437791610 FS_HSMU_DEMO20_28 4;
BA_ "AfdxFDSname" SG_ 437791610 FS_HSMU_DEMO20_28 "FDS_HSMU_DEMO20_28";
BA_ "AfdxSignalType" SG_ 437791610 FS_HSMU_DEMO20_28 6;
BA_ "AfdxFSaddr" SG_ 437791610 IOM_DEMO_VFG_OIL_TEMP20_A_58 127;
BA_ "AfdxFDSaddr" SG_ 437791610 IOM_DEMO_VFG_OIL_TEMP20_A_58 140;
BA_ "AfdxFDSlength" SG_ 437791610 IOM_DEMO_VFG_OIL_TEMP20_A_58 4;
BA_ "AfdxFDSname" SG_ 437791610 IOM_DEMO_VFG_OIL_TEMP20_A_58 "FDS_HSMU_DEMO20_28";
BA_ "AfdxSignalType" SG_ 437791610 IOM_DEMO_VFG_OIL_TEMP20_A_58 3;
BA_ "AfdxFSaddr" SG_ 437791610 FS_HSMU_DEMO20_29 144;
BA_ "AfdxFDSaddr" SG_ 437791610 FS_HSMU_DEMO20_29 148;
BA_ "AfdxFDSlength" SG_ 437791610 FS_HSMU_DEMO20_29 4;
BA_ "AfdxFDSname" SG_ 437791610 FS_HSMU_DEMO20_29 "FDS_HSMU_DEMO20_29";
BA_ "AfdxSignalType" SG_ 437791610 FS_HSMU_DEMO20_29 6;
BA_ "AfdxFSaddr" SG_ 437791610 IOM_DEMO_VFG_OIL_TEMP20_A_59 144;
BA_ "AfdxFDSaddr" SG_ 437791610 IOM_DEMO_VFG_OIL_TEMP20_A_59 148;
BA_ "AfdxFDSlength" SG_ 437791610 IOM_DEMO_VFG_OIL_TEMP20_A_59 4;
BA_ "AfdxFDSname" SG_ 437791610 IOM_DEMO_VFG_OIL_TEMP20_A_59 "FDS_HSMU_DEMO20_29";
BA_ "AfdxSignalType" SG_ 437791610 IOM_DEMO_VFG_OIL_TEMP20_A_59 3;
BA_ "AfdxFSaddr" SG_ 437791610 FS_HSMU_DEMO20_30 145;
BA_ "AfdxFDSaddr" SG_ 437791610 FS_HSMU_DEMO20_30 152;
BA_ "AfdxFDSlength" SG_ 437791610 FS_HSMU_DEMO20_30 4;
BA_ "AfdxFDSname" SG_ 437791610 FS_HSMU_DEMO20_30 "FDS_HSMU_DEMO20_30";
BA_ "AfdxSignalType" SG_ 437791610 FS_HSMU_DEMO20_30 6;
BA_ "AfdxFSaddr" SG_ 437791610 IOM_DEMO_VFG_OIL_TEMP20_A_60 145;
BA_ "AfdxFDSaddr" SG_ 437791610 IOM_DEMO_VFG_OIL_TEMP20_A_60 152;
BA_ "AfdxFDSlength" SG_ 437791610 IOM_DEMO_VFG_OIL_TEMP20_A_60 4;
BA_ "AfdxFDSname" SG_ 437791610 IOM_DEMO_VFG_OIL_TEMP20_A_60 "FDS_HSMU_DEMO20_30";
BA_ "AfdxSignalType" SG_ 437791610 IOM_DEMO_VFG_OIL_TEMP20_A_60 3;
BA_ "AfdxFSaddr" SG_ 437791610 FS_HSMU_DEMO20_31 146;
BA_ "AfdxFDSaddr" SG_ 437791610 FS_HSMU_DEMO20_31 156;
BA_ "AfdxFDSlength" SG_ 437791610 FS_HSMU_DEMO20_31 4;
BA_ "AfdxFDSname" SG_ 437791610 FS_HSMU_DEMO20_31 "FDS_HSMU_DEMO20_31";
BA_ "AfdxSignalType" SG_ 437791610 FS_HSMU_DEMO20_31 6;
BA_ "AfdxFSaddr" SG_ 437791610 IOM_DEMO_VFG_OIL_TEMP20_A_61 146;
BA_ "AfdxFDSaddr" SG_ 437791610 IOM_DEMO_VFG_OIL_TEMP20_A_61 156;
BA_ "AfdxFDSlength" SG_ 437791610 IOM_DEMO_VFG_OIL_TEMP20_A_61 4;
BA_ "AfdxFDSname" SG_ 437791610 IOM_DEMO_VFG_OIL_TEMP20_A_61 "FDS_HSMU_DEMO20_31";
BA_ "AfdxSignalType" SG_ 437791610 IOM_DEMO_VFG_OIL_TEMP20_A_61 3;
BA_ "AfdxFSaddr" SG_ 437791610 FS_HSMU_DEMO20_32 147;
BA_ "AfdxFDSaddr" SG_ 437791610 FS_HSMU_DEMO20_32 160;
BA_ "AfdxFDSlength" SG_ 437791610 FS_HSMU_DEMO20_32 4;
BA_ "AfdxFDSname" SG_ 437791610 FS_HSMU_DEMO20_32 "FDS_HSMU_DEMO20_32";
BA_ "AfdxSignalType" SG_ 437791610 FS_HSMU_DEMO20_32 6;
BA_ "AfdxFSaddr" SG_ 437791610 IOM_DEMO_VFG_OIL_TEMP20_A_62 147;
BA_ "AfdxFDSaddr" SG_ 437791610 IOM_DEMO_VFG_OIL_TEMP20_A_62 160;
BA_ "AfdxFDSlength" SG_ 437791610 IOM_DEMO_VFG_OIL_TEMP20_A_62 4;
BA_ "AfdxFDSname" SG_ 437791610 IOM_DEMO_VFG_OIL_TEMP20_A_62 "FDS_HSMU_DEMO20_32";
BA_ "AfdxSignalType" SG_ 437791610 IOM_DEMO_VFG_OIL_TEMP20_A_62 3;
BA_ "AfdxFSaddr" SG_ 437791610 FS_HSMU_DEMO20_33 164;
BA_ "AfdxFDSaddr" SG_ 437791610 FS_HSMU_DEMO20_33 168;
BA_ "AfdxFDSlength" SG_ 437791610 FS_HSMU_DEMO20_33 4;
BA_ "AfdxFDSname" SG_ 437791610 FS_HSMU_DEMO20_33 "FDS_HSMU_DEMO20_33";
BA_ "AfdxSignalType" SG_ 437791610 FS_HSMU_DEMO20_33 6;
BA_ "AfdxFSaddr" SG_ 437791610 IOM_DEMO_VFG_OIL_TEMP20_A_63 164;
BA_ "AfdxFDSaddr" SG_ 437791610 IOM_DEMO_VFG_OIL_TEMP20_A_63 168;
BA_ "AfdxFDSlength" SG_ 437791610 IOM_DEMO_VFG_OIL_TEMP20_A_63 4;
BA_ "AfdxFDSname" SG_ 437791610 IOM_DEMO_VFG_OIL_TEMP20_A_63 "FDS_HSMU_DEMO20_33";
BA_ "AfdxSignalType" SG_ 437791610 IOM_DEMO_VFG_OIL_TEMP20_A_63 3;
BA_ "AfdxFSaddr" SG_ 437791610 FS_HSMU_DEMO20_34 165;
BA_ "AfdxFDSaddr" SG_ 437791610 FS_HSMU_DEMO20_34 172;
BA_ "AfdxFDSlength" SG_ 437791610 FS_HSMU_DEMO20_34 4;
BA_ "AfdxFDSname" SG_ 437791610 FS_HSMU_DEMO20_34 "FDS_HSMU_DEMO20_34";
BA_ "AfdxSignalType" SG_ 437791610 FS_HSMU_DEMO20_34 6;
BA_ "AfdxFSaddr" SG_ 437791610 IOM_DEMO_VFG_OIL_TEMP20_A_64 165;
BA_ "AfdxFDSaddr" SG_ 437791610 IOM_DEMO_VFG_OIL_TEMP20_A_64 172;
BA_ "AfdxFDSlength" SG_ 437791610 IOM_DEMO_VFG_OIL_TEMP20_A_64 4;
BA_ "AfdxFDSname" SG_ 437791610 IOM_DEMO_VFG_OIL_TEMP20_A_64 "FDS_HSMU_DEMO20_34";
BA_ "AfdxSignalType" SG_ 437791610 IOM_DEMO_VFG_OIL_TEMP20_A_64 3;
BA_ "AfdxFSaddr" SG_ 437791610 FS_HSMU_DEMO20_35 166;
BA_ "AfdxFDSaddr" SG_ 437791610 FS_HSMU_DEMO20_35 176;
BA_ "AfdxFDSlength" SG_ 437791610 FS_HSMU_DEMO20_35 4;
BA_ "AfdxFDSname" SG_ 437791610 FS_HSMU_DEMO20_35 "FDS_HSMU_DEMO20_35";
BA_ "AfdxSignalType" SG_ 437791610 FS_HSMU_DEMO20_35 6;
BA_ "AfdxFSaddr" SG_ 437791610 IOM_DEMO_VFG_OIL_TEMP20_A_65 166;
BA_ "AfdxFDSaddr" SG_ 437791610 IOM_DEMO_VFG_OIL_TEMP20_A_65 176;
BA_ "AfdxFDSlength" SG_ 437791610 IOM_DEMO_VFG_OIL_TEMP20_A_65 4;
BA_ "AfdxFDSname" SG_ 437791610 IOM_DEMO_VFG_OIL_TEMP20_A_65 "FDS_HSMU_DEMO20_35";
BA_ "AfdxSignalType" SG_ 437791610 IOM_DEMO_VFG_OIL_TEMP20_A_65 3;
BA_ "AfdxFSaddr" SG_ 437791610 FS_HSMU_DEMO20_36 167;
BA_ "AfdxFDSaddr" SG_ 437791610 FS_HSMU_DEMO20_36 180;
BA_ "AfdxFDSlength" SG_ 437791610 FS_HSMU_DEMO20_36 4;
BA_ "AfdxFDSname" SG_ 437791610 FS_HSMU_DEMO20_36 "FDS_HSMU_DEMO20_36";
BA_ "AfdxSignalType" SG_ 437791610 FS_HSMU_DEMO20_36 6;
BA_ "AfdxFSaddr" SG_ 437791610 IOM_DEMO_VFG_OIL_TEMP20_A_66 167;
BA_ "AfdxFDSaddr" SG_ 437791610 IOM_DEMO_VFG_OIL_TEMP20_A_66 180;
BA_ "AfdxFDSlength" SG_ 437791610 IOM_DEMO_VFG_OIL_TEMP20_A_66 4;
BA_ "AfdxFDSname" SG_ 437791610 IOM_DEMO_VFG_OIL_TEMP20_A_66 "FDS_HSMU_DEMO20_36";
BA_ "AfdxSignalType" SG_ 437791610 IOM_DEMO_VFG_OIL_TEMP20_A_66 3;
BA_ "AfdxFSaddr" SG_ 437791610 FS_HSMU_DEMO20_37 184;
BA_ "AfdxFDSaddr" SG_ 437791610 FS_HSMU_DEMO20_37 188;
BA_ "AfdxFDSlength" SG_ 437791610 FS_HSMU_DEMO20_37 4;
BA_ "AfdxFDSname" SG_ 437791610 FS_HSMU_DEMO20_37 "FDS_HSMU_DEMO20_37";
BA_ "AfdxSignalType" SG_ 437791610 FS_HSMU_DEMO20_37 6;
BA_ "AfdxFSaddr" SG_ 437791610 IOM_DEMO_VFG_OIL_TEMP20_A_67 184;
BA_ "AfdxFDSaddr" SG_ 437791610 IOM_DEMO_VFG_OIL_TEMP20_A_67 188;
BA_ "AfdxFDSlength" SG_ 437791610 IOM_DEMO_VFG_OIL_TEMP20_A_67 4;
BA_ "AfdxFDSname" SG_ 437791610 IOM_DEMO_VFG_OIL_TEMP20_A_67 "FDS_HSMU_DEMO20_37";
BA_ "AfdxSignalType" SG_ 437791610 IOM_DEMO_VFG_OIL_TEMP20_A_67 3;
BA_ "AfdxFSaddr" SG_ 437791610 FS_HSMU_DEMO20_38 185;
BA_ "AfdxFDSaddr" SG_ 437791610 FS_HSMU_DEMO20_38 192;
BA_ "AfdxFDSlength" SG_ 437791610 FS_HSMU_DEMO20_38 4;
BA_ "AfdxFDSname" SG_ 437791610 FS_HSMU_DEMO20_38 "FDS_HSMU_DEMO20_38";
BA_ "AfdxSignalType" SG_ 437791610 FS_HSMU_DEMO20_38 6;
BA_ "AfdxFSaddr" SG_ 437791610 IOM_DEMO_VFG_OIL_TEMP20_A_68 185;
BA_ "AfdxFDSaddr" SG_ 437791610 IOM_DEMO_VFG_OIL_TEMP20_A_68 192;
BA_ "AfdxFDSlength" SG_ 437791610 IOM_DEMO_VFG_OIL_TEMP20_A_68 4;
BA_ "AfdxFDSname" SG_ 437791610 IOM_DEMO_VFG_OIL_TEMP20_A_68 "FDS_HSMU_DEMO20_38";
BA_ "AfdxSignalType" SG_ 437791610 IOM_DEMO_VFG_OIL_TEMP20_A_68 3;
BA_ "AfdxFSaddr" SG_ 437791610 FS_HSMU_DEMO20_39 186;
BA_ "AfdxFDSaddr" SG_ 437791610 FS_HSMU_DEMO20_39 196;
BA_ "AfdxFDSlength" SG_ 437791610 FS_HSMU_DEMO20_39 4;
BA_ "AfdxFDSname" SG_ 437791610 FS_HSMU_DEMO20_39 "FDS_HSMU_DEMO20_39";
BA_ "AfdxSignalType" SG_ 437791610 FS_HSMU_DEMO20_39 6;
BA_ "AfdxFSaddr" SG_ 437791610 IOM_DEMO_VFG_OIL_TEMP20_A_69 186;
BA_ "AfdxFDSaddr" SG_ 437791610 IOM_DEMO_VFG_OIL_TEMP20_A_69 196;
BA_ "AfdxFDSlength" SG_ 437791610 IOM_DEMO_VFG_OIL_TEMP20_A_69 4;
BA_ "AfdxFDSname" SG_ 437791610 IOM_DEMO_VFG_OIL_TEMP20_A_69 "FDS_HSMU_DEMO20_39";
BA_ "AfdxSignalType" SG_ 437791610 IOM_DEMO_VFG_OIL_TEMP20_A_69 3;
BA_ "AfdxFSaddr" SG_ 437791610 FS_HSMU_DEMO20_40 187;
BA_ "AfdxFDSaddr" SG_ 437791610 FS_HSMU_DEMO20_40 200;
BA_ "AfdxFDSlength" SG_ 437791610 FS_HSMU_DEMO20_40 4;
BA_ "AfdxFDSname" SG_ 437791610 FS_HSMU_DEMO20_40 "FDS_HSMU_DEMO20_40";
BA_ "AfdxSignalType" SG_ 437791610 FS_HSMU_DEMO20_40 6;
BA_ "AfdxFSaddr" SG_ 437791610 IOM_DEMO_VFG_OIL_TEMP20_A_70 187;
BA_ "AfdxFDSaddr" SG_ 437791610 IOM_DEMO_VFG_OIL_TEMP20_A_70 200;
BA_ "AfdxFDSlength" SG_ 437791610 IOM_DEMO_VFG_OIL_TEMP20_A_70 4;
BA_ "AfdxFDSname" SG_ 437791610 IOM_DEMO_VFG_OIL_TEMP20_A_70 "FDS_HSMU_DEMO20_40";
BA_ "AfdxSignalType" SG_ 437791610 IOM_DEMO_VFG_OIL_TEMP20_A_70 3;
BA_ "AfdxFSaddr" SG_ 437791610 FS_HSMU_DEMO20_41 204;
BA_ "AfdxFDSaddr" SG_ 437791610 FS_HSMU_DEMO20_41 208;
BA_ "AfdxFDSlength" SG_ 437791610 FS_HSMU_DEMO20_41 4;
BA_ "AfdxFDSname" SG_ 437791610 FS_HSMU_DEMO20_41 "FDS_HSMU_DEMO20_41";
BA_ "AfdxSignalType" SG_ 437791610 FS_HSMU_DEMO20_41 6;
BA_ "AfdxFSaddr" SG_ 437791610 IOM_DEMO_VFG_OIL_TEMP20_A_71 204;
BA_ "AfdxFDSaddr" SG_ 437791610 IOM_DEMO_VFG_OIL_TEMP20_A_71 208;
BA_ "AfdxFDSlength" SG_ 437791610 IOM_DEMO_VFG_OIL_TEMP20_A_71 4;
BA_ "AfdxFDSname" SG_ 437791610 IOM_DEMO_VFG_OIL_TEMP20_A_71 "FDS_HSMU_DEMO20_41";
BA_ "AfdxSignalType" SG_ 437791610 IOM_DEMO_VFG_OIL_TEMP20_A_71 3;
BA_ "AfdxFSaddr" SG_ 437791610 FS_HSMU_DEMO20_42 205;
BA_ "AfdxFDSaddr" SG_ 437791610 FS_HSMU_DEMO20_42 212;
BA_ "AfdxFDSlength" SG_ 437791610 FS_HSMU_DEMO20_42 4;
BA_ "AfdxFDSname" SG_ 437791610 FS_HSMU_DEMO20_42 "FDS_HSMU_DEMO20_42";
BA_ "AfdxSignalType" SG_ 437791610 FS_HSMU_DEMO20_42 6;
BA_ "AfdxFSaddr" SG_ 437791610 IOM_DEMO_VFG_OIL_TEMP20_A_72 205;
BA_ "AfdxFDSaddr" SG_ 437791610 IOM_DEMO_VFG_OIL_TEMP20_A_72 212;
BA_ "AfdxFDSlength" SG_ 437791610 IOM_DEMO_VFG_OIL_TEMP20_A_72 4;
BA_ "AfdxFDSname" SG_ 437791610 IOM_DEMO_VFG_OIL_TEMP20_A_72 "FDS_HSMU_DEMO20_42";
BA_ "AfdxSignalType" SG_ 437791610 IOM_DEMO_VFG_OIL_TEMP20_A_72 3;
BA_ "AfdxFSaddr" SG_ 437791610 FS_HSMU_DEMO20_43 206;
BA_ "AfdxFDSaddr" SG_ 437791610 FS_HSMU_DEMO20_43 216;
BA_ "AfdxFDSlength" SG_ 437791610 FS_HSMU_DEMO20_43 4;
BA_ "AfdxFDSname" SG_ 437791610 FS_HSMU_DEMO20_43 "FDS_HSMU_DEMO20_43";
BA_ "AfdxSignalType" SG_ 437791610 FS_HSMU_DEMO20_43 6;
BA_ "AfdxFSaddr" SG_ 437791610 IOM_DEMO_VFG_OIL_TEMP20_A_73 206;
BA_ "AfdxFDSaddr" SG_ 437791610 IOM_DEMO_VFG_OIL_TEMP20_A_73 216;
BA_ "AfdxFDSlength" SG_ 437791610 IOM_DEMO_VFG_OIL_TEMP20_A_73 4;
BA_ "AfdxFDSname" SG_ 437791610 IOM_DEMO_VFG_OIL_TEMP20_A_73 "FDS_HSMU_DEMO20_43";
BA_ "AfdxSignalType" SG_ 437791610 IOM_DEMO_VFG_OIL_TEMP20_A_73 3;
BA_ "AfdxFSaddr" SG_ 437791610 FS_HSMU_DEMO20_44 207;
BA_ "AfdxFDSaddr" SG_ 437791610 FS_HSMU_DEMO20_44 220;
BA_ "AfdxFDSlength" SG_ 437791610 FS_HSMU_DEMO20_44 4;
BA_ "AfdxFDSname" SG_ 437791610 FS_HSMU_DEMO20_44 "FDS_HSMU_DEMO20_44";
BA_ "AfdxSignalType" SG_ 437791610 FS_HSMU_DEMO20_44 6;
BA_ "AfdxFSaddr" SG_ 437791610 IOM_DEMO_VFG_OIL_TEMP20_A_74 207;
BA_ "AfdxFDSaddr" SG_ 437791610 IOM_DEMO_VFG_OIL_TEMP20_A_74 220;
BA_ "AfdxFDSlength" SG_ 437791610 IOM_DEMO_VFG_OIL_TEMP20_A_74 4;
BA_ "AfdxFDSname" SG_ 437791610 IOM_DEMO_VFG_OIL_TEMP20_A_74 "FDS_HSMU_DEMO20_44";
BA_ "AfdxSignalType" SG_ 437791610 IOM_DEMO_VFG_OIL_TEMP20_A_74 3;
BA_ "AfdxFSaddr" SG_ 437791610 FS_HSMU_DEMO20_45 224;
BA_ "AfdxFDSaddr" SG_ 437791610 FS_HSMU_DEMO20_45 228;
BA_ "AfdxFDSlength" SG_ 437791610 FS_HSMU_DEMO20_45 4;
BA_ "AfdxFDSname" SG_ 437791610 FS_HSMU_DEMO20_45 "FDS_HSMU_DEMO20_45";
BA_ "AfdxSignalType" SG_ 437791610 FS_HSMU_DEMO20_45 6;
BA_ "AfdxFSaddr" SG_ 437791610 IOM_DEMO_VFG_OIL_TEMP20_A_75 224;
BA_ "AfdxFDSaddr" SG_ 437791610 IOM_DEMO_VFG_OIL_TEMP20_A_75 228;
BA_ "AfdxFDSlength" SG_ 437791610 IOM_DEMO_VFG_OIL_TEMP20_A_75 4;
BA_ "AfdxFDSname" SG_ 437791610 IOM_DEMO_VFG_OIL_TEMP20_A_75 "FDS_HSMU_DEMO20_45";
BA_ "AfdxSignalType" SG_ 437791610 IOM_DEMO_VFG_OIL_TEMP20_A_75 3;
BA_ "AfdxFSaddr" SG_ 437791610 FS_HSMU_DEMO20_46 225;
BA_ "AfdxFDSaddr" SG_ 437791610 FS_HSMU_DEMO20_46 232;
BA_ "AfdxFDSlength" SG_ 437791610 FS_HSMU_DEMO20_46 4;
BA_ "AfdxFDSname" SG_ 437791610 FS_HSMU_DEMO20_46 "FDS_HSMU_DEMO20_46";
BA_ "AfdxSignalType" SG_ 437791610 FS_HSMU_DEMO20_46 6;
BA_ "AfdxFSaddr" SG_ 437791610 IOM_DEMO_VFG_OIL_TEMP20_A_76 225;
BA_ "AfdxFDSaddr" SG_ 437791610 IOM_DEMO_VFG_OIL_TEMP20_A_76 232;
BA_ "AfdxFDSlength" SG_ 437791610 IOM_DEMO_VFG_OIL_TEMP20_A_76 4;
BA_ "AfdxFDSname" SG_ 437791610 IOM_DEMO_VFG_OIL_TEMP20_A_76 "FDS_HSMU_DEMO20_46";
BA_ "AfdxSignalType" SG_ 437791610 IOM_DEMO_VFG_OIL_TEMP20_A_76 3;
BA_ "AfdxFSaddr" SG_ 437791610 FS_HSMU_DEMO20_47 226;
BA_ "AfdxFDSaddr" SG_ 437791610 FS_HSMU_DEMO20_47 236;
BA_ "AfdxFDSlength" SG_ 437791610 FS_HSMU_DEMO20_47 4;
BA_ "AfdxFDSname" SG_ 437791610 FS_HSMU_DEMO20_47 "FDS_HSMU_DEMO20_47";
BA_ "AfdxSignalType" SG_ 437791610 FS_HSMU_DEMO20_47 6;
BA_ "AfdxFSaddr" SG_ 437791610 IOM_DEMO_VFG_OIL_TEMP20_A_77 226;
BA_ "AfdxFDSaddr" SG_ 437791610 IOM_DEMO_VFG_OIL_TEMP20_A_77 236;
BA_ "AfdxFDSlength" SG_ 437791610 IOM_DEMO_VFG_OIL_TEMP20_A_77 4;
BA_ "AfdxFDSname" SG_ 437791610 IOM_DEMO_VFG_OIL_TEMP20_A_77 "FDS_HSMU_DEMO20_47";
BA_ "AfdxSignalType" SG_ 437791610 IOM_DEMO_VFG_OIL_TEMP20_A_77 3;
BA_ "AfdxFSaddr" SG_ 437791610 FS_HSMU_DEMO20_48 227;
BA_ "AfdxFDSaddr" SG_ 437791610 FS_HSMU_DEMO20_48 240;
BA_ "AfdxFDSlength" SG_ 437791610 FS_HSMU_DEMO20_48 4;
BA_ "AfdxFDSname" SG_ 437791610 FS_HSMU_DEMO20_48 "FDS_HSMU_DEMO20_48";
BA_ "AfdxSignalType" SG_ 437791610 FS_HSMU_DEMO20_48 6;
BA_ "AfdxFSaddr" SG_ 437791610 IOM_DEMO_VFG_OIL_TEMP20_A_78 227;
BA_ "AfdxFDSaddr" SG_ 437791610 IOM_DEMO_VFG_OIL_TEMP20_A_78 240;
BA_ "AfdxFDSlength" SG_ 437791610 IOM_DEMO_VFG_OIL_TEMP20_A_78 4;
BA_ "AfdxFDSname" SG_ 437791610 IOM_DEMO_VFG_OIL_TEMP20_A_78 "FDS_HSMU_DEMO20_48";
BA_ "AfdxSignalType" SG_ 437791610 IOM_DEMO_VFG_OIL_TEMP20_A_78 3;
BA_ "AfdxFSaddr" SG_ 437791610 FS_HSMU_DEMO20_49 244;
BA_ "AfdxFDSaddr" SG_ 437791610 FS_HSMU_DEMO20_49 248;
BA_ "AfdxFDSlength" SG_ 437791610 FS_HSMU_DEMO20_49 4;
BA_ "AfdxFDSname" SG_ 437791610 FS_HSMU_DEMO20_49 "FDS_HSMU_DEMO20_49";
BA_ "AfdxSignalType" SG_ 437791610 FS_HSMU_DEMO20_49 6;
BA_ "AfdxFSaddr" SG_ 437791610 IOM_DEMO_VFG_OIL_TEMP20_A_79 244;
BA_ "AfdxFDSaddr" SG_ 437791610 IOM_DEMO_VFG_OIL_TEMP20_A_79 248;
BA_ "AfdxFDSlength" SG_ 437791610 IOM_DEMO_VFG_OIL_TEMP20_A_79 4;
BA_ "AfdxFDSname" SG_ 437791610 IOM_DEMO_VFG_OIL_TEMP20_A_79 "FDS_HSMU_DEMO20_49";
BA_ "AfdxSignalType" SG_ 437791610 IOM_DEMO_VFG_OIL_TEMP20_A_79 3;
BA_ "AfdxFSaddr" SG_ 437791610 FS_HSMU_DEMO20_50 245;
BA_ "AfdxFDSaddr" SG_ 437791610 FS_HSMU_DEMO20_50 252;
BA_ "AfdxFDSlength" SG_ 437791610 FS_HSMU_DEMO20_50 4;
BA_ "AfdxFDSname" SG_ 437791610 FS_HSMU_DEMO20_50 "FDS_HSMU_DEMO20_50";
BA_ "AfdxSignalType" SG_ 437791610 FS_HSMU_DEMO20_50 6;
BA_ "AfdxFSaddr" SG_ 437791610 IOM_DEMO_VFG_OIL_TEMP20_A_80 245;
BA_ "AfdxFDSaddr" SG_ 437791610 IOM_DEMO_VFG_OIL_TEMP20_A_80 252;
BA_ "AfdxFDSlength" SG_ 437791610 IOM_DEMO_VFG_OIL_TEMP20_A_80 4;
BA_ "AfdxFDSname" SG_ 437791610 IOM_DEMO_VFG_OIL_TEMP20_A_80 "FDS_HSMU_DEMO20_50";
BA_ "AfdxSignalType" SG_ 437791610 IOM_DEMO_VFG_OIL_TEMP20_A_80 3;
BA_ "AfdxFSaddr" SG_ 437791610 FS_HSMU_DEMO20_51 246;
BA_ "AfdxFDSaddr" SG_ 437791610 FS_HSMU_DEMO20_51 256;
BA_ "AfdxFDSlength" SG_ 437791610 FS_HSMU_DEMO20_51 4;
BA_ "AfdxFDSname" SG_ 437791610 FS_HSMU_DEMO20_51 "FDS_HSMU_DEMO20_51";
BA_ "AfdxSignalType" SG_ 437791610 FS_HSMU_DEMO20_51 6;
BA_ "AfdxFSaddr" SG_ 437791610 IOM_DEMO_VFG_OIL_TEMP20_A_81 246;
BA_ "AfdxFDSaddr" SG_ 437791610 IOM_DEMO_VFG_OIL_TEMP20_A_81 256;
BA_ "AfdxFDSlength" SG_ 437791610 IOM_DEMO_VFG_OIL_TEMP20_A_81 4;
BA_ "AfdxFDSname" SG_ 437791610 IOM_DEMO_VFG_OIL_TEMP20_A_81 "FDS_HSMU_DEMO20_51";
BA_ "AfdxSignalType" SG_ 437791610 IOM_DEMO_VFG_OIL_TEMP20_A_81 3;
BA_ "AfdxFSaddr" SG_ 437791610 FS_HSMU_DEMO20_52 247;
BA_ "AfdxFDSaddr" SG_ 437791610 FS_HSMU_DEMO20_52 260;
BA_ "AfdxFDSlength" SG_ 437791610 FS_HSMU_DEMO20_52 4;
BA_ "AfdxFDSname" SG_ 437791610 FS_HSMU_DEMO20_52 "FDS_HSMU_DEMO20_52";
BA_ "AfdxSignalType" SG_ 437791610 FS_HSMU_DEMO20_52 6;
BA_ "AfdxFSaddr" SG_ 437791610 IOM_DEMO_VFG_OIL_TEMP20_A_82 247;
BA_ "AfdxFDSaddr" SG_ 437791610 IOM_DEMO_VFG_OIL_TEMP20_A_82 260;
BA_ "AfdxFDSlength" SG_ 437791610 IOM_DEMO_VFG_OIL_TEMP20_A_82 4;
BA_ "AfdxFDSname" SG_ 437791610 IOM_DEMO_VFG_OIL_TEMP20_A_82 "FDS_HSMU_DEMO20_52";
BA_ "AfdxSignalType" SG_ 437791610 IOM_DEMO_VFG_OIL_TEMP20_A_82 3;
BA_ "AfdxFSaddr" SG_ 437791610 FS_HSMU_DEMO20_53 264;
BA_ "AfdxFDSaddr" SG_ 437791610 FS_HSMU_DEMO20_53 268;
BA_ "AfdxFDSlength" SG_ 437791610 FS_HSMU_DEMO20_53 4;
BA_ "AfdxFDSname" SG_ 437791610 FS_HSMU_DEMO20_53 "FDS_HSMU_DEMO20_53";
BA_ "AfdxSignalType" SG_ 437791610 FS_HSMU_DEMO20_53 6;
BA_ "AfdxFSaddr" SG_ 437791610 IOM_DEMO_VFG_OIL_TEMP20_A_83 264;
BA_ "AfdxFDSaddr" SG_ 437791610 IOM_DEMO_VFG_OIL_TEMP20_A_83 268;
BA_ "AfdxFDSlength" SG_ 437791610 IOM_DEMO_VFG_OIL_TEMP20_A_83 4;
BA_ "AfdxFDSname" SG_ 437791610 IOM_DEMO_VFG_OIL_TEMP20_A_83 "FDS_HSMU_DEMO20_53";
BA_ "AfdxSignalType" SG_ 437791610 IOM_DEMO_VFG_OIL_TEMP20_A_83 3;
BA_ "AfdxFSaddr" SG_ 437791610 FS_HSMU_DEMO20_54 265;
BA_ "AfdxFDSaddr" SG_ 437791610 FS_HSMU_DEMO20_54 272;
BA_ "AfdxFDSlength" SG_ 437791610 FS_HSMU_DEMO20_54 4;
BA_ "AfdxFDSname" SG_ 437791610 FS_HSMU_DEMO20_54 "FDS_HSMU_DEMO20_54";
BA_ "AfdxSignalType" SG_ 437791610 FS_HSMU_DEMO20_54 6;
BA_ "AfdxFSaddr" SG_ 437791610 IOM_DEMO_VFG_OIL_TEMP20_A_84 265;
BA_ "AfdxFDSaddr" SG_ 437791610 IOM_DEMO_VFG_OIL_TEMP20_A_84 272;
BA_ "AfdxFDSlength" SG_ 437791610 IOM_DEMO_VFG_OIL_TEMP20_A_84 4;
BA_ "AfdxFDSname" SG_ 437791610 IOM_DEMO_VFG_OIL_TEMP20_A_84 "FDS_HSMU_DEMO20_54";
BA_ "AfdxSignalType" SG_ 437791610 IOM_DEMO_VFG_OIL_TEMP20_A_84 3;
BA_ "AfdxFSaddr" SG_ 437791610 FS_HSMU_DEMO20_55 266;
BA_ "AfdxFDSaddr" SG_ 437791610 FS_HSMU_DEMO20_55 276;
BA_ "AfdxFDSlength" SG_ 437791610 FS_HSMU_DEMO20_55 4;
BA_ "AfdxFDSname" SG_ 437791610 FS_HSMU_DEMO20_55 "FDS_HSMU_DEMO20_55";
BA_ "AfdxSignalType" SG_ 437791610 FS_HSMU_DEMO20_55 6;
BA_ "AfdxFSaddr" SG_ 437791610 IOM_DEMO_VFG_OIL_TEMP20_A_85 266;
BA_ "AfdxFDSaddr" SG_ 437791610 IOM_DEMO_VFG_OIL_TEMP20_A_85 276;
BA_ "AfdxFDSlength" SG_ 437791610 IOM_DEMO_VFG_OIL_TEMP20_A_85 4;
BA_ "AfdxFDSname" SG_ 437791610 IOM_DEMO_VFG_OIL_TEMP20_A_85 "FDS_HSMU_DEMO20_55";
BA_ "AfdxSignalType" SG_ 437791610 IOM_DEMO_VFG_OIL_TEMP20_A_85 3;
BA_ "AfdxFSaddr" SG_ 437791610 FS_HSMU_DEMO20_56 267;
BA_ "AfdxFDSaddr" SG_ 437791610 FS_HSMU_DEMO20_56 280;
BA_ "AfdxFDSlength" SG_ 437791610 FS_HSMU_DEMO20_56 4;
BA_ "AfdxFDSname" SG_ 437791610 FS_HSMU_DEMO20_56 "FDS_HSMU_DEMO20_56";
BA_ "AfdxSignalType" SG_ 437791610 FS_HSMU_DEMO20_56 6;
BA_ "AfdxFSaddr" SG_ 437791610 IOM_DEMO_VFG_OIL_TEMP20_A_86 267;
BA_ "AfdxFDSaddr" SG_ 437791610 IOM_DEMO_VFG_OIL_TEMP20_A_86 280;
BA_ "AfdxFDSlength" SG_ 437791610 IOM_DEMO_VFG_OIL_TEMP20_A_86 4;
BA_ "AfdxFDSname" SG_ 437791610 IOM_DEMO_VFG_OIL_TEMP20_A_86 "FDS_HSMU_DEMO20_56";
BA_ "AfdxSignalType" SG_ 437791610 IOM_DEMO_VFG_OIL_TEMP20_A_86 3;
BA_ "AfdxFSaddr" SG_ 437791610 FS_HSMU_DEMO20_57 284;
BA_ "AfdxFDSaddr" SG_ 437791610 FS_HSMU_DEMO20_57 288;
BA_ "AfdxFDSlength" SG_ 437791610 FS_HSMU_DEMO20_57 4;
BA_ "AfdxFDSname" SG_ 437791610 FS_HSMU_DEMO20_57 "FDS_HSMU_DEMO20_57";
BA_ "AfdxSignalType" SG_ 437791610 FS_HSMU_DEMO20_57 6;
BA_ "AfdxFSaddr" SG_ 437791610 IOM_DEMO_VFG_OIL_TEMP20_A_87 284;
BA_ "AfdxFDSaddr" SG_ 437791610 IOM_DEMO_VFG_OIL_TEMP20_A_87 288;
BA_ "AfdxFDSlength" SG_ 437791610 IOM_DEMO_VFG_OIL_TEMP20_A_87 4;
BA_ "AfdxFDSname" SG_ 437791610 IOM_DEMO_VFG_OIL_TEMP20_A_87 "FDS_HSMU_DEMO20_57";
BA_ "AfdxSignalType" SG_ 437791610 IOM_DEMO_VFG_OIL_TEMP20_A_87 3;
BA_ "AfdxFSaddr" SG_ 437791610 FS_HSMU_DEMO20_58 285;
BA_ "AfdxFDSaddr" SG_ 437791610 FS_HSMU_DEMO20_58 292;
BA_ "AfdxFDSlength" SG_ 437791610 FS_HSMU_DEMO20_58 4;
BA_ "AfdxFDSname" SG_ 437791610 FS_HSMU_DEMO20_58 "FDS_HSMU_DEMO20_58";
BA_ "AfdxSignalType" SG_ 437791610 FS_HSMU_DEMO20_58 6;
BA_ "AfdxFSaddr" SG_ 437791610 IOM_DEMO_VFG_OIL_TEMP20_A_88 285;
BA_ "AfdxFDSaddr" SG_ 437791610 IOM_DEMO_VFG_OIL_TEMP20_A_88 292;
BA_ "AfdxFDSlength" SG_ 437791610 IOM_DEMO_VFG_OIL_TEMP20_A_88 4;
BA_ "AfdxFDSname" SG_ 437791610 IOM_DEMO_VFG_OIL_TEMP20_A_88 "FDS_HSMU_DEMO20_58";
BA_ "AfdxSignalType" SG_ 437791610 IOM_DEMO_VFG_OIL_TEMP20_A_88 3;
BA_ "AfdxFSaddr" SG_ 437791610 FS_HSMU_DEMO20_59 286;
BA_ "AfdxFDSaddr" SG_ 437791610 FS_HSMU_DEMO20_59 296;
BA_ "AfdxFDSlength" SG_ 437791610 FS_HSMU_DEMO20_59 4;
BA_ "AfdxFDSname" SG_ 437791610 FS_HSMU_DEMO20_59 "FDS_HSMU_DEMO20_59";
BA_ "AfdxSignalType" SG_ 437791610 FS_HSMU_DEMO20_59 6;
BA_ "AfdxFSaddr" SG_ 437791610 IOM_DEMO_VFG_OIL_TEMP20_A_89 286;
BA_ "AfdxFDSaddr" SG_ 437791610 IOM_DEMO_VFG_OIL_TEMP20_A_89 296;
BA_ "AfdxFDSlength" SG_ 437791610 IOM_DEMO_VFG_OIL_TEMP20_A_89 4;
BA_ "AfdxFDSname" SG_ 437791610 IOM_DEMO_VFG_OIL_TEMP20_A_89 "FDS_HSMU_DEMO20_59";
BA_ "AfdxSignalType" SG_ 437791610 IOM_DEMO_VFG_OIL_TEMP20_A_89 3;
BA_ "AfdxFSaddr" SG_ 437791610 FS_HSMU_DEMO20_60 287;
BA_ "AfdxFDSaddr" SG_ 437791610 FS_HSMU_DEMO20_60 300;
BA_ "AfdxFDSlength" SG_ 437791610 FS_HSMU_DEMO20_60 4;
BA_ "AfdxFDSname" SG_ 437791610 FS_HSMU_DEMO20_60 "FDS_HSMU_DEMO20_60";
BA_ "AfdxSignalType" SG_ 437791610 FS_HSMU_DEMO20_60 6;
BA_ "AfdxFSaddr" SG_ 437791610 IOM_DEMO_VFG_OIL_TEMP20_A_90 287;
BA_ "AfdxFDSaddr" SG_ 437791610 IOM_DEMO_VFG_OIL_TEMP20_A_90 300;
BA_ "AfdxFDSlength" SG_ 437791610 IOM_DEMO_VFG_OIL_TEMP20_A_90 4;
BA_ "AfdxFDSname" SG_ 437791610 IOM_DEMO_VFG_OIL_TEMP20_A_90 "FDS_HSMU_DEMO20_60";
BA_ "AfdxSignalType" SG_ 437791610 IOM_DEMO_VFG_OIL_TEMP20_A_90 3;
BA_ "AfdxFSaddr" SG_ 437791610 FS_HSMU_DEMO20_61 304;
BA_ "AfdxFDSaddr" SG_ 437791610 FS_HSMU_DEMO20_61 308;
BA_ "AfdxFDSlength" SG_ 437791610 FS_HSMU_DEMO20_61 4;
BA_ "AfdxFDSname" SG_ 437791610 FS_HSMU_DEMO20_61 "FDS_HSMU_DEMO20_61";
BA_ "AfdxSignalType" SG_ 437791610 FS_HSMU_DEMO20_61 6;
BA_ "AfdxFSaddr" SG_ 437791610 IOM_DEMO_VFG_OIL_TEMP20_A_91 304;
BA_ "AfdxFDSaddr" SG_ 437791610 IOM_DEMO_VFG_OIL_TEMP20_A_91 308;
BA_ "AfdxFDSlength" SG_ 437791610 IOM_DEMO_VFG_OIL_TEMP20_A_91 4;
BA_ "AfdxFDSname" SG_ 437791610 IOM_DEMO_VFG_OIL_TEMP20_A_91 "FDS_HSMU_DEMO20_61";
BA_ "AfdxSignalType" SG_ 437791610 IOM_DEMO_VFG_OIL_TEMP20_A_91 3;
BA_ "AfdxFSaddr" SG_ 437791610 FS_HSMU_DEMO20_62 305;
BA_ "AfdxFDSaddr" SG_ 437791610 FS_HSMU_DEMO20_62 312;
BA_ "AfdxFDSlength" SG_ 437791610 FS_HSMU_DEMO20_62 4;
BA_ "AfdxFDSname" SG_ 437791610 FS_HSMU_DEMO20_62 "FDS_HSMU_DEMO20_62";
BA_ "AfdxSignalType" SG_ 437791610 FS_HSMU_DEMO20_62 6;
BA_ "AfdxFSaddr" SG_ 437791610 IOM_DEMO_VFG_OIL_TEMP20_A_92 305;
BA_ "AfdxFDSaddr" SG_ 437791610 IOM_DEMO_VFG_OIL_TEMP20_A_92 312;
BA_ "AfdxFDSlength" SG_ 437791610 IOM_DEMO_VFG_OIL_TEMP20_A_92 4;
BA_ "AfdxFDSname" SG_ 437791610 IOM_DEMO_VFG_OIL_TEMP20_A_92 "FDS_HSMU_DEMO20_62";
BA_ "AfdxSignalType" SG_ 437791610 IOM_DEMO_VFG_OIL_TEMP20_A_92 3;
BA_ "AfdxFSaddr" SG_ 437791610 FS_HSMU_DEMO20_63 306;
BA_ "AfdxFDSaddr" SG_ 437791610 FS_HSMU_DEMO20_63 316;
BA_ "AfdxFDSlength" SG_ 437791610 FS_HSMU_DEMO20_63 4;
BA_ "AfdxFDSname" SG_ 437791610 FS_HSMU_DEMO20_63 "FDS_HSMU_DEMO20_63";
BA_ "AfdxSignalType" SG_ 437791610 FS_HSMU_DEMO20_63 6;
BA_ "AfdxFSaddr" SG_ 437791610 IOM_DEMO_VFG_OIL_TEMP20_A_93 306;
BA_ "AfdxFDSaddr" SG_ 437791610 IOM_DEMO_VFG_OIL_TEMP20_A_93 316;
BA_ "AfdxFDSlength" SG_ 437791610 IOM_DEMO_VFG_OIL_TEMP20_A_93 4;
BA_ "AfdxFDSname" SG_ 437791610 IOM_DEMO_VFG_OIL_TEMP20_A_93 "FDS_HSMU_DEMO20_63";
BA_ "AfdxSignalType" SG_ 437791610 IOM_DEMO_VFG_OIL_TEMP20_A_93 3;
BA_ "AfdxFSaddr" SG_ 437791610 FS_HSMU_DEMO20_64 307;
BA_ "AfdxFDSaddr" SG_ 437791610 FS_HSMU_DEMO20_64 320;
BA_ "AfdxFDSlength" SG_ 437791610 FS_HSMU_DEMO20_64 4;
BA_ "AfdxFDSname" SG_ 437791610 FS_HSMU_DEMO20_64 "FDS_HSMU_DEMO20_64";
BA_ "AfdxSignalType" SG_ 437791610 FS_HSMU_DEMO20_64 6;
BA_ "AfdxFSaddr" SG_ 437791610 IOM_DEMO_VFG_OIL_TEMP20_A_94 307;
BA_ "AfdxFDSaddr" SG_ 437791610 IOM_DEMO_VFG_OIL_TEMP20_A_94 320;
BA_ "AfdxFDSlength" SG_ 437791610 IOM_DEMO_VFG_OIL_TEMP20_A_94 4;
BA_ "AfdxFDSname" SG_ 437791610 IOM_DEMO_VFG_OIL_TEMP20_A_94 "FDS_HSMU_DEMO20_64";
BA_ "AfdxSignalType" SG_ 437791610 IOM_DEMO_VFG_OIL_TEMP20_A_94 3;
BA_ "AfdxFSaddr" SG_ 437791610 FS_HSMU_DEMO20_65 324;
BA_ "AfdxFDSaddr" SG_ 437791610 FS_HSMU_DEMO20_65 328;
BA_ "AfdxFDSlength" SG_ 437791610 FS_HSMU_DEMO20_65 4;
BA_ "AfdxFDSname" SG_ 437791610 FS_HSMU_DEMO20_65 "FDS_HSMU_DEMO20_65";
BA_ "AfdxSignalType" SG_ 437791610 FS_HSMU_DEMO20_65 6;
BA_ "AfdxFSaddr" SG_ 437791610 IOM_DEMO_VFG_OIL_TEMP20_A_95 324;
BA_ "AfdxFDSaddr" SG_ 437791610 IOM_DEMO_VFG_OIL_TEMP20_A_95 328;
BA_ "AfdxFDSlength" SG_ 437791610 IOM_DEMO_VFG_OIL_TEMP20_A_95 4;
BA_ "AfdxFDSname" SG_ 437791610 IOM_DEMO_VFG_OIL_TEMP20_A_95 "FDS_HSMU_DEMO20_65";
BA_ "AfdxSignalType" SG_ 437791610 IOM_DEMO_VFG_OIL_TEMP20_A_95 3;
BA_ "AfdxFSaddr" SG_ 437791610 FS_HSMU_DEMO20_66 325;
BA_ "AfdxFDSaddr" SG_ 437791610 FS_HSMU_DEMO20_66 332;
BA_ "AfdxFDSlength" SG_ 437791610 FS_HSMU_DEMO20_66 4;
BA_ "AfdxFDSname" SG_ 437791610 FS_HSMU_DEMO20_66 "FDS_HSMU_DEMO20_66";
BA_ "AfdxSignalType" SG_ 437791610 FS_HSMU_DEMO20_66 6;
BA_ "AfdxFSaddr" SG_ 437791610 IOM_DEMO_VFG_OIL_TEMP20_A_96 325;
BA_ "AfdxFDSaddr" SG_ 437791610 IOM_DEMO_VFG_OIL_TEMP20_A_96 332;
BA_ "AfdxFDSlength" SG_ 437791610 IOM_DEMO_VFG_OIL_TEMP20_A_96 4;
BA_ "AfdxFDSname" SG_ 437791610 IOM_DEMO_VFG_OIL_TEMP20_A_96 "FDS_HSMU_DEMO20_66";
BA_ "AfdxSignalType" SG_ 437791610 IOM_DEMO_VFG_OIL_TEMP20_A_96 3;
BA_ "AfdxFSaddr" SG_ 437791610 FS_HSMU_DEMO20_67 326;
BA_ "AfdxFDSaddr" SG_ 437791610 FS_HSMU_DEMO20_67 336;
BA_ "AfdxFDSlength" SG_ 437791610 FS_HSMU_DEMO20_67 4;
BA_ "AfdxFDSname" SG_ 437791610 FS_HSMU_DEMO20_67 "FDS_HSMU_DEMO20_67";
BA_ "AfdxSignalType" SG_ 437791610 FS_HSMU_DEMO20_67 6;
BA_ "AfdxFSaddr" SG_ 437791610 IOM_DEMO_VFG_OIL_TEMP20_A_97 326;
BA_ "AfdxFDSaddr" SG_ 437791610 IOM_DEMO_VFG_OIL_TEMP20_A_97 336;
BA_ "AfdxFDSlength" SG_ 437791610 IOM_DEMO_VFG_OIL_TEMP20_A_97 4;
BA_ "AfdxFDSname" SG_ 437791610 IOM_DEMO_VFG_OIL_TEMP20_A_97 "FDS_HSMU_DEMO20_67";
BA_ "AfdxSignalType" SG_ 437791610 IOM_DEMO_VFG_OIL_TEMP20_A_97 3;
BA_ "AfdxFSaddr" SG_ 437791610 FS_HSMU_DEMO20_68 327;
BA_ "AfdxFDSaddr" SG_ 437791610 FS_HSMU_DEMO20_68 340;
BA_ "AfdxFDSlength" SG_ 437791610 FS_HSMU_DEMO20_68 4;
BA_ "AfdxFDSname" SG_ 437791610 FS_HSMU_DEMO20_68 "FDS_HSMU_DEMO20_68";
BA_ "AfdxSignalType" SG_ 437791610 FS_HSMU_DEMO20_68 6;
BA_ "AfdxFSaddr" SG_ 437791610 IOM_DEMO_VFG_OIL_TEMP20_A_98 327;
BA_ "AfdxFDSaddr" SG_ 437791610 IOM_DEMO_VFG_OIL_TEMP20_A_98 340;
BA_ "AfdxFDSlength" SG_ 437791610 IOM_DEMO_VFG_OIL_TEMP20_A_98 4;
BA_ "AfdxFDSname" SG_ 437791610 IOM_DEMO_VFG_OIL_TEMP20_A_98 "FDS_HSMU_DEMO20_68";
BA_ "AfdxSignalType" SG_ 437791610 IOM_DEMO_VFG_OIL_TEMP20_A_98 3;
BA_ "AfdxFSaddr" SG_ 437791610 FS_HSMU_DEMO20_69 344;
BA_ "AfdxFDSaddr" SG_ 437791610 FS_HSMU_DEMO20_69 348;
BA_ "AfdxFDSlength" SG_ 437791610 FS_HSMU_DEMO20_69 4;
BA_ "AfdxFDSname" SG_ 437791610 FS_HSMU_DEMO20_69 "FDS_HSMU_DEMO20_69";
BA_ "AfdxSignalType" SG_ 437791610 FS_HSMU_DEMO20_69 6;
BA_ "AfdxFSaddr" SG_ 437791610 IOM_DEMO_VFG_OIL_TEMP20_A_99 344;
BA_ "AfdxFDSaddr" SG_ 437791610 IOM_DEMO_VFG_OIL_TEMP20_A_99 348;
BA_ "AfdxFDSlength" SG_ 437791610 IOM_DEMO_VFG_OIL_TEMP20_A_99 4;
BA_ "AfdxFDSname" SG_ 437791610 IOM_DEMO_VFG_OIL_TEMP20_A_99 "FDS_HSMU_DEMO20_69";
BA_ "AfdxSignalType" SG_ 437791610 IOM_DEMO_VFG_OIL_TEMP20_A_99 3;
BA_ "AfdxFSaddr" SG_ 437791610 FS_HSMU_DEMO20_70 345;
BA_ "AfdxFDSaddr" SG_ 437791610 FS_HSMU_DEMO20_70 352;
BA_ "AfdxFDSlength" SG_ 437791610 FS_HSMU_DEMO20_70 4;
BA_ "AfdxFDSname" SG_ 437791610 FS_HSMU_DEMO20_70 "FDS_HSMU_DEMO20_70";
BA_ "AfdxSignalType" SG_ 437791610 FS_HSMU_DEMO20_70 6;
BA_ "AfdxFSaddr" SG_ 437791610 IOM_DEMO_VFG_OIL_TEMP20_A_100 345;
BA_ "AfdxFDSaddr" SG_ 437791610 IOM_DEMO_VFG_OIL_TEMP20_A_100 352;
BA_ "AfdxFDSlength" SG_ 437791610 IOM_DEMO_VFG_OIL_TEMP20_A_100 4;
BA_ "AfdxFDSname" SG_ 437791610 IOM_DEMO_VFG_OIL_TEMP20_A_100 "FDS_HSMU_DEMO20_70";
BA_ "AfdxSignalType" SG_ 437791610 IOM_DEMO_VFG_OIL_TEMP20_A_100 3;
BA_ "AfdxFSaddr" SG_ 437791610 FS_HSMU_DEMO20_71 346;
BA_ "AfdxFDSaddr" SG_ 437791610 FS_HSMU_DEMO20_71 356;
BA_ "AfdxFDSlength" SG_ 437791610 FS_HSMU_DEMO20_71 4;
BA_ "AfdxFDSname" SG_ 437791610 FS_HSMU_DEMO20_71 "FDS_HSMU_DEMO20_71";
BA_ "AfdxSignalType" SG_ 437791610 FS_HSMU_DEMO20_71 6;
BA_ "AfdxFSaddr" SG_ 437791610 IOM_DEMO_VFG_OIL_TEMP20_A_101 346;
BA_ "AfdxFDSaddr" SG_ 437791610 IOM_DEMO_VFG_OIL_TEMP20_A_101 356;
BA_ "AfdxFDSlength" SG_ 437791610 IOM_DEMO_VFG_OIL_TEMP20_A_101 4;
BA_ "AfdxFDSname" SG_ 437791610 IOM_DEMO_VFG_OIL_TEMP20_A_101 "FDS_HSMU_DEMO20_71";
BA_ "AfdxSignalType" SG_ 437791610 IOM_DEMO_VFG_OIL_TEMP20_A_101 3;
BA_ "AfdxFSaddr" SG_ 437791610 FS_HSMU_DEMO20_72 347;
BA_ "AfdxFDSaddr" SG_ 437791610 FS_HSMU_DEMO20_72 360;
BA_ "AfdxFDSlength" SG_ 437791610 FS_HSMU_DEMO20_72 4;
BA_ "AfdxFDSname" SG_ 437791610 FS_HSMU_DEMO20_72 "FDS_HSMU_DEMO20_72";
BA_ "AfdxSignalType" SG_ 437791610 FS_HSMU_DEMO20_72 6;
BA_ "AfdxFSaddr" SG_ 437791610 IOM_DEMO_VFG_OIL_TEMP20_A_102 347;
BA_ "AfdxFDSaddr" SG_ 437791610 IOM_DEMO_VFG_OIL_TEMP20_A_102 360;
BA_ "AfdxFDSlength" SG_ 437791610 IOM_DEMO_VFG_OIL_TEMP20_A_102 4;
BA_ "AfdxFDSname" SG_ 437791610 IOM_DEMO_VFG_OIL_TEMP20_A_102 "FDS_HSMU_DEMO20_72";
BA_ "AfdxSignalType" SG_ 437791610 IOM_DEMO_VFG_OIL_TEMP20_A_102 3;
BA_ "AfdxFSaddr" SG_ 437791610 FS_HSMU_DEMO20_73 364;
BA_ "AfdxFDSaddr" SG_ 437791610 FS_HSMU_DEMO20_73 368;
BA_ "AfdxFDSlength" SG_ 437791610 FS_HSMU_DEMO20_73 4;
BA_ "AfdxFDSname" SG_ 437791610 FS_HSMU_DEMO20_73 "FDS_HSMU_DEMO20_73";
BA_ "AfdxSignalType" SG_ 437791610 FS_HSMU_DEMO20_73 6;
BA_ "AfdxFSaddr" SG_ 437791610 IOM_DEMO_VFG_OIL_TEMP20_A_103 364;
BA_ "AfdxFDSaddr" SG_ 437791610 IOM_DEMO_VFG_OIL_TEMP20_A_103 368;
BA_ "AfdxFDSlength" SG_ 437791610 IOM_DEMO_VFG_OIL_TEMP20_A_103 4;
BA_ "AfdxFDSname" SG_ 437791610 IOM_DEMO_VFG_OIL_TEMP20_A_103 "FDS_HSMU_DEMO20_73";
BA_ "AfdxSignalType" SG_ 437791610 IOM_DEMO_VFG_OIL_TEMP20_A_103 3;
BA_ "AfdxFSaddr" SG_ 437791610 FS_HSMU_DEMO20_74 365;
BA_ "AfdxFDSaddr" SG_ 437791610 FS_HSMU_DEMO20_74 372;
BA_ "AfdxFDSlength" SG_ 437791610 FS_HSMU_DEMO20_74 4;
BA_ "AfdxFDSname" SG_ 437791610 FS_HSMU_DEMO20_74 "FDS_HSMU_DEMO20_74";
BA_ "AfdxSignalType" SG_ 437791610 FS_HSMU_DEMO20_74 6;
BA_ "AfdxFSaddr" SG_ 437791610 IOM_DEMO_VFG_OIL_TEMP20_A_104 365;
BA_ "AfdxFDSaddr" SG_ 437791610 IOM_DEMO_VFG_OIL_TEMP20_A_104 372;
BA_ "AfdxFDSlength" SG_ 437791610 IOM_DEMO_VFG_OIL_TEMP20_A_104 4;
BA_ "AfdxFDSname" SG_ 437791610 IOM_DEMO_VFG_OIL_TEMP20_A_104 "FDS_HSMU_DEMO20_74";
BA_ "AfdxSignalType" SG_ 437791610 IOM_DEMO_VFG_OIL_TEMP20_A_104 3;
BA_ "AfdxFSaddr" SG_ 437791610 FS_HSMU_DEMO20_75 366;
BA_ "AfdxFDSaddr" SG_ 437791610 FS_HSMU_DEMO20_75 376;
BA_ "AfdxFDSlength" SG_ 437791610 FS_HSMU_DEMO20_75 4;
BA_ "AfdxFDSname" SG_ 437791610 FS_HSMU_DEMO20_75 "FDS_HSMU_DEMO20_75";
BA_ "AfdxSignalType" SG_ 437791610 FS_HSMU_DEMO20_75 6;
BA_ "AfdxFSaddr" SG_ 437791610 IOM_DEMO_VFG_OIL_TEMP20_A_105 366;
BA_ "AfdxFDSaddr" SG_ 437791610 IOM_DEMO_VFG_OIL_TEMP20_A_105 376;
BA_ "AfdxFDSlength" SG_ 437791610 IOM_DEMO_VFG_OIL_TEMP20_A_105 4;
BA_ "AfdxFDSname" SG_ 437791610 IOM_DEMO_VFG_OIL_TEMP20_A_105 "FDS_HSMU_DEMO20_75";
BA_ "AfdxSignalType" SG_ 437791610 IOM_DEMO_VFG_OIL_TEMP20_A_105 3;
BA_ "AfdxFSaddr" SG_ 437791610 FS_HSMU_DEMO20_76 367;
BA_ "AfdxFDSaddr" SG_ 437791610 FS_HSMU_DEMO20_76 380;
BA_ "AfdxFDSlength" SG_ 437791610 FS_HSMU_DEMO20_76 4;
BA_ "AfdxFDSname" SG_ 437791610 FS_HSMU_DEMO20_76 "FDS_HSMU_DEMO20_76";
BA_ "AfdxSignalType" SG_ 437791610 FS_HSMU_DEMO20_76 6;
BA_ "AfdxFSaddr" SG_ 437791610 IOM_DEMO_VFG_OIL_TEMP20_A_106 367;
BA_ "AfdxFDSaddr" SG_ 437791610 IOM_DEMO_VFG_OIL_TEMP20_A_106 380;
BA_ "AfdxFDSlength" SG_ 437791610 IOM_DEMO_VFG_OIL_TEMP20_A_106 4;
BA_ "AfdxFDSname" SG_ 437791610 IOM_DEMO_VFG_OIL_TEMP20_A_106 "FDS_HSMU_DEMO20_76";
BA_ "AfdxSignalType" SG_ 437791610 IOM_DEMO_VFG_OIL_TEMP20_A_106 3;
BA_ "AfdxFSaddr" SG_ 437791610 FS_HSMU_DEMO20_77 384;
BA_ "AfdxFDSaddr" SG_ 437791610 FS_HSMU_DEMO20_77 388;
BA_ "AfdxFDSlength" SG_ 437791610 FS_HSMU_DEMO20_77 4;
BA_ "AfdxFDSname" SG_ 437791610 FS_HSMU_DEMO20_77 "FDS_HSMU_DEMO20_77";
BA_ "AfdxSignalType" SG_ 437791610 FS_HSMU_DEMO20_77 6;
BA_ "AfdxFSaddr" SG_ 437791610 IOM_DEMO_VFG_OIL_TEMP20_A_107 384;
BA_ "AfdxFDSaddr" SG_ 437791610 IOM_DEMO_VFG_OIL_TEMP20_A_107 388;
BA_ "AfdxFDSlength" SG_ 437791610 IOM_DEMO_VFG_OIL_TEMP20_A_107 4;
BA_ "AfdxFDSname" SG_ 437791610 IOM_DEMO_VFG_OIL_TEMP20_A_107 "FDS_HSMU_DEMO20_77";
BA_ "AfdxSignalType" SG_ 437791610 IOM_DEMO_VFG_OIL_TEMP20_A_107 3;
BA_ "AfdxFSaddr" SG_ 437791610 FS_HSMU_DEMO20_78 385;
BA_ "AfdxFDSaddr" SG_ 437791610 FS_HSMU_DEMO20_78 392;
BA_ "AfdxFDSlength" SG_ 437791610 FS_HSMU_DEMO20_78 4;
BA_ "AfdxFDSname" SG_ 437791610 FS_HSMU_DEMO20_78 "FDS_HSMU_DEMO20_78";
BA_ "AfdxSignalType" SG_ 437791610 FS_HSMU_DEMO20_78 6;
BA_ "AfdxFSaddr" SG_ 437791610 IOM_DEMO_VFG_OIL_TEMP20_A_108 385;
BA_ "AfdxFDSaddr" SG_ 437791610 IOM_DEMO_VFG_OIL_TEMP20_A_108 392;
BA_ "AfdxFDSlength" SG_ 437791610 IOM_DEMO_VFG_OIL_TEMP20_A_108 4;
BA_ "AfdxFDSname" SG_ 437791610 IOM_DEMO_VFG_OIL_TEMP20_A_108 "FDS_HSMU_DEMO20_78";
BA_ "AfdxSignalType" SG_ 437791610 IOM_DEMO_VFG_OIL_TEMP20_A_108 3;
BA_ "AfdxFSaddr" SG_ 437791610 FS_HSMU_DEMO20_79 386;
BA_ "AfdxFDSaddr" SG_ 437791610 FS_HSMU_DEMO20_79 396;
BA_ "AfdxFDSlength" SG_ 437791610 FS_HSMU_DEMO20_79 4;
BA_ "AfdxFDSname" SG_ 437791610 FS_HSMU_DEMO20_79 "FDS_HSMU_DEMO20_79";
BA_ "AfdxSignalType" SG_ 437791610 FS_HSMU_DEMO20_79 6;
BA_ "AfdxFSaddr" SG_ 437791610 IOM_DEMO_VFG_OIL_TEMP20_A_109 386;
BA_ "AfdxFDSaddr" SG_ 437791610 IOM_DEMO_VFG_OIL_TEMP20_A_109 396;
BA_ "AfdxFDSlength" SG_ 437791610 IOM_DEMO_VFG_OIL_TEMP20_A_109 4;
BA_ "AfdxFDSname" SG_ 437791610 IOM_DEMO_VFG_OIL_TEMP20_A_109 "FDS_HSMU_DEMO20_79";
BA_ "AfdxSignalType" SG_ 437791610 IOM_DEMO_VFG_OIL_TEMP20_A_109 3;
BA_ "AfdxFSaddr" SG_ 437791610 FS_HSMU_DEMO20_80 387;
BA_ "AfdxFDSaddr" SG_ 437791610 FS_HSMU_DEMO20_80 400;
BA_ "AfdxFDSlength" SG_ 437791610 FS_HSMU_DEMO20_80 4;
BA_ "AfdxFDSname" SG_ 437791610 FS_HSMU_DEMO20_80 "FDS_HSMU_DEMO20_80";
BA_ "AfdxSignalType" SG_ 437791610 FS_HSMU_DEMO20_80 6;
BA_ "AfdxFSaddr" SG_ 437791610 IOM_DEMO_VFG_OIL_TEMP20_A_110 387;
BA_ "AfdxFDSaddr" SG_ 437791610 IOM_DEMO_VFG_OIL_TEMP20_A_110 400;
BA_ "AfdxFDSlength" SG_ 437791610 IOM_DEMO_VFG_OIL_TEMP20_A_110 4;
BA_ "AfdxFDSname" SG_ 437791610 IOM_DEMO_VFG_OIL_TEMP20_A_110 "FDS_HSMU_DEMO20_80";
BA_ "AfdxSignalType" SG_ 437791610 IOM_DEMO_VFG_OIL_TEMP20_A_110 3;
BA_ "AfdxFSaddr" SG_ 437791610 FS_HSMU_DEMO20_81 404;
BA_ "AfdxFDSaddr" SG_ 437791610 FS_HSMU_DEMO20_81 408;
BA_ "AfdxFDSlength" SG_ 437791610 FS_HSMU_DEMO20_81 4;
BA_ "AfdxFDSname" SG_ 437791610 FS_HSMU_DEMO20_81 "FDS_HSMU_DEMO20_81";
BA_ "AfdxSignalType" SG_ 437791610 FS_HSMU_DEMO20_81 6;
BA_ "AfdxFSaddr" SG_ 437791610 IOM_DEMO_VFG_OIL_TEMP20_A_111 404;
BA_ "AfdxFDSaddr" SG_ 437791610 IOM_DEMO_VFG_OIL_TEMP20_A_111 408;
BA_ "AfdxFDSlength" SG_ 437791610 IOM_DEMO_VFG_OIL_TEMP20_A_111 4;
BA_ "AfdxFDSname" SG_ 437791610 IOM_DEMO_VFG_OIL_TEMP20_A_111 "FDS_HSMU_DEMO20_81";
BA_ "AfdxSignalType" SG_ 437791610 IOM_DEMO_VFG_OIL_TEMP20_A_111 3;
BA_ "AfdxFSaddr" SG_ 437791610 FS_HSMU_DEMO20_82 405;
BA_ "AfdxFDSaddr" SG_ 437791610 FS_HSMU_DEMO20_82 412;
BA_ "AfdxFDSlength" SG_ 437791610 FS_HSMU_DEMO20_82 4;
BA_ "AfdxFDSname" SG_ 437791610 FS_HSMU_DEMO20_82 "FDS_HSMU_DEMO20_82";
BA_ "AfdxSignalType" SG_ 437791610 FS_HSMU_DEMO20_82 6;
BA_ "AfdxFSaddr" SG_ 437791610 IOM_DEMO_VFG_OIL_TEMP20_A_112 405;
BA_ "AfdxFDSaddr" SG_ 437791610 IOM_DEMO_VFG_OIL_TEMP20_A_112 412;
BA_ "AfdxFDSlength" SG_ 437791610 IOM_DEMO_VFG_OIL_TEMP20_A_112 4;
BA_ "AfdxFDSname" SG_ 437791610 IOM_DEMO_VFG_OIL_TEMP20_A_112 "FDS_HSMU_DEMO20_82";
BA_ "AfdxSignalType" SG_ 437791610 IOM_DEMO_VFG_OIL_TEMP20_A_112 3;
BA_ "AfdxFSaddr" SG_ 437791610 FS_HSMU_DEMO20_83 406;
BA_ "AfdxFDSaddr" SG_ 437791610 FS_HSMU_DEMO20_83 416;
BA_ "AfdxFDSlength" SG_ 437791610 FS_HSMU_DEMO20_83 4;
BA_ "AfdxFDSname" SG_ 437791610 FS_HSMU_DEMO20_83 "FDS_HSMU_DEMO20_83";
BA_ "AfdxSignalType" SG_ 437791610 FS_HSMU_DEMO20_83 6;
BA_ "AfdxFSaddr" SG_ 437791610 IOM_DEMO_VFG_OIL_TEMP20_A_113 406;
BA_ "AfdxFDSaddr" SG_ 437791610 IOM_DEMO_VFG_OIL_TEMP20_A_113 416;
BA_ "AfdxFDSlength" SG_ 437791610 IOM_DEMO_VFG_OIL_TEMP20_A_113 4;
BA_ "AfdxFDSname" SG_ 437791610 IOM_DEMO_VFG_OIL_TEMP20_A_113 "FDS_HSMU_DEMO20_83";
BA_ "AfdxSignalType" SG_ 437791610 IOM_DEMO_VFG_OIL_TEMP20_A_113 3;
BA_ "AfdxFSaddr" SG_ 437791610 FS_HSMU_DEMO20_84 407;
BA_ "AfdxFDSaddr" SG_ 437791610 FS_HSMU_DEMO20_84 420;
BA_ "AfdxFDSlength" SG_ 437791610 FS_HSMU_DEMO20_84 4;
BA_ "AfdxFDSname" SG_ 437791610 FS_HSMU_DEMO20_84 "FDS_HSMU_DEMO20_84";
BA_ "AfdxSignalType" SG_ 437791610 FS_HSMU_DEMO20_84 6;
BA_ "AfdxFSaddr" SG_ 437791610 IOM_DEMO_VFG_OIL_TEMP20_A_114 407;
BA_ "AfdxFDSaddr" SG_ 437791610 IOM_DEMO_VFG_OIL_TEMP20_A_114 420;
BA_ "AfdxFDSlength" SG_ 437791610 IOM_DEMO_VFG_OIL_TEMP20_A_114 4;
BA_ "AfdxFDSname" SG_ 437791610 IOM_DEMO_VFG_OIL_TEMP20_A_114 "FDS_HSMU_DEMO20_84";
BA_ "AfdxSignalType" SG_ 437791610 IOM_DEMO_VFG_OIL_TEMP20_A_114 3;
BA_ "AfdxFSaddr" SG_ 437791610 FS_HSMU_DEMO20_85 424;
BA_ "AfdxFDSaddr" SG_ 437791610 FS_HSMU_DEMO20_85 428;
BA_ "AfdxFDSlength" SG_ 437791610 FS_HSMU_DEMO20_85 4;
BA_ "AfdxFDSname" SG_ 437791610 FS_HSMU_DEMO20_85 "FDS_HSMU_DEMO20_85";
BA_ "AfdxSignalType" SG_ 437791610 FS_HSMU_DEMO20_85 6;
BA_ "AfdxFSaddr" SG_ 437791610 IOM_DEMO_VFG_OIL_TEMP20_A_115 424;
BA_ "AfdxFDSaddr" SG_ 437791610 IOM_DEMO_VFG_OIL_TEMP20_A_115 428;
BA_ "AfdxFDSlength" SG_ 437791610 IOM_DEMO_VFG_OIL_TEMP20_A_115 4;
BA_ "AfdxFDSname" SG_ 437791610 IOM_DEMO_VFG_OIL_TEMP20_A_115 "FDS_HSMU_DEMO20_85";
BA_ "AfdxSignalType" SG_ 437791610 IOM_DEMO_VFG_OIL_TEMP20_A_115 3;
BA_ "AfdxFSaddr" SG_ 437791610 FS_HSMU_DEMO20_86 425;
BA_ "AfdxFDSaddr" SG_ 437791610 FS_HSMU_DEMO20_86 432;
BA_ "AfdxFDSlength" SG_ 437791610 FS_HSMU_DEMO20_86 4;
BA_ "AfdxFDSname" SG_ 437791610 FS_HSMU_DEMO20_86 "FDS_HSMU_DEMO20_86";
BA_ "AfdxSignalType" SG_ 437791610 FS_HSMU_DEMO20_86 6;
BA_ "AfdxFSaddr" SG_ 437791610 IOM_DEMO_VFG_OIL_TEMP20_A_116 425;
BA_ "AfdxFDSaddr" SG_ 437791610 IOM_DEMO_VFG_OIL_TEMP20_A_116 432;
BA_ "AfdxFDSlength" SG_ 437791610 IOM_DEMO_VFG_OIL_TEMP20_A_116 4;
BA_ "AfdxFDSname" SG_ 437791610 IOM_DEMO_VFG_OIL_TEMP20_A_116 "FDS_HSMU_DEMO20_86";
BA_ "AfdxSignalType" SG_ 437791610 IOM_DEMO_VFG_OIL_TEMP20_A_116 3;
BA_ "AfdxFSaddr" SG_ 437791610 FS_HSMU_DEMO20_87 426;
BA_ "AfdxFDSaddr" SG_ 437791610 FS_HSMU_DEMO20_87 436;
BA_ "AfdxFDSlength" SG_ 437791610 FS_HSMU_DEMO20_87 4;
BA_ "AfdxFDSname" SG_ 437791610 FS_HSMU_DEMO20_87 "FDS_HSMU_DEMO20_87";
BA_ "AfdxSignalType" SG_ 437791610 FS_HSMU_DEMO20_87 6;
BA_ "AfdxFSaddr" SG_ 437791610 IOM_DEMO_VFG_OIL_TEMP20_A_117 426;
BA_ "AfdxFDSaddr" SG_ 437791610 IOM_DEMO_VFG_OIL_TEMP20_A_117 436;
BA_ "AfdxFDSlength" SG_ 437791610 IOM_DEMO_VFG_OIL_TEMP20_A_117 4;
BA_ "AfdxFDSname" SG_ 437791610 IOM_DEMO_VFG_OIL_TEMP20_A_117 "FDS_HSMU_DEMO20_87";
BA_ "AfdxSignalType" SG_ 437791610 IOM_DEMO_VFG_OIL_TEMP20_A_117 3;
BA_ "AfdxFSaddr" SG_ 437791610 FS_HSMU_DEMO20_88 427;
BA_ "AfdxFDSaddr" SG_ 437791610 FS_HSMU_DEMO20_88 440;
BA_ "AfdxFDSlength" SG_ 437791610 FS_HSMU_DEMO20_88 4;
BA_ "AfdxFDSname" SG_ 437791610 FS_HSMU_DEMO20_88 "FDS_HSMU_DEMO20_88";
BA_ "AfdxSignalType" SG_ 437791610 FS_HSMU_DEMO20_88 6;
BA_ "AfdxFSaddr" SG_ 437791610 IOM_DEMO_VFG_OIL_TEMP20_A_118 427;
BA_ "AfdxFDSaddr" SG_ 437791610 IOM_DEMO_VFG_OIL_TEMP20_A_118 440;
BA_ "AfdxFDSlength" SG_ 437791610 IOM_DEMO_VFG_OIL_TEMP20_A_118 4;
BA_ "AfdxFDSname" SG_ 437791610 IOM_DEMO_VFG_OIL_TEMP20_A_118 "FDS_HSMU_DEMO20_88";
BA_ "AfdxSignalType" SG_ 437791610 IOM_DEMO_VFG_OIL_TEMP20_A_118 3;
BA_ "AfdxFSaddr" SG_ 437791610 FS_HSMU_DEMO20_89 444;
BA_ "AfdxFDSaddr" SG_ 437791610 FS_HSMU_DEMO20_89 448;
BA_ "AfdxFDSlength" SG_ 437791610 FS_HSMU_DEMO20_89 4;
BA_ "AfdxFDSname" SG_ 437791610 FS_HSMU_DEMO20_89 "FDS_HSMU_DEMO20_89";
BA_ "AfdxSignalType" SG_ 437791610 FS_HSMU_DEMO20_89 6;
BA_ "AfdxFSaddr" SG_ 437791610 IOM_DEMO_VFG_OIL_TEMP20_A_119 444;
BA_ "AfdxFDSaddr" SG_ 437791610 IOM_DEMO_VFG_OIL_TEMP20_A_119 448;
BA_ "AfdxFDSlength" SG_ 437791610 IOM_DEMO_VFG_OIL_TEMP20_A_119 4;
BA_ "AfdxFDSname" SG_ 437791610 IOM_DEMO_VFG_OIL_TEMP20_A_119 "FDS_HSMU_DEMO20_89";
BA_ "AfdxSignalType" SG_ 437791610 IOM_DEMO_VFG_OIL_TEMP20_A_119 3;
BA_ "AfdxFSaddr" SG_ 437791610 FS_HSMU_DEMO20_90 445;
BA_ "AfdxFDSaddr" SG_ 437791610 FS_HSMU_DEMO20_90 452;
BA_ "AfdxFDSlength" SG_ 437791610 FS_HSMU_DEMO20_90 4;
BA_ "AfdxFDSname" SG_ 437791610 FS_HSMU_DEMO20_90 "FDS_HSMU_DEMO20_90";
BA_ "AfdxSignalType" SG_ 437791610 FS_HSMU_DEMO20_90 6;
BA_ "AfdxFSaddr" SG_ 437791610 IOM_DEMO_VFG_OIL_TEMP20_A_120 445;
BA_ "AfdxFDSaddr" SG_ 437791610 IOM_DEMO_VFG_OIL_TEMP20_A_120 452;
BA_ "AfdxFDSlength" SG_ 437791610 IOM_DEMO_VFG_OIL_TEMP20_A_120 4;
BA_ "AfdxFDSname" SG_ 437791610 IOM_DEMO_VFG_OIL_TEMP20_A_120 "FDS_HSMU_DEMO20_90";
BA_ "AfdxSignalType" SG_ 437791610 IOM_DEMO_VFG_OIL_TEMP20_A_120 3;
BA_ "AfdxFSaddr" SG_ 437791610 FS_HSMU_DEMO20_91 446;
BA_ "AfdxFDSaddr" SG_ 437791610 FS_HSMU_DEMO20_91 456;
BA_ "AfdxFDSlength" SG_ 437791610 FS_HSMU_DEMO20_91 4;
BA_ "AfdxFDSname" SG_ 437791610 FS_HSMU_DEMO20_91 "FDS_HSMU_DEMO20_91";
BA_ "AfdxSignalType" SG_ 437791610 FS_HSMU_DEMO20_91 6;
BA_ "AfdxFSaddr" SG_ 437791610 IOM_DEMO_VFG_OIL_TEMP20_A_121 446;
BA_ "AfdxFDSaddr" SG_ 437791610 IOM_DEMO_VFG_OIL_TEMP20_A_121 456;
BA_ "AfdxFDSlength" SG_ 437791610 IOM_DEMO_VFG_OIL_TEMP20_A_121 4;
BA_ "AfdxFDSname" SG_ 437791610 IOM_DEMO_VFG_OIL_TEMP20_A_121 "FDS_HSMU_DEMO20_91";
BA_ "AfdxSignalType" SG_ 437791610 IOM_DEMO_VFG_OIL_TEMP20_A_121 3;
BA_ "AfdxFSaddr" SG_ 437791610 FS_HSMU_DEMO20_92 447;
BA_ "AfdxFDSaddr" SG_ 437791610 FS_HSMU_DEMO20_92 460;
BA_ "AfdxFDSlength" SG_ 437791610 FS_HSMU_DEMO20_92 4;
BA_ "AfdxFDSname" SG_ 437791610 FS_HSMU_DEMO20_92 "FDS_HSMU_DEMO20_92";
BA_ "AfdxSignalType" SG_ 437791610 FS_HSMU_DEMO20_92 6;
BA_ "AfdxFSaddr" SG_ 437791610 IOM_DEMO_VFG_OIL_TEMP20_A_122 447;
BA_ "AfdxFDSaddr" SG_ 437791610 IOM_DEMO_VFG_OIL_TEMP20_A_122 460;
BA_ "AfdxFDSlength" SG_ 437791610 IOM_DEMO_VFG_OIL_TEMP20_A_122 4;
BA_ "AfdxFDSname" SG_ 437791610 IOM_DEMO_VFG_OIL_TEMP20_A_122 "FDS_HSMU_DEMO20_92";
BA_ "AfdxSignalType" SG_ 437791610 IOM_DEMO_VFG_OIL_TEMP20_A_122 3;
BA_ "AfdxFSaddr" SG_ 437791610 FS_HSMU_DEMO20_93 464;
BA_ "AfdxFDSaddr" SG_ 437791610 FS_HSMU_DEMO20_93 468;
BA_ "AfdxFDSlength" SG_ 437791610 FS_HSMU_DEMO20_93 4;
BA_ "AfdxFDSname" SG_ 437791610 FS_HSMU_DEMO20_93 "FDS_HSMU_DEMO20_93";
BA_ "AfdxSignalType" SG_ 437791610 FS_HSMU_DEMO20_93 6;
BA_ "AfdxFSaddr" SG_ 437791610 IOM_DEMO_VFG_OIL_TEMP20_A_123 464;
BA_ "AfdxFDSaddr" SG_ 437791610 IOM_DEMO_VFG_OIL_TEMP20_A_123 468;
BA_ "AfdxFDSlength" SG_ 437791610 IOM_DEMO_VFG_OIL_TEMP20_A_123 4;
BA_ "AfdxFDSname" SG_ 437791610 IOM_DEMO_VFG_OIL_TEMP20_A_123 "FDS_HSMU_DEMO20_93";
BA_ "AfdxSignalType" SG_ 437791610 IOM_DEMO_VFG_OIL_TEMP20_A_123 3;
BA_ "AfdxFSaddr" SG_ 437791610 FS_HSMU_DEMO20_94 465;
BA_ "AfdxFDSaddr" SG_ 437791610 FS_HSMU_DEMO20_94 472;
BA_ "AfdxFDSlength" SG_ 437791610 FS_HSMU_DEMO20_94 4;
BA_ "AfdxFDSname" SG_ 437791610 FS_HSMU_DEMO20_94 "FDS_HSMU_DEMO20_94";
BA_ "AfdxSignalType" SG_ 437791610 FS_HSMU_DEMO20_94 6;
BA_ "AfdxFSaddr" SG_ 437791610 IOM_DEMO_VFG_OIL_TEMP20_A_124 465;
BA_ "AfdxFDSaddr" SG_ 437791610 IOM_DEMO_VFG_OIL_TEMP20_A_124 472;
BA_ "AfdxFDSlength" SG_ 437791610 IOM_DEMO_VFG_OIL_TEMP20_A_124 4;
BA_ "AfdxFDSname" SG_ 437791610 IOM_DEMO_VFG_OIL_TEMP20_A_124 "FDS_HSMU_DEMO20_94";
BA_ "AfdxSignalType" SG_ 437791610 IOM_DEMO_VFG_OIL_TEMP20_A_124 3;
BA_ "AfdxFSaddr" SG_ 437791610 FS_HSMU_DEMO20_95 466;
BA_ "AfdxFDSaddr" SG_ 437791610 FS_HSMU_DEMO20_95 476;
BA_ "AfdxFDSlength" SG_ 437791610 FS_HSMU_DEMO20_95 4;
BA_ "AfdxFDSname" SG_ 437791610 FS_HSMU_DEMO20_95 "FDS_HSMU_DEMO20_95";
BA_ "AfdxSignalType" SG_ 437791610 FS_HSMU_DEMO20_95 6;
BA_ "AfdxFSaddr" SG_ 437791610 IOM_DEMO_VFG_OIL_TEMP20_A_125 466;
BA_ "AfdxFDSaddr" SG_ 437791610 IOM_DEMO_VFG_OIL_TEMP20_A_125 476;
BA_ "AfdxFDSlength" SG_ 437791610 IOM_DEMO_VFG_OIL_TEMP20_A_125 4;
BA_ "AfdxFDSname" SG_ 437791610 IOM_DEMO_VFG_OIL_TEMP20_A_125 "FDS_HSMU_DEMO20_95";
BA_ "AfdxSignalType" SG_ 437791610 IOM_DEMO_VFG_OIL_TEMP20_A_125 3;
BA_ "AfdxFSaddr" SG_ 437791610 FS_HSMU_DEMO20_96 467;
BA_ "AfdxFDSaddr" SG_ 437791610 FS_HSMU_DEMO20_96 480;
BA_ "AfdxFDSlength" SG_ 437791610 FS_HSMU_DEMO20_96 4;
BA_ "AfdxFDSname" SG_ 437791610 FS_HSMU_DEMO20_96 "FDS_HSMU_DEMO20_96";
BA_ "AfdxSignalType" SG_ 437791610 FS_HSMU_DEMO20_96 6;
BA_ "AfdxFSaddr" SG_ 437791610 IOM_DEMO_VFG_OIL_TEMP20_A_126 467;
BA_ "AfdxFDSaddr" SG_ 437791610 IOM_DEMO_VFG_OIL_TEMP20_A_126 480;
BA_ "AfdxFDSlength" SG_ 437791610 IOM_DEMO_VFG_OIL_TEMP20_A_126 4;
BA_ "AfdxFDSname" SG_ 437791610 IOM_DEMO_VFG_OIL_TEMP20_A_126 "FDS_HSMU_DEMO20_96";
BA_ "AfdxSignalType" SG_ 437791610 IOM_DEMO_VFG_OIL_TEMP20_A_126 3;
BA_ "AfdxFSaddr" SG_ 437791610 FS_HSMU_DEMO20_97 484;
BA_ "AfdxFDSaddr" SG_ 437791610 FS_HSMU_DEMO20_97 488;
BA_ "AfdxFDSlength" SG_ 437791610 FS_HSMU_DEMO20_97 4;
BA_ "AfdxFDSname" SG_ 437791610 FS_HSMU_DEMO20_97 "FDS_HSMU_DEMO20_97";
BA_ "AfdxSignalType" SG_ 437791610 FS_HSMU_DEMO20_97 6;
BA_ "AfdxFSaddr" SG_ 437791610 IOM_DEMO_VFG_OIL_TEMP20_A_127 484;
BA_ "AfdxFDSaddr" SG_ 437791610 IOM_DEMO_VFG_OIL_TEMP20_A_127 488;
BA_ "AfdxFDSlength" SG_ 437791610 IOM_DEMO_VFG_OIL_TEMP20_A_127 4;
BA_ "AfdxFDSname" SG_ 437791610 IOM_DEMO_VFG_OIL_TEMP20_A_127 "FDS_HSMU_DEMO20_97";
BA_ "AfdxSignalType" SG_ 437791610 IOM_DEMO_VFG_OIL_TEMP20_A_127 3;
BA_ "AfdxFSaddr" SG_ 437791610 FS_HSMU_DEMO20_98 485;
BA_ "AfdxFDSaddr" SG_ 437791610 FS_HSMU_DEMO20_98 492;
BA_ "AfdxFDSlength" SG_ 437791610 FS_HSMU_DEMO20_98 4;
BA_ "AfdxFDSname" SG_ 437791610 FS_HSMU_DEMO20_98 "FDS_HSMU_DEMO20_98";
BA_ "AfdxSignalType" SG_ 437791610 FS_HSMU_DEMO20_98 6;
BA_ "AfdxFSaddr" SG_ 437791610 IOM_DEMO_VFG_OIL_TEMP20_A_128 485;
BA_ "AfdxFDSaddr" SG_ 437791610 IOM_DEMO_VFG_OIL_TEMP20_A_128 492;
BA_ "AfdxFDSlength" SG_ 437791610 IOM_DEMO_VFG_OIL_TEMP20_A_128 4;
BA_ "AfdxFDSname" SG_ 437791610 IOM_DEMO_VFG_OIL_TEMP20_A_128 "FDS_HSMU_DEMO20_98";
BA_ "AfdxSignalType" SG_ 437791610 IOM_DEMO_VFG_OIL_TEMP20_A_128 3;
BA_ "AfdxFSaddr" SG_ 437791610 FS_HSMU_DEMO20_99 486;
BA_ "AfdxFDSaddr" SG_ 437791610 FS_HSMU_DEMO20_99 496;
BA_ "AfdxFDSlength" SG_ 437791610 FS_HSMU_DEMO20_99 4;
BA_ "AfdxFDSname" SG_ 437791610 FS_HSMU_DEMO20_99 "FDS_HSMU_DEMO20_99";
BA_ "AfdxSignalType" SG_ 437791610 FS_HSMU_DEMO20_99 6;
BA_ "AfdxFSaddr" SG_ 437791610 IOM_DEMO_VFG_OIL_TEMP20_A_129 486;
BA_ "AfdxFDSaddr" SG_ 437791610 IOM_DEMO_VFG_OIL_TEMP20_A_129 496;
BA_ "AfdxFDSlength" SG_ 437791610 IOM_DEMO_VFG_OIL_TEMP20_A_129 4;
BA_ "AfdxFDSname" SG_ 437791610 IOM_DEMO_VFG_OIL_TEMP20_A_129 "FDS_HSMU_DEMO20_99";
BA_ "AfdxSignalType" SG_ 437791610 IOM_DEMO_VFG_OIL_TEMP20_A_129 3;
BA_ "AfdxFSaddr" SG_ 437791610 FS_HSMU_DEMO20_100 487;
BA_ "AfdxFDSaddr" SG_ 437791610 FS_HSMU_DEMO20_100 500;
BA_ "AfdxFDSlength" SG_ 437791610 FS_HSMU_DEMO20_100 4;
BA_ "AfdxFDSname" SG_ 437791610 FS_HSMU_DEMO20_100 "FDS_HSMU_DEMO20_100";
BA_ "AfdxSignalType" SG_ 437791610 FS_HSMU_DEMO20_100 6;
BA_ "AfdxFSaddr" SG_ 437791610 IOM_DEMO_VFG_OIL_TEMP20_A_130 487;
BA_ "AfdxFDSaddr" SG_ 437791610 IOM_DEMO_VFG_OIL_TEMP20_A_130 500;
BA_ "AfdxFDSlength" SG_ 437791610 IOM_DEMO_VFG_OIL_TEMP20_A_130 4;
BA_ "AfdxFDSname" SG_ 437791610 IOM_DEMO_VFG_OIL_TEMP20_A_130 "FDS_HSMU_DEMO20_100";
BA_ "AfdxSignalType" SG_ 437791610 IOM_DEMO_VFG_OIL_TEMP20_A_130 3;
BA_ "AfdxFDSaddr" SG_ 437332851 FS_FDS_1_HSMU_DEMO_ALLTYPES 8;
BA_ "AfdxFDSlength" SG_ 437332851 FS_FDS_1_HSMU_DEMO_ALLTYPES 4;
BA_ "AfdxFDSname" SG_ 437332851 FS_FDS_1_HSMU_DEMO_ALLTYPES "FDS_1_HSMU_DEMO_ALLTYPES";
BA_ "AfdxSignalType" SG_ 437332851 FS_FDS_1_HSMU_DEMO_ALLTYPES 6;
BA_ "AfdxFDSaddr" SG_ 437332851 VFG_OIL_TEMP_A_34 8;
BA_ "AfdxFDSlength" SG_ 437332851 VFG_OIL_TEMP_A_34 4;
BA_ "AfdxFDSname" SG_ 437332851 VFG_OIL_TEMP_A_34 "FDS_1_HSMU_DEMO_ALLTYPES";
BA_ "AfdxSignalType" SG_ 437332851 VFG_OIL_TEMP_A_34 3;
BA_ "AfdxFSaddr" SG_ 437332851 FS_FDS_2_HSMU_DEMO_ALLTYPES 5;
BA_ "AfdxFDSaddr" SG_ 437332851 FS_FDS_2_HSMU_DEMO_ALLTYPES 12;
BA_ "AfdxFDSlength" SG_ 437332851 FS_FDS_2_HSMU_DEMO_ALLTYPES 4;
BA_ "AfdxFDSname" SG_ 437332851 FS_FDS_2_HSMU_DEMO_ALLTYPES "FDS_2_HSMU_DEMO_ALLTYPES";
BA_ "AfdxSignalType" SG_ 437332851 FS_FDS_2_HSMU_DEMO_ALLTYPES 6;
BA_ "AfdxFSaddr" SG_ 437332851 VFG_OIL_TEMP_AB_32 5;
BA_ "AfdxFDSaddr" SG_ 437332851 VFG_OIL_TEMP_AB_32 12;
BA_ "AfdxFDSlength" SG_ 437332851 VFG_OIL_TEMP_AB_32 4;
BA_ "AfdxFDSname" SG_ 437332851 VFG_OIL_TEMP_AB_32 "FDS_2_HSMU_DEMO_ALLTYPES";
BA_ "AfdxSignalType" SG_ 437332851 VFG_OIL_TEMP_AB_32 2;
BA_ "AfdxFSaddr" SG_ 437332851 FS_FDS_3_HSMU_DEMO_ALLTYPES 6;
BA_ "AfdxFDSaddr" SG_ 437332851 FS_FDS_3_HSMU_DEMO_ALLTYPES 16;
BA_ "AfdxFDSlength" SG_ 437332851 FS_FDS_3_HSMU_DEMO_ALLTYPES 4;
BA_ "AfdxFDSname" SG_ 437332851 FS_FDS_3_HSMU_DEMO_ALLTYPES "FDS_3_HSMU_DEMO_ALLTYPES";
BA_ "AfdxSignalType" SG_ 437332851 FS_FDS_3_HSMU_DEMO_ALLTYPES 6;
BA_ "AfdxFSaddr" SG_ 437332851 VFG_OIL_TEMP_A_ON 6;
BA_ "AfdxFDSaddr" SG_ 437332851 VFG_OIL_TEMP_A_ON 16;
BA_ "AfdxFDSlength" SG_ 437332851 VFG_OIL_TEMP_A_ON 4;
BA_ "AfdxFDSname" SG_ 437332851 VFG_OIL_TEMP_A_ON "FDS_3_HSMU_DEMO_ALLTYPES";
BA_ "AfdxFSaddr" SG_ 437332851 FS_FDS_4_HSMU_DEMO_ALLTYPES 7;
BA_ "AfdxFDSaddr" SG_ 437332851 FS_FDS_4_HSMU_DEMO_ALLTYPES 20;
BA_ "AfdxFDSlength" SG_ 437332851 FS_FDS_4_HSMU_DEMO_ALLTYPES 4;
BA_ "AfdxFDSname" SG_ 437332851 FS_FDS_4_HSMU_DEMO_ALLTYPES "FDS_4_HSMU_DEMO_ALLTYPES";
BA_ "AfdxSignalType" SG_ 437332851 FS_FDS_4_HSMU_DEMO_ALLTYPES 6;
BA_ "AfdxFSaddr" SG_ 437332851 FLIGHT_GROUND_COND_3 7;
BA_ "AfdxFDSaddr" SG_ 437332851 FLIGHT_GROUND_COND_3 20;
BA_ "AfdxFDSlength" SG_ 437332851 FLIGHT_GROUND_COND_3 4;
BA_ "AfdxFDSname" SG_ 437332851 FLIGHT_GROUND_COND_3 "FDS_4_HSMU_DEMO_ALLTYPES";
BA_ "AfdxSignalType" SG_ 437332851 FLIGHT_GROUND_COND_3 1;
BA_ "AfdxFSaddr" SG_ 437332851 FS_FDS_5_HSMU_DEMO_ALLTYPES 25;
BA_ "AfdxFDSaddr" SG_ 437332851 FS_FDS_5_HSMU_DEMO_ALLTYPES 40;
BA_ "AfdxFDSlength" SG_ 437332851 FS_FDS_5_HSMU_DEMO_ALLTYPES 25;
BA_ "AfdxFDSname" SG_ 437332851 FS_FDS_5_HSMU_DEMO_ALLTYPES "FDS_5_HSMU_DEMO_ALLTYPES";
BA_ "AfdxSignalType" SG_ 437332851 FS_FDS_5_HSMU_DEMO_ALLTYPES 6;
BA_ "AfdxFSaddr" SG_ 437332851 DEMO_STRING14_CITY 25;
BA_ "AfdxFDSaddr" SG_ 437332851 DEMO_STRING14_CITY 40;
BA_ "AfdxFDSlength" SG_ 437332851 DEMO_STRING14_CITY 25;
BA_ "AfdxFDSname" SG_ 437332851 DEMO_STRING14_CITY "FDS_5_HSMU_DEMO_ALLTYPES";
BA_ "AfdxSignalType" SG_ 437332851 DEMO_STRING14_CITY 5;
BA_ "SignalTypeExt" SG_ 437332851 DEMO_STRING14_CITY 1;
BA_ "AfdxFSaddr" SG_ 437332851 DEMO_OPAQUE14_IDENT 25;
BA_ "AfdxFDSaddr" SG_ 437332851 DEMO_OPAQUE14_IDENT 40;
BA_ "AfdxFDSlength" SG_ 437332851 DEMO_OPAQUE14_IDENT 25;
BA_ "AfdxFDSname" SG_ 437332851 DEMO_OPAQUE14_IDENT "FDS_5_HSMU_DEMO_ALLTYPES";
BA_ "AfdxSignalType" SG_ 437332851 DEMO_OPAQUE14_IDENT 4;
BA_ "SignalTypeExt" SG_ 437332851 DEMO_OPAQUE14_IDENT 2;
BA_ "AfdxFDSaddr" SG_ 437267314 FS_FDS_1_HSMU_DEMO_INT3 8;
BA_ "AfdxFDSlength" SG_ 437267314 FS_FDS_1_HSMU_DEMO_INT3 4;
BA_ "AfdxFDSname" SG_ 437267314 FS_FDS_1_HSMU_DEMO_INT3 "FDS_1_HSMU_DEMO_INT3";
BA_ "AfdxSignalType" SG_ 437267314 FS_FDS_1_HSMU_DEMO_INT3 6;
BA_ "AfdxFDSaddr" SG_ 437267314 IOM_DEMO_VFG_OIL_TEMP_A_31 8;
BA_ "AfdxFDSlength" SG_ 437267314 IOM_DEMO_VFG_OIL_TEMP_A_31 4;
BA_ "AfdxFDSname" SG_ 437267314 IOM_DEMO_VFG_OIL_TEMP_A_31 "FDS_1_HSMU_DEMO_INT3";
BA_ "AfdxSignalType" SG_ 437267314 IOM_DEMO_VFG_OIL_TEMP_A_31 3;
BA_ "AfdxFSaddr" SG_ 437267314 FS_FDS_2_HSMU_DEMO_INT3 5;
BA_ "AfdxFDSaddr" SG_ 437267314 FS_FDS_2_HSMU_DEMO_INT3 12;
BA_ "AfdxFDSlength" SG_ 437267314 FS_FDS_2_HSMU_DEMO_INT3 4;
BA_ "AfdxFDSname" SG_ 437267314 FS_FDS_2_HSMU_DEMO_INT3 "FDS_2_HSMU_DEMO_INT3";
BA_ "AfdxSignalType" SG_ 437267314 FS_FDS_2_HSMU_DEMO_INT3 6;
BA_ "AfdxFSaddr" SG_ 437267314 IOM_DEMO_VFG_OIL_TEMP_A_32 5;
BA_ "AfdxFDSaddr" SG_ 437267314 IOM_DEMO_VFG_OIL_TEMP_A_32 12;
BA_ "AfdxFDSlength" SG_ 437267314 IOM_DEMO_VFG_OIL_TEMP_A_32 4;
BA_ "AfdxFDSname" SG_ 437267314 IOM_DEMO_VFG_OIL_TEMP_A_32 "FDS_2_HSMU_DEMO_INT3";
BA_ "AfdxSignalType" SG_ 437267314 IOM_DEMO_VFG_OIL_TEMP_A_32 3;
BA_ "AfdxFSaddr" SG_ 437267314 FS_FDS_3_HSMU_DEMO_INT3 6;
BA_ "AfdxFDSaddr" SG_ 437267314 FS_FDS_3_HSMU_DEMO_INT3 16;
BA_ "AfdxFDSlength" SG_ 437267314 FS_FDS_3_HSMU_DEMO_INT3 4;
BA_ "AfdxFDSname" SG_ 437267314 FS_FDS_3_HSMU_DEMO_INT3 "FDS_3_HSMU_DEMO_INT3";
BA_ "AfdxSignalType" SG_ 437267314 FS_FDS_3_HSMU_DEMO_INT3 6;
BA_ "AfdxFSaddr" SG_ 437267314 IOM_DEMO_VFG_OIL_TEMP_A_33 6;
BA_ "AfdxFDSaddr" SG_ 437267314 IOM_DEMO_VFG_OIL_TEMP_A_33 16;
BA_ "AfdxFDSlength" SG_ 437267314 IOM_DEMO_VFG_OIL_TEMP_A_33 4;
BA_ "AfdxFDSname" SG_ 437267314 IOM_DEMO_VFG_OIL_TEMP_A_33 "FDS_3_HSMU_DEMO_INT3";
BA_ "AfdxSignalType" SG_ 437267314 IOM_DEMO_VFG_OIL_TEMP_A_33 3;
BA_ "AfdxFSaddr" SG_ 437201777 FS_FDS_1_HSMU_DEMO_INT2 5;
BA_ "AfdxFDSaddr" SG_ 437201777 FS_FDS_1_HSMU_DEMO_INT2 12;
BA_ "AfdxFDSlength" SG_ 437201777 FS_FDS_1_HSMU_DEMO_INT2 4;
BA_ "AfdxFDSname" SG_ 437201777 FS_FDS_1_HSMU_DEMO_INT2 "FDS_1_HSMU_DEMO_INT2";
BA_ "AfdxSignalType" SG_ 437201777 FS_FDS_1_HSMU_DEMO_INT2 6;
BA_ "AfdxFSaddr" SG_ 437201777 IOM_DEMO_VFG_OIL_TEMP_A_2_21 5;
BA_ "AfdxFDSaddr" SG_ 437201777 IOM_DEMO_VFG_OIL_TEMP_A_2_21 12;
BA_ "AfdxFDSlength" SG_ 437201777 IOM_DEMO_VFG_OIL_TEMP_A_2_21 4;
BA_ "AfdxFDSname" SG_ 437201777 IOM_DEMO_VFG_OIL_TEMP_A_2_21 "FDS_1_HSMU_DEMO_INT2";
BA_ "AfdxSignalType" SG_ 437201777 IOM_DEMO_VFG_OIL_TEMP_A_2_21 3;
BA_ "AfdxFSaddr" SG_ 437201777 IOM_DEMO_VFG_OIL_TEMP_A_2_22 5;
BA_ "AfdxFDSaddr" SG_ 437201777 IOM_DEMO_VFG_OIL_TEMP_A_2_22 12;
BA_ "AfdxFDSlength" SG_ 437201777 IOM_DEMO_VFG_OIL_TEMP_A_2_22 4;
BA_ "AfdxFDSname" SG_ 437201777 IOM_DEMO_VFG_OIL_TEMP_A_2_22 "FDS_1_HSMU_DEMO_INT2";
BA_ "AfdxSignalType" SG_ 437201777 IOM_DEMO_VFG_OIL_TEMP_A_2_22 3;
BA_ "AfdxFDSaddr" SG_ 437136240 FS_FDS_1_HSMU_DEMO_INT1 8;
BA_ "AfdxFDSlength" SG_ 437136240 FS_FDS_1_HSMU_DEMO_INT1 4;
BA_ "AfdxFDSname" SG_ 437136240 FS_FDS_1_HSMU_DEMO_INT1 "FDS_1_HSMU_DEMO_INT1";
BA_ "AfdxSignalType" SG_ 437136240 FS_FDS_1_HSMU_DEMO_INT1 6;
BA_ "AfdxFDSaddr" SG_ 437136240 IOM_DEMO_VFG_OIL_TEMP_A_2_1 8;
BA_ "AfdxFDSlength" SG_ 437136240 IOM_DEMO_VFG_OIL_TEMP_A_2_1 4;
BA_ "AfdxFDSname" SG_ 437136240 IOM_DEMO_VFG_OIL_TEMP_A_2_1 "FDS_1_HSMU_DEMO_INT1";
BA_ "AfdxSignalType" SG_ 437136240 IOM_DEMO_VFG_OIL_TEMP_A_2_1 3;
BA_ "AfdxFDSaddr" SG_ 437070703 FS_FDS_1_HSMU_DEMO10_FLOAT 8;
BA_ "AfdxFDSlength" SG_ 437070703 FS_FDS_1_HSMU_DEMO10_FLOAT 4;
BA_ "AfdxFDSname" SG_ 437070703 FS_FDS_1_HSMU_DEMO10_FLOAT "FDS_1_HSMU_DEMO10_FLOAT";
BA_ "AfdxSignalType" SG_ 437070703 FS_FDS_1_HSMU_DEMO10_FLOAT 6;
BA_ "AfdxFDSaddr" SG_ 437070703 IOM_DEMO_SYS_PRESS_2_YY_10 8;
BA_ "AfdxFDSlength" SG_ 437070703 IOM_DEMO_SYS_PRESS_2_YY_10 4;
BA_ "AfdxFDSname" SG_ 437070703 IOM_DEMO_SYS_PRESS_2_YY_10 "FDS_1_HSMU_DEMO10_FLOAT";
BA_ "AfdxSignalType" SG_ 437070703 IOM_DEMO_SYS_PRESS_2_YY_10 2;
BA_ "AfdxFDSaddr" SG_ 437005166 FS_FDS_1_HSMU_DEMO9_FLOAT 8;
BA_ "AfdxFDSlength" SG_ 437005166 FS_FDS_1_HSMU_DEMO9_FLOAT 4;
BA_ "AfdxFDSname" SG_ 437005166 FS_FDS_1_HSMU_DEMO9_FLOAT "FDS_1_HSMU_DEMO9_FLOAT";
BA_ "AfdxSignalType" SG_ 437005166 FS_FDS_1_HSMU_DEMO9_FLOAT 6;
BA_ "AfdxFDSaddr" SG_ 437005166 IOM_DEMO_SYS_PRESS_2_YY_9 8;
BA_ "AfdxFDSlength" SG_ 437005166 IOM_DEMO_SYS_PRESS_2_YY_9 4;
BA_ "AfdxFDSname" SG_ 437005166 IOM_DEMO_SYS_PRESS_2_YY_9 "FDS_1_HSMU_DEMO9_FLOAT";
BA_ "AfdxSignalType" SG_ 437005166 IOM_DEMO_SYS_PRESS_2_YY_9 2;
BA_ "AfdxFDSaddr" SG_ 436939629 FS_FDS_1_HSMU_DEMO8_FLOAT 8;
BA_ "AfdxFDSlength" SG_ 436939629 FS_FDS_1_HSMU_DEMO8_FLOAT 4;
BA_ "AfdxFDSname" SG_ 436939629 FS_FDS_1_HSMU_DEMO8_FLOAT "FDS_1_HSMU_DEMO8_FLOAT";
BA_ "AfdxSignalType" SG_ 436939629 FS_FDS_1_HSMU_DEMO8_FLOAT 6;
BA_ "AfdxFDSaddr" SG_ 436939629 IOM_DEMO_SYS_PRESS_2_YY_8 8;
BA_ "AfdxFDSlength" SG_ 436939629 IOM_DEMO_SYS_PRESS_2_YY_8 4;
BA_ "AfdxFDSname" SG_ 436939629 IOM_DEMO_SYS_PRESS_2_YY_8 "FDS_1_HSMU_DEMO8_FLOAT";
BA_ "AfdxSignalType" SG_ 436939629 IOM_DEMO_SYS_PRESS_2_YY_8 2;
BA_ "AfdxFSaddr" SG_ 436874092 FS_FDS_1_HSMU_DEMO7_FLOAT 24;
BA_ "AfdxFDSaddr" SG_ 436874092 FS_FDS_1_HSMU_DEMO7_FLOAT 28;
BA_ "AfdxFDSlength" SG_ 436874092 FS_FDS_1_HSMU_DEMO7_FLOAT 4;
BA_ "AfdxFDSname" SG_ 436874092 FS_FDS_1_HSMU_DEMO7_FLOAT "FDS_1_HSMU_DEMO7_FLOAT";
BA_ "AfdxSignalType" SG_ 436874092 FS_FDS_1_HSMU_DEMO7_FLOAT 6;
BA_ "AfdxFSaddr" SG_ 436874092 IOM_DEMO_SYS_PRESS_2_YY_71 24;
BA_ "AfdxFDSaddr" SG_ 436874092 IOM_DEMO_SYS_PRESS_2_YY_71 28;
BA_ "AfdxFDSlength" SG_ 436874092 IOM_DEMO_SYS_PRESS_2_YY_71 4;
BA_ "AfdxFDSname" SG_ 436874092 IOM_DEMO_SYS_PRESS_2_YY_71 "FDS_1_HSMU_DEMO7_FLOAT";
BA_ "AfdxSignalType" SG_ 436874092 IOM_DEMO_SYS_PRESS_2_YY_71 2;
BA_ "AfdxFSaddr" SG_ 436874092 IOM_DEMO_SYS_PRESS_2_YY_72 24;
BA_ "AfdxFDSaddr" SG_ 436874092 IOM_DEMO_SYS_PRESS_2_YY_72 28;
BA_ "AfdxFDSlength" SG_ 436874092 IOM_DEMO_SYS_PRESS_2_YY_72 4;
BA_ "AfdxFDSname" SG_ 436874092 IOM_DEMO_SYS_PRESS_2_YY_72 "FDS_1_HSMU_DEMO7_FLOAT";
BA_ "AfdxSignalType" SG_ 436874092 IOM_DEMO_SYS_PRESS_2_YY_72 2;
BA_ "AfdxFSaddr" SG_ 436874092 IOM_DEMO_SYS_PRESS_2_YY_73 24;
BA_ "AfdxFDSaddr" SG_ 436874092 IOM_DEMO_SYS_PRESS_2_YY_73 28;
BA_ "AfdxFDSlength" SG_ 436874092 IOM_DEMO_SYS_PRESS_2_YY_73 4;
BA_ "AfdxFDSname" SG_ 436874092 IOM_DEMO_SYS_PRESS_2_YY_73 "FDS_1_HSMU_DEMO7_FLOAT";
BA_ "AfdxSignalType" SG_ 436874092 IOM_DEMO_SYS_PRESS_2_YY_73 2;
BA_ "AfdxFSaddr" SG_ 436874092 IOM_DEMO_SYS_PRESS_2_YY_74 24;
BA_ "AfdxFDSaddr" SG_ 436874092 IOM_DEMO_SYS_PRESS_2_YY_74 28;
BA_ "AfdxFDSlength" SG_ 436874092 IOM_DEMO_SYS_PRESS_2_YY_74 4;
BA_ "AfdxFDSname" SG_ 436874092 IOM_DEMO_SYS_PRESS_2_YY_74 "FDS_1_HSMU_DEMO7_FLOAT";
BA_ "AfdxSignalType" SG_ 436874092 IOM_DEMO_SYS_PRESS_2_YY_74 2;
BA_ "AfdxFSaddr" SG_ 436874092 IOM_DEMO_SYS_PRESS_2_YY_75 24;
BA_ "AfdxFDSaddr" SG_ 436874092 IOM_DEMO_SYS_PRESS_2_YY_75 28;
BA_ "AfdxFDSlength" SG_ 436874092 IOM_DEMO_SYS_PRESS_2_YY_75 4;
BA_ "AfdxFDSname" SG_ 436874092 IOM_DEMO_SYS_PRESS_2_YY_75 "FDS_1_HSMU_DEMO7_FLOAT";
BA_ "AfdxSignalType" SG_ 436874092 IOM_DEMO_SYS_PRESS_2_YY_75 2;
BA_ "AfdxFSaddr" SG_ 436808555 FS_FDS_1_HSMU_DEMO6_FLOAT 7;
BA_ "AfdxFDSaddr" SG_ 436808555 FS_FDS_1_HSMU_DEMO6_FLOAT 20;
BA_ "AfdxFDSlength" SG_ 436808555 FS_FDS_1_HSMU_DEMO6_FLOAT 4;
BA_ "AfdxFDSname" SG_ 436808555 FS_FDS_1_HSMU_DEMO6_FLOAT "FDS_1_HSMU_DEMO6_FLOAT";
BA_ "AfdxSignalType" SG_ 436808555 FS_FDS_1_HSMU_DEMO6_FLOAT 6;
BA_ "AfdxFSaddr" SG_ 436808555 IOM_DEMO_SYS_PRESS_2_YY_61 7;
BA_ "AfdxFDSaddr" SG_ 436808555 IOM_DEMO_SYS_PRESS_2_YY_61 20;
BA_ "AfdxFDSlength" SG_ 436808555 IOM_DEMO_SYS_PRESS_2_YY_61 4;
BA_ "AfdxFDSname" SG_ 436808555 IOM_DEMO_SYS_PRESS_2_YY_61 "FDS_1_HSMU_DEMO6_FLOAT";
BA_ "AfdxSignalType" SG_ 436808555 IOM_DEMO_SYS_PRESS_2_YY_61 2;
BA_ "AfdxFSaddr" SG_ 436808555 IOM_DEMO_SYS_PRESS_2_YY_62 7;
BA_ "AfdxFDSaddr" SG_ 436808555 IOM_DEMO_SYS_PRESS_2_YY_62 20;
BA_ "AfdxFDSlength" SG_ 436808555 IOM_DEMO_SYS_PRESS_2_YY_62 4;
BA_ "AfdxFDSname" SG_ 436808555 IOM_DEMO_SYS_PRESS_2_YY_62 "FDS_1_HSMU_DEMO6_FLOAT";
BA_ "AfdxSignalType" SG_ 436808555 IOM_DEMO_SYS_PRESS_2_YY_62 2;
BA_ "AfdxFSaddr" SG_ 436808555 IOM_DEMO_SYS_PRESS_2_YY_63 7;
BA_ "AfdxFDSaddr" SG_ 436808555 IOM_DEMO_SYS_PRESS_2_YY_63 20;
BA_ "AfdxFDSlength" SG_ 436808555 IOM_DEMO_SYS_PRESS_2_YY_63 4;
BA_ "AfdxFDSname" SG_ 436808555 IOM_DEMO_SYS_PRESS_2_YY_63 "FDS_1_HSMU_DEMO6_FLOAT";
BA_ "AfdxSignalType" SG_ 436808555 IOM_DEMO_SYS_PRESS_2_YY_63 2;
BA_ "AfdxFSaddr" SG_ 436808555 IOM_DEMO_SYS_PRESS_2_YY_64 7;
BA_ "AfdxFDSaddr" SG_ 436808555 IOM_DEMO_SYS_PRESS_2_YY_64 20;
BA_ "AfdxFDSlength" SG_ 436808555 IOM_DEMO_SYS_PRESS_2_YY_64 4;
BA_ "AfdxFDSname" SG_ 436808555 IOM_DEMO_SYS_PRESS_2_YY_64 "FDS_1_HSMU_DEMO6_FLOAT";
BA_ "AfdxSignalType" SG_ 436808555 IOM_DEMO_SYS_PRESS_2_YY_64 2;
BA_ "AfdxFSaddr" SG_ 436743018 FS_FDS_1_HSMU_DEMO5_FLOAT 6;
BA_ "AfdxFDSaddr" SG_ 436743018 FS_FDS_1_HSMU_DEMO5_FLOAT 16;
BA_ "AfdxFDSlength" SG_ 436743018 FS_FDS_1_HSMU_DEMO5_FLOAT 4;
BA_ "AfdxFDSname" SG_ 436743018 FS_FDS_1_HSMU_DEMO5_FLOAT "FDS_1_HSMU_DEMO5_FLOAT";
BA_ "AfdxSignalType" SG_ 436743018 FS_FDS_1_HSMU_DEMO5_FLOAT 6;
BA_ "AfdxFSaddr" SG_ 436743018 IOM_DEMO_SYS_PRESS_2_YY_51 6;
BA_ "AfdxFDSaddr" SG_ 436743018 IOM_DEMO_SYS_PRESS_2_YY_51 16;
BA_ "AfdxFDSlength" SG_ 436743018 IOM_DEMO_SYS_PRESS_2_YY_51 4;
BA_ "AfdxFDSname" SG_ 436743018 IOM_DEMO_SYS_PRESS_2_YY_51 "FDS_1_HSMU_DEMO5_FLOAT";
BA_ "AfdxSignalType" SG_ 436743018 IOM_DEMO_SYS_PRESS_2_YY_51 2;
BA_ "AfdxFSaddr" SG_ 436743018 IOM_DEMO_SYS_PRESS_2_YY_52 6;
BA_ "AfdxFDSaddr" SG_ 436743018 IOM_DEMO_SYS_PRESS_2_YY_52 16;
BA_ "AfdxFDSlength" SG_ 436743018 IOM_DEMO_SYS_PRESS_2_YY_52 4;
BA_ "AfdxFDSname" SG_ 436743018 IOM_DEMO_SYS_PRESS_2_YY_52 "FDS_1_HSMU_DEMO5_FLOAT";
BA_ "AfdxSignalType" SG_ 436743018 IOM_DEMO_SYS_PRESS_2_YY_52 2;
BA_ "AfdxFSaddr" SG_ 436743018 IOM_DEMO_SYS_PRESS_2_YY_5 6;
BA_ "AfdxFDSaddr" SG_ 436743018 IOM_DEMO_SYS_PRESS_2_YY_5 16;
BA_ "AfdxFDSlength" SG_ 436743018 IOM_DEMO_SYS_PRESS_2_YY_5 4;
BA_ "AfdxFDSname" SG_ 436743018 IOM_DEMO_SYS_PRESS_2_YY_5 "FDS_1_HSMU_DEMO5_FLOAT";
BA_ "AfdxSignalType" SG_ 436743018 IOM_DEMO_SYS_PRESS_2_YY_5 2;
BA_ "AfdxFSaddr" SG_ 436677481 FS_FDS_1_HSMU_DEMO4_FLOAT 5;
BA_ "AfdxFDSaddr" SG_ 436677481 FS_FDS_1_HSMU_DEMO4_FLOAT 12;
BA_ "AfdxFDSlength" SG_ 436677481 FS_FDS_1_HSMU_DEMO4_FLOAT 4;
BA_ "AfdxFDSname" SG_ 436677481 FS_FDS_1_HSMU_DEMO4_FLOAT "FDS_1_HSMU_DEMO4_FLOAT";
BA_ "AfdxSignalType" SG_ 436677481 FS_FDS_1_HSMU_DEMO4_FLOAT 6;
BA_ "AfdxFSaddr" SG_ 436677481 IOM_DEMO_SYS_PRESS_2_YY_41 5;
BA_ "AfdxFDSaddr" SG_ 436677481 IOM_DEMO_SYS_PRESS_2_YY_41 12;
BA_ "AfdxFDSlength" SG_ 436677481 IOM_DEMO_SYS_PRESS_2_YY_41 4;
BA_ "AfdxFDSname" SG_ 436677481 IOM_DEMO_SYS_PRESS_2_YY_41 "FDS_1_HSMU_DEMO4_FLOAT";
BA_ "AfdxSignalType" SG_ 436677481 IOM_DEMO_SYS_PRESS_2_YY_41 2;
BA_ "AfdxFSaddr" SG_ 436677481 IOM_DEMO_SYS_PRESS_2_YY_42 5;
BA_ "AfdxFDSaddr" SG_ 436677481 IOM_DEMO_SYS_PRESS_2_YY_42 12;
BA_ "AfdxFDSlength" SG_ 436677481 IOM_DEMO_SYS_PRESS_2_YY_42 4;
BA_ "AfdxFDSname" SG_ 436677481 IOM_DEMO_SYS_PRESS_2_YY_42 "FDS_1_HSMU_DEMO4_FLOAT";
BA_ "AfdxSignalType" SG_ 436677481 IOM_DEMO_SYS_PRESS_2_YY_42 2;
BA_ "AfdxFDSaddr" SG_ 436611944 FS_FDS_1_HSMU_DEMO3_FLOAT 8;
BA_ "AfdxFDSlength" SG_ 436611944 FS_FDS_1_HSMU_DEMO3_FLOAT 4;
BA_ "AfdxFDSname" SG_ 436611944 FS_FDS_1_HSMU_DEMO3_FLOAT "FDS_1_HSMU_DEMO3_FLOAT";
BA_ "AfdxSignalType" SG_ 436611944 FS_FDS_1_HSMU_DEMO3_FLOAT 6;
BA_ "AfdxFDSaddr" SG_ 436611944 IOM_DEMO_SYS_PRESS_2_YY_31 8;
BA_ "AfdxFDSlength" SG_ 436611944 IOM_DEMO_SYS_PRESS_2_YY_31 4;
BA_ "AfdxFDSname" SG_ 436611944 IOM_DEMO_SYS_PRESS_2_YY_31 "FDS_1_HSMU_DEMO3_FLOAT";
BA_ "AfdxSignalType" SG_ 436611944 IOM_DEMO_SYS_PRESS_2_YY_31 2;
BA_ "AfdxFDSaddr" SG_ 436546407 FS_FDS_1_HSMU_DEMO1_FLOAT 8;
BA_ "AfdxFDSlength" SG_ 436546407 FS_FDS_1_HSMU_DEMO1_FLOAT 4;
BA_ "AfdxFDSname" SG_ 436546407 FS_FDS_1_HSMU_DEMO1_FLOAT "FDS_1_HSMU_DEMO1_FLOAT";
BA_ "AfdxSignalType" SG_ 436546407 FS_FDS_1_HSMU_DEMO1_FLOAT 6;
BA_ "AfdxFDSaddr" SG_ 436546407 IOM_DEMO_SYS_PRESS_2_YY_3 8;
BA_ "AfdxFDSlength" SG_ 436546407 IOM_DEMO_SYS_PRESS_2_YY_3 4;
BA_ "AfdxFDSname" SG_ 436546407 IOM_DEMO_SYS_PRESS_2_YY_3 "FDS_1_HSMU_DEMO1_FLOAT";
BA_ "AfdxSignalType" SG_ 436546407 IOM_DEMO_SYS_PRESS_2_YY_3 2;
BA_ "AfdxFSaddr" SG_ 436546407 FS_FDS_2_HSMU_DEMO1_FLOAT 5;
BA_ "AfdxFDSaddr" SG_ 436546407 FS_FDS_2_HSMU_DEMO1_FLOAT 12;
BA_ "AfdxFDSlength" SG_ 436546407 FS_FDS_2_HSMU_DEMO1_FLOAT 4;
BA_ "AfdxFDSname" SG_ 436546407 FS_FDS_2_HSMU_DEMO1_FLOAT "FDS_2_HSMU_DEMO1_FLOAT";
BA_ "AfdxSignalType" SG_ 436546407 FS_FDS_2_HSMU_DEMO1_FLOAT 6;
BA_ "AfdxFSaddr" SG_ 436546407 IOM_DEMO_RSVR_LEVEL_YY_3 5;
BA_ "AfdxFDSaddr" SG_ 436546407 IOM_DEMO_RSVR_LEVEL_YY_3 12;
BA_ "AfdxFDSlength" SG_ 436546407 IOM_DEMO_RSVR_LEVEL_YY_3 4;
BA_ "AfdxFDSname" SG_ 436546407 IOM_DEMO_RSVR_LEVEL_YY_3 "FDS_2_HSMU_DEMO1_FLOAT";
BA_ "AfdxSignalType" SG_ 436546407 IOM_DEMO_RSVR_LEVEL_YY_3 2;
BA_ "AfdxFSaddr" SG_ 436546407 FS_FDS_3_HSMU_DEMO1_FLOAT 6;
BA_ "AfdxFDSaddr" SG_ 436546407 FS_FDS_3_HSMU_DEMO1_FLOAT 16;
BA_ "AfdxFDSlength" SG_ 436546407 FS_FDS_3_HSMU_DEMO1_FLOAT 4;
BA_ "AfdxFDSname" SG_ 436546407 FS_FDS_3_HSMU_DEMO1_FLOAT "FDS_3_HSMU_DEMO1_FLOAT";
BA_ "AfdxSignalType" SG_ 436546407 FS_FDS_3_HSMU_DEMO1_FLOAT 6;
BA_ "AfdxFSaddr" SG_ 436546407 IOM_DEMO_RSVR_MOVABLE_INDEX_YY_3 6;
BA_ "AfdxFDSaddr" SG_ 436546407 IOM_DEMO_RSVR_MOVABLE_INDEX_YY_3 16;
BA_ "AfdxFDSlength" SG_ 436546407 IOM_DEMO_RSVR_MOVABLE_INDEX_YY_3 4;
BA_ "AfdxFDSname" SG_ 436546407 IOM_DEMO_RSVR_MOVABLE_INDEX_YY_3 "FDS_3_HSMU_DEMO1_FLOAT";
BA_ "AfdxSignalType" SG_ 436546407 IOM_DEMO_RSVR_MOVABLE_INDEX_YY_3 2;
BA_ "AfdxFSaddr" SG_ 436546407 FS_FDS_4_HSMU_DEMO1_FLOAT 7;
BA_ "AfdxFDSaddr" SG_ 436546407 FS_FDS_4_HSMU_DEMO1_FLOAT 20;
BA_ "AfdxFDSlength" SG_ 436546407 FS_FDS_4_HSMU_DEMO1_FLOAT 4;
BA_ "AfdxFDSname" SG_ 436546407 FS_FDS_4_HSMU_DEMO1_FLOAT "FDS_4_HSMU_DEMO1_FLOAT";
BA_ "AfdxSignalType" SG_ 436546407 FS_FDS_4_HSMU_DEMO1_FLOAT 6;
BA_ "AfdxFSaddr" SG_ 436546407 IOM_DEMO_NORMAL_BRAKE_PRESSURE_W 7;
BA_ "AfdxFDSaddr" SG_ 436546407 IOM_DEMO_NORMAL_BRAKE_PRESSURE_W 20;
BA_ "AfdxFDSlength" SG_ 436546407 IOM_DEMO_NORMAL_BRAKE_PRESSURE_W 4;
BA_ "AfdxFDSname" SG_ 436546407 IOM_DEMO_NORMAL_BRAKE_PRESSURE_W "FDS_4_HSMU_DEMO1_FLOAT";
BA_ "AfdxSignalType" SG_ 436546407 IOM_DEMO_NORMAL_BRAKE_PRESSURE_W 2;
BA_ "SystemSignalLongSymbol" SG_ 436546407 IOM_DEMO_NORMAL_BRAKE_PRESSURE_W "IOM_DEMO_NORMAL_BRAKE_PRESSURE_WHEEL_11_12_SGX_1_3";
BA_ "AfdxFSaddr" SG_ 436546407 FS_FDS_5_HSMU_DEMO1_FLOAT 24;
BA_ "AfdxFDSaddr" SG_ 436546407 FS_FDS_5_HSMU_DEMO1_FLOAT 28;
BA_ "AfdxFDSlength" SG_ 436546407 FS_FDS_5_HSMU_DEMO1_FLOAT 4;
BA_ "AfdxFDSname" SG_ 436546407 FS_FDS_5_HSMU_DEMO1_FLOAT "FDS_5_HSMU_DEMO1_FLOAT";
BA_ "AfdxSignalType" SG_ 436546407 FS_FDS_5_HSMU_DEMO1_FLOAT 6;
BA_ "AfdxFSaddr" SG_ 436546407 IOM_DEMO_NORMAL_BRAKE_PRESS_0000 24;
BA_ "AfdxFDSaddr" SG_ 436546407 IOM_DEMO_NORMAL_BRAKE_PRESS_0000 28;
BA_ "AfdxFDSlength" SG_ 436546407 IOM_DEMO_NORMAL_BRAKE_PRESS_0000 4;
BA_ "AfdxFDSname" SG_ 436546407 IOM_DEMO_NORMAL_BRAKE_PRESS_0000 "FDS_5_HSMU_DEMO1_FLOAT";
BA_ "AfdxSignalType" SG_ 436546407 IOM_DEMO_NORMAL_BRAKE_PRESS_0000 2;
BA_ "SystemSignalLongSymbol" SG_ 436546407 IOM_DEMO_NORMAL_BRAKE_PRESS_0000 "IOM_DEMO_NORMAL_BRAKE_PRESSURE_WHEEL_13_14_SGX_1_3";
BA_ "AfdxFSaddr" SG_ 436546407 FS_FDS_6_HSMU_DEMO1_FLOAT 25;
BA_ "AfdxFDSaddr" SG_ 436546407 FS_FDS_6_HSMU_DEMO1_FLOAT 32;
BA_ "AfdxFDSlength" SG_ 436546407 FS_FDS_6_HSMU_DEMO1_FLOAT 4;
BA_ "AfdxFDSname" SG_ 436546407 FS_FDS_6_HSMU_DEMO1_FLOAT "FDS_6_HSMU_DEMO1_FLOAT";
BA_ "AfdxSignalType" SG_ 436546407 FS_FDS_6_HSMU_DEMO1_FLOAT 6;
BA_ "AfdxFSaddr" SG_ 436546407 IOM_DEMO_ACCU_PRESSURE_SGX_1_3 25;
BA_ "AfdxFDSaddr" SG_ 436546407 IOM_DEMO_ACCU_PRESSURE_SGX_1_3 32;
BA_ "AfdxFDSlength" SG_ 436546407 IOM_DEMO_ACCU_PRESSURE_SGX_1_3 4;
BA_ "AfdxFDSname" SG_ 436546407 IOM_DEMO_ACCU_PRESSURE_SGX_1_3 "FDS_6_HSMU_DEMO1_FLOAT";
BA_ "AfdxSignalType" SG_ 436546407 IOM_DEMO_ACCU_PRESSURE_SGX_1_3 2;
BA_ "AfdxFDSaddr" SG_ 436480870 FS_FDS_1_HSMU_DEMO1_FLOAT 8;
BA_ "AfdxFDSlength" SG_ 436480870 FS_FDS_1_HSMU_DEMO1_FLOAT 4;
BA_ "AfdxFDSname" SG_ 436480870 FS_FDS_1_HSMU_DEMO1_FLOAT "FDS_1_HSMU_DEMO1_FLOAT";
BA_ "AfdxSignalType" SG_ 436480870 FS_FDS_1_HSMU_DEMO1_FLOAT 6;
BA_ "AfdxFDSaddr" SG_ 436480870 IOM_DEMO_SYS_PRESS_2_YY_3 8;
BA_ "AfdxFDSlength" SG_ 436480870 IOM_DEMO_SYS_PRESS_2_YY_3 4;
BA_ "AfdxFDSname" SG_ 436480870 IOM_DEMO_SYS_PRESS_2_YY_3 "FDS_1_HSMU_DEMO1_FLOAT";
BA_ "AfdxSignalType" SG_ 436480870 IOM_DEMO_SYS_PRESS_2_YY_3 2;
BA_ "AfdxFSaddr" SG_ 436480870 FS_FDS_2_HSMU_DEMO1_FLOAT 5;
BA_ "AfdxFDSaddr" SG_ 436480870 FS_FDS_2_HSMU_DEMO1_FLOAT 12;
BA_ "AfdxFDSlength" SG_ 436480870 FS_FDS_2_HSMU_DEMO1_FLOAT 4;
BA_ "AfdxFDSname" SG_ 436480870 FS_FDS_2_HSMU_DEMO1_FLOAT "FDS_2_HSMU_DEMO1_FLOAT";
BA_ "AfdxSignalType" SG_ 436480870 FS_FDS_2_HSMU_DEMO1_FLOAT 6;
BA_ "AfdxFSaddr" SG_ 436480870 IOM_DEMO_RSVR_LEVEL_YY_3 5;
BA_ "AfdxFDSaddr" SG_ 436480870 IOM_DEMO_RSVR_LEVEL_YY_3 12;
BA_ "AfdxFDSlength" SG_ 436480870 IOM_DEMO_RSVR_LEVEL_YY_3 4;
BA_ "AfdxFDSname" SG_ 436480870 IOM_DEMO_RSVR_LEVEL_YY_3 "FDS_2_HSMU_DEMO1_FLOAT";
BA_ "AfdxSignalType" SG_ 436480870 IOM_DEMO_RSVR_LEVEL_YY_3 2;
BA_ "AfdxFSaddr" SG_ 436480870 FS_FDS_3_HSMU_DEMO1_FLOAT 6;
BA_ "AfdxFDSaddr" SG_ 436480870 FS_FDS_3_HSMU_DEMO1_FLOAT 16;
BA_ "AfdxFDSlength" SG_ 436480870 FS_FDS_3_HSMU_DEMO1_FLOAT 4;
BA_ "AfdxFDSname" SG_ 436480870 FS_FDS_3_HSMU_DEMO1_FLOAT "FDS_3_HSMU_DEMO1_FLOAT";
BA_ "AfdxSignalType" SG_ 436480870 FS_FDS_3_HSMU_DEMO1_FLOAT 6;
BA_ "AfdxFSaddr" SG_ 436480870 IOM_DEMO_RSVR_MOVABLE_INDEX_YY_3 6;
BA_ "AfdxFDSaddr" SG_ 436480870 IOM_DEMO_RSVR_MOVABLE_INDEX_YY_3 16;
BA_ "AfdxFDSlength" SG_ 436480870 IOM_DEMO_RSVR_MOVABLE_INDEX_YY_3 4;
BA_ "AfdxFDSname" SG_ 436480870 IOM_DEMO_RSVR_MOVABLE_INDEX_YY_3 "FDS_3_HSMU_DEMO1_FLOAT";
BA_ "AfdxSignalType" SG_ 436480870 IOM_DEMO_RSVR_MOVABLE_INDEX_YY_3 2;
BA_ "AfdxFSaddr" SG_ 436480870 FS_FDS_4_HSMU_DEMO1_FLOAT 7;
BA_ "AfdxFDSaddr" SG_ 436480870 FS_FDS_4_HSMU_DEMO1_FLOAT 20;
BA_ "AfdxFDSlength" SG_ 436480870 FS_FDS_4_HSMU_DEMO1_FLOAT 4;
BA_ "AfdxFDSname" SG_ 436480870 FS_FDS_4_HSMU_DEMO1_FLOAT "FDS_4_HSMU_DEMO1_FLOAT";
BA_ "AfdxSignalType" SG_ 436480870 FS_FDS_4_HSMU_DEMO1_FLOAT 6;
BA_ "AfdxFSaddr" SG_ 436480870 IOM_DEMO_NORMAL_BRAKE_PRESS_0001 7;
BA_ "AfdxFDSaddr" SG_ 436480870 IOM_DEMO_NORMAL_BRAKE_PRESS_0001 20;
BA_ "AfdxFDSlength" SG_ 436480870 IOM_DEMO_NORMAL_BRAKE_PRESS_0001 4;
BA_ "AfdxFDSname" SG_ 436480870 IOM_DEMO_NORMAL_BRAKE_PRESS_0001 "FDS_4_HSMU_DEMO1_FLOAT";
BA_ "AfdxSignalType" SG_ 436480870 IOM_DEMO_NORMAL_BRAKE_PRESS_0001 2;
BA_ "SystemSignalLongSymbol" SG_ 436480870 IOM_DEMO_NORMAL_BRAKE_PRESS_0001 "IOM_DEMO_NORMAL_BRAKE_PRESSURE_WHEEL_11_12_SGX_1_3";
BA_ "AfdxFSaddr" SG_ 436480870 FS_FDS_5_HSMU_DEMO1_FLOAT 24;
BA_ "AfdxFDSaddr" SG_ 436480870 FS_FDS_5_HSMU_DEMO1_FLOAT 28;
BA_ "AfdxFDSlength" SG_ 436480870 FS_FDS_5_HSMU_DEMO1_FLOAT 4;
BA_ "AfdxFDSname" SG_ 436480870 FS_FDS_5_HSMU_DEMO1_FLOAT "FDS_5_HSMU_DEMO1_FLOAT";
BA_ "AfdxSignalType" SG_ 436480870 FS_FDS_5_HSMU_DEMO1_FLOAT 6;
BA_ "AfdxFSaddr" SG_ 436480870 IOM_DEMO_NORMAL_BRAKE_PRESS_0002 24;
BA_ "AfdxFDSaddr" SG_ 436480870 IOM_DEMO_NORMAL_BRAKE_PRESS_0002 28;
BA_ "AfdxFDSlength" SG_ 436480870 IOM_DEMO_NORMAL_BRAKE_PRESS_0002 4;
BA_ "AfdxFDSname" SG_ 436480870 IOM_DEMO_NORMAL_BRAKE_PRESS_0002 "FDS_5_HSMU_DEMO1_FLOAT";
BA_ "AfdxSignalType" SG_ 436480870 IOM_DEMO_NORMAL_BRAKE_PRESS_0002 2;
BA_ "SystemSignalLongSymbol" SG_ 436480870 IOM_DEMO_NORMAL_BRAKE_PRESS_0002 "IOM_DEMO_NORMAL_BRAKE_PRESSURE_WHEEL_13_14_SGX_1_3";
BA_ "AfdxFSaddr" SG_ 436480870 FS_FDS_6_HSMU_DEMO1_FLOAT 25;
BA_ "AfdxFDSaddr" SG_ 436480870 FS_FDS_6_HSMU_DEMO1_FLOAT 32;
BA_ "AfdxFDSlength" SG_ 436480870 FS_FDS_6_HSMU_DEMO1_FLOAT 4;
BA_ "AfdxFDSname" SG_ 436480870 FS_FDS_6_HSMU_DEMO1_FLOAT "FDS_6_HSMU_DEMO1_FLOAT";
BA_ "AfdxSignalType" SG_ 436480870 FS_FDS_6_HSMU_DEMO1_FLOAT 6;
BA_ "AfdxFSaddr" SG_ 436480870 IOM_DEMO_ACCU_PRESSURE_SGX_1_3 25;
BA_ "AfdxFDSaddr" SG_ 436480870 IOM_DEMO_ACCU_PRESSURE_SGX_1_3 32;
BA_ "AfdxFDSlength" SG_ 436480870 IOM_DEMO_ACCU_PRESSURE_SGX_1_3 4;
BA_ "AfdxFDSname" SG_ 436480870 IOM_DEMO_ACCU_PRESSURE_SGX_1_3 "FDS_6_HSMU_DEMO1_FLOAT";
BA_ "AfdxSignalType" SG_ 436480870 IOM_DEMO_ACCU_PRESSURE_SGX_1_3 2;
VAL_ 437791610 FS_HSMU_DEMO20_1 48 "NCD" 12 "FT" 3 "NO" 0 "ND" ;
VAL_ 437791610 FS_HSMU_DEMO20_2 48 "NCD" 12 "FT" 3 "NO" 0 "ND" ;
VAL_ 437791610 FS_HSMU_DEMO20_3 48 "NCD" 12 "FT" 3 "NO" 0 "ND" ;
VAL_ 437791610 FS_HSMU_DEMO20_4 48 "NCD" 12 "FT" 3 "NO" 0 "ND" ;
VAL_ 437791610 FS_HSMU_DEMO20_5 48 "NCD" 12 "FT" 3 "NO" 0 "ND" ;
VAL_ 437791610 FS_HSMU_DEMO20_6 48 "NCD" 12 "FT" 3 "NO" 0 "ND" ;
VAL_ 437791610 FS_HSMU_DEMO20_7 48 "NCD" 12 "FT" 3 "NO" 0 "ND" ;
VAL_ 437791610 FS_HSMU_DEMO20_8 48 "NCD" 12 "FT" 3 "NO" 0 "ND" ;
VAL_ 437791610 FS_HSMU_DEMO20_9 48 "NCD" 12 "FT" 3 "NO" 0 "ND" ;
VAL_ 437791610 FS_HSMU_DEMO20_10 48 "NCD" 12 "FT" 3 "NO" 0 "ND" ;
VAL_ 437791610 FS_HSMU_DEMO20_11 48 "NCD" 12 "FT" 3 "NO" 0 "ND" ;
VAL_ 437791610 FS_HSMU_DEMO20_12 48 "NCD" 12 "FT" 3 "NO" 0 "ND" ;
VAL_ 437791610 FS_HSMU_DEMO20_13 48 "NCD" 12 "FT" 3 "NO" 0 "ND" ;
VAL_ 437791610 FS_HSMU_DEMO20_14 48 "NCD" 12 "FT" 3 "NO" 0 "ND" ;
VAL_ 437791610 FS_HSMU_DEMO20_15 48 "NCD" 12 "FT" 3 "NO" 0 "ND" ;
VAL_ 437791610 FS_HSMU_DEMO20_16 48 "NCD" 12 "FT" 3 "NO" 0 "ND" ;
VAL_ 437791610 FS_HSMU_DEMO20_17 48 "NCD" 12 "FT" 3 "NO" 0 "ND" ;
VAL_ 437791610 FS_HSMU_DEMO20_18 48 "NCD" 12 "FT" 3 "NO" 0 "ND" ;
VAL_ 437791610 FS_HSMU_DEMO20_19 48 "NCD" 12 "FT" 3 "NO" 0 "ND" ;
VAL_ 437791610 FS_HSMU_DEMO20_20 48 "NCD" 12 "FT" 3 "NO" 0 "ND" ;
VAL_ 437791610 FS_HSMU_DEMO20_21 48 "NCD" 12 "FT" 3 "NO" 0 "ND" ;
VAL_ 437791610 FS_HSMU_DEMO20_22 48 "NCD" 12 "FT" 3 "NO" 0 "ND" ;
VAL_ 437791610 FS_HSMU_DEMO20_23 48 "NCD" 12 "FT" 3 "NO" 0 "ND" ;
VAL_ 437791610 FS_HSMU_DEMO20_24 48 "NCD" 12 "FT" 3 "NO" 0 "ND" ;
VAL_ 437791610 FS_HSMU_DEMO20_25 48 "NCD" 12 "FT" 3 "NO" 0 "ND" ;
VAL_ 437791610 FS_HSMU_DEMO20_26 48 "NCD" 12 "FT" 3 "NO" 0 "ND" ;
VAL_ 437791610 FS_HSMU_DEMO20_27 48 "NCD" 12 "FT" 3 "NO" 0 "ND" ;
VAL_ 437791610 FS_HSMU_DEMO20_28 48 "NCD" 12 "FT" 3 "NO" 0 "ND" ;
VAL_ 437791610 FS_HSMU_DEMO20_29 48 "NCD" 12 "FT" 3 "NO" 0 "ND" ;
VAL_ 437791610 FS_HSMU_DEMO20_30 48 "NCD" 12 "FT" 3 "NO" 0 "ND" ;
VAL_ 437791610 FS_HSMU_DEMO20_31 48 "NCD" 12 "FT" 3 "NO" 0 "ND" ;
VAL_ 437791610 FS_HSMU_DEMO20_32 48 "NCD" 12 "FT" 3 "NO" 0 "ND" ;
VAL_ 437791610 FS_HSMU_DEMO20_33 48 "NCD" 12 "FT" 3 "NO" 0 "ND" ;
VAL_ 437791610 FS_HSMU_DEMO20_34 48 "NCD" 12 "FT" 3 "NO" 0 "ND" ;
VAL_ 437791610 FS_HSMU_DEMO20_35 48 "NCD" 12 "FT" 3 "NO" 0 "ND" ;
VAL_ 437791610 FS_HSMU_DEMO20_36 48 "NCD" 12 "FT" 3 "NO" 0 "ND" ;
VAL_ 437791610 FS_HSMU_DEMO20_37 48 "NCD" 12 "FT" 3 "NO" 0 "ND" ;
VAL_ 437791610 FS_HSMU_DEMO20_38 48 "NCD" 12 "FT" 3 "NO" 0 "ND" ;
VAL_ 437791610 FS_HSMU_DEMO20_39 48 "NCD" 12 "FT" 3 "NO" 0 "ND" ;
VAL_ 437791610 FS_HSMU_DEMO20_40 48 "NCD" 12 "FT" 3 "NO" 0 "ND" ;
VAL_ 437791610 FS_HSMU_DEMO20_41 48 "NCD" 12 "FT" 3 "NO" 0 "ND" ;
VAL_ 437791610 FS_HSMU_DEMO20_42 48 "NCD" 12 "FT" 3 "NO" 0 "ND" ;
VAL_ 437791610 FS_HSMU_DEMO20_43 48 "NCD" 12 "FT" 3 "NO" 0 "ND" ;
VAL_ 437791610 FS_HSMU_DEMO20_44 48 "NCD" 12 "FT" 3 "NO" 0 "ND" ;
VAL_ 437791610 FS_HSMU_DEMO20_45 48 "NCD" 12 "FT" 3 "NO" 0 "ND" ;
VAL_ 437791610 FS_HSMU_DEMO20_46 48 "NCD" 12 "FT" 3 "NO" 0 "ND" ;
VAL_ 437791610 FS_HSMU_DEMO20_47 48 "NCD" 12 "FT" 3 "NO" 0 "ND" ;
VAL_ 437791610 FS_HSMU_DEMO20_48 48 "NCD" 12 "FT" 3 "NO" 0 "ND" ;
VAL_ 437791610 FS_HSMU_DEMO20_49 48 "NCD" 12 "FT" 3 "NO" 0 "ND" ;
VAL_ 437791610 FS_HSMU_DEMO20_50 48 "NCD" 12 "FT" 3 "NO" 0 "ND" ;
VAL_ 437791610 FS_HSMU_DEMO20_51 48 "NCD" 12 "FT" 3 "NO" 0 "ND" ;
VAL_ 437791610 FS_HSMU_DEMO20_52 48 "NCD" 12 "FT" 3 "NO" 0 "ND" ;
VAL_ 437791610 FS_HSMU_DEMO20_53 48 "NCD" 12 "FT" 3 "NO" 0 "ND" ;
VAL_ 437791610 FS_HSMU_DEMO20_54 48 "NCD" 12 "FT" 3 "NO" 0 "ND" ;
VAL_ 437791610 FS_HSMU_DEMO20_55 48 "NCD" 12 "FT" 3 "NO" 0 "ND" ;
VAL_ 437791610 FS_HSMU_DEMO20_56 48 "NCD" 12 "FT" 3 "NO" 0 "ND" ;
VAL_ 437791610 FS_HSMU_DEMO20_57 48 "NCD" 12 "FT" 3 "NO" 0 "ND" ;
VAL_ 437791610 FS_HSMU_DEMO20_58 48 "NCD" 12 "FT" 3 "NO" 0 "ND" ;
VAL_ 437791610 FS_HSMU_DEMO20_59 48 "NCD" 12 "FT" 3 "NO" 0 "ND" ;
VAL_ 437791610 FS_HSMU_DEMO20_60 48 "NCD" 12 "FT" 3 "NO" 0 "ND" ;
VAL_ 437791610 FS_HSMU_DEMO20_61 48 "NCD" 12 "FT" 3 "NO" 0 "ND" ;
VAL_ 437791610 FS_HSMU_DEMO20_62 48 "NCD" 12 "FT" 3 "NO" 0 "ND" ;
VAL_ 437791610 FS_HSMU_DEMO20_63 48 "NCD" 12 "FT" 3 "NO" 0 "ND" ;
VAL_ 437791610 FS_HSMU_DEMO20_64 48 "NCD" 12 "FT" 3 "NO" 0 "ND" ;
VAL_ 437791610 FS_HSMU_DEMO20_65 48 "NCD" 12 "FT" 3 "NO" 0 "ND" ;
VAL_ 437791610 FS_HSMU_DEMO20_66 48 "NCD" 12 "FT" 3 "NO" 0 "ND" ;
VAL_ 437791610 FS_HSMU_DEMO20_67 48 "NCD" 12 "FT" 3 "NO" 0 "ND" ;
VAL_ 437791610 FS_HSMU_DEMO20_68 48 "NCD" 12 "FT" 3 "NO" 0 "ND" ;
VAL_ 437791610 FS_HSMU_DEMO20_69 48 "NCD" 12 "FT" 3 "NO" 0 "ND" ;
VAL_ 437791610 FS_HSMU_DEMO20_70 48 "NCD" 12 "FT" 3 "NO" 0 "ND" ;
VAL_ 437791610 FS_HSMU_DEMO20_71 48 "NCD" 12 "FT" 3 "NO" 0 "ND" ;
VAL_ 437791610 FS_HSMU_DEMO20_72 48 "NCD" 12 "FT" 3 "NO" 0 "ND" ;
VAL_ 437791610 FS_HSMU_DEMO20_73 48 "NCD" 12 "FT" 3 "NO" 0 "ND" ;
VAL_ 437791610 FS_HSMU_DEMO20_74 48 "NCD" 12 "FT" 3 "NO" 0 "ND" ;
VAL_ 437791610 FS_HSMU_DEMO20_75 48 "NCD" 12 "FT" 3 "NO" 0 "ND" ;
VAL_ 437791610 FS_HSMU_DEMO20_76 48 "NCD" 12 "FT" 3 "NO" 0 "ND" ;
VAL_ 437791610 FS_HSMU_DEMO20_77 48 "NCD" 12 "FT" 3 "NO" 0 "ND" ;
VAL_ 437791610 FS_HSMU_DEMO20_78 48 "NCD" 12 "FT" 3 "NO" 0 "ND" ;
VAL_ 437791610 FS_HSMU_DEMO20_79 48 "NCD" 12 "FT" 3 "NO" 0 "ND" ;
VAL_ 437791610 FS_HSMU_DEMO20_80 48 "NCD" 12 "FT" 3 "NO" 0 "ND" ;
VAL_ 437791610 FS_HSMU_DEMO20_81 48 "NCD" 12 "FT" 3 "NO" 0 "ND" ;
VAL_ 437791610 FS_HSMU_DEMO20_82 48 "NCD" 12 "FT" 3 "NO" 0 "ND" ;
VAL_ 437791610 FS_HSMU_DEMO20_83 48 "NCD" 12 "FT" 3 "NO" 0 "ND" ;
VAL_ 437791610 FS_HSMU_DEMO20_84 48 "NCD" 12 "FT" 3 "NO" 0 "ND" ;
VAL_ 437791610 FS_HSMU_DEMO20_85 48 "NCD" 12 "FT" 3 "NO" 0 "ND" ;
VAL_ 437791610 FS_HSMU_DEMO20_86 48 "NCD" 12 "FT" 3 "NO" 0 "ND" ;
VAL_ 437791610 FS_HSMU_DEMO20_87 48 "NCD" 12 "FT" 3 "NO" 0 "ND" ;
VAL_ 437791610 FS_HSMU_DEMO20_88 48 "NCD" 12 "FT" 3 "NO" 0 "ND" ;
VAL_ 437791610 FS_HSMU_DEMO20_89 48 "NCD" 12 "FT" 3 "NO" 0 "ND" ;
VAL_ 437791610 FS_HSMU_DEMO20_90 48 "NCD" 12 "FT" 3 "NO" 0 "ND" ;
VAL_ 437791610 FS_HSMU_DEMO20_91 48 "NCD" 12 "FT" 3 "NO" 0 "ND" ;
VAL_ 437791610 FS_HSMU_DEMO20_92 48 "NCD" 12 "FT" 3 "NO" 0 "ND" ;
VAL_ 437791610 FS_HSMU_DEMO20_93 48 "NCD" 12 "FT" 3 "NO" 0 "ND" ;
VAL_ 437791610 FS_HSMU_DEMO20_94 48 "NCD" 12 "FT" 3 "NO" 0 "ND" ;
VAL_ 437791610 FS_HSMU_DEMO20_95 48 "NCD" 12 "FT" 3 "NO" 0 "ND" ;
VAL_ 437791610 FS_HSMU_DEMO20_96 48 "NCD" 12 "FT" 3 "NO" 0 "ND" ;
VAL_ 437791610 FS_HSMU_DEMO20_97 48 "NCD" 12 "FT" 3 "NO" 0 "ND" ;
VAL_ 437791610 FS_HSMU_DEMO20_98 48 "NCD" 12 "FT" 3 "NO" 0 "ND" ;
VAL_ 437791610 FS_HSMU_DEMO20_99 48 "NCD" 12 "FT" 3 "NO" 0 "ND" ;
VAL_ 437791610 FS_HSMU_DEMO20_100 48 "NCD" 12 "FT" 3 "NO" 0 "ND" ;
VAL_ 437332851 FS_FDS_1_HSMU_DEMO_ALLTYPES 48 "NCD" 12 "FT" 3 "NO" 0 "ND" ;
VAL_ 437332851 FS_FDS_2_HSMU_DEMO_ALLTYPES 48 "NCD" 12 "FT" 3 "NO" 0 "ND" ;
VAL_ 437332851 FS_FDS_3_HSMU_DEMO_ALLTYPES 48 "NCD" 12 "FT" 3 "NO" 0 "ND" ;
VAL_ 437332851 VFG_OIL_TEMP_A_ON 1 "pushed" 0 "not pushed" ;
VAL_ 437332851 FS_FDS_4_HSMU_DEMO_ALLTYPES 48 "NCD" 12 "FT" 3 "NO" 0 "ND" ;
VAL_ 437332851 FLIGHT_GROUND_COND_3 10 "Flight" 5 "Ground" ;
VAL_ 437332851 FS_FDS_5_HSMU_DEMO_ALLTYPES 48 "NCD" 12 "FT" 3 "NO" 0 "ND" ;
VAL_ 437267314 FS_FDS_1_HSMU_DEMO_INT3 48 "NCD" 12 "FT" 3 "NO" 0 "ND" ;
VAL_ 437267314 FS_FDS_2_HSMU_DEMO_INT3 48 "NCD" 12 "FT" 3 "NO" 0 "ND" ;
VAL_ 437267314 FS_FDS_3_HSMU_DEMO_INT3 48 "NCD" 12 "FT" 3 "NO" 0 "ND" ;
VAL_ 437201777 FS_FDS_1_HSMU_DEMO_INT2 48 "NCD" 12 "FT" 3 "NO" 0 "ND" ;
VAL_ 437136240 FS_FDS_1_HSMU_DEMO_INT1 48 "NCD" 12 "FT" 3 "NO" 0 "ND" ;
VAL_ 437070703 FS_FDS_1_HSMU_DEMO10_FLOAT 48 "NCD" 12 "FT" 3 "NO" 0 "ND" ;
VAL_ 437005166 FS_FDS_1_HSMU_DEMO9_FLOAT 48 "NCD" 12 "FT" 3 "NO" 0 "ND" ;
VAL_ 436939629 FS_FDS_1_HSMU_DEMO8_FLOAT 48 "NCD" 12 "FT" 3 "NO" 0 "ND" ;
VAL_ 436874092 FS_FDS_1_HSMU_DEMO7_FLOAT 48 "NCD" 12 "FT" 3 "NO" 0 "ND" ;
VAL_ 436808555 FS_FDS_1_HSMU_DEMO6_FLOAT 48 "NCD" 12 "FT" 3 "NO" 0 "ND" ;
VAL_ 436743018 FS_FDS_1_HSMU_DEMO5_FLOAT 48 "NCD" 12 "FT" 3 "NO" 0 "ND" ;
VAL_ 436677481 FS_FDS_1_HSMU_DEMO4_FLOAT 48 "NCD" 12 "FT" 3 "NO" 0 "ND" ;
VAL_ 436611944 FS_FDS_1_HSMU_DEMO3_FLOAT 48 "NCD" 12 "FT" 3 "NO" 0 "ND" ;
VAL_ 436546407 FS_FDS_1_HSMU_DEMO1_FLOAT 48 "NCD" 12 "FT" 3 "NO" 0 "ND" ;
VAL_ 436546407 FS_FDS_2_HSMU_DEMO1_FLOAT 48 "NCD" 12 "FT" 3 "NO" 0 "ND" ;
VAL_ 436546407 FS_FDS_3_HSMU_DEMO1_FLOAT 48 "NCD" 12 "FT" 3 "NO" 0 "ND" ;
VAL_ 436546407 FS_FDS_4_HSMU_DEMO1_FLOAT 48 "NCD" 12 "FT" 3 "NO" 0 "ND" ;
VAL_ 436546407 FS_FDS_5_HSMU_DEMO1_FLOAT 48 "NCD" 12 "FT" 3 "NO" 0 "ND" ;
VAL_ 436546407 FS_FDS_6_HSMU_DEMO1_FLOAT 48 "NCD" 12 "FT" 3 "NO" 0 "ND" ;
VAL_ 436480870 FS_FDS_1_HSMU_DEMO1_FLOAT 48 "NCD" 12 "FT" 3 "NO" 0 "ND" ;
VAL_ 436480870 FS_FDS_2_HSMU_DEMO1_FLOAT 48 "NCD" 12 "FT" 3 "NO" 0 "ND" ;
VAL_ 436480870 FS_FDS_3_HSMU_DEMO1_FLOAT 48 "NCD" 12 "FT" 3 "NO" 0 "ND" ;
VAL_ 436480870 FS_FDS_4_HSMU_DEMO1_FLOAT 48 "NCD" 12 "FT" 3 "NO" 0 "ND" ;
VAL_ 436480870 FS_FDS_5_HSMU_DEMO1_FLOAT 48 "NCD" 12 "FT" 3 "NO" 0 "ND" ;
VAL_ 436480870 FS_FDS_6_HSMU_DEMO1_FLOAT 48 "NCD" 12 "FT" 3 "NO" 0 "ND" ;
SIG_VALTYPE_ 437332851 VFG_OIL_TEMP_AB_32 : 1;
SIG_VALTYPE_ 437070703 IOM_DEMO_SYS_PRESS_2_YY_10 : 1;
SIG_VALTYPE_ 437005166 IOM_DEMO_SYS_PRESS_2_YY_9 : 1;
SIG_VALTYPE_ 436939629 IOM_DEMO_SYS_PRESS_2_YY_8 : 1;
SIG_VALTYPE_ 436874092 IOM_DEMO_SYS_PRESS_2_YY_71 : 1;
SIG_VALTYPE_ 436874092 IOM_DEMO_SYS_PRESS_2_YY_72 : 1;
SIG_VALTYPE_ 436874092 IOM_DEMO_SYS_PRESS_2_YY_73 : 1;
SIG_VALTYPE_ 436874092 IOM_DEMO_SYS_PRESS_2_YY_74 : 1;
SIG_VALTYPE_ 436874092 IOM_DEMO_SYS_PRESS_2_YY_75 : 1;
SIG_VALTYPE_ 436808555 IOM_DEMO_SYS_PRESS_2_YY_61 : 1;
SIG_VALTYPE_ 436808555 IOM_DEMO_SYS_PRESS_2_YY_62 : 1;
SIG_VALTYPE_ 436808555 IOM_DEMO_SYS_PRESS_2_YY_63 : 1;
SIG_VALTYPE_ 436808555 IOM_DEMO_SYS_PRESS_2_YY_64 : 1;
SIG_VALTYPE_ 436743018 IOM_DEMO_SYS_PRESS_2_YY_51 : 1;
SIG_VALTYPE_ 436743018 IOM_DEMO_SYS_PRESS_2_YY_52 : 1;
SIG_VALTYPE_ 436743018 IOM_DEMO_SYS_PRESS_2_YY_5 : 1;
SIG_VALTYPE_ 436677481 IOM_DEMO_SYS_PRESS_2_YY_41 : 1;
SIG_VALTYPE_ 436677481 IOM_DEMO_SYS_PRESS_2_YY_42 : 1;
SIG_VALTYPE_ 436611944 IOM_DEMO_SYS_PRESS_2_YY_31 : 1;
SIG_VALTYPE_ 436546407 IOM_DEMO_SYS_PRESS_2_YY_3 : 1;
SIG_VALTYPE_ 436546407 IOM_DEMO_RSVR_LEVEL_YY_3 : 1;
SIG_VALTYPE_ 436546407 IOM_DEMO_RSVR_MOVABLE_INDEX_YY_3 : 1;
SIG_VALTYPE_ 436546407 IOM_DEMO_NORMAL_BRAKE_PRESSURE_W : 1;
SIG_VALTYPE_ 436546407 IOM_DEMO_NORMAL_BRAKE_PRESS_0000 : 1;
SIG_VALTYPE_ 436546407 IOM_DEMO_ACCU_PRESSURE_SGX_1_3 : 1;
SIG_VALTYPE_ 436480870 IOM_DEMO_SYS_PRESS_2_YY_3 : 1;
SIG_VALTYPE_ 436480870 IOM_DEMO_RSVR_LEVEL_YY_3 : 1;
SIG_VALTYPE_ 436480870 IOM_DEMO_RSVR_MOVABLE_INDEX_YY_3 : 1;
SIG_VALTYPE_ 436480870 IOM_DEMO_NORMAL_BRAKE_PRESS_0001 : 1;
SIG_VALTYPE_ 436480870 IOM_DEMO_NORMAL_BRAKE_PRESS_0002 : 1;
SIG_VALTYPE_ 436480870 IOM_DEMO_ACCU_PRESSURE_SGX_1_3 : 1;
