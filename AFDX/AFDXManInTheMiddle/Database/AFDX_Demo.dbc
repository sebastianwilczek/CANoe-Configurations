VERSION ""

NS_ :

BS_:

BU_: IOM_APP2 IOM_APP1

BO_ 337519120 RX_MESSAGE_ADR_3: 312 Vector__XXX
 SG_ FS_ADR_TEMP_TAT : 863|8@0+ (1,0) [0|0] "" Vector__XXX
 SG_ RXDEMO_211_TOTALAIRTEMPERATURE_S : 967|32@0- (1,0) [-60|99] "deg C"  IOM_APP1
 SG_ FS_ADR_VELO_CAS : 1007|8@0+ (1,0) [0|0] "" Vector__XXX
 SG_ RXDEMO_206_COMPUTEDAIRSPEED_SG_3 : 1063|32@0- (1,0) [30|450] "kt"  IOM_APP1

BO_ 298197520 RX_MESSAGE_ADR_2: 312 Vector__XXX
 SG_ FS_ADR_TEMP_TAT : 863|8@0+ (1,0) [0|0] "" Vector__XXX
 SG_ RXDEMO_211_TOTALAIRTEMPERAT_0000 : 967|32@0- (1,0) [-60|99] "deg C"  IOM_APP2
 SG_ FS_ADR_VELO_CAS : 1007|8@0+ (1,0) [0|0] "" Vector__XXX
 SG_ RXDEMO_206_COMPUTEDAIRSPEED_SG_2 : 1063|32@0- (1,0) [30|450] "kt"  IOM_APP2

BO_ 258875920 RX_MESSAGE_ADR_1: 312 Vector__XXX
 SG_ FS_ADR_ALT : 39|8@0+ (1,0) [0|0] "" Vector__XXX
 SG_ RXDEMO_203_STANDARDPRESSUREALTIT : 71|32@0- (1,0) [-2000|50000] "ft"  IOM_APP2
 SG_ FS_ADR_PRESSURE_COR_SP : 447|8@0+ (1,0) [0|0] "" Vector__XXX
 SG_ RXDEMO_246_CORR_AVG_STATIC_PRESS : 551|32@0- (1,0) [100|1100] "mbar"  IOM_APP2
 SG_ FS_ADR_PRESSURE_TP : 599|8@0+ (1,0) [0|0] "" Vector__XXX
 SG_ RXDEMO_242_INDICATED_TOTAL_PRESS : 775|32@0- (1,0) [100|1400] "mbar"  IOM_APP2
 SG_ FS_ADR_TEMP_SAT : 855|8@0+ (1,0) [0|0] "" Vector__XXX
 SG_ RXDEMO_213_STATICAIRTEMPERATURE_ : 935|32@0- (1,0) [-99|80] "deg C"  IOM_APP2
 SG_ FS_ADR_TEMP_TAT : 863|8@0+ (1,0) [0|0] "" Vector__XXX
 SG_ RXDEMO_211_TOTALAIRTEMPERAT_0001 : 967|32@0- (1,0) [-60|99] "deg C"  IOM_APP2
 SG_ FS_ADR_VELO_CAS : 1007|8@0+ (1,0) [0|0] "" Vector__XXX
 SG_ RXDEMO_206_COMPUTEDAIRSPEED_SG_1 : 1063|32@0- (1,0) [30|450] "kt"  IOM_APP2
 SG_ FS_ADR_VELO_MA : 1015|8@0+ (1,0) [0|0] "" Vector__XXX
 SG_ RXDEMO_205_MACHNUMBER_SG_1 : 1095|32@0- (1,0) [0.08|1] "Mach"  IOM_APP2

BO_ 4233822370 DEMO_SNMP_TRAP_NMF_AFDX_TX_3: 8192 Vector__XXX

BO_ 4233861889 DEMO_ANSWER_TO_PIT_3: 8192 Vector__XXX

BO_ 4266852514 DEMO_SNMP_TRAP_NBF_AFDX_TX_3: 8192 Vector__XXX

BO_ 4266902806 DEMO_QUEUE_PORT_TFTPC_SND2_3: 512 Vector__XXX

BO_ 4266902804 DEMO_QUEUE_PORT_TFTPC_SND1_3: 512 Vector__XXX

BO_ 4266902805 DEMO_QUEUE_PORT_TFTPC_REQ2_3: 8192 Vector__XXX

BO_ 4266902803 DEMO_QUEUE_PORT_TFTPC_REQ1_3: 8192 Vector__XXX

BO_ 437922684 DEMOMSG22_INT: 1400 IOM_APP1
 SG_ FS_HSMU_DEMO22_1 : 39|8@0+ (1,0) [0|0] "" Vector__XXX
 SG_ IOM_DEMO_VFG_OIL_TEMP22_A_31 : 71|32@0- (1,0) [0|100] "deg C" Vector__XXX
 SG_ FS_HSMU_DEMO22_2 : 47|8@0+ (1,0) [0|0] "" Vector__XXX
 SG_ IOM_DEMO_VFG_OIL_TEMP22_A_32 : 103|32@0- (1,0) [0|100] "deg C" Vector__XXX
 SG_ FS_HSMU_DEMO22_3 : 55|8@0+ (1,0) [0|0] "" Vector__XXX
 SG_ IOM_DEMO_VFG_OIL_TEMP22_A_33 : 135|32@0- (1,0) [0|100] "deg C" Vector__XXX
 SG_ FS_HSMU_DEMO22_4 : 63|8@0+ (1,0) [0|0] "" Vector__XXX
 SG_ IOM_DEMO_VFG_OIL_TEMP22_A_34 : 167|32@0- (1,0) [0|100] "deg C" Vector__XXX
 SG_ FS_HSMU_DEMO22_5 : 199|8@0+ (1,0) [0|0] "" Vector__XXX
 SG_ IOM_DEMO_VFG_OIL_TEMP22_A_35 : 231|32@0- (1,0) [0|100] "deg C" Vector__XXX
 SG_ FS_HSMU_DEMO22_6 : 207|8@0+ (1,0) [0|0] "" Vector__XXX
 SG_ IOM_DEMO_VFG_OIL_TEMP22_A_36 : 263|32@0- (1,0) [0|100] "deg C" Vector__XXX
 SG_ FS_HSMU_DEMO22_7 : 215|8@0+ (1,0) [0|0] "" Vector__XXX
 SG_ IOM_DEMO_VFG_OIL_TEMP22_A_37 : 295|32@0- (1,0) [0|100] "deg C" Vector__XXX
 SG_ FS_HSMU_DEMO22_8 : 223|8@0+ (1,0) [0|0] "" Vector__XXX
 SG_ IOM_DEMO_VFG_OIL_TEMP22_A_38 : 327|32@0- (1,0) [0|100] "deg C" Vector__XXX
 SG_ FS_HSMU_DEMO22_9 : 359|8@0+ (1,0) [0|0] "" Vector__XXX
 SG_ IOM_DEMO_VFG_OIL_TEMP22_A_39 : 391|32@0- (1,0) [0|100] "deg C" Vector__XXX
 SG_ FS_HSMU_DEMO22_10 : 367|8@0+ (1,0) [0|0] "" Vector__XXX
 SG_ IOM_DEMO_VFG_OIL_TEMP22_A_40 : 423|32@0- (1,0) [0|100] "deg C" Vector__XXX
 SG_ FS_HSMU_DEMO22_11 : 375|8@0+ (1,0) [0|0] "" Vector__XXX
 SG_ IOM_DEMO_VFG_OIL_TEMP22_A_41 : 455|32@0- (1,0) [0|100] "deg C" Vector__XXX
 SG_ FS_HSMU_DEMO22_12 : 383|8@0+ (1,0) [0|0] "" Vector__XXX
 SG_ IOM_DEMO_VFG_OIL_TEMP22_A_42 : 487|32@0- (1,0) [0|100] "deg C" Vector__XXX
 SG_ FS_HSMU_DEMO22_13 : 519|8@0+ (1,0) [0|0] "" Vector__XXX
 SG_ IOM_DEMO_VFG_OIL_TEMP22_A_43 : 551|32@0- (1,0) [0|100] "deg C" Vector__XXX
 SG_ FS_HSMU_DEMO22_14 : 527|8@0+ (1,0) [0|0] "" Vector__XXX
 SG_ IOM_DEMO_VFG_OIL_TEMP22_A_44 : 583|32@0- (1,0) [0|100] "deg C" Vector__XXX
 SG_ FS_HSMU_DEMO22_15 : 535|8@0+ (1,0) [0|0] "" Vector__XXX
 SG_ IOM_DEMO_VFG_OIL_TEMP22_A_45 : 615|32@0- (1,0) [0|100] "deg C" Vector__XXX
 SG_ FS_HSMU_DEMO22_16 : 543|8@0+ (1,0) [0|0] "" Vector__XXX
 SG_ IOM_DEMO_VFG_OIL_TEMP22_A_46 : 647|32@0- (1,0) [0|100] "deg C" Vector__XXX
 SG_ FS_HSMU_DEMO22_17 : 679|8@0+ (1,0) [0|0] "" Vector__XXX
 SG_ IOM_DEMO_VFG_OIL_TEMP22_A_47 : 711|32@0- (1,0) [0|100] "deg C" Vector__XXX
 SG_ FS_HSMU_DEMO22_18 : 687|8@0+ (1,0) [0|0] "" Vector__XXX
 SG_ IOM_DEMO_VFG_OIL_TEMP22_A_48 : 743|32@0- (1,0) [0|100] "deg C" Vector__XXX
 SG_ FS_HSMU_DEMO22_19 : 695|8@0+ (1,0) [0|0] "" Vector__XXX
 SG_ IOM_DEMO_VFG_OIL_TEMP22_A_49 : 775|32@0- (1,0) [0|100] "deg C" Vector__XXX
 SG_ FS_HSMU_DEMO22_20 : 703|8@0+ (1,0) [0|0] "" Vector__XXX
 SG_ IOM_DEMO_VFG_OIL_TEMP22_A_50 : 807|32@0- (1,0) [0|100] "deg C" Vector__XXX
 SG_ FS_HSMU_DEMO22_21 : 839|8@0+ (1,0) [0|0] "" Vector__XXX
 SG_ IOM_DEMO_VFG_OIL_TEMP22_A_51 : 871|32@0- (1,0) [0|100] "deg C" Vector__XXX

BO_ 437857147 DEMOMSG21_INT: 1400 IOM_APP1
 SG_ FS_HSMU_DEMO21_1 : 39|8@0+ (1,0) [0|0] "" Vector__XXX
 SG_ IOM_DEMO_VFG_OIL_TEMP21_A_31 : 71|32@0- (1,0) [0|100] "deg C" Vector__XXX
 SG_ FS_HSMU_DEMO21_2 : 47|8@0+ (1,0) [0|0] "" Vector__XXX
 SG_ IOM_DEMO_VFG_OIL_TEMP21_A_32 : 103|32@0- (1,0) [0|100] "deg C" Vector__XXX
 SG_ FS_HSMU_DEMO21_3 : 55|8@0+ (1,0) [0|0] "" Vector__XXX
 SG_ IOM_DEMO_VFG_OIL_TEMP21_A_33 : 135|32@0- (1,0) [0|100] "deg C" Vector__XXX
 SG_ FS_HSMU_DEMO21_4 : 63|8@0+ (1,0) [0|0] "" Vector__XXX
 SG_ IOM_DEMO_VFG_OIL_TEMP21_A_34 : 167|32@0- (1,0) [0|100] "deg C" Vector__XXX
 SG_ FS_HSMU_DEMO21_5 : 199|8@0+ (1,0) [0|0] "" Vector__XXX
 SG_ IOM_DEMO_VFG_OIL_TEMP21_A_35 : 231|32@0- (1,0) [0|100] "deg C" Vector__XXX
 SG_ FS_HSMU_DEMO21_6 : 207|8@0+ (1,0) [0|0] "" Vector__XXX
 SG_ IOM_DEMO_VFG_OIL_TEMP21_A_36 : 263|32@0- (1,0) [0|100] "deg C" Vector__XXX
 SG_ FS_HSMU_DEMO21_7 : 215|8@0+ (1,0) [0|0] "" Vector__XXX
 SG_ IOM_DEMO_VFG_OIL_TEMP21_A_37 : 295|32@0- (1,0) [0|100] "deg C" Vector__XXX
 SG_ FS_HSMU_DEMO21_8 : 223|8@0+ (1,0) [0|0] "" Vector__XXX
 SG_ IOM_DEMO_VFG_OIL_TEMP21_A_38 : 327|32@0- (1,0) [0|100] "deg C" Vector__XXX
 SG_ FS_HSMU_DEMO21_9 : 359|8@0+ (1,0) [0|0] "" Vector__XXX
 SG_ IOM_DEMO_VFG_OIL_TEMP21_A_39 : 391|32@0- (1,0) [0|100] "deg C" Vector__XXX
 SG_ FS_HSMU_DEMO21_10 : 367|8@0+ (1,0) [0|0] "" Vector__XXX
 SG_ IOM_DEMO_VFG_OIL_TEMP21_A_40 : 423|32@0- (1,0) [0|100] "deg C" Vector__XXX
 SG_ FS_HSMU_DEMO21_11 : 375|8@0+ (1,0) [0|0] "" Vector__XXX
 SG_ IOM_DEMO_VFG_OIL_TEMP21_A_41 : 455|32@0- (1,0) [0|100] "deg C" Vector__XXX
 SG_ FS_HSMU_DEMO21_12 : 383|8@0+ (1,0) [0|0] "" Vector__XXX
 SG_ IOM_DEMO_VFG_OIL_TEMP21_A_42 : 487|32@0- (1,0) [0|100] "deg C" Vector__XXX
 SG_ FS_HSMU_DEMO21_13 : 519|8@0+ (1,0) [0|0] "" Vector__XXX
 SG_ IOM_DEMO_VFG_OIL_TEMP21_A_43 : 551|32@0- (1,0) [0|100] "deg C" Vector__XXX
 SG_ FS_HSMU_DEMO21_14 : 527|8@0+ (1,0) [0|0] "" Vector__XXX
 SG_ IOM_DEMO_VFG_OIL_TEMP21_A_44 : 583|32@0- (1,0) [0|100] "deg C" Vector__XXX
 SG_ FS_HSMU_DEMO21_15 : 535|8@0+ (1,0) [0|0] "" Vector__XXX
 SG_ IOM_DEMO_VFG_OIL_TEMP21_A_45 : 615|32@0- (1,0) [0|100] "deg C" Vector__XXX
 SG_ FS_HSMU_DEMO21_16 : 543|8@0+ (1,0) [0|0] "" Vector__XXX
 SG_ IOM_DEMO_VFG_OIL_TEMP21_A_46 : 647|32@0- (1,0) [0|100] "deg C" Vector__XXX
 SG_ FS_HSMU_DEMO21_17 : 679|8@0+ (1,0) [0|0] "" Vector__XXX
 SG_ IOM_DEMO_VFG_OIL_TEMP21_A_47 : 711|32@0- (1,0) [0|100] "deg C" Vector__XXX
 SG_ FS_HSMU_DEMO21_18 : 687|8@0+ (1,0) [0|0] "" Vector__XXX
 SG_ IOM_DEMO_VFG_OIL_TEMP21_A_48 : 743|32@0- (1,0) [0|100] "deg C" Vector__XXX
 SG_ FS_HSMU_DEMO21_19 : 695|8@0+ (1,0) [0|0] "" Vector__XXX
 SG_ IOM_DEMO_VFG_OIL_TEMP21_A_49 : 775|32@0- (1,0) [0|100] "deg C" Vector__XXX
 SG_ FS_HSMU_DEMO21_20 : 703|8@0+ (1,0) [0|0] "" Vector__XXX
 SG_ IOM_DEMO_VFG_OIL_TEMP21_A_50 : 807|32@0- (1,0) [0|100] "deg C" Vector__XXX
 SG_ FS_HSMU_DEMO21_21 : 839|8@0+ (1,0) [0|0] "" Vector__XXX
 SG_ IOM_DEMO_VFG_OIL_TEMP21_A_51 : 871|32@0- (1,0) [0|100] "deg C" Vector__XXX
 SG_ FS_HSMU_DEMO21_22 : 847|8@0+ (1,0) [0|0] "" Vector__XXX
 SG_ IOM_DEMO_VFG_OIL_TEMP21_A_52 : 903|32@0- (1,0) [0|100] "deg C" Vector__XXX
 SG_ FS_HSMU_DEMO21_23 : 855|8@0+ (1,0) [0|0] "" Vector__XXX
 SG_ IOM_DEMO_VFG_OIL_TEMP21_A_53 : 935|32@0- (1,0) [0|100] "deg C" Vector__XXX
 SG_ FS_HSMU_DEMO21_24 : 863|8@0+ (1,0) [0|0] "" Vector__XXX
 SG_ IOM_DEMO_VFG_OIL_TEMP21_A_54 : 967|32@0- (1,0) [0|100] "deg C" Vector__XXX
 SG_ FS_HSMU_DEMO21_25 : 999|8@0+ (1,0) [0|0] "" Vector__XXX
 SG_ IOM_DEMO_VFG_OIL_TEMP21_A_55 : 1031|32@0- (1,0) [0|100] "deg C" Vector__XXX
 SG_ FS_HSMU_DEMO21_26 : 1007|8@0+ (1,0) [0|0] "" Vector__XXX
 SG_ IOM_DEMO_VFG_OIL_TEMP21_A_56 : 1063|32@0- (1,0) [0|100] "deg C" Vector__XXX
 SG_ FS_HSMU_DEMO21_27 : 1015|8@0+ (1,0) [0|0] "" Vector__XXX
 SG_ IOM_DEMO_VFG_OIL_TEMP21_A_57 : 1095|32@0- (1,0) [0|100] "deg C" Vector__XXX
 SG_ FS_HSMU_DEMO21_28 : 1023|8@0+ (1,0) [0|0] "" Vector__XXX
 SG_ IOM_DEMO_VFG_OIL_TEMP21_A_58 : 1127|32@0- (1,0) [0|100] "deg C" Vector__XXX
 SG_ FS_HSMU_DEMO21_29 : 1159|8@0+ (1,0) [0|0] "" Vector__XXX
 SG_ IOM_DEMO_VFG_OIL_TEMP21_A_59 : 1191|32@0- (1,0) [0|100] "deg C" Vector__XXX
 SG_ FS_HSMU_DEMO21_30 : 1167|8@0+ (1,0) [0|0] "" Vector__XXX
 SG_ IOM_DEMO_VFG_OIL_TEMP21_A_60 : 1223|32@0- (1,0) [0|100] "deg C" Vector__XXX
 SG_ FS_HSMU_DEMO21_31 : 1175|8@0+ (1,0) [0|0] "" Vector__XXX
 SG_ IOM_DEMO_VFG_OIL_TEMP21_A_61 : 1255|32@0- (1,0) [0|100] "deg C" Vector__XXX
 SG_ FS_HSMU_DEMO21_32 : 1183|8@0+ (1,0) [0|0] "" Vector__XXX
 SG_ IOM_DEMO_VFG_OIL_TEMP21_A_62 : 1287|32@0- (1,0) [0|100] "deg C" Vector__XXX
 SG_ FS_HSMU_DEMO21_33 : 1319|8@0+ (1,0) [0|0] "" Vector__XXX
 SG_ IOM_DEMO_VFG_OIL_TEMP21_A_63 : 1351|32@0- (1,0) [0|100] "deg C" Vector__XXX
 SG_ FS_HSMU_DEMO21_34 : 1327|8@0+ (1,0) [0|0] "" Vector__XXX
 SG_ IOM_DEMO_VFG_OIL_TEMP21_A_64 : 1383|32@0- (1,0) [0|100] "deg C" Vector__XXX
 SG_ FS_HSMU_DEMO21_35 : 1335|8@0+ (1,0) [0|0] "" Vector__XXX
 SG_ IOM_DEMO_VFG_OIL_TEMP21_A_65 : 1415|32@0- (1,0) [0|100] "deg C" Vector__XXX
 SG_ FS_HSMU_DEMO21_36 : 1343|8@0+ (1,0) [0|0] "" Vector__XXX
 SG_ IOM_DEMO_VFG_OIL_TEMP21_A_66 : 1447|32@0- (1,0) [0|100] "deg C" Vector__XXX
 SG_ FS_HSMU_DEMO21_37 : 1479|8@0+ (1,0) [0|0] "" Vector__XXX
 SG_ IOM_DEMO_VFG_OIL_TEMP21_A_67 : 1511|32@0- (1,0) [0|100] "deg C" Vector__XXX
 SG_ FS_HSMU_DEMO21_38 : 1487|8@0+ (1,0) [0|0] "" Vector__XXX
 SG_ IOM_DEMO_VFG_OIL_TEMP21_A_68 : 1543|32@0- (1,0) [0|100] "deg C" Vector__XXX
 SG_ FS_HSMU_DEMO21_39 : 1495|8@0+ (1,0) [0|0] "" Vector__XXX
 SG_ IOM_DEMO_VFG_OIL_TEMP21_A_69 : 1575|32@0- (1,0) [0|100] "deg C" Vector__XXX
 SG_ FS_HSMU_DEMO21_40 : 1503|8@0+ (1,0) [0|0] "" Vector__XXX
 SG_ IOM_DEMO_VFG_OIL_TEMP21_A_70 : 1607|32@0- (1,0) [0|100] "deg C" Vector__XXX

CM_ "ATA0 - AFDX

ICD file name used:
- AFDX_Test.csv

Equipments:
- IOM_EQIP1_3
";
BA_DEF_ SG_  "AfdxFSaddr" INT 4 8192;
BA_DEF_ SG_  "AfdxFDSaddr" INT 0 8192;
BA_DEF_ SG_  "AfdxFDSlength" INT 0 8192;
BA_DEF_ SG_  "AfdxFDSname" STRING ;
BA_DEF_ SG_  "AfdxSignalType" ENUM  "Boolean","Enumerate","Float","Integer","Opaque","String","Status";
BA_DEF_ BO_  "AfdxTxPortId" INT 1 65535;
BA_DEF_ BO_  "AfdxPortMasterName" STRING ;
BA_DEF_ BO_  "AfdxMsgRefreshDef" INT 0 0;
BA_DEF_ BO_  "AfdxMsgTxRate" INT 0 0;
BA_DEF_ BO_  "AfdxVLbufSize" INT 1 8192;
BA_DEF_ BO_  "AfdxVLdestUDP" INT 0 65535;
BA_DEF_ BO_  "AfdxVLsrcUDP" INT 0 65535;
BA_DEF_ BO_  "AfdxVLdestIP" STRING ;
BA_DEF_ BO_  "AfdxVLsrcIP" STRING ;
BA_DEF_ BO_  "AfdxVLipFrag" ENUM  "True","False";
BA_DEF_ BO_  "AfdxVLportChar" ENUM  "Unknown","SAP","Sampling","Queuing";
BA_DEF_ BO_  "AfdxVLportType" ENUM  "Unknown","SAP","AFDX Communication Port";
BA_DEF_ BO_  "AfdxVLsubVLId" INT 0 4;
BA_DEF_ BO_  "AfdxVLsubVL" INT 0 4;
BA_DEF_ BO_  "AfdxVLskewMax" INT 0 65535;
BA_DEF_ BO_  "AfdxVLintCheck" ENUM  "True","False";
BA_DEF_ BO_  "AfdxVLrma" STRING ;
BA_DEF_ BO_  "AfdxVLmaxFrame" INT 17 1471;
BA_DEF_ BO_  "AfdxVLbag" INT 1 128;
BA_DEF_ BO_  "AfdxVLnetSel" ENUM  "NETWORK_NONE","NETWORK_A","NETWORK_B","NETWORK_AB";
BA_DEF_ BO_  "AfdxVLname" STRING ;
BA_DEF_ BO_  "AfdxVLid" INT 1 65535;
BA_DEF_ BO_  "AfdxVLportSpeed" INT 10 100;
BA_DEF_ BU_  "AfdxEquipment" STRING ;
BA_DEF_ SG_  "SignalTypeExt" ENUM  "No","StringType","ByteArray";
BA_DEF_ BU_  "NodeLayerModules" STRING ;
BA_DEF_  "BusType" STRING ;
BA_DEF_  "ToolVersion" STRING ;
BA_DEF_  "ToolName" STRING ;
BA_DEF_ SG_  "SystemSignalLongSymbol" STRING ;
BA_DEF_DEF_  "AfdxFSaddr" 4;
BA_DEF_DEF_  "AfdxFDSaddr" 0;
BA_DEF_DEF_  "AfdxFDSlength" 0;
BA_DEF_DEF_  "AfdxFDSname" "";
BA_DEF_DEF_  "AfdxSignalType" "Boolean";
BA_DEF_DEF_  "AfdxTxPortId" 1;
BA_DEF_DEF_  "AfdxPortMasterName" "";
BA_DEF_DEF_  "AfdxMsgRefreshDef" 0;
BA_DEF_DEF_  "AfdxMsgTxRate" 0;
BA_DEF_DEF_  "AfdxVLbufSize" 1;
BA_DEF_DEF_  "AfdxVLdestUDP" 0;
BA_DEF_DEF_  "AfdxVLsrcUDP" 0;
BA_DEF_DEF_  "AfdxVLdestIP" "0:0:0:0";
BA_DEF_DEF_  "AfdxVLsrcIP" "0:0:0:0";
BA_DEF_DEF_  "AfdxVLipFrag" "True";
BA_DEF_DEF_  "AfdxVLportChar" "Sampling";
BA_DEF_DEF_  "AfdxVLportType" "AFDX Communication Port";
BA_DEF_DEF_  "AfdxVLsubVLId" 0;
BA_DEF_DEF_  "AfdxVLsubVL" 0;
BA_DEF_DEF_  "AfdxVLskewMax" 0;
BA_DEF_DEF_  "AfdxVLintCheck" "True";
BA_DEF_DEF_  "AfdxVLrma" "";
BA_DEF_DEF_  "AfdxVLmaxFrame" 17;
BA_DEF_DEF_  "AfdxVLbag" 1;
BA_DEF_DEF_  "AfdxVLnetSel" "NETWORK_AB";
BA_DEF_DEF_  "AfdxVLname" "";
BA_DEF_DEF_  "AfdxVLid" 1;
BA_DEF_DEF_  "AfdxVLportSpeed" 10;
BA_DEF_DEF_  "AfdxEquipment" "<unknown>";
BA_DEF_DEF_  "SignalTypeExt" "No";
BA_DEF_DEF_  "NodeLayerModules" "AFDX_IL.dll";
BA_DEF_DEF_  "BusType" "AFDX";
BA_DEF_DEF_  "ToolVersion" "1.1.0.5";
BA_DEF_DEF_  "ToolName" "ICD2DBC";
BA_DEF_DEF_  "SystemSignalLongSymbol" "";
BA_ "AfdxEquipment" BU_ IOM_APP2 "IOM_EQIP1_3";
BA_ "AfdxEquipment" BU_ IOM_APP1 "IOM_EQIP1_3";
BA_ "AfdxTxPortId" BO_ 337519120 8722;
BA_ "AfdxPortMasterName" BO_ 337519120 "RX_PORT_OUT_MESSAGE_ADR";
BA_ "AfdxMsgRefreshDef" BO_ 337519120 180;
BA_ "AfdxMsgTxRate" BO_ 337519120 60;
BA_ "AfdxVLbufSize" BO_ 337519120 312;
BA_ "AfdxVLdestUDP" BO_ 337519120 8720;
BA_ "AfdxVLdestIP" BO_ 337519120 "224.224.20.30";
BA_ "AfdxVLsrcIP" BO_ 337519120 "0.0.0.0";
BA_ "AfdxVLipFrag" BO_ 337519120 1;
BA_ "AfdxVLskewMax" BO_ 337519120 65500;
BA_ "AfdxVLrma" BO_ 337519120 "Active";
BA_ "AfdxVLmaxFrame" BO_ 337519120 312;
BA_ "AfdxVLbag" BO_ 337519120 32;
BA_ "AfdxVLname" BO_ 337519120 "VL_RXDEMO_3_ADR";
BA_ "AfdxVLid" BO_ 337519120 5150;
BA_ "AfdxVLportSpeed" BO_ 337519120 100;
BA_ "AfdxTxPortId" BO_ 298197520 8721;
BA_ "AfdxPortMasterName" BO_ 298197520 "RX_PORT_OUT_MESSAGE_ADR";
BA_ "AfdxMsgRefreshDef" BO_ 298197520 180;
BA_ "AfdxMsgTxRate" BO_ 298197520 60;
BA_ "AfdxVLbufSize" BO_ 298197520 312;
BA_ "AfdxVLdestUDP" BO_ 298197520 8720;
BA_ "AfdxVLdestIP" BO_ 298197520 "224.224.17.198";
BA_ "AfdxVLsrcIP" BO_ 298197520 "0.0.0.0";
BA_ "AfdxVLipFrag" BO_ 298197520 1;
BA_ "AfdxVLskewMax" BO_ 298197520 65500;
BA_ "AfdxVLrma" BO_ 298197520 "Active";
BA_ "AfdxVLmaxFrame" BO_ 298197520 312;
BA_ "AfdxVLbag" BO_ 298197520 32;
BA_ "AfdxVLname" BO_ 298197520 "VL_RXDEMO_2_ADR";
BA_ "AfdxVLid" BO_ 298197520 4550;
BA_ "AfdxVLportSpeed" BO_ 298197520 100;
BA_ "AfdxTxPortId" BO_ 258875920 8720;
BA_ "AfdxPortMasterName" BO_ 258875920 "RX_PORT_OUT_MESSAGE_ADR";
BA_ "AfdxMsgRefreshDef" BO_ 258875920 180;
BA_ "AfdxMsgTxRate" BO_ 258875920 60;
BA_ "AfdxVLbufSize" BO_ 258875920 312;
BA_ "AfdxVLdestUDP" BO_ 258875920 8720;
BA_ "AfdxVLdestIP" BO_ 258875920 "224.224.15.110";
BA_ "AfdxVLsrcIP" BO_ 258875920 "0.0.0.0";
BA_ "AfdxVLipFrag" BO_ 258875920 1;
BA_ "AfdxVLskewMax" BO_ 258875920 65500;
BA_ "AfdxVLrma" BO_ 258875920 "Active";
BA_ "AfdxVLmaxFrame" BO_ 258875920 312;
BA_ "AfdxVLbag" BO_ 258875920 32;
BA_ "AfdxVLname" BO_ 258875920 "VL_RXDEMO_1_ADR";
BA_ "AfdxVLid" BO_ 258875920 3950;
BA_ "AfdxVLportSpeed" BO_ 258875920 100;
BA_ "AfdxTxPortId" BO_ 4233822370 14238;
BA_ "AfdxPortMasterName" BO_ 4233822370 "DEMO_SNMP_TRAP_NMF_AFDX_TX";
BA_ "AfdxVLbufSize" BO_ 4233822370 8192;
BA_ "AfdxVLdestUDP" BO_ 4233822370 162;
BA_ "AfdxVLsrcUDP" BO_ 4233822370 162;
BA_ "AfdxVLdestIP" BO_ 4233822370 "10.3.71.2";
BA_ "AfdxVLsrcIP" BO_ 4233822370 "10.2.38.0";
BA_ "AfdxVLportChar" BO_ 4233822370 3;
BA_ "AfdxVLsubVLId" BO_ 4233822370 2;
BA_ "AfdxVLsubVL" BO_ 4233822370 2;
BA_ "AfdxVLintCheck" BO_ 4233822370 1;
BA_ "AfdxVLmaxFrame" BO_ 4233822370 696;
BA_ "AfdxVLbag" BO_ 4233822370 4;
BA_ "AfdxVLname" BO_ 4233822370 "VL_DEMO_SCI";
BA_ "AfdxVLid" BO_ 4233822370 64603;
BA_ "AfdxVLportSpeed" BO_ 4233822370 100;
BA_ "AfdxTxPortId" BO_ 4233861889 39681;
BA_ "AfdxPortMasterName" BO_ 4233861889 "DEMO_ANSWER_TO_PIT";
BA_ "AfdxVLbufSize" BO_ 4233861889 8192;
BA_ "AfdxVLsrcUDP" BO_ 4233861889 39681;
BA_ "AfdxVLdestIP" BO_ 4233861889 "10.3.71.2";
BA_ "AfdxVLsrcIP" BO_ 4233861889 "10.2.38.0";
BA_ "AfdxVLportChar" BO_ 4233861889 1;
BA_ "AfdxVLportType" BO_ 4233861889 1;
BA_ "AfdxVLsubVLId" BO_ 4233861889 1;
BA_ "AfdxVLsubVL" BO_ 4233861889 2;
BA_ "AfdxVLintCheck" BO_ 4233861889 1;
BA_ "AfdxVLmaxFrame" BO_ 4233861889 696;
BA_ "AfdxVLbag" BO_ 4233861889 4;
BA_ "AfdxVLname" BO_ 4233861889 "VL_DEMO_SCI";
BA_ "AfdxVLid" BO_ 4233861889 64603;
BA_ "AfdxVLportSpeed" BO_ 4233861889 100;
BA_ "AfdxTxPortId" BO_ 4266852514 14239;
BA_ "AfdxPortMasterName" BO_ 4266852514 "DEMO_SNMP_TRAP_NBF_AFDX_TX";
BA_ "AfdxVLbufSize" BO_ 4266852514 8192;
BA_ "AfdxVLdestUDP" BO_ 4266852514 162;
BA_ "AfdxVLsrcUDP" BO_ 4266852514 162;
BA_ "AfdxVLdestIP" BO_ 4266852514 "10.1.58.1";
BA_ "AfdxVLsrcIP" BO_ 4266852514 "10.2.38.0";
BA_ "AfdxVLportChar" BO_ 4266852514 3;
BA_ "AfdxVLsubVL" BO_ 4266852514 2;
BA_ "AfdxVLintCheck" BO_ 4266852514 1;
BA_ "AfdxVLmaxFrame" BO_ 4266852514 152;
BA_ "AfdxVLbag" BO_ 4266852514 32;
BA_ "AfdxVLname" BO_ 4266852514 "VL_SERVICE";
BA_ "AfdxVLid" BO_ 4266852514 65107;
BA_ "AfdxVLportSpeed" BO_ 4266852514 100;
BA_ "AfdxTxPortId" BO_ 4266902806 50454;
BA_ "AfdxPortMasterName" BO_ 4266902806 "DEMO_QUEUE_PORT_TFTP_TX4";
BA_ "AfdxVLbufSize" BO_ 4266902806 8192;
BA_ "AfdxVLsrcUDP" BO_ 4266902806 50454;
BA_ "AfdxVLdestIP" BO_ 4266902806 "10.1.58.1";
BA_ "AfdxVLsrcIP" BO_ 4266902806 "10.2.38.0";
BA_ "AfdxVLportChar" BO_ 4266902806 1;
BA_ "AfdxVLportType" BO_ 4266902806 1;
BA_ "AfdxVLsubVLId" BO_ 4266902806 1;
BA_ "AfdxVLsubVL" BO_ 4266902806 2;
BA_ "AfdxVLintCheck" BO_ 4266902806 1;
BA_ "AfdxVLmaxFrame" BO_ 4266902806 152;
BA_ "AfdxVLbag" BO_ 4266902806 32;
BA_ "AfdxVLname" BO_ 4266902806 "VL_SERVICE";
BA_ "AfdxVLid" BO_ 4266902806 65107;
BA_ "AfdxVLportSpeed" BO_ 4266902806 100;
BA_ "AfdxTxPortId" BO_ 4266902804 50452;
BA_ "AfdxPortMasterName" BO_ 4266902804 "DEMO_QUEUE_PORT_TFTP_TX2";
BA_ "AfdxVLbufSize" BO_ 4266902804 8192;
BA_ "AfdxVLsrcUDP" BO_ 4266902804 50452;
BA_ "AfdxVLdestIP" BO_ 4266902804 "10.1.58.1";
BA_ "AfdxVLsrcIP" BO_ 4266902804 "10.2.38.0";
BA_ "AfdxVLportChar" BO_ 4266902804 1;
BA_ "AfdxVLportType" BO_ 4266902804 1;
BA_ "AfdxVLsubVL" BO_ 4266902804 2;
BA_ "AfdxVLintCheck" BO_ 4266902804 1;
BA_ "AfdxVLmaxFrame" BO_ 4266902804 152;
BA_ "AfdxVLbag" BO_ 4266902804 32;
BA_ "AfdxVLname" BO_ 4266902804 "VL_SERVICE";
BA_ "AfdxVLid" BO_ 4266902804 65107;
BA_ "AfdxVLportSpeed" BO_ 4266902804 100;
BA_ "AfdxTxPortId" BO_ 4266902805 50453;
BA_ "AfdxPortMasterName" BO_ 4266902805 "DEMO_QUEUE_PORT_TFTP_TX3";
BA_ "AfdxVLbufSize" BO_ 4266902805 8192;
BA_ "AfdxVLsrcUDP" BO_ 4266902805 50453;
BA_ "AfdxVLdestIP" BO_ 4266902805 "10.1.58.1";
BA_ "AfdxVLsrcIP" BO_ 4266902805 "10.2.38.0";
BA_ "AfdxVLportChar" BO_ 4266902805 1;
BA_ "AfdxVLportType" BO_ 4266902805 1;
BA_ "AfdxVLsubVL" BO_ 4266902805 2;
BA_ "AfdxVLintCheck" BO_ 4266902805 1;
BA_ "AfdxVLmaxFrame" BO_ 4266902805 152;
BA_ "AfdxVLbag" BO_ 4266902805 32;
BA_ "AfdxVLname" BO_ 4266902805 "VL_SERVICE";
BA_ "AfdxVLid" BO_ 4266902805 65107;
BA_ "AfdxVLportSpeed" BO_ 4266902805 100;
BA_ "AfdxTxPortId" BO_ 4266902803 50451;
BA_ "AfdxPortMasterName" BO_ 4266902803 "DEMO_QUEUE_PORT_TFTP_TX1";
BA_ "AfdxVLbufSize" BO_ 4266902803 8192;
BA_ "AfdxVLsrcUDP" BO_ 4266902803 50451;
BA_ "AfdxVLdestIP" BO_ 4266902803 "10.1.58.1";
BA_ "AfdxVLsrcIP" BO_ 4266902803 "10.2.38.0";
BA_ "AfdxVLportChar" BO_ 4266902803 1;
BA_ "AfdxVLportType" BO_ 4266902803 1;
BA_ "AfdxVLsubVL" BO_ 4266902803 2;
BA_ "AfdxVLintCheck" BO_ 4266902803 1;
BA_ "AfdxVLmaxFrame" BO_ 4266902803 152;
BA_ "AfdxVLbag" BO_ 4266902803 32;
BA_ "AfdxVLname" BO_ 4266902803 "VL_SERVICE";
BA_ "AfdxVLid" BO_ 4266902803 65107;
BA_ "AfdxVLportSpeed" BO_ 4266902803 100;
BA_ "AfdxTxPortId" BO_ 437922684 11132;
BA_ "AfdxPortMasterName" BO_ 437922684 "DEMO22_AFDX_PORT_18";
BA_ "AfdxMsgTxRate" BO_ 437922684 1;
BA_ "AfdxVLbufSize" BO_ 437922684 1400;
BA_ "AfdxVLdestUDP" BO_ 437922684 11132;
BA_ "AfdxVLsrcUDP" BO_ 437922684 11132;
BA_ "AfdxVLdestIP" BO_ 437922684 "224.224.26.26";
BA_ "AfdxVLsrcIP" BO_ 437922684 "10.2.38.0";
BA_ "AfdxVLportChar" BO_ 437922684 3;
BA_ "AfdxVLsubVLId" BO_ 437922684 1;
BA_ "AfdxVLsubVL" BO_ 437922684 1;
BA_ "AfdxVLintCheck" BO_ 437922684 1;
BA_ "AfdxVLmaxFrame" BO_ 437922684 1400;
BA_ "AfdxVLname" BO_ 437922684 "VL_DEMO22";
BA_ "AfdxVLid" BO_ 437922684 6682;
BA_ "AfdxVLportSpeed" BO_ 437922684 100;
BA_ "AfdxTxPortId" BO_ 437857147 11131;
BA_ "AfdxPortMasterName" BO_ 437857147 "DEMO21_AFDX_PORT_17";
BA_ "AfdxMsgTxRate" BO_ 437857147 1;
BA_ "AfdxVLbufSize" BO_ 437857147 1400;
BA_ "AfdxVLdestUDP" BO_ 437857147 11131;
BA_ "AfdxVLsrcUDP" BO_ 437857147 11131;
BA_ "AfdxVLdestIP" BO_ 437857147 "224.224.26.25";
BA_ "AfdxVLsrcIP" BO_ 437857147 "10.2.38.0";
BA_ "AfdxVLportChar" BO_ 437857147 3;
BA_ "AfdxVLsubVLId" BO_ 437857147 1;
BA_ "AfdxVLsubVL" BO_ 437857147 1;
BA_ "AfdxVLintCheck" BO_ 437857147 1;
BA_ "AfdxVLmaxFrame" BO_ 437857147 1400;
BA_ "AfdxVLname" BO_ 437857147 "VL_DEMO21";
BA_ "AfdxVLid" BO_ 437857147 6681;
BA_ "AfdxVLportSpeed" BO_ 437857147 100;
BA_ "AfdxFSaddr" SG_ 337519120 FS_ADR_TEMP_TAT 107;
BA_ "AfdxFDSaddr" SG_ 337519120 FS_ADR_TEMP_TAT 120;
BA_ "AfdxFDSlength" SG_ 337519120 FS_ADR_TEMP_TAT 4;
BA_ "AfdxFDSname" SG_ 337519120 FS_ADR_TEMP_TAT "ADR_TEMP_TAT";
BA_ "AfdxSignalType" SG_ 337519120 FS_ADR_TEMP_TAT 6;
BA_ "AfdxFSaddr" SG_ 337519120 RXDEMO_211_TOTALAIRTEMPERATURE_S 107;
BA_ "AfdxFDSaddr" SG_ 337519120 RXDEMO_211_TOTALAIRTEMPERATURE_S 120;
BA_ "AfdxFDSlength" SG_ 337519120 RXDEMO_211_TOTALAIRTEMPERATURE_S 4;
BA_ "AfdxFDSname" SG_ 337519120 RXDEMO_211_TOTALAIRTEMPERATURE_S "ADR_TEMP_TAT";
BA_ "AfdxSignalType" SG_ 337519120 RXDEMO_211_TOTALAIRTEMPERATURE_S 2;
BA_ "SystemSignalLongSymbol" SG_ 337519120 RXDEMO_211_TOTALAIRTEMPERATURE_S "RXDEMO_211_TOTALAIRTEMPERATURE_SG_3";
BA_ "AfdxFSaddr" SG_ 337519120 FS_ADR_VELO_CAS 125;
BA_ "AfdxFDSaddr" SG_ 337519120 FS_ADR_VELO_CAS 132;
BA_ "AfdxFDSlength" SG_ 337519120 FS_ADR_VELO_CAS 4;
BA_ "AfdxFDSname" SG_ 337519120 FS_ADR_VELO_CAS "ADR_VELO_CAS";
BA_ "AfdxSignalType" SG_ 337519120 FS_ADR_VELO_CAS 6;
BA_ "AfdxFSaddr" SG_ 337519120 RXDEMO_206_COMPUTEDAIRSPEED_SG_3 125;
BA_ "AfdxFDSaddr" SG_ 337519120 RXDEMO_206_COMPUTEDAIRSPEED_SG_3 132;
BA_ "AfdxFDSlength" SG_ 337519120 RXDEMO_206_COMPUTEDAIRSPEED_SG_3 4;
BA_ "AfdxFDSname" SG_ 337519120 RXDEMO_206_COMPUTEDAIRSPEED_SG_3 "ADR_VELO_CAS";
BA_ "AfdxSignalType" SG_ 337519120 RXDEMO_206_COMPUTEDAIRSPEED_SG_3 2;
BA_ "AfdxFSaddr" SG_ 298197520 FS_ADR_TEMP_TAT 107;
BA_ "AfdxFDSaddr" SG_ 298197520 FS_ADR_TEMP_TAT 120;
BA_ "AfdxFDSlength" SG_ 298197520 FS_ADR_TEMP_TAT 4;
BA_ "AfdxFDSname" SG_ 298197520 FS_ADR_TEMP_TAT "ADR_TEMP_TAT";
BA_ "AfdxSignalType" SG_ 298197520 FS_ADR_TEMP_TAT 6;
BA_ "AfdxFSaddr" SG_ 298197520 RXDEMO_211_TOTALAIRTEMPERAT_0000 107;
BA_ "AfdxFDSaddr" SG_ 298197520 RXDEMO_211_TOTALAIRTEMPERAT_0000 120;
BA_ "AfdxFDSlength" SG_ 298197520 RXDEMO_211_TOTALAIRTEMPERAT_0000 4;
BA_ "AfdxFDSname" SG_ 298197520 RXDEMO_211_TOTALAIRTEMPERAT_0000 "ADR_TEMP_TAT";
BA_ "AfdxSignalType" SG_ 298197520 RXDEMO_211_TOTALAIRTEMPERAT_0000 2;
BA_ "SystemSignalLongSymbol" SG_ 298197520 RXDEMO_211_TOTALAIRTEMPERAT_0000 "RXDEMO_211_TOTALAIRTEMPERATURE_SG_2";
BA_ "AfdxFSaddr" SG_ 298197520 FS_ADR_VELO_CAS 125;
BA_ "AfdxFDSaddr" SG_ 298197520 FS_ADR_VELO_CAS 132;
BA_ "AfdxFDSlength" SG_ 298197520 FS_ADR_VELO_CAS 4;
BA_ "AfdxFDSname" SG_ 298197520 FS_ADR_VELO_CAS "ADR_VELO_CAS";
BA_ "AfdxSignalType" SG_ 298197520 FS_ADR_VELO_CAS 6;
BA_ "AfdxFSaddr" SG_ 298197520 RXDEMO_206_COMPUTEDAIRSPEED_SG_2 125;
BA_ "AfdxFDSaddr" SG_ 298197520 RXDEMO_206_COMPUTEDAIRSPEED_SG_2 132;
BA_ "AfdxFDSlength" SG_ 298197520 RXDEMO_206_COMPUTEDAIRSPEED_SG_2 4;
BA_ "AfdxFDSname" SG_ 298197520 RXDEMO_206_COMPUTEDAIRSPEED_SG_2 "ADR_VELO_CAS";
BA_ "AfdxSignalType" SG_ 298197520 RXDEMO_206_COMPUTEDAIRSPEED_SG_2 2;
BA_ "AfdxFDSaddr" SG_ 258875920 FS_ADR_ALT 8;
BA_ "AfdxFDSlength" SG_ 258875920 FS_ADR_ALT 12;
BA_ "AfdxFDSname" SG_ 258875920 FS_ADR_ALT "ADR_ALT";
BA_ "AfdxSignalType" SG_ 258875920 FS_ADR_ALT 6;
BA_ "AfdxFDSaddr" SG_ 258875920 RXDEMO_203_STANDARDPRESSUREALTIT 8;
BA_ "AfdxFDSlength" SG_ 258875920 RXDEMO_203_STANDARDPRESSUREALTIT 12;
BA_ "AfdxFDSname" SG_ 258875920 RXDEMO_203_STANDARDPRESSUREALTIT "ADR_ALT";
BA_ "AfdxSignalType" SG_ 258875920 RXDEMO_203_STANDARDPRESSUREALTIT 3;
BA_ "SystemSignalLongSymbol" SG_ 258875920 RXDEMO_203_STANDARDPRESSUREALTIT "RXDEMO_203_STANDARDPRESSUREALTITUDE_SG_1";
BA_ "AfdxFSaddr" SG_ 258875920 FS_ADR_PRESSURE_COR_SP 55;
BA_ "AfdxFDSaddr" SG_ 258875920 FS_ADR_PRESSURE_COR_SP 68;
BA_ "AfdxFDSlength" SG_ 258875920 FS_ADR_PRESSURE_COR_SP 4;
BA_ "AfdxFDSname" SG_ 258875920 FS_ADR_PRESSURE_COR_SP "ADR_PRESSURE_COR_SP";
BA_ "AfdxSignalType" SG_ 258875920 FS_ADR_PRESSURE_COR_SP 6;
BA_ "AfdxFSaddr" SG_ 258875920 RXDEMO_246_CORR_AVG_STATIC_PRESS 55;
BA_ "AfdxFDSaddr" SG_ 258875920 RXDEMO_246_CORR_AVG_STATIC_PRESS 68;
BA_ "AfdxFDSlength" SG_ 258875920 RXDEMO_246_CORR_AVG_STATIC_PRESS 4;
BA_ "AfdxFDSname" SG_ 258875920 RXDEMO_246_CORR_AVG_STATIC_PRESS "ADR_PRESSURE_COR_SP";
BA_ "AfdxSignalType" SG_ 258875920 RXDEMO_246_CORR_AVG_STATIC_PRESS 2;
BA_ "SystemSignalLongSymbol" SG_ 258875920 RXDEMO_246_CORR_AVG_STATIC_PRESS "RXDEMO_246_CORR_AVG_STATIC_PRESSURE_SG_1";
BA_ "AfdxFSaddr" SG_ 258875920 FS_ADR_PRESSURE_TP 74;
BA_ "AfdxFDSaddr" SG_ 258875920 FS_ADR_PRESSURE_TP 96;
BA_ "AfdxFDSlength" SG_ 258875920 FS_ADR_PRESSURE_TP 4;
BA_ "AfdxFDSname" SG_ 258875920 FS_ADR_PRESSURE_TP "ADR_PRESSURE_TP";
BA_ "AfdxSignalType" SG_ 258875920 FS_ADR_PRESSURE_TP 6;
BA_ "AfdxFSaddr" SG_ 258875920 RXDEMO_242_INDICATED_TOTAL_PRESS 74;
BA_ "AfdxFDSaddr" SG_ 258875920 RXDEMO_242_INDICATED_TOTAL_PRESS 96;
BA_ "AfdxFDSlength" SG_ 258875920 RXDEMO_242_INDICATED_TOTAL_PRESS 4;
BA_ "AfdxFDSname" SG_ 258875920 RXDEMO_242_INDICATED_TOTAL_PRESS "ADR_PRESSURE_TP";
BA_ "AfdxSignalType" SG_ 258875920 RXDEMO_242_INDICATED_TOTAL_PRESS 2;
BA_ "SystemSignalLongSymbol" SG_ 258875920 RXDEMO_242_INDICATED_TOTAL_PRESS "RXDEMO_242_INDICATED_TOTAL_PRESSURE_SG_1";
BA_ "AfdxFSaddr" SG_ 258875920 FS_ADR_TEMP_SAT 106;
BA_ "AfdxFDSaddr" SG_ 258875920 FS_ADR_TEMP_SAT 116;
BA_ "AfdxFDSlength" SG_ 258875920 FS_ADR_TEMP_SAT 4;
BA_ "AfdxFDSname" SG_ 258875920 FS_ADR_TEMP_SAT "ADR_TEMP_SAT";
BA_ "AfdxSignalType" SG_ 258875920 FS_ADR_TEMP_SAT 6;
BA_ "AfdxFSaddr" SG_ 258875920 RXDEMO_213_STATICAIRTEMPERATURE_ 106;
BA_ "AfdxFDSaddr" SG_ 258875920 RXDEMO_213_STATICAIRTEMPERATURE_ 116;
BA_ "AfdxFDSlength" SG_ 258875920 RXDEMO_213_STATICAIRTEMPERATURE_ 4;
BA_ "AfdxFDSname" SG_ 258875920 RXDEMO_213_STATICAIRTEMPERATURE_ "ADR_TEMP_SAT";
BA_ "AfdxSignalType" SG_ 258875920 RXDEMO_213_STATICAIRTEMPERATURE_ 2;
BA_ "SystemSignalLongSymbol" SG_ 258875920 RXDEMO_213_STATICAIRTEMPERATURE_ "RXDEMO_213_STATICAIRTEMPERATURE_SG_1";
BA_ "AfdxFSaddr" SG_ 258875920 FS_ADR_TEMP_TAT 107;
BA_ "AfdxFDSaddr" SG_ 258875920 FS_ADR_TEMP_TAT 120;
BA_ "AfdxFDSlength" SG_ 258875920 FS_ADR_TEMP_TAT 4;
BA_ "AfdxFDSname" SG_ 258875920 FS_ADR_TEMP_TAT "ADR_TEMP_TAT";
BA_ "AfdxSignalType" SG_ 258875920 FS_ADR_TEMP_TAT 6;
BA_ "AfdxFSaddr" SG_ 258875920 RXDEMO_211_TOTALAIRTEMPERAT_0001 107;
BA_ "AfdxFDSaddr" SG_ 258875920 RXDEMO_211_TOTALAIRTEMPERAT_0001 120;
BA_ "AfdxFDSlength" SG_ 258875920 RXDEMO_211_TOTALAIRTEMPERAT_0001 4;
BA_ "AfdxFDSname" SG_ 258875920 RXDEMO_211_TOTALAIRTEMPERAT_0001 "ADR_TEMP_TAT";
BA_ "AfdxSignalType" SG_ 258875920 RXDEMO_211_TOTALAIRTEMPERAT_0001 2;
BA_ "SystemSignalLongSymbol" SG_ 258875920 RXDEMO_211_TOTALAIRTEMPERAT_0001 "RXDEMO_211_TOTALAIRTEMPERATURE_SG_1";
BA_ "AfdxFSaddr" SG_ 258875920 FS_ADR_VELO_CAS 125;
BA_ "AfdxFDSaddr" SG_ 258875920 FS_ADR_VELO_CAS 132;
BA_ "AfdxFDSlength" SG_ 258875920 FS_ADR_VELO_CAS 4;
BA_ "AfdxFDSname" SG_ 258875920 FS_ADR_VELO_CAS "ADR_VELO_CAS";
BA_ "AfdxSignalType" SG_ 258875920 FS_ADR_VELO_CAS 6;
BA_ "AfdxFSaddr" SG_ 258875920 RXDEMO_206_COMPUTEDAIRSPEED_SG_1 125;
BA_ "AfdxFDSaddr" SG_ 258875920 RXDEMO_206_COMPUTEDAIRSPEED_SG_1 132;
BA_ "AfdxFDSlength" SG_ 258875920 RXDEMO_206_COMPUTEDAIRSPEED_SG_1 4;
BA_ "AfdxFDSname" SG_ 258875920 RXDEMO_206_COMPUTEDAIRSPEED_SG_1 "ADR_VELO_CAS";
BA_ "AfdxSignalType" SG_ 258875920 RXDEMO_206_COMPUTEDAIRSPEED_SG_1 2;
BA_ "AfdxFSaddr" SG_ 258875920 FS_ADR_VELO_MA 126;
BA_ "AfdxFDSaddr" SG_ 258875920 FS_ADR_VELO_MA 136;
BA_ "AfdxFDSlength" SG_ 258875920 FS_ADR_VELO_MA 4;
BA_ "AfdxFDSname" SG_ 258875920 FS_ADR_VELO_MA "ADR_VELO_MA";
BA_ "AfdxSignalType" SG_ 258875920 FS_ADR_VELO_MA 6;
BA_ "AfdxFSaddr" SG_ 258875920 RXDEMO_205_MACHNUMBER_SG_1 126;
BA_ "AfdxFDSaddr" SG_ 258875920 RXDEMO_205_MACHNUMBER_SG_1 136;
BA_ "AfdxFDSlength" SG_ 258875920 RXDEMO_205_MACHNUMBER_SG_1 4;
BA_ "AfdxFDSname" SG_ 258875920 RXDEMO_205_MACHNUMBER_SG_1 "ADR_VELO_MA";
BA_ "AfdxSignalType" SG_ 258875920 RXDEMO_205_MACHNUMBER_SG_1 2;
BA_ "AfdxFDSaddr" SG_ 437922684 FS_HSMU_DEMO22_1 8;
BA_ "AfdxFDSlength" SG_ 437922684 FS_HSMU_DEMO22_1 4;
BA_ "AfdxFDSname" SG_ 437922684 FS_HSMU_DEMO22_1 "FDS_HSMU_DEMO22_1";
BA_ "AfdxSignalType" SG_ 437922684 FS_HSMU_DEMO22_1 6;
BA_ "AfdxFDSaddr" SG_ 437922684 IOM_DEMO_VFG_OIL_TEMP22_A_31 8;
BA_ "AfdxFDSlength" SG_ 437922684 IOM_DEMO_VFG_OIL_TEMP22_A_31 4;
BA_ "AfdxFDSname" SG_ 437922684 IOM_DEMO_VFG_OIL_TEMP22_A_31 "FDS_HSMU_DEMO22_1";
BA_ "AfdxSignalType" SG_ 437922684 IOM_DEMO_VFG_OIL_TEMP22_A_31 3;
BA_ "AfdxFSaddr" SG_ 437922684 FS_HSMU_DEMO22_2 5;
BA_ "AfdxFDSaddr" SG_ 437922684 FS_HSMU_DEMO22_2 12;
BA_ "AfdxFDSlength" SG_ 437922684 FS_HSMU_DEMO22_2 4;
BA_ "AfdxFDSname" SG_ 437922684 FS_HSMU_DEMO22_2 "FDS_HSMU_DEMO22_2";
BA_ "AfdxSignalType" SG_ 437922684 FS_HSMU_DEMO22_2 6;
BA_ "AfdxFSaddr" SG_ 437922684 IOM_DEMO_VFG_OIL_TEMP22_A_32 5;
BA_ "AfdxFDSaddr" SG_ 437922684 IOM_DEMO_VFG_OIL_TEMP22_A_32 12;
BA_ "AfdxFDSlength" SG_ 437922684 IOM_DEMO_VFG_OIL_TEMP22_A_32 4;
BA_ "AfdxFDSname" SG_ 437922684 IOM_DEMO_VFG_OIL_TEMP22_A_32 "FDS_HSMU_DEMO22_2";
BA_ "AfdxSignalType" SG_ 437922684 IOM_DEMO_VFG_OIL_TEMP22_A_32 3;
BA_ "AfdxFSaddr" SG_ 437922684 FS_HSMU_DEMO22_3 6;
BA_ "AfdxFDSaddr" SG_ 437922684 FS_HSMU_DEMO22_3 16;
BA_ "AfdxFDSlength" SG_ 437922684 FS_HSMU_DEMO22_3 4;
BA_ "AfdxFDSname" SG_ 437922684 FS_HSMU_DEMO22_3 "FDS_HSMU_DEMO22_3";
BA_ "AfdxSignalType" SG_ 437922684 FS_HSMU_DEMO22_3 6;
BA_ "AfdxFSaddr" SG_ 437922684 IOM_DEMO_VFG_OIL_TEMP22_A_33 6;
BA_ "AfdxFDSaddr" SG_ 437922684 IOM_DEMO_VFG_OIL_TEMP22_A_33 16;
BA_ "AfdxFDSlength" SG_ 437922684 IOM_DEMO_VFG_OIL_TEMP22_A_33 4;
BA_ "AfdxFDSname" SG_ 437922684 IOM_DEMO_VFG_OIL_TEMP22_A_33 "FDS_HSMU_DEMO22_3";
BA_ "AfdxSignalType" SG_ 437922684 IOM_DEMO_VFG_OIL_TEMP22_A_33 3;
BA_ "AfdxFSaddr" SG_ 437922684 FS_HSMU_DEMO22_4 7;
BA_ "AfdxFDSaddr" SG_ 437922684 FS_HSMU_DEMO22_4 20;
BA_ "AfdxFDSlength" SG_ 437922684 FS_HSMU_DEMO22_4 4;
BA_ "AfdxFDSname" SG_ 437922684 FS_HSMU_DEMO22_4 "FDS_HSMU_DEMO22_4";
BA_ "AfdxSignalType" SG_ 437922684 FS_HSMU_DEMO22_4 6;
BA_ "AfdxFSaddr" SG_ 437922684 IOM_DEMO_VFG_OIL_TEMP22_A_34 7;
BA_ "AfdxFDSaddr" SG_ 437922684 IOM_DEMO_VFG_OIL_TEMP22_A_34 20;
BA_ "AfdxFDSlength" SG_ 437922684 IOM_DEMO_VFG_OIL_TEMP22_A_34 4;
BA_ "AfdxFDSname" SG_ 437922684 IOM_DEMO_VFG_OIL_TEMP22_A_34 "FDS_HSMU_DEMO22_4";
BA_ "AfdxSignalType" SG_ 437922684 IOM_DEMO_VFG_OIL_TEMP22_A_34 3;
BA_ "AfdxFSaddr" SG_ 437922684 FS_HSMU_DEMO22_5 24;
BA_ "AfdxFDSaddr" SG_ 437922684 FS_HSMU_DEMO22_5 28;
BA_ "AfdxFDSlength" SG_ 437922684 FS_HSMU_DEMO22_5 4;
BA_ "AfdxFDSname" SG_ 437922684 FS_HSMU_DEMO22_5 "FDS_HSMU_DEMO22_5";
BA_ "AfdxSignalType" SG_ 437922684 FS_HSMU_DEMO22_5 6;
BA_ "AfdxFSaddr" SG_ 437922684 IOM_DEMO_VFG_OIL_TEMP22_A_35 24;
BA_ "AfdxFDSaddr" SG_ 437922684 IOM_DEMO_VFG_OIL_TEMP22_A_35 28;
BA_ "AfdxFDSlength" SG_ 437922684 IOM_DEMO_VFG_OIL_TEMP22_A_35 4;
BA_ "AfdxFDSname" SG_ 437922684 IOM_DEMO_VFG_OIL_TEMP22_A_35 "FDS_HSMU_DEMO22_5";
BA_ "AfdxSignalType" SG_ 437922684 IOM_DEMO_VFG_OIL_TEMP22_A_35 3;
BA_ "AfdxFSaddr" SG_ 437922684 FS_HSMU_DEMO22_6 25;
BA_ "AfdxFDSaddr" SG_ 437922684 FS_HSMU_DEMO22_6 32;
BA_ "AfdxFDSlength" SG_ 437922684 FS_HSMU_DEMO22_6 4;
BA_ "AfdxFDSname" SG_ 437922684 FS_HSMU_DEMO22_6 "FDS_HSMU_DEMO22_6";
BA_ "AfdxSignalType" SG_ 437922684 FS_HSMU_DEMO22_6 6;
BA_ "AfdxFSaddr" SG_ 437922684 IOM_DEMO_VFG_OIL_TEMP22_A_36 25;
BA_ "AfdxFDSaddr" SG_ 437922684 IOM_DEMO_VFG_OIL_TEMP22_A_36 32;
BA_ "AfdxFDSlength" SG_ 437922684 IOM_DEMO_VFG_OIL_TEMP22_A_36 4;
BA_ "AfdxFDSname" SG_ 437922684 IOM_DEMO_VFG_OIL_TEMP22_A_36 "FDS_HSMU_DEMO22_6";
BA_ "AfdxSignalType" SG_ 437922684 IOM_DEMO_VFG_OIL_TEMP22_A_36 3;
BA_ "AfdxFSaddr" SG_ 437922684 FS_HSMU_DEMO22_7 26;
BA_ "AfdxFDSaddr" SG_ 437922684 FS_HSMU_DEMO22_7 36;
BA_ "AfdxFDSlength" SG_ 437922684 FS_HSMU_DEMO22_7 4;
BA_ "AfdxFDSname" SG_ 437922684 FS_HSMU_DEMO22_7 "FDS_HSMU_DEMO22_7";
BA_ "AfdxSignalType" SG_ 437922684 FS_HSMU_DEMO22_7 6;
BA_ "AfdxFSaddr" SG_ 437922684 IOM_DEMO_VFG_OIL_TEMP22_A_37 26;
BA_ "AfdxFDSaddr" SG_ 437922684 IOM_DEMO_VFG_OIL_TEMP22_A_37 36;
BA_ "AfdxFDSlength" SG_ 437922684 IOM_DEMO_VFG_OIL_TEMP22_A_37 4;
BA_ "AfdxFDSname" SG_ 437922684 IOM_DEMO_VFG_OIL_TEMP22_A_37 "FDS_HSMU_DEMO22_7";
BA_ "AfdxSignalType" SG_ 437922684 IOM_DEMO_VFG_OIL_TEMP22_A_37 3;
BA_ "AfdxFSaddr" SG_ 437922684 FS_HSMU_DEMO22_8 27;
BA_ "AfdxFDSaddr" SG_ 437922684 FS_HSMU_DEMO22_8 40;
BA_ "AfdxFDSlength" SG_ 437922684 FS_HSMU_DEMO22_8 4;
BA_ "AfdxFDSname" SG_ 437922684 FS_HSMU_DEMO22_8 "FDS_HSMU_DEMO22_8";
BA_ "AfdxSignalType" SG_ 437922684 FS_HSMU_DEMO22_8 6;
BA_ "AfdxFSaddr" SG_ 437922684 IOM_DEMO_VFG_OIL_TEMP22_A_38 27;
BA_ "AfdxFDSaddr" SG_ 437922684 IOM_DEMO_VFG_OIL_TEMP22_A_38 40;
BA_ "AfdxFDSlength" SG_ 437922684 IOM_DEMO_VFG_OIL_TEMP22_A_38 4;
BA_ "AfdxFDSname" SG_ 437922684 IOM_DEMO_VFG_OIL_TEMP22_A_38 "FDS_HSMU_DEMO22_8";
BA_ "AfdxSignalType" SG_ 437922684 IOM_DEMO_VFG_OIL_TEMP22_A_38 3;
BA_ "AfdxFSaddr" SG_ 437922684 FS_HSMU_DEMO22_9 44;
BA_ "AfdxFDSaddr" SG_ 437922684 FS_HSMU_DEMO22_9 48;
BA_ "AfdxFDSlength" SG_ 437922684 FS_HSMU_DEMO22_9 4;
BA_ "AfdxFDSname" SG_ 437922684 FS_HSMU_DEMO22_9 "FDS_HSMU_DEMO22_9";
BA_ "AfdxSignalType" SG_ 437922684 FS_HSMU_DEMO22_9 6;
BA_ "AfdxFSaddr" SG_ 437922684 IOM_DEMO_VFG_OIL_TEMP22_A_39 44;
BA_ "AfdxFDSaddr" SG_ 437922684 IOM_DEMO_VFG_OIL_TEMP22_A_39 48;
BA_ "AfdxFDSlength" SG_ 437922684 IOM_DEMO_VFG_OIL_TEMP22_A_39 4;
BA_ "AfdxFDSname" SG_ 437922684 IOM_DEMO_VFG_OIL_TEMP22_A_39 "FDS_HSMU_DEMO22_9";
BA_ "AfdxSignalType" SG_ 437922684 IOM_DEMO_VFG_OIL_TEMP22_A_39 3;
BA_ "AfdxFSaddr" SG_ 437922684 FS_HSMU_DEMO22_10 45;
BA_ "AfdxFDSaddr" SG_ 437922684 FS_HSMU_DEMO22_10 52;
BA_ "AfdxFDSlength" SG_ 437922684 FS_HSMU_DEMO22_10 4;
BA_ "AfdxFDSname" SG_ 437922684 FS_HSMU_DEMO22_10 "FDS_HSMU_DEMO22_10";
BA_ "AfdxSignalType" SG_ 437922684 FS_HSMU_DEMO22_10 6;
BA_ "AfdxFSaddr" SG_ 437922684 IOM_DEMO_VFG_OIL_TEMP22_A_40 45;
BA_ "AfdxFDSaddr" SG_ 437922684 IOM_DEMO_VFG_OIL_TEMP22_A_40 52;
BA_ "AfdxFDSlength" SG_ 437922684 IOM_DEMO_VFG_OIL_TEMP22_A_40 4;
BA_ "AfdxFDSname" SG_ 437922684 IOM_DEMO_VFG_OIL_TEMP22_A_40 "FDS_HSMU_DEMO22_10";
BA_ "AfdxSignalType" SG_ 437922684 IOM_DEMO_VFG_OIL_TEMP22_A_40 3;
BA_ "AfdxFSaddr" SG_ 437922684 FS_HSMU_DEMO22_11 46;
BA_ "AfdxFDSaddr" SG_ 437922684 FS_HSMU_DEMO22_11 56;
BA_ "AfdxFDSlength" SG_ 437922684 FS_HSMU_DEMO22_11 4;
BA_ "AfdxFDSname" SG_ 437922684 FS_HSMU_DEMO22_11 "FDS_HSMU_DEMO22_11";
BA_ "AfdxSignalType" SG_ 437922684 FS_HSMU_DEMO22_11 6;
BA_ "AfdxFSaddr" SG_ 437922684 IOM_DEMO_VFG_OIL_TEMP22_A_41 46;
BA_ "AfdxFDSaddr" SG_ 437922684 IOM_DEMO_VFG_OIL_TEMP22_A_41 56;
BA_ "AfdxFDSlength" SG_ 437922684 IOM_DEMO_VFG_OIL_TEMP22_A_41 4;
BA_ "AfdxFDSname" SG_ 437922684 IOM_DEMO_VFG_OIL_TEMP22_A_41 "FDS_HSMU_DEMO22_11";
BA_ "AfdxSignalType" SG_ 437922684 IOM_DEMO_VFG_OIL_TEMP22_A_41 3;
BA_ "AfdxFSaddr" SG_ 437922684 FS_HSMU_DEMO22_12 47;
BA_ "AfdxFDSaddr" SG_ 437922684 FS_HSMU_DEMO22_12 60;
BA_ "AfdxFDSlength" SG_ 437922684 FS_HSMU_DEMO22_12 4;
BA_ "AfdxFDSname" SG_ 437922684 FS_HSMU_DEMO22_12 "FDS_HSMU_DEMO22_12";
BA_ "AfdxSignalType" SG_ 437922684 FS_HSMU_DEMO22_12 6;
BA_ "AfdxFSaddr" SG_ 437922684 IOM_DEMO_VFG_OIL_TEMP22_A_42 47;
BA_ "AfdxFDSaddr" SG_ 437922684 IOM_DEMO_VFG_OIL_TEMP22_A_42 60;
BA_ "AfdxFDSlength" SG_ 437922684 IOM_DEMO_VFG_OIL_TEMP22_A_42 4;
BA_ "AfdxFDSname" SG_ 437922684 IOM_DEMO_VFG_OIL_TEMP22_A_42 "FDS_HSMU_DEMO22_12";
BA_ "AfdxSignalType" SG_ 437922684 IOM_DEMO_VFG_OIL_TEMP22_A_42 3;
BA_ "AfdxFSaddr" SG_ 437922684 FS_HSMU_DEMO22_13 64;
BA_ "AfdxFDSaddr" SG_ 437922684 FS_HSMU_DEMO22_13 68;
BA_ "AfdxFDSlength" SG_ 437922684 FS_HSMU_DEMO22_13 4;
BA_ "AfdxFDSname" SG_ 437922684 FS_HSMU_DEMO22_13 "FDS_HSMU_DEMO22_13";
BA_ "AfdxSignalType" SG_ 437922684 FS_HSMU_DEMO22_13 6;
BA_ "AfdxFSaddr" SG_ 437922684 IOM_DEMO_VFG_OIL_TEMP22_A_43 64;
BA_ "AfdxFDSaddr" SG_ 437922684 IOM_DEMO_VFG_OIL_TEMP22_A_43 68;
BA_ "AfdxFDSlength" SG_ 437922684 IOM_DEMO_VFG_OIL_TEMP22_A_43 4;
BA_ "AfdxFDSname" SG_ 437922684 IOM_DEMO_VFG_OIL_TEMP22_A_43 "FDS_HSMU_DEMO22_13";
BA_ "AfdxSignalType" SG_ 437922684 IOM_DEMO_VFG_OIL_TEMP22_A_43 3;
BA_ "AfdxFSaddr" SG_ 437922684 FS_HSMU_DEMO22_14 65;
BA_ "AfdxFDSaddr" SG_ 437922684 FS_HSMU_DEMO22_14 72;
BA_ "AfdxFDSlength" SG_ 437922684 FS_HSMU_DEMO22_14 4;
BA_ "AfdxFDSname" SG_ 437922684 FS_HSMU_DEMO22_14 "FDS_HSMU_DEMO22_14";
BA_ "AfdxSignalType" SG_ 437922684 FS_HSMU_DEMO22_14 6;
BA_ "AfdxFSaddr" SG_ 437922684 IOM_DEMO_VFG_OIL_TEMP22_A_44 65;
BA_ "AfdxFDSaddr" SG_ 437922684 IOM_DEMO_VFG_OIL_TEMP22_A_44 72;
BA_ "AfdxFDSlength" SG_ 437922684 IOM_DEMO_VFG_OIL_TEMP22_A_44 4;
BA_ "AfdxFDSname" SG_ 437922684 IOM_DEMO_VFG_OIL_TEMP22_A_44 "FDS_HSMU_DEMO22_14";
BA_ "AfdxSignalType" SG_ 437922684 IOM_DEMO_VFG_OIL_TEMP22_A_44 3;
BA_ "AfdxFSaddr" SG_ 437922684 FS_HSMU_DEMO22_15 66;
BA_ "AfdxFDSaddr" SG_ 437922684 FS_HSMU_DEMO22_15 76;
BA_ "AfdxFDSlength" SG_ 437922684 FS_HSMU_DEMO22_15 4;
BA_ "AfdxFDSname" SG_ 437922684 FS_HSMU_DEMO22_15 "FDS_HSMU_DEMO22_15";
BA_ "AfdxSignalType" SG_ 437922684 FS_HSMU_DEMO22_15 6;
BA_ "AfdxFSaddr" SG_ 437922684 IOM_DEMO_VFG_OIL_TEMP22_A_45 66;
BA_ "AfdxFDSaddr" SG_ 437922684 IOM_DEMO_VFG_OIL_TEMP22_A_45 76;
BA_ "AfdxFDSlength" SG_ 437922684 IOM_DEMO_VFG_OIL_TEMP22_A_45 4;
BA_ "AfdxFDSname" SG_ 437922684 IOM_DEMO_VFG_OIL_TEMP22_A_45 "FDS_HSMU_DEMO22_15";
BA_ "AfdxSignalType" SG_ 437922684 IOM_DEMO_VFG_OIL_TEMP22_A_45 3;
BA_ "AfdxFSaddr" SG_ 437922684 FS_HSMU_DEMO22_16 67;
BA_ "AfdxFDSaddr" SG_ 437922684 FS_HSMU_DEMO22_16 80;
BA_ "AfdxFDSlength" SG_ 437922684 FS_HSMU_DEMO22_16 4;
BA_ "AfdxFDSname" SG_ 437922684 FS_HSMU_DEMO22_16 "FDS_HSMU_DEMO22_16";
BA_ "AfdxSignalType" SG_ 437922684 FS_HSMU_DEMO22_16 6;
BA_ "AfdxFSaddr" SG_ 437922684 IOM_DEMO_VFG_OIL_TEMP22_A_46 67;
BA_ "AfdxFDSaddr" SG_ 437922684 IOM_DEMO_VFG_OIL_TEMP22_A_46 80;
BA_ "AfdxFDSlength" SG_ 437922684 IOM_DEMO_VFG_OIL_TEMP22_A_46 4;
BA_ "AfdxFDSname" SG_ 437922684 IOM_DEMO_VFG_OIL_TEMP22_A_46 "FDS_HSMU_DEMO22_16";
BA_ "AfdxSignalType" SG_ 437922684 IOM_DEMO_VFG_OIL_TEMP22_A_46 3;
BA_ "AfdxFSaddr" SG_ 437922684 FS_HSMU_DEMO22_17 84;
BA_ "AfdxFDSaddr" SG_ 437922684 FS_HSMU_DEMO22_17 88;
BA_ "AfdxFDSlength" SG_ 437922684 FS_HSMU_DEMO22_17 4;
BA_ "AfdxFDSname" SG_ 437922684 FS_HSMU_DEMO22_17 "FDS_HSMU_DEMO22_17";
BA_ "AfdxSignalType" SG_ 437922684 FS_HSMU_DEMO22_17 6;
BA_ "AfdxFSaddr" SG_ 437922684 IOM_DEMO_VFG_OIL_TEMP22_A_47 84;
BA_ "AfdxFDSaddr" SG_ 437922684 IOM_DEMO_VFG_OIL_TEMP22_A_47 88;
BA_ "AfdxFDSlength" SG_ 437922684 IOM_DEMO_VFG_OIL_TEMP22_A_47 4;
BA_ "AfdxFDSname" SG_ 437922684 IOM_DEMO_VFG_OIL_TEMP22_A_47 "FDS_HSMU_DEMO22_17";
BA_ "AfdxSignalType" SG_ 437922684 IOM_DEMO_VFG_OIL_TEMP22_A_47 3;
BA_ "AfdxFSaddr" SG_ 437922684 FS_HSMU_DEMO22_18 85;
BA_ "AfdxFDSaddr" SG_ 437922684 FS_HSMU_DEMO22_18 92;
BA_ "AfdxFDSlength" SG_ 437922684 FS_HSMU_DEMO22_18 4;
BA_ "AfdxFDSname" SG_ 437922684 FS_HSMU_DEMO22_18 "FDS_HSMU_DEMO22_18";
BA_ "AfdxSignalType" SG_ 437922684 FS_HSMU_DEMO22_18 6;
BA_ "AfdxFSaddr" SG_ 437922684 IOM_DEMO_VFG_OIL_TEMP22_A_48 85;
BA_ "AfdxFDSaddr" SG_ 437922684 IOM_DEMO_VFG_OIL_TEMP22_A_48 92;
BA_ "AfdxFDSlength" SG_ 437922684 IOM_DEMO_VFG_OIL_TEMP22_A_48 4;
BA_ "AfdxFDSname" SG_ 437922684 IOM_DEMO_VFG_OIL_TEMP22_A_48 "FDS_HSMU_DEMO22_18";
BA_ "AfdxSignalType" SG_ 437922684 IOM_DEMO_VFG_OIL_TEMP22_A_48 3;
BA_ "AfdxFSaddr" SG_ 437922684 FS_HSMU_DEMO22_19 86;
BA_ "AfdxFDSaddr" SG_ 437922684 FS_HSMU_DEMO22_19 96;
BA_ "AfdxFDSlength" SG_ 437922684 FS_HSMU_DEMO22_19 4;
BA_ "AfdxFDSname" SG_ 437922684 FS_HSMU_DEMO22_19 "FDS_HSMU_DEMO22_19";
BA_ "AfdxSignalType" SG_ 437922684 FS_HSMU_DEMO22_19 6;
BA_ "AfdxFSaddr" SG_ 437922684 IOM_DEMO_VFG_OIL_TEMP22_A_49 86;
BA_ "AfdxFDSaddr" SG_ 437922684 IOM_DEMO_VFG_OIL_TEMP22_A_49 96;
BA_ "AfdxFDSlength" SG_ 437922684 IOM_DEMO_VFG_OIL_TEMP22_A_49 4;
BA_ "AfdxFDSname" SG_ 437922684 IOM_DEMO_VFG_OIL_TEMP22_A_49 "FDS_HSMU_DEMO22_19";
BA_ "AfdxSignalType" SG_ 437922684 IOM_DEMO_VFG_OIL_TEMP22_A_49 3;
BA_ "AfdxFSaddr" SG_ 437922684 FS_HSMU_DEMO22_20 87;
BA_ "AfdxFDSaddr" SG_ 437922684 FS_HSMU_DEMO22_20 100;
BA_ "AfdxFDSlength" SG_ 437922684 FS_HSMU_DEMO22_20 4;
BA_ "AfdxFDSname" SG_ 437922684 FS_HSMU_DEMO22_20 "FDS_HSMU_DEMO22_20";
BA_ "AfdxSignalType" SG_ 437922684 FS_HSMU_DEMO22_20 6;
BA_ "AfdxFSaddr" SG_ 437922684 IOM_DEMO_VFG_OIL_TEMP22_A_50 87;
BA_ "AfdxFDSaddr" SG_ 437922684 IOM_DEMO_VFG_OIL_TEMP22_A_50 100;
BA_ "AfdxFDSlength" SG_ 437922684 IOM_DEMO_VFG_OIL_TEMP22_A_50 4;
BA_ "AfdxFDSname" SG_ 437922684 IOM_DEMO_VFG_OIL_TEMP22_A_50 "FDS_HSMU_DEMO22_20";
BA_ "AfdxSignalType" SG_ 437922684 IOM_DEMO_VFG_OIL_TEMP22_A_50 3;
BA_ "AfdxFSaddr" SG_ 437922684 FS_HSMU_DEMO22_21 104;
BA_ "AfdxFDSaddr" SG_ 437922684 FS_HSMU_DEMO22_21 108;
BA_ "AfdxFDSlength" SG_ 437922684 FS_HSMU_DEMO22_21 4;
BA_ "AfdxFDSname" SG_ 437922684 FS_HSMU_DEMO22_21 "FDS_HSMU_DEMO22_21";
BA_ "AfdxSignalType" SG_ 437922684 FS_HSMU_DEMO22_21 6;
BA_ "AfdxFSaddr" SG_ 437922684 IOM_DEMO_VFG_OIL_TEMP22_A_51 104;
BA_ "AfdxFDSaddr" SG_ 437922684 IOM_DEMO_VFG_OIL_TEMP22_A_51 108;
BA_ "AfdxFDSlength" SG_ 437922684 IOM_DEMO_VFG_OIL_TEMP22_A_51 4;
BA_ "AfdxFDSname" SG_ 437922684 IOM_DEMO_VFG_OIL_TEMP22_A_51 "FDS_HSMU_DEMO22_21";
BA_ "AfdxSignalType" SG_ 437922684 IOM_DEMO_VFG_OIL_TEMP22_A_51 3;
BA_ "AfdxFDSaddr" SG_ 437857147 FS_HSMU_DEMO21_1 8;
BA_ "AfdxFDSlength" SG_ 437857147 FS_HSMU_DEMO21_1 4;
BA_ "AfdxFDSname" SG_ 437857147 FS_HSMU_DEMO21_1 "FDS_HSMU_DEMO21_1";
BA_ "AfdxSignalType" SG_ 437857147 FS_HSMU_DEMO21_1 6;
BA_ "AfdxFDSaddr" SG_ 437857147 IOM_DEMO_VFG_OIL_TEMP21_A_31 8;
BA_ "AfdxFDSlength" SG_ 437857147 IOM_DEMO_VFG_OIL_TEMP21_A_31 4;
BA_ "AfdxFDSname" SG_ 437857147 IOM_DEMO_VFG_OIL_TEMP21_A_31 "FDS_HSMU_DEMO21_1";
BA_ "AfdxSignalType" SG_ 437857147 IOM_DEMO_VFG_OIL_TEMP21_A_31 3;
BA_ "AfdxFSaddr" SG_ 437857147 FS_HSMU_DEMO21_2 5;
BA_ "AfdxFDSaddr" SG_ 437857147 FS_HSMU_DEMO21_2 12;
BA_ "AfdxFDSlength" SG_ 437857147 FS_HSMU_DEMO21_2 4;
BA_ "AfdxFDSname" SG_ 437857147 FS_HSMU_DEMO21_2 "FDS_HSMU_DEMO21_2";
BA_ "AfdxSignalType" SG_ 437857147 FS_HSMU_DEMO21_2 6;
BA_ "AfdxFSaddr" SG_ 437857147 IOM_DEMO_VFG_OIL_TEMP21_A_32 5;
BA_ "AfdxFDSaddr" SG_ 437857147 IOM_DEMO_VFG_OIL_TEMP21_A_32 12;
BA_ "AfdxFDSlength" SG_ 437857147 IOM_DEMO_VFG_OIL_TEMP21_A_32 4;
BA_ "AfdxFDSname" SG_ 437857147 IOM_DEMO_VFG_OIL_TEMP21_A_32 "FDS_HSMU_DEMO21_2";
BA_ "AfdxSignalType" SG_ 437857147 IOM_DEMO_VFG_OIL_TEMP21_A_32 3;
BA_ "AfdxFSaddr" SG_ 437857147 FS_HSMU_DEMO21_3 6;
BA_ "AfdxFDSaddr" SG_ 437857147 FS_HSMU_DEMO21_3 16;
BA_ "AfdxFDSlength" SG_ 437857147 FS_HSMU_DEMO21_3 4;
BA_ "AfdxFDSname" SG_ 437857147 FS_HSMU_DEMO21_3 "FDS_HSMU_DEMO21_3";
BA_ "AfdxSignalType" SG_ 437857147 FS_HSMU_DEMO21_3 6;
BA_ "AfdxFSaddr" SG_ 437857147 IOM_DEMO_VFG_OIL_TEMP21_A_33 6;
BA_ "AfdxFDSaddr" SG_ 437857147 IOM_DEMO_VFG_OIL_TEMP21_A_33 16;
BA_ "AfdxFDSlength" SG_ 437857147 IOM_DEMO_VFG_OIL_TEMP21_A_33 4;
BA_ "AfdxFDSname" SG_ 437857147 IOM_DEMO_VFG_OIL_TEMP21_A_33 "FDS_HSMU_DEMO21_3";
BA_ "AfdxSignalType" SG_ 437857147 IOM_DEMO_VFG_OIL_TEMP21_A_33 3;
BA_ "AfdxFSaddr" SG_ 437857147 FS_HSMU_DEMO21_4 7;
BA_ "AfdxFDSaddr" SG_ 437857147 FS_HSMU_DEMO21_4 20;
BA_ "AfdxFDSlength" SG_ 437857147 FS_HSMU_DEMO21_4 4;
BA_ "AfdxFDSname" SG_ 437857147 FS_HSMU_DEMO21_4 "FDS_HSMU_DEMO21_4";
BA_ "AfdxSignalType" SG_ 437857147 FS_HSMU_DEMO21_4 6;
BA_ "AfdxFSaddr" SG_ 437857147 IOM_DEMO_VFG_OIL_TEMP21_A_34 7;
BA_ "AfdxFDSaddr" SG_ 437857147 IOM_DEMO_VFG_OIL_TEMP21_A_34 20;
BA_ "AfdxFDSlength" SG_ 437857147 IOM_DEMO_VFG_OIL_TEMP21_A_34 4;
BA_ "AfdxFDSname" SG_ 437857147 IOM_DEMO_VFG_OIL_TEMP21_A_34 "FDS_HSMU_DEMO21_4";
BA_ "AfdxSignalType" SG_ 437857147 IOM_DEMO_VFG_OIL_TEMP21_A_34 3;
BA_ "AfdxFSaddr" SG_ 437857147 FS_HSMU_DEMO21_5 24;
BA_ "AfdxFDSaddr" SG_ 437857147 FS_HSMU_DEMO21_5 28;
BA_ "AfdxFDSlength" SG_ 437857147 FS_HSMU_DEMO21_5 4;
BA_ "AfdxFDSname" SG_ 437857147 FS_HSMU_DEMO21_5 "FDS_HSMU_DEMO21_5";
BA_ "AfdxSignalType" SG_ 437857147 FS_HSMU_DEMO21_5 6;
BA_ "AfdxFSaddr" SG_ 437857147 IOM_DEMO_VFG_OIL_TEMP21_A_35 24;
BA_ "AfdxFDSaddr" SG_ 437857147 IOM_DEMO_VFG_OIL_TEMP21_A_35 28;
BA_ "AfdxFDSlength" SG_ 437857147 IOM_DEMO_VFG_OIL_TEMP21_A_35 4;
BA_ "AfdxFDSname" SG_ 437857147 IOM_DEMO_VFG_OIL_TEMP21_A_35 "FDS_HSMU_DEMO21_5";
BA_ "AfdxSignalType" SG_ 437857147 IOM_DEMO_VFG_OIL_TEMP21_A_35 3;
BA_ "AfdxFSaddr" SG_ 437857147 FS_HSMU_DEMO21_6 25;
BA_ "AfdxFDSaddr" SG_ 437857147 FS_HSMU_DEMO21_6 32;
BA_ "AfdxFDSlength" SG_ 437857147 FS_HSMU_DEMO21_6 4;
BA_ "AfdxFDSname" SG_ 437857147 FS_HSMU_DEMO21_6 "FDS_HSMU_DEMO21_6";
BA_ "AfdxSignalType" SG_ 437857147 FS_HSMU_DEMO21_6 6;
BA_ "AfdxFSaddr" SG_ 437857147 IOM_DEMO_VFG_OIL_TEMP21_A_36 25;
BA_ "AfdxFDSaddr" SG_ 437857147 IOM_DEMO_VFG_OIL_TEMP21_A_36 32;
BA_ "AfdxFDSlength" SG_ 437857147 IOM_DEMO_VFG_OIL_TEMP21_A_36 4;
BA_ "AfdxFDSname" SG_ 437857147 IOM_DEMO_VFG_OIL_TEMP21_A_36 "FDS_HSMU_DEMO21_6";
BA_ "AfdxSignalType" SG_ 437857147 IOM_DEMO_VFG_OIL_TEMP21_A_36 3;
BA_ "AfdxFSaddr" SG_ 437857147 FS_HSMU_DEMO21_7 26;
BA_ "AfdxFDSaddr" SG_ 437857147 FS_HSMU_DEMO21_7 36;
BA_ "AfdxFDSlength" SG_ 437857147 FS_HSMU_DEMO21_7 4;
BA_ "AfdxFDSname" SG_ 437857147 FS_HSMU_DEMO21_7 "FDS_HSMU_DEMO21_7";
BA_ "AfdxSignalType" SG_ 437857147 FS_HSMU_DEMO21_7 6;
BA_ "AfdxFSaddr" SG_ 437857147 IOM_DEMO_VFG_OIL_TEMP21_A_37 26;
BA_ "AfdxFDSaddr" SG_ 437857147 IOM_DEMO_VFG_OIL_TEMP21_A_37 36;
BA_ "AfdxFDSlength" SG_ 437857147 IOM_DEMO_VFG_OIL_TEMP21_A_37 4;
BA_ "AfdxFDSname" SG_ 437857147 IOM_DEMO_VFG_OIL_TEMP21_A_37 "FDS_HSMU_DEMO21_7";
BA_ "AfdxSignalType" SG_ 437857147 IOM_DEMO_VFG_OIL_TEMP21_A_37 3;
BA_ "AfdxFSaddr" SG_ 437857147 FS_HSMU_DEMO21_8 27;
BA_ "AfdxFDSaddr" SG_ 437857147 FS_HSMU_DEMO21_8 40;
BA_ "AfdxFDSlength" SG_ 437857147 FS_HSMU_DEMO21_8 4;
BA_ "AfdxFDSname" SG_ 437857147 FS_HSMU_DEMO21_8 "FDS_HSMU_DEMO21_8";
BA_ "AfdxSignalType" SG_ 437857147 FS_HSMU_DEMO21_8 6;
BA_ "AfdxFSaddr" SG_ 437857147 IOM_DEMO_VFG_OIL_TEMP21_A_38 27;
BA_ "AfdxFDSaddr" SG_ 437857147 IOM_DEMO_VFG_OIL_TEMP21_A_38 40;
BA_ "AfdxFDSlength" SG_ 437857147 IOM_DEMO_VFG_OIL_TEMP21_A_38 4;
BA_ "AfdxFDSname" SG_ 437857147 IOM_DEMO_VFG_OIL_TEMP21_A_38 "FDS_HSMU_DEMO21_8";
BA_ "AfdxSignalType" SG_ 437857147 IOM_DEMO_VFG_OIL_TEMP21_A_38 3;
BA_ "AfdxFSaddr" SG_ 437857147 FS_HSMU_DEMO21_9 44;
BA_ "AfdxFDSaddr" SG_ 437857147 FS_HSMU_DEMO21_9 48;
BA_ "AfdxFDSlength" SG_ 437857147 FS_HSMU_DEMO21_9 4;
BA_ "AfdxFDSname" SG_ 437857147 FS_HSMU_DEMO21_9 "FDS_HSMU_DEMO21_9";
BA_ "AfdxSignalType" SG_ 437857147 FS_HSMU_DEMO21_9 6;
BA_ "AfdxFSaddr" SG_ 437857147 IOM_DEMO_VFG_OIL_TEMP21_A_39 44;
BA_ "AfdxFDSaddr" SG_ 437857147 IOM_DEMO_VFG_OIL_TEMP21_A_39 48;
BA_ "AfdxFDSlength" SG_ 437857147 IOM_DEMO_VFG_OIL_TEMP21_A_39 4;
BA_ "AfdxFDSname" SG_ 437857147 IOM_DEMO_VFG_OIL_TEMP21_A_39 "FDS_HSMU_DEMO21_9";
BA_ "AfdxSignalType" SG_ 437857147 IOM_DEMO_VFG_OIL_TEMP21_A_39 3;
BA_ "AfdxFSaddr" SG_ 437857147 FS_HSMU_DEMO21_10 45;
BA_ "AfdxFDSaddr" SG_ 437857147 FS_HSMU_DEMO21_10 52;
BA_ "AfdxFDSlength" SG_ 437857147 FS_HSMU_DEMO21_10 4;
BA_ "AfdxFDSname" SG_ 437857147 FS_HSMU_DEMO21_10 "FDS_HSMU_DEMO21_10";
BA_ "AfdxSignalType" SG_ 437857147 FS_HSMU_DEMO21_10 6;
BA_ "AfdxFSaddr" SG_ 437857147 IOM_DEMO_VFG_OIL_TEMP21_A_40 45;
BA_ "AfdxFDSaddr" SG_ 437857147 IOM_DEMO_VFG_OIL_TEMP21_A_40 52;
BA_ "AfdxFDSlength" SG_ 437857147 IOM_DEMO_VFG_OIL_TEMP21_A_40 4;
BA_ "AfdxFDSname" SG_ 437857147 IOM_DEMO_VFG_OIL_TEMP21_A_40 "FDS_HSMU_DEMO21_10";
BA_ "AfdxSignalType" SG_ 437857147 IOM_DEMO_VFG_OIL_TEMP21_A_40 3;
BA_ "AfdxFSaddr" SG_ 437857147 FS_HSMU_DEMO21_11 46;
BA_ "AfdxFDSaddr" SG_ 437857147 FS_HSMU_DEMO21_11 56;
BA_ "AfdxFDSlength" SG_ 437857147 FS_HSMU_DEMO21_11 4;
BA_ "AfdxFDSname" SG_ 437857147 FS_HSMU_DEMO21_11 "FDS_HSMU_DEMO21_11";
BA_ "AfdxSignalType" SG_ 437857147 FS_HSMU_DEMO21_11 6;
BA_ "AfdxFSaddr" SG_ 437857147 IOM_DEMO_VFG_OIL_TEMP21_A_41 46;
BA_ "AfdxFDSaddr" SG_ 437857147 IOM_DEMO_VFG_OIL_TEMP21_A_41 56;
BA_ "AfdxFDSlength" SG_ 437857147 IOM_DEMO_VFG_OIL_TEMP21_A_41 4;
BA_ "AfdxFDSname" SG_ 437857147 IOM_DEMO_VFG_OIL_TEMP21_A_41 "FDS_HSMU_DEMO21_11";
BA_ "AfdxSignalType" SG_ 437857147 IOM_DEMO_VFG_OIL_TEMP21_A_41 3;
BA_ "AfdxFSaddr" SG_ 437857147 FS_HSMU_DEMO21_12 47;
BA_ "AfdxFDSaddr" SG_ 437857147 FS_HSMU_DEMO21_12 60;
BA_ "AfdxFDSlength" SG_ 437857147 FS_HSMU_DEMO21_12 4;
BA_ "AfdxFDSname" SG_ 437857147 FS_HSMU_DEMO21_12 "FDS_HSMU_DEMO21_12";
BA_ "AfdxSignalType" SG_ 437857147 FS_HSMU_DEMO21_12 6;
BA_ "AfdxFSaddr" SG_ 437857147 IOM_DEMO_VFG_OIL_TEMP21_A_42 47;
BA_ "AfdxFDSaddr" SG_ 437857147 IOM_DEMO_VFG_OIL_TEMP21_A_42 60;
BA_ "AfdxFDSlength" SG_ 437857147 IOM_DEMO_VFG_OIL_TEMP21_A_42 4;
BA_ "AfdxFDSname" SG_ 437857147 IOM_DEMO_VFG_OIL_TEMP21_A_42 "FDS_HSMU_DEMO21_12";
BA_ "AfdxSignalType" SG_ 437857147 IOM_DEMO_VFG_OIL_TEMP21_A_42 3;
BA_ "AfdxFSaddr" SG_ 437857147 FS_HSMU_DEMO21_13 64;
BA_ "AfdxFDSaddr" SG_ 437857147 FS_HSMU_DEMO21_13 68;
BA_ "AfdxFDSlength" SG_ 437857147 FS_HSMU_DEMO21_13 4;
BA_ "AfdxFDSname" SG_ 437857147 FS_HSMU_DEMO21_13 "FDS_HSMU_DEMO21_13";
BA_ "AfdxSignalType" SG_ 437857147 FS_HSMU_DEMO21_13 6;
BA_ "AfdxFSaddr" SG_ 437857147 IOM_DEMO_VFG_OIL_TEMP21_A_43 64;
BA_ "AfdxFDSaddr" SG_ 437857147 IOM_DEMO_VFG_OIL_TEMP21_A_43 68;
BA_ "AfdxFDSlength" SG_ 437857147 IOM_DEMO_VFG_OIL_TEMP21_A_43 4;
BA_ "AfdxFDSname" SG_ 437857147 IOM_DEMO_VFG_OIL_TEMP21_A_43 "FDS_HSMU_DEMO21_13";
BA_ "AfdxSignalType" SG_ 437857147 IOM_DEMO_VFG_OIL_TEMP21_A_43 3;
BA_ "AfdxFSaddr" SG_ 437857147 FS_HSMU_DEMO21_14 65;
BA_ "AfdxFDSaddr" SG_ 437857147 FS_HSMU_DEMO21_14 72;
BA_ "AfdxFDSlength" SG_ 437857147 FS_HSMU_DEMO21_14 4;
BA_ "AfdxFDSname" SG_ 437857147 FS_HSMU_DEMO21_14 "FDS_HSMU_DEMO21_14";
BA_ "AfdxSignalType" SG_ 437857147 FS_HSMU_DEMO21_14 6;
BA_ "AfdxFSaddr" SG_ 437857147 IOM_DEMO_VFG_OIL_TEMP21_A_44 65;
BA_ "AfdxFDSaddr" SG_ 437857147 IOM_DEMO_VFG_OIL_TEMP21_A_44 72;
BA_ "AfdxFDSlength" SG_ 437857147 IOM_DEMO_VFG_OIL_TEMP21_A_44 4;
BA_ "AfdxFDSname" SG_ 437857147 IOM_DEMO_VFG_OIL_TEMP21_A_44 "FDS_HSMU_DEMO21_14";
BA_ "AfdxSignalType" SG_ 437857147 IOM_DEMO_VFG_OIL_TEMP21_A_44 3;
BA_ "AfdxFSaddr" SG_ 437857147 FS_HSMU_DEMO21_15 66;
BA_ "AfdxFDSaddr" SG_ 437857147 FS_HSMU_DEMO21_15 76;
BA_ "AfdxFDSlength" SG_ 437857147 FS_HSMU_DEMO21_15 4;
BA_ "AfdxFDSname" SG_ 437857147 FS_HSMU_DEMO21_15 "FDS_HSMU_DEMO21_15";
BA_ "AfdxSignalType" SG_ 437857147 FS_HSMU_DEMO21_15 6;
BA_ "AfdxFSaddr" SG_ 437857147 IOM_DEMO_VFG_OIL_TEMP21_A_45 66;
BA_ "AfdxFDSaddr" SG_ 437857147 IOM_DEMO_VFG_OIL_TEMP21_A_45 76;
BA_ "AfdxFDSlength" SG_ 437857147 IOM_DEMO_VFG_OIL_TEMP21_A_45 4;
BA_ "AfdxFDSname" SG_ 437857147 IOM_DEMO_VFG_OIL_TEMP21_A_45 "FDS_HSMU_DEMO21_15";
BA_ "AfdxSignalType" SG_ 437857147 IOM_DEMO_VFG_OIL_TEMP21_A_45 3;
BA_ "AfdxFSaddr" SG_ 437857147 FS_HSMU_DEMO21_16 67;
BA_ "AfdxFDSaddr" SG_ 437857147 FS_HSMU_DEMO21_16 80;
BA_ "AfdxFDSlength" SG_ 437857147 FS_HSMU_DEMO21_16 4;
BA_ "AfdxFDSname" SG_ 437857147 FS_HSMU_DEMO21_16 "FDS_HSMU_DEMO21_16";
BA_ "AfdxSignalType" SG_ 437857147 FS_HSMU_DEMO21_16 6;
BA_ "AfdxFSaddr" SG_ 437857147 IOM_DEMO_VFG_OIL_TEMP21_A_46 67;
BA_ "AfdxFDSaddr" SG_ 437857147 IOM_DEMO_VFG_OIL_TEMP21_A_46 80;
BA_ "AfdxFDSlength" SG_ 437857147 IOM_DEMO_VFG_OIL_TEMP21_A_46 4;
BA_ "AfdxFDSname" SG_ 437857147 IOM_DEMO_VFG_OIL_TEMP21_A_46 "FDS_HSMU_DEMO21_16";
BA_ "AfdxSignalType" SG_ 437857147 IOM_DEMO_VFG_OIL_TEMP21_A_46 3;
BA_ "AfdxFSaddr" SG_ 437857147 FS_HSMU_DEMO21_17 84;
BA_ "AfdxFDSaddr" SG_ 437857147 FS_HSMU_DEMO21_17 88;
BA_ "AfdxFDSlength" SG_ 437857147 FS_HSMU_DEMO21_17 4;
BA_ "AfdxFDSname" SG_ 437857147 FS_HSMU_DEMO21_17 "FDS_HSMU_DEMO21_17";
BA_ "AfdxSignalType" SG_ 437857147 FS_HSMU_DEMO21_17 6;
BA_ "AfdxFSaddr" SG_ 437857147 IOM_DEMO_VFG_OIL_TEMP21_A_47 84;
BA_ "AfdxFDSaddr" SG_ 437857147 IOM_DEMO_VFG_OIL_TEMP21_A_47 88;
BA_ "AfdxFDSlength" SG_ 437857147 IOM_DEMO_VFG_OIL_TEMP21_A_47 4;
BA_ "AfdxFDSname" SG_ 437857147 IOM_DEMO_VFG_OIL_TEMP21_A_47 "FDS_HSMU_DEMO21_17";
BA_ "AfdxSignalType" SG_ 437857147 IOM_DEMO_VFG_OIL_TEMP21_A_47 3;
BA_ "AfdxFSaddr" SG_ 437857147 FS_HSMU_DEMO21_18 85;
BA_ "AfdxFDSaddr" SG_ 437857147 FS_HSMU_DEMO21_18 92;
BA_ "AfdxFDSlength" SG_ 437857147 FS_HSMU_DEMO21_18 4;
BA_ "AfdxFDSname" SG_ 437857147 FS_HSMU_DEMO21_18 "FDS_HSMU_DEMO21_18";
BA_ "AfdxSignalType" SG_ 437857147 FS_HSMU_DEMO21_18 6;
BA_ "AfdxFSaddr" SG_ 437857147 IOM_DEMO_VFG_OIL_TEMP21_A_48 85;
BA_ "AfdxFDSaddr" SG_ 437857147 IOM_DEMO_VFG_OIL_TEMP21_A_48 92;
BA_ "AfdxFDSlength" SG_ 437857147 IOM_DEMO_VFG_OIL_TEMP21_A_48 4;
BA_ "AfdxFDSname" SG_ 437857147 IOM_DEMO_VFG_OIL_TEMP21_A_48 "FDS_HSMU_DEMO21_18";
BA_ "AfdxSignalType" SG_ 437857147 IOM_DEMO_VFG_OIL_TEMP21_A_48 3;
BA_ "AfdxFSaddr" SG_ 437857147 FS_HSMU_DEMO21_19 86;
BA_ "AfdxFDSaddr" SG_ 437857147 FS_HSMU_DEMO21_19 96;
BA_ "AfdxFDSlength" SG_ 437857147 FS_HSMU_DEMO21_19 4;
BA_ "AfdxFDSname" SG_ 437857147 FS_HSMU_DEMO21_19 "FDS_HSMU_DEMO21_19";
BA_ "AfdxSignalType" SG_ 437857147 FS_HSMU_DEMO21_19 6;
BA_ "AfdxFSaddr" SG_ 437857147 IOM_DEMO_VFG_OIL_TEMP21_A_49 86;
BA_ "AfdxFDSaddr" SG_ 437857147 IOM_DEMO_VFG_OIL_TEMP21_A_49 96;
BA_ "AfdxFDSlength" SG_ 437857147 IOM_DEMO_VFG_OIL_TEMP21_A_49 4;
BA_ "AfdxFDSname" SG_ 437857147 IOM_DEMO_VFG_OIL_TEMP21_A_49 "FDS_HSMU_DEMO21_19";
BA_ "AfdxSignalType" SG_ 437857147 IOM_DEMO_VFG_OIL_TEMP21_A_49 3;
BA_ "AfdxFSaddr" SG_ 437857147 FS_HSMU_DEMO21_20 87;
BA_ "AfdxFDSaddr" SG_ 437857147 FS_HSMU_DEMO21_20 100;
BA_ "AfdxFDSlength" SG_ 437857147 FS_HSMU_DEMO21_20 4;
BA_ "AfdxFDSname" SG_ 437857147 FS_HSMU_DEMO21_20 "FDS_HSMU_DEMO21_20";
BA_ "AfdxSignalType" SG_ 437857147 FS_HSMU_DEMO21_20 6;
BA_ "AfdxFSaddr" SG_ 437857147 IOM_DEMO_VFG_OIL_TEMP21_A_50 87;
BA_ "AfdxFDSaddr" SG_ 437857147 IOM_DEMO_VFG_OIL_TEMP21_A_50 100;
BA_ "AfdxFDSlength" SG_ 437857147 IOM_DEMO_VFG_OIL_TEMP21_A_50 4;
BA_ "AfdxFDSname" SG_ 437857147 IOM_DEMO_VFG_OIL_TEMP21_A_50 "FDS_HSMU_DEMO21_20";
BA_ "AfdxSignalType" SG_ 437857147 IOM_DEMO_VFG_OIL_TEMP21_A_50 3;
BA_ "AfdxFSaddr" SG_ 437857147 FS_HSMU_DEMO21_21 104;
BA_ "AfdxFDSaddr" SG_ 437857147 FS_HSMU_DEMO21_21 108;
BA_ "AfdxFDSlength" SG_ 437857147 FS_HSMU_DEMO21_21 4;
BA_ "AfdxFDSname" SG_ 437857147 FS_HSMU_DEMO21_21 "FDS_HSMU_DEMO21_21";
BA_ "AfdxSignalType" SG_ 437857147 FS_HSMU_DEMO21_21 6;
BA_ "AfdxFSaddr" SG_ 437857147 IOM_DEMO_VFG_OIL_TEMP21_A_51 104;
BA_ "AfdxFDSaddr" SG_ 437857147 IOM_DEMO_VFG_OIL_TEMP21_A_51 108;
BA_ "AfdxFDSlength" SG_ 437857147 IOM_DEMO_VFG_OIL_TEMP21_A_51 4;
BA_ "AfdxFDSname" SG_ 437857147 IOM_DEMO_VFG_OIL_TEMP21_A_51 "FDS_HSMU_DEMO21_21";
BA_ "AfdxSignalType" SG_ 437857147 IOM_DEMO_VFG_OIL_TEMP21_A_51 3;
BA_ "AfdxFSaddr" SG_ 437857147 FS_HSMU_DEMO21_22 105;
BA_ "AfdxFDSaddr" SG_ 437857147 FS_HSMU_DEMO21_22 112;
BA_ "AfdxFDSlength" SG_ 437857147 FS_HSMU_DEMO21_22 4;
BA_ "AfdxFDSname" SG_ 437857147 FS_HSMU_DEMO21_22 "FDS_HSMU_DEMO21_22";
BA_ "AfdxSignalType" SG_ 437857147 FS_HSMU_DEMO21_22 6;
BA_ "AfdxFSaddr" SG_ 437857147 IOM_DEMO_VFG_OIL_TEMP21_A_52 105;
BA_ "AfdxFDSaddr" SG_ 437857147 IOM_DEMO_VFG_OIL_TEMP21_A_52 112;
BA_ "AfdxFDSlength" SG_ 437857147 IOM_DEMO_VFG_OIL_TEMP21_A_52 4;
BA_ "AfdxFDSname" SG_ 437857147 IOM_DEMO_VFG_OIL_TEMP21_A_52 "FDS_HSMU_DEMO21_22";
BA_ "AfdxSignalType" SG_ 437857147 IOM_DEMO_VFG_OIL_TEMP21_A_52 3;
BA_ "AfdxFSaddr" SG_ 437857147 FS_HSMU_DEMO21_23 106;
BA_ "AfdxFDSaddr" SG_ 437857147 FS_HSMU_DEMO21_23 116;
BA_ "AfdxFDSlength" SG_ 437857147 FS_HSMU_DEMO21_23 4;
BA_ "AfdxFDSname" SG_ 437857147 FS_HSMU_DEMO21_23 "FDS_HSMU_DEMO21_23";
BA_ "AfdxSignalType" SG_ 437857147 FS_HSMU_DEMO21_23 6;
BA_ "AfdxFSaddr" SG_ 437857147 IOM_DEMO_VFG_OIL_TEMP21_A_53 106;
BA_ "AfdxFDSaddr" SG_ 437857147 IOM_DEMO_VFG_OIL_TEMP21_A_53 116;
BA_ "AfdxFDSlength" SG_ 437857147 IOM_DEMO_VFG_OIL_TEMP21_A_53 4;
BA_ "AfdxFDSname" SG_ 437857147 IOM_DEMO_VFG_OIL_TEMP21_A_53 "FDS_HSMU_DEMO21_23";
BA_ "AfdxSignalType" SG_ 437857147 IOM_DEMO_VFG_OIL_TEMP21_A_53 3;
BA_ "AfdxFSaddr" SG_ 437857147 FS_HSMU_DEMO21_24 107;
BA_ "AfdxFDSaddr" SG_ 437857147 FS_HSMU_DEMO21_24 120;
BA_ "AfdxFDSlength" SG_ 437857147 FS_HSMU_DEMO21_24 4;
BA_ "AfdxFDSname" SG_ 437857147 FS_HSMU_DEMO21_24 "FDS_HSMU_DEMO21_24";
BA_ "AfdxSignalType" SG_ 437857147 FS_HSMU_DEMO21_24 6;
BA_ "AfdxFSaddr" SG_ 437857147 IOM_DEMO_VFG_OIL_TEMP21_A_54 107;
BA_ "AfdxFDSaddr" SG_ 437857147 IOM_DEMO_VFG_OIL_TEMP21_A_54 120;
BA_ "AfdxFDSlength" SG_ 437857147 IOM_DEMO_VFG_OIL_TEMP21_A_54 4;
BA_ "AfdxFDSname" SG_ 437857147 IOM_DEMO_VFG_OIL_TEMP21_A_54 "FDS_HSMU_DEMO21_24";
BA_ "AfdxSignalType" SG_ 437857147 IOM_DEMO_VFG_OIL_TEMP21_A_54 3;
BA_ "AfdxFSaddr" SG_ 437857147 FS_HSMU_DEMO21_25 124;
BA_ "AfdxFDSaddr" SG_ 437857147 FS_HSMU_DEMO21_25 128;
BA_ "AfdxFDSlength" SG_ 437857147 FS_HSMU_DEMO21_25 4;
BA_ "AfdxFDSname" SG_ 437857147 FS_HSMU_DEMO21_25 "FDS_HSMU_DEMO21_25";
BA_ "AfdxSignalType" SG_ 437857147 FS_HSMU_DEMO21_25 6;
BA_ "AfdxFSaddr" SG_ 437857147 IOM_DEMO_VFG_OIL_TEMP21_A_55 124;
BA_ "AfdxFDSaddr" SG_ 437857147 IOM_DEMO_VFG_OIL_TEMP21_A_55 128;
BA_ "AfdxFDSlength" SG_ 437857147 IOM_DEMO_VFG_OIL_TEMP21_A_55 4;
BA_ "AfdxFDSname" SG_ 437857147 IOM_DEMO_VFG_OIL_TEMP21_A_55 "FDS_HSMU_DEMO21_25";
BA_ "AfdxSignalType" SG_ 437857147 IOM_DEMO_VFG_OIL_TEMP21_A_55 3;
BA_ "AfdxFSaddr" SG_ 437857147 FS_HSMU_DEMO21_26 125;
BA_ "AfdxFDSaddr" SG_ 437857147 FS_HSMU_DEMO21_26 132;
BA_ "AfdxFDSlength" SG_ 437857147 FS_HSMU_DEMO21_26 4;
BA_ "AfdxFDSname" SG_ 437857147 FS_HSMU_DEMO21_26 "FDS_HSMU_DEMO21_26";
BA_ "AfdxSignalType" SG_ 437857147 FS_HSMU_DEMO21_26 6;
BA_ "AfdxFSaddr" SG_ 437857147 IOM_DEMO_VFG_OIL_TEMP21_A_56 125;
BA_ "AfdxFDSaddr" SG_ 437857147 IOM_DEMO_VFG_OIL_TEMP21_A_56 132;
BA_ "AfdxFDSlength" SG_ 437857147 IOM_DEMO_VFG_OIL_TEMP21_A_56 4;
BA_ "AfdxFDSname" SG_ 437857147 IOM_DEMO_VFG_OIL_TEMP21_A_56 "FDS_HSMU_DEMO21_26";
BA_ "AfdxSignalType" SG_ 437857147 IOM_DEMO_VFG_OIL_TEMP21_A_56 3;
BA_ "AfdxFSaddr" SG_ 437857147 FS_HSMU_DEMO21_27 126;
BA_ "AfdxFDSaddr" SG_ 437857147 FS_HSMU_DEMO21_27 136;
BA_ "AfdxFDSlength" SG_ 437857147 FS_HSMU_DEMO21_27 4;
BA_ "AfdxFDSname" SG_ 437857147 FS_HSMU_DEMO21_27 "FDS_HSMU_DEMO21_27";
BA_ "AfdxSignalType" SG_ 437857147 FS_HSMU_DEMO21_27 6;
BA_ "AfdxFSaddr" SG_ 437857147 IOM_DEMO_VFG_OIL_TEMP21_A_57 126;
BA_ "AfdxFDSaddr" SG_ 437857147 IOM_DEMO_VFG_OIL_TEMP21_A_57 136;
BA_ "AfdxFDSlength" SG_ 437857147 IOM_DEMO_VFG_OIL_TEMP21_A_57 4;
BA_ "AfdxFDSname" SG_ 437857147 IOM_DEMO_VFG_OIL_TEMP21_A_57 "FDS_HSMU_DEMO21_27";
BA_ "AfdxSignalType" SG_ 437857147 IOM_DEMO_VFG_OIL_TEMP21_A_57 3;
BA_ "AfdxFSaddr" SG_ 437857147 FS_HSMU_DEMO21_28 127;
BA_ "AfdxFDSaddr" SG_ 437857147 FS_HSMU_DEMO21_28 140;
BA_ "AfdxFDSlength" SG_ 437857147 FS_HSMU_DEMO21_28 4;
BA_ "AfdxFDSname" SG_ 437857147 FS_HSMU_DEMO21_28 "FDS_HSMU_DEMO21_28";
BA_ "AfdxSignalType" SG_ 437857147 FS_HSMU_DEMO21_28 6;
BA_ "AfdxFSaddr" SG_ 437857147 IOM_DEMO_VFG_OIL_TEMP21_A_58 127;
BA_ "AfdxFDSaddr" SG_ 437857147 IOM_DEMO_VFG_OIL_TEMP21_A_58 140;
BA_ "AfdxFDSlength" SG_ 437857147 IOM_DEMO_VFG_OIL_TEMP21_A_58 4;
BA_ "AfdxFDSname" SG_ 437857147 IOM_DEMO_VFG_OIL_TEMP21_A_58 "FDS_HSMU_DEMO21_28";
BA_ "AfdxSignalType" SG_ 437857147 IOM_DEMO_VFG_OIL_TEMP21_A_58 3;
BA_ "AfdxFSaddr" SG_ 437857147 FS_HSMU_DEMO21_29 144;
BA_ "AfdxFDSaddr" SG_ 437857147 FS_HSMU_DEMO21_29 148;
BA_ "AfdxFDSlength" SG_ 437857147 FS_HSMU_DEMO21_29 4;
BA_ "AfdxFDSname" SG_ 437857147 FS_HSMU_DEMO21_29 "FDS_HSMU_DEMO21_29";
BA_ "AfdxSignalType" SG_ 437857147 FS_HSMU_DEMO21_29 6;
BA_ "AfdxFSaddr" SG_ 437857147 IOM_DEMO_VFG_OIL_TEMP21_A_59 144;
BA_ "AfdxFDSaddr" SG_ 437857147 IOM_DEMO_VFG_OIL_TEMP21_A_59 148;
BA_ "AfdxFDSlength" SG_ 437857147 IOM_DEMO_VFG_OIL_TEMP21_A_59 4;
BA_ "AfdxFDSname" SG_ 437857147 IOM_DEMO_VFG_OIL_TEMP21_A_59 "FDS_HSMU_DEMO21_29";
BA_ "AfdxSignalType" SG_ 437857147 IOM_DEMO_VFG_OIL_TEMP21_A_59 3;
BA_ "AfdxFSaddr" SG_ 437857147 FS_HSMU_DEMO21_30 145;
BA_ "AfdxFDSaddr" SG_ 437857147 FS_HSMU_DEMO21_30 152;
BA_ "AfdxFDSlength" SG_ 437857147 FS_HSMU_DEMO21_30 4;
BA_ "AfdxFDSname" SG_ 437857147 FS_HSMU_DEMO21_30 "FDS_HSMU_DEMO21_30";
BA_ "AfdxSignalType" SG_ 437857147 FS_HSMU_DEMO21_30 6;
BA_ "AfdxFSaddr" SG_ 437857147 IOM_DEMO_VFG_OIL_TEMP21_A_60 145;
BA_ "AfdxFDSaddr" SG_ 437857147 IOM_DEMO_VFG_OIL_TEMP21_A_60 152;
BA_ "AfdxFDSlength" SG_ 437857147 IOM_DEMO_VFG_OIL_TEMP21_A_60 4;
BA_ "AfdxFDSname" SG_ 437857147 IOM_DEMO_VFG_OIL_TEMP21_A_60 "FDS_HSMU_DEMO21_30";
BA_ "AfdxSignalType" SG_ 437857147 IOM_DEMO_VFG_OIL_TEMP21_A_60 3;
BA_ "AfdxFSaddr" SG_ 437857147 FS_HSMU_DEMO21_31 146;
BA_ "AfdxFDSaddr" SG_ 437857147 FS_HSMU_DEMO21_31 156;
BA_ "AfdxFDSlength" SG_ 437857147 FS_HSMU_DEMO21_31 4;
BA_ "AfdxFDSname" SG_ 437857147 FS_HSMU_DEMO21_31 "FDS_HSMU_DEMO21_31";
BA_ "AfdxSignalType" SG_ 437857147 FS_HSMU_DEMO21_31 6;
BA_ "AfdxFSaddr" SG_ 437857147 IOM_DEMO_VFG_OIL_TEMP21_A_61 146;
BA_ "AfdxFDSaddr" SG_ 437857147 IOM_DEMO_VFG_OIL_TEMP21_A_61 156;
BA_ "AfdxFDSlength" SG_ 437857147 IOM_DEMO_VFG_OIL_TEMP21_A_61 4;
BA_ "AfdxFDSname" SG_ 437857147 IOM_DEMO_VFG_OIL_TEMP21_A_61 "FDS_HSMU_DEMO21_31";
BA_ "AfdxSignalType" SG_ 437857147 IOM_DEMO_VFG_OIL_TEMP21_A_61 3;
BA_ "AfdxFSaddr" SG_ 437857147 FS_HSMU_DEMO21_32 147;
BA_ "AfdxFDSaddr" SG_ 437857147 FS_HSMU_DEMO21_32 160;
BA_ "AfdxFDSlength" SG_ 437857147 FS_HSMU_DEMO21_32 4;
BA_ "AfdxFDSname" SG_ 437857147 FS_HSMU_DEMO21_32 "FDS_HSMU_DEMO21_32";
BA_ "AfdxSignalType" SG_ 437857147 FS_HSMU_DEMO21_32 6;
BA_ "AfdxFSaddr" SG_ 437857147 IOM_DEMO_VFG_OIL_TEMP21_A_62 147;
BA_ "AfdxFDSaddr" SG_ 437857147 IOM_DEMO_VFG_OIL_TEMP21_A_62 160;
BA_ "AfdxFDSlength" SG_ 437857147 IOM_DEMO_VFG_OIL_TEMP21_A_62 4;
BA_ "AfdxFDSname" SG_ 437857147 IOM_DEMO_VFG_OIL_TEMP21_A_62 "FDS_HSMU_DEMO21_32";
BA_ "AfdxSignalType" SG_ 437857147 IOM_DEMO_VFG_OIL_TEMP21_A_62 3;
BA_ "AfdxFSaddr" SG_ 437857147 FS_HSMU_DEMO21_33 164;
BA_ "AfdxFDSaddr" SG_ 437857147 FS_HSMU_DEMO21_33 168;
BA_ "AfdxFDSlength" SG_ 437857147 FS_HSMU_DEMO21_33 4;
BA_ "AfdxFDSname" SG_ 437857147 FS_HSMU_DEMO21_33 "FDS_HSMU_DEMO21_33";
BA_ "AfdxSignalType" SG_ 437857147 FS_HSMU_DEMO21_33 6;
BA_ "AfdxFSaddr" SG_ 437857147 IOM_DEMO_VFG_OIL_TEMP21_A_63 164;
BA_ "AfdxFDSaddr" SG_ 437857147 IOM_DEMO_VFG_OIL_TEMP21_A_63 168;
BA_ "AfdxFDSlength" SG_ 437857147 IOM_DEMO_VFG_OIL_TEMP21_A_63 4;
BA_ "AfdxFDSname" SG_ 437857147 IOM_DEMO_VFG_OIL_TEMP21_A_63 "FDS_HSMU_DEMO21_33";
BA_ "AfdxSignalType" SG_ 437857147 IOM_DEMO_VFG_OIL_TEMP21_A_63 3;
BA_ "AfdxFSaddr" SG_ 437857147 FS_HSMU_DEMO21_34 165;
BA_ "AfdxFDSaddr" SG_ 437857147 FS_HSMU_DEMO21_34 172;
BA_ "AfdxFDSlength" SG_ 437857147 FS_HSMU_DEMO21_34 4;
BA_ "AfdxFDSname" SG_ 437857147 FS_HSMU_DEMO21_34 "FDS_HSMU_DEMO21_34";
BA_ "AfdxSignalType" SG_ 437857147 FS_HSMU_DEMO21_34 6;
BA_ "AfdxFSaddr" SG_ 437857147 IOM_DEMO_VFG_OIL_TEMP21_A_64 165;
BA_ "AfdxFDSaddr" SG_ 437857147 IOM_DEMO_VFG_OIL_TEMP21_A_64 172;
BA_ "AfdxFDSlength" SG_ 437857147 IOM_DEMO_VFG_OIL_TEMP21_A_64 4;
BA_ "AfdxFDSname" SG_ 437857147 IOM_DEMO_VFG_OIL_TEMP21_A_64 "FDS_HSMU_DEMO21_34";
BA_ "AfdxSignalType" SG_ 437857147 IOM_DEMO_VFG_OIL_TEMP21_A_64 3;
BA_ "AfdxFSaddr" SG_ 437857147 FS_HSMU_DEMO21_35 166;
BA_ "AfdxFDSaddr" SG_ 437857147 FS_HSMU_DEMO21_35 176;
BA_ "AfdxFDSlength" SG_ 437857147 FS_HSMU_DEMO21_35 4;
BA_ "AfdxFDSname" SG_ 437857147 FS_HSMU_DEMO21_35 "FDS_HSMU_DEMO21_35";
BA_ "AfdxSignalType" SG_ 437857147 FS_HSMU_DEMO21_35 6;
BA_ "AfdxFSaddr" SG_ 437857147 IOM_DEMO_VFG_OIL_TEMP21_A_65 166;
BA_ "AfdxFDSaddr" SG_ 437857147 IOM_DEMO_VFG_OIL_TEMP21_A_65 176;
BA_ "AfdxFDSlength" SG_ 437857147 IOM_DEMO_VFG_OIL_TEMP21_A_65 4;
BA_ "AfdxFDSname" SG_ 437857147 IOM_DEMO_VFG_OIL_TEMP21_A_65 "FDS_HSMU_DEMO21_35";
BA_ "AfdxSignalType" SG_ 437857147 IOM_DEMO_VFG_OIL_TEMP21_A_65 3;
BA_ "AfdxFSaddr" SG_ 437857147 FS_HSMU_DEMO21_36 167;
BA_ "AfdxFDSaddr" SG_ 437857147 FS_HSMU_DEMO21_36 180;
BA_ "AfdxFDSlength" SG_ 437857147 FS_HSMU_DEMO21_36 4;
BA_ "AfdxFDSname" SG_ 437857147 FS_HSMU_DEMO21_36 "FDS_HSMU_DEMO21_36";
BA_ "AfdxSignalType" SG_ 437857147 FS_HSMU_DEMO21_36 6;
BA_ "AfdxFSaddr" SG_ 437857147 IOM_DEMO_VFG_OIL_TEMP21_A_66 167;
BA_ "AfdxFDSaddr" SG_ 437857147 IOM_DEMO_VFG_OIL_TEMP21_A_66 180;
BA_ "AfdxFDSlength" SG_ 437857147 IOM_DEMO_VFG_OIL_TEMP21_A_66 4;
BA_ "AfdxFDSname" SG_ 437857147 IOM_DEMO_VFG_OIL_TEMP21_A_66 "FDS_HSMU_DEMO21_36";
BA_ "AfdxSignalType" SG_ 437857147 IOM_DEMO_VFG_OIL_TEMP21_A_66 3;
BA_ "AfdxFSaddr" SG_ 437857147 FS_HSMU_DEMO21_37 184;
BA_ "AfdxFDSaddr" SG_ 437857147 FS_HSMU_DEMO21_37 188;
BA_ "AfdxFDSlength" SG_ 437857147 FS_HSMU_DEMO21_37 4;
BA_ "AfdxFDSname" SG_ 437857147 FS_HSMU_DEMO21_37 "FDS_HSMU_DEMO21_37";
BA_ "AfdxSignalType" SG_ 437857147 FS_HSMU_DEMO21_37 6;
BA_ "AfdxFSaddr" SG_ 437857147 IOM_DEMO_VFG_OIL_TEMP21_A_67 184;
BA_ "AfdxFDSaddr" SG_ 437857147 IOM_DEMO_VFG_OIL_TEMP21_A_67 188;
BA_ "AfdxFDSlength" SG_ 437857147 IOM_DEMO_VFG_OIL_TEMP21_A_67 4;
BA_ "AfdxFDSname" SG_ 437857147 IOM_DEMO_VFG_OIL_TEMP21_A_67 "FDS_HSMU_DEMO21_37";
BA_ "AfdxSignalType" SG_ 437857147 IOM_DEMO_VFG_OIL_TEMP21_A_67 3;
BA_ "AfdxFSaddr" SG_ 437857147 FS_HSMU_DEMO21_38 185;
BA_ "AfdxFDSaddr" SG_ 437857147 FS_HSMU_DEMO21_38 192;
BA_ "AfdxFDSlength" SG_ 437857147 FS_HSMU_DEMO21_38 4;
BA_ "AfdxFDSname" SG_ 437857147 FS_HSMU_DEMO21_38 "FDS_HSMU_DEMO21_38";
BA_ "AfdxSignalType" SG_ 437857147 FS_HSMU_DEMO21_38 6;
BA_ "AfdxFSaddr" SG_ 437857147 IOM_DEMO_VFG_OIL_TEMP21_A_68 185;
BA_ "AfdxFDSaddr" SG_ 437857147 IOM_DEMO_VFG_OIL_TEMP21_A_68 192;
BA_ "AfdxFDSlength" SG_ 437857147 IOM_DEMO_VFG_OIL_TEMP21_A_68 4;
BA_ "AfdxFDSname" SG_ 437857147 IOM_DEMO_VFG_OIL_TEMP21_A_68 "FDS_HSMU_DEMO21_38";
BA_ "AfdxSignalType" SG_ 437857147 IOM_DEMO_VFG_OIL_TEMP21_A_68 3;
BA_ "AfdxFSaddr" SG_ 437857147 FS_HSMU_DEMO21_39 186;
BA_ "AfdxFDSaddr" SG_ 437857147 FS_HSMU_DEMO21_39 196;
BA_ "AfdxFDSlength" SG_ 437857147 FS_HSMU_DEMO21_39 4;
BA_ "AfdxFDSname" SG_ 437857147 FS_HSMU_DEMO21_39 "FDS_HSMU_DEMO21_39";
BA_ "AfdxSignalType" SG_ 437857147 FS_HSMU_DEMO21_39 6;
BA_ "AfdxFSaddr" SG_ 437857147 IOM_DEMO_VFG_OIL_TEMP21_A_69 186;
BA_ "AfdxFDSaddr" SG_ 437857147 IOM_DEMO_VFG_OIL_TEMP21_A_69 196;
BA_ "AfdxFDSlength" SG_ 437857147 IOM_DEMO_VFG_OIL_TEMP21_A_69 4;
BA_ "AfdxFDSname" SG_ 437857147 IOM_DEMO_VFG_OIL_TEMP21_A_69 "FDS_HSMU_DEMO21_39";
BA_ "AfdxSignalType" SG_ 437857147 IOM_DEMO_VFG_OIL_TEMP21_A_69 3;
BA_ "AfdxFSaddr" SG_ 437857147 FS_HSMU_DEMO21_40 187;
BA_ "AfdxFDSaddr" SG_ 437857147 FS_HSMU_DEMO21_40 200;
BA_ "AfdxFDSlength" SG_ 437857147 FS_HSMU_DEMO21_40 4;
BA_ "AfdxFDSname" SG_ 437857147 FS_HSMU_DEMO21_40 "FDS_HSMU_DEMO21_40";
BA_ "AfdxSignalType" SG_ 437857147 FS_HSMU_DEMO21_40 6;
BA_ "AfdxFSaddr" SG_ 437857147 IOM_DEMO_VFG_OIL_TEMP21_A_70 187;
BA_ "AfdxFDSaddr" SG_ 437857147 IOM_DEMO_VFG_OIL_TEMP21_A_70 200;
BA_ "AfdxFDSlength" SG_ 437857147 IOM_DEMO_VFG_OIL_TEMP21_A_70 4;
BA_ "AfdxFDSname" SG_ 437857147 IOM_DEMO_VFG_OIL_TEMP21_A_70 "FDS_HSMU_DEMO21_40";
BA_ "AfdxSignalType" SG_ 437857147 IOM_DEMO_VFG_OIL_TEMP21_A_70 3;
VAL_ 337519120 FS_ADR_TEMP_TAT 48 "NCD" 12 "FT" 3 "NO" 0 "ND" ;
VAL_ 337519120 FS_ADR_VELO_CAS 48 "NCD" 12 "FT" 3 "NO" 0 "ND" ;
VAL_ 298197520 FS_ADR_TEMP_TAT 48 "NCD" 12 "FT" 3 "NO" 0 "ND" ;
VAL_ 298197520 FS_ADR_VELO_CAS 48 "NCD" 12 "FT" 3 "NO" 0 "ND" ;
VAL_ 258875920 FS_ADR_ALT 48 "NCD" 12 "FT" 3 "NO" 0 "ND" ;
VAL_ 258875920 FS_ADR_PRESSURE_COR_SP 48 "NCD" 12 "FT" 3 "NO" 0 "ND" ;
VAL_ 258875920 FS_ADR_PRESSURE_TP 48 "NCD" 12 "FT" 3 "NO" 0 "ND" ;
VAL_ 258875920 FS_ADR_TEMP_SAT 48 "NCD" 12 "FT" 3 "NO" 0 "ND" ;
VAL_ 258875920 FS_ADR_TEMP_TAT 48 "NCD" 12 "FT" 3 "NO" 0 "ND" ;
VAL_ 258875920 FS_ADR_VELO_CAS 48 "NCD" 12 "FT" 3 "NO" 0 "ND" ;
VAL_ 258875920 FS_ADR_VELO_MA 48 "NCD" 12 "FT" 3 "NO" 0 "ND" ;
VAL_ 437922684 FS_HSMU_DEMO22_1 48 "NCD" 12 "FT" 3 "NO" 0 "ND" ;
VAL_ 437922684 FS_HSMU_DEMO22_2 48 "NCD" 12 "FT" 3 "NO" 0 "ND" ;
VAL_ 437922684 FS_HSMU_DEMO22_3 48 "NCD" 12 "FT" 3 "NO" 0 "ND" ;
VAL_ 437922684 FS_HSMU_DEMO22_4 48 "NCD" 12 "FT" 3 "NO" 0 "ND" ;
VAL_ 437922684 FS_HSMU_DEMO22_5 48 "NCD" 12 "FT" 3 "NO" 0 "ND" ;
VAL_ 437922684 FS_HSMU_DEMO22_6 48 "NCD" 12 "FT" 3 "NO" 0 "ND" ;
VAL_ 437922684 FS_HSMU_DEMO22_7 48 "NCD" 12 "FT" 3 "NO" 0 "ND" ;
VAL_ 437922684 FS_HSMU_DEMO22_8 48 "NCD" 12 "FT" 3 "NO" 0 "ND" ;
VAL_ 437922684 FS_HSMU_DEMO22_9 48 "NCD" 12 "FT" 3 "NO" 0 "ND" ;
VAL_ 437922684 FS_HSMU_DEMO22_10 48 "NCD" 12 "FT" 3 "NO" 0 "ND" ;
VAL_ 437922684 FS_HSMU_DEMO22_11 48 "NCD" 12 "FT" 3 "NO" 0 "ND" ;
VAL_ 437922684 FS_HSMU_DEMO22_12 48 "NCD" 12 "FT" 3 "NO" 0 "ND" ;
VAL_ 437922684 FS_HSMU_DEMO22_13 48 "NCD" 12 "FT" 3 "NO" 0 "ND" ;
VAL_ 437922684 FS_HSMU_DEMO22_14 48 "NCD" 12 "FT" 3 "NO" 0 "ND" ;
VAL_ 437922684 FS_HSMU_DEMO22_15 48 "NCD" 12 "FT" 3 "NO" 0 "ND" ;
VAL_ 437922684 FS_HSMU_DEMO22_16 48 "NCD" 12 "FT" 3 "NO" 0 "ND" ;
VAL_ 437922684 FS_HSMU_DEMO22_17 48 "NCD" 12 "FT" 3 "NO" 0 "ND" ;
VAL_ 437922684 FS_HSMU_DEMO22_18 48 "NCD" 12 "FT" 3 "NO" 0 "ND" ;
VAL_ 437922684 FS_HSMU_DEMO22_19 48 "NCD" 12 "FT" 3 "NO" 0 "ND" ;
VAL_ 437922684 FS_HSMU_DEMO22_20 48 "NCD" 12 "FT" 3 "NO" 0 "ND" ;
VAL_ 437922684 FS_HSMU_DEMO22_21 48 "NCD" 12 "FT" 3 "NO" 0 "ND" ;
VAL_ 437857147 FS_HSMU_DEMO21_1 48 "NCD" 12 "FT" 3 "NO" 0 "ND" ;
VAL_ 437857147 FS_HSMU_DEMO21_2 48 "NCD" 12 "FT" 3 "NO" 0 "ND" ;
VAL_ 437857147 FS_HSMU_DEMO21_3 48 "NCD" 12 "FT" 3 "NO" 0 "ND" ;
VAL_ 437857147 FS_HSMU_DEMO21_4 48 "NCD" 12 "FT" 3 "NO" 0 "ND" ;
VAL_ 437857147 FS_HSMU_DEMO21_5 48 "NCD" 12 "FT" 3 "NO" 0 "ND" ;
VAL_ 437857147 FS_HSMU_DEMO21_6 48 "NCD" 12 "FT" 3 "NO" 0 "ND" ;
VAL_ 437857147 FS_HSMU_DEMO21_7 48 "NCD" 12 "FT" 3 "NO" 0 "ND" ;
VAL_ 437857147 FS_HSMU_DEMO21_8 48 "NCD" 12 "FT" 3 "NO" 0 "ND" ;
VAL_ 437857147 FS_HSMU_DEMO21_9 48 "NCD" 12 "FT" 3 "NO" 0 "ND" ;
VAL_ 437857147 FS_HSMU_DEMO21_10 48 "NCD" 12 "FT" 3 "NO" 0 "ND" ;
VAL_ 437857147 FS_HSMU_DEMO21_11 48 "NCD" 12 "FT" 3 "NO" 0 "ND" ;
VAL_ 437857147 FS_HSMU_DEMO21_12 48 "NCD" 12 "FT" 3 "NO" 0 "ND" ;
VAL_ 437857147 FS_HSMU_DEMO21_13 48 "NCD" 12 "FT" 3 "NO" 0 "ND" ;
VAL_ 437857147 FS_HSMU_DEMO21_14 48 "NCD" 12 "FT" 3 "NO" 0 "ND" ;
VAL_ 437857147 FS_HSMU_DEMO21_15 48 "NCD" 12 "FT" 3 "NO" 0 "ND" ;
VAL_ 437857147 FS_HSMU_DEMO21_16 48 "NCD" 12 "FT" 3 "NO" 0 "ND" ;
VAL_ 437857147 FS_HSMU_DEMO21_17 48 "NCD" 12 "FT" 3 "NO" 0 "ND" ;
VAL_ 437857147 FS_HSMU_DEMO21_18 48 "NCD" 12 "FT" 3 "NO" 0 "ND" ;
VAL_ 437857147 FS_HSMU_DEMO21_19 48 "NCD" 12 "FT" 3 "NO" 0 "ND" ;
VAL_ 437857147 FS_HSMU_DEMO21_20 48 "NCD" 12 "FT" 3 "NO" 0 "ND" ;
VAL_ 437857147 FS_HSMU_DEMO21_21 48 "NCD" 12 "FT" 3 "NO" 0 "ND" ;
VAL_ 437857147 FS_HSMU_DEMO21_22 48 "NCD" 12 "FT" 3 "NO" 0 "ND" ;
VAL_ 437857147 FS_HSMU_DEMO21_23 48 "NCD" 12 "FT" 3 "NO" 0 "ND" ;
VAL_ 437857147 FS_HSMU_DEMO21_24 48 "NCD" 12 "FT" 3 "NO" 0 "ND" ;
VAL_ 437857147 FS_HSMU_DEMO21_25 48 "NCD" 12 "FT" 3 "NO" 0 "ND" ;
VAL_ 437857147 FS_HSMU_DEMO21_26 48 "NCD" 12 "FT" 3 "NO" 0 "ND" ;
VAL_ 437857147 FS_HSMU_DEMO21_27 48 "NCD" 12 "FT" 3 "NO" 0 "ND" ;
VAL_ 437857147 FS_HSMU_DEMO21_28 48 "NCD" 12 "FT" 3 "NO" 0 "ND" ;
VAL_ 437857147 FS_HSMU_DEMO21_29 48 "NCD" 12 "FT" 3 "NO" 0 "ND" ;
VAL_ 437857147 FS_HSMU_DEMO21_30 48 "NCD" 12 "FT" 3 "NO" 0 "ND" ;
VAL_ 437857147 FS_HSMU_DEMO21_31 48 "NCD" 12 "FT" 3 "NO" 0 "ND" ;
VAL_ 437857147 FS_HSMU_DEMO21_32 48 "NCD" 12 "FT" 3 "NO" 0 "ND" ;
VAL_ 437857147 FS_HSMU_DEMO21_33 48 "NCD" 12 "FT" 3 "NO" 0 "ND" ;
VAL_ 437857147 FS_HSMU_DEMO21_34 48 "NCD" 12 "FT" 3 "NO" 0 "ND" ;
VAL_ 437857147 FS_HSMU_DEMO21_35 48 "NCD" 12 "FT" 3 "NO" 0 "ND" ;
VAL_ 437857147 FS_HSMU_DEMO21_36 48 "NCD" 12 "FT" 3 "NO" 0 "ND" ;
VAL_ 437857147 FS_HSMU_DEMO21_37 48 "NCD" 12 "FT" 3 "NO" 0 "ND" ;
VAL_ 437857147 FS_HSMU_DEMO21_38 48 "NCD" 12 "FT" 3 "NO" 0 "ND" ;
VAL_ 437857147 FS_HSMU_DEMO21_39 48 "NCD" 12 "FT" 3 "NO" 0 "ND" ;
VAL_ 437857147 FS_HSMU_DEMO21_40 48 "NCD" 12 "FT" 3 "NO" 0 "ND" ;
SIG_VALTYPE_ 337519120 RXDEMO_211_TOTALAIRTEMPERATURE_S : 1;
SIG_VALTYPE_ 337519120 RXDEMO_206_COMPUTEDAIRSPEED_SG_3 : 1;
SIG_VALTYPE_ 298197520 RXDEMO_211_TOTALAIRTEMPERAT_0000 : 1;
SIG_VALTYPE_ 298197520 RXDEMO_206_COMPUTEDAIRSPEED_SG_2 : 1;
SIG_VALTYPE_ 258875920 RXDEMO_246_CORR_AVG_STATIC_PRESS : 1;
SIG_VALTYPE_ 258875920 RXDEMO_242_INDICATED_TOTAL_PRESS : 1;
SIG_VALTYPE_ 258875920 RXDEMO_213_STATICAIRTEMPERATURE_ : 1;
SIG_VALTYPE_ 258875920 RXDEMO_211_TOTALAIRTEMPERAT_0001 : 1;
SIG_VALTYPE_ 258875920 RXDEMO_206_COMPUTEDAIRSPEED_SG_1 : 1;
SIG_VALTYPE_ 258875920 RXDEMO_205_MACHNUMBER_SG_1 : 1;
