/*@!Encoding:1252*/
// -------------------------------------------------------------------------
// Module: NodeA.can
// Interfaces: -
// -------------------------------------------------------------------------
// Implementation of the Class NodeA
// -------------------------------------------------------------------------
// Copyright (c) Vector Informatik GmbH. All rights reserved.
// -------------------------------------------------------------------------

// Increase the Tx Packet counter on AFDX 2, if an message received
includes
{
  #include "AFDX/Utils.cin"
}

variables
{
  
}

on a664Message MsgChannel2.*
{ 
  if( isSimulated())
  {
    @NodeB::TxPacketCount++;
  }
  else
  {
    if( this.DIR == rx)
    {
      @NodeB::RxPacketCount++;
    }
    else
    {
      @NodeB::TxPacketCount++;
    }
  }
}