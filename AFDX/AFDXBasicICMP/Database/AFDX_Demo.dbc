VERSION ""

NS_ :

BS_:

BU_: IOM_APP2 IOM_APP1

BO_ 20654972 DEMOMSG_GPS: 88 IOM_APP1
 SG_ Demo_Switch_long : 551|32@0- (1,0) [0|0] ""  IOM_APP2
 SG_ Demo_Switch_MsgCode : 583|32@0- (1,0) [0|0] ""  IOM_APP2
 SG_ Demo_Switch_ServiceCode : 615|32@0- (1,0) [0|0] "" Vector__XXX
 SG_ Demo_Switch_TxNodeID : 647|32@0- (1,0) [0|0] "" Vector__XXX
 SG_ FS_FDS_Demo_Switch : 63|8@0+ (1,0) [0|0] ""  IOM_APP2
 SG_ Demo_Long_float : 71|32@0+ (1,0) [0|0] "" Vector__XXX
 SG_ Demo_Long_MsgCode : 103|32@0- (1,0) [0|0] "" Vector__XXX
 SG_ Demo_Long_ServiceCode : 135|32@0- (1,0) [0|0] "" Vector__XXX
 SG_ Demo_Long_TxNodeID : 167|32@0- (1,0) [0|0] "" Vector__XXX
 SG_ FS_FDS_Demo_LONG : 39|8@0+ (1,0) [0|0] ""  IOM_APP2
 SG_ Demo_LAT_float : 231|32@0+ (1,0) [0|0] "" Vector__XXX
 SG_ Demo_LAT_MsgCode : 263|32@0- (1,0) [0|0] "" Vector__XXX
 SG_ Demo_LAT_ServiceCode : 295|32@0- (1,0) [0|0] "" Vector__XXX
 SG_ Demo_LAT_TxNodeID : 327|32@0- (1,0) [0|0] "" Vector__XXX
 SG_ FS_FDS_Demo_Lat : 47|8@0+ (1,0) [0|0] ""  IOM_APP2
 SG_ Demo_ALT_float : 391|32@0+ (1,0) [0|0] ""  IOM_APP2
 SG_ Demo_ALT_MsgCode : 423|32@0- (1,0) [0|0] "" Vector__XXX
 SG_ Demo_ALT_ServiceCode : 455|32@0- (1,0) [0|0] "" Vector__XXX
 SG_ TxNodeID : 487|32@0- (1,0) [0|0] "" Vector__XXX
 SG_ FS_New_Signal3 : 55|8@0+ (1,0) [0|0] ""  IOM_APP2

CM_ "ICMP_Demo.ame : AFDX_Demo.dbc ";
BA_DEF_ SG_  "AfdxFSaddr" INT 4 8192;
BA_DEF_ SG_  "AfdxFDSaddr" INT 0 8192;
BA_DEF_ SG_  "AfdxFDSlength" INT 0 8192;
BA_DEF_ SG_  "AfdxFDSname" STRING ;
BA_DEF_ SG_  "AfdxSignalType" ENUM  "Boolean","Enumerate","Float","Integer","Opaque","String","Status";
BA_DEF_ BO_  "AfdxTxPortId" INT 1 65535;
BA_DEF_ BO_  "AfdxPortMasterName" STRING ;
BA_DEF_ BO_  "AfdxMsgTxRate" INT 0 0;
BA_DEF_ BO_  "AfdxVLbufSize" INT 1 8192;
BA_DEF_ BO_  "AfdxVLdestUDP" INT 0 65535;
BA_DEF_ BO_  "AfdxVLsrcUDP" INT 0 65535;
BA_DEF_ BO_  "AfdxVLdestIP" STRING ;
BA_DEF_ BO_  "AfdxVLsrcIP" STRING ;
BA_DEF_ BO_  "AfdxVLportChar" ENUM  "Unknown","SAP","Sampling","Queuing";
BA_DEF_ BO_  "AfdxVLportType" ENUM  "Unknown","SAP","AFDX Communication Port";
BA_DEF_ BO_  "AfdxVLskewMax" INT 0 65535;
BA_DEF_ BO_  "AfdxVLintCheck" ENUM  "True","False";
BA_DEF_ BO_  "AfdxVLrma" STRING ;
BA_DEF_ BO_  "AfdxVLmaxFrame" INT 17 1471;
BA_DEF_ BO_  "AfdxVLbag" INT 1 128;
BA_DEF_ BO_  "AfdxVLnetSel" ENUM  "NETWORK_NONE","NETWORK_A","NETWORK_B","NETWORK_AB";
BA_DEF_ BO_  "AfdxVLname" STRING ;
BA_DEF_ BO_  "AfdxVLid" INT 1 65535;
BA_DEF_ BO_  "AfdxVLportSpeed" INT 10 100;
BA_DEF_ BU_  "ICMP_outVLbufSize" INT 1 1471;
BA_DEF_ BU_  "ICMP_inVLbufSize" INT 1 1471;
BA_DEF_ BU_  "ICMP_inVLmaxFrame" INT 17 1471;
BA_DEF_ BU_  "ICMP_inVLrma" ENUM  "False","True";
BA_DEF_ BU_  "ICMP_inVLintCheck" ENUM  "False","True";
BA_DEF_ BU_  "ICMP_inVLskewmax" INT 0 65535;
BA_DEF_ BU_  "ICMP_inVLbag" INT 1 128;
BA_DEF_ BU_  "ICMP_inVLnetSel" ENUM  "NETWORK_NONE","NETWORK_A","NETWORK_B","NETWORK_AB";
BA_DEF_ BU_  "ICMP_inVLid" INT 1 65535;
BA_DEF_ BU_  "ICMP_outVLmaxFrame" INT 17 1471;
BA_DEF_ BU_  "ICMP_outVLbag" INT 1 128;
BA_DEF_ BU_  "ICMP_outVLnetSel" ENUM  "NETWORK_NONE","NETWORK_A","NETWORK_B","NETWORK_AB";
BA_DEF_ BU_  "ICMP_outsubVLid" INT 1 4;
BA_DEF_ BU_  "ICMP_outVLid" INT 1 65535;
BA_DEF_ BU_  "ICMP_destIP" STRING ;
BA_DEF_ BU_  "AfdxGroupNamesVT" STRING ;
BA_DEF_ BU_  "AfdxEquipment" STRING ;
BA_DEF_  "VersionYear" INT 0 0;
BA_DEF_  "VersionMonth" INT 0 12;
BA_DEF_  "VersionDay" INT 0 31;
BA_DEF_  "TemplateVersion" STRING ;
BA_DEF_  "BusType" STRING ;
BA_DEF_  "ToolVersion" STRING ;
BA_DEF_  "ToolName" STRING ;
BA_DEF_DEF_  "AfdxFSaddr" 4;
BA_DEF_DEF_  "AfdxFDSaddr" 0;
BA_DEF_DEF_  "AfdxFDSlength" 0;
BA_DEF_DEF_  "AfdxFDSname" "";
BA_DEF_DEF_  "AfdxSignalType" "Boolean";
BA_DEF_DEF_  "AfdxTxPortId" 1;
BA_DEF_DEF_  "AfdxPortMasterName" "";
BA_DEF_DEF_  "AfdxMsgTxRate" 0;
BA_DEF_DEF_  "AfdxVLbufSize" 2048;
BA_DEF_DEF_  "AfdxVLdestUDP" 0;
BA_DEF_DEF_  "AfdxVLsrcUDP" 0;
BA_DEF_DEF_  "AfdxVLdestIP" "0.0.0.0";
BA_DEF_DEF_  "AfdxVLsrcIP" "0.0.0.0";
BA_DEF_DEF_  "AfdxVLportChar" "Sampling";
BA_DEF_DEF_  "AfdxVLportType" "AFDX Communication Port";
BA_DEF_DEF_  "AfdxVLskewMax" 0;
BA_DEF_DEF_  "AfdxVLintCheck" "True";
BA_DEF_DEF_  "AfdxVLrma" "";
BA_DEF_DEF_  "AfdxVLmaxFrame" 1471;
BA_DEF_DEF_  "AfdxVLbag" 128;
BA_DEF_DEF_  "AfdxVLnetSel" "NETWORK_AB";
BA_DEF_DEF_  "AfdxVLname" "";
BA_DEF_DEF_  "AfdxVLid" 1;
BA_DEF_DEF_  "AfdxVLportSpeed" 100;
BA_DEF_DEF_  "ICMP_outVLbufSize" 64;
BA_DEF_DEF_  "ICMP_inVLbufSize" 64;
BA_DEF_DEF_  "ICMP_inVLmaxFrame" 1471;
BA_DEF_DEF_  "ICMP_inVLrma" "True";
BA_DEF_DEF_  "ICMP_inVLintCheck" "True";
BA_DEF_DEF_  "ICMP_inVLskewmax" 0;
BA_DEF_DEF_  "ICMP_inVLbag" 128;
BA_DEF_DEF_  "ICMP_inVLnetSel" "NETWORK_AB";
BA_DEF_DEF_  "ICMP_inVLid" 2000;
BA_DEF_DEF_  "ICMP_outVLmaxFrame" 1471;
BA_DEF_DEF_  "ICMP_outVLbag" 128;
BA_DEF_DEF_  "ICMP_outVLnetSel" "NETWORK_AB";
BA_DEF_DEF_  "ICMP_outsubVLid" 1;
BA_DEF_DEF_  "ICMP_outVLid" 1000;
BA_DEF_DEF_  "ICMP_destIP" "";
BA_DEF_DEF_  "AfdxGroupNamesVT" "AfdxGroupNames";
BA_DEF_DEF_  "AfdxEquipment" "<unknown>";
BA_DEF_DEF_  "VersionYear" 2017;
BA_DEF_DEF_  "VersionMonth" 1;
BA_DEF_DEF_  "VersionDay" 12;
BA_DEF_DEF_  "TemplateVersion" "1.0.0.0";
BA_DEF_DEF_  "BusType" "AFDX";
BA_DEF_DEF_  "ToolVersion" "3.1.13.0";
BA_DEF_DEF_  "ToolName" "Vector Aerospace Message Editor";
BA_ "AfdxEquipment" BU_ IOM_APP2 "IOM_EQIP2_3";
BA_ "ICMP_inVLmaxFrame" BU_ IOM_APP1 1024;
BA_ "ICMP_inVLskewmax" BU_ IOM_APP1 65500;
BA_ "ICMP_inVLid" BU_ IOM_APP1 1337;
BA_ "ICMP_outVLmaxFrame" BU_ IOM_APP1 1024;
BA_ "ICMP_outVLid" BU_ IOM_APP1 1338;
BA_ "ICMP_destIP" BU_ IOM_APP1 "10.0.36.2";
BA_ "AfdxEquipment" BU_ IOM_APP1 "IOM_EQIP1_3";
BA_ "AfdxPortMasterName" BO_ 20654972 "AFDX_Port_Joystick";
BA_ "AfdxMsgTxRate" BO_ 20654972 250;
BA_ "AfdxVLbufSize" BO_ 20654972 512;
BA_ "AfdxVLdestUDP" BO_ 20654972 11132;
BA_ "AfdxVLsrcUDP" BO_ 20654972 11132;
BA_ "AfdxVLdestIP" BO_ 20654972 "10.1.58.1";
BA_ "AfdxVLsrcIP" BO_ 20654972 "10.2.38.0";
BA_ "AfdxVLskewMax" BO_ 20654972 65500;
BA_ "AfdxVLrma" BO_ 20654972 "Active";
BA_ "AfdxVLmaxFrame" BO_ 20654972 1024;
BA_ "AfdxVLname" BO_ 20654972 "VL_FDS";
BA_ "AfdxVLid" BO_ 20654972 315;
BA_ "AfdxFSaddr" SG_ 20654972 Demo_Switch_long 7;
BA_ "AfdxFDSaddr" SG_ 20654972 Demo_Switch_long 68;
BA_ "AfdxFDSlength" SG_ 20654972 Demo_Switch_long 20;
BA_ "AfdxFDSname" SG_ 20654972 Demo_Switch_long "FDS_Demo_SWITCH";
BA_ "AfdxSignalType" SG_ 20654972 Demo_Switch_long 3;
BA_ "AfdxFSaddr" SG_ 20654972 Demo_Switch_MsgCode 7;
BA_ "AfdxFDSaddr" SG_ 20654972 Demo_Switch_MsgCode 68;
BA_ "AfdxFDSlength" SG_ 20654972 Demo_Switch_MsgCode 20;
BA_ "AfdxFDSname" SG_ 20654972 Demo_Switch_MsgCode "FDS_Demo_SWITCH";
BA_ "AfdxSignalType" SG_ 20654972 Demo_Switch_MsgCode 3;
BA_ "AfdxFSaddr" SG_ 20654972 Demo_Switch_ServiceCode 7;
BA_ "AfdxFDSaddr" SG_ 20654972 Demo_Switch_ServiceCode 68;
BA_ "AfdxFDSlength" SG_ 20654972 Demo_Switch_ServiceCode 20;
BA_ "AfdxFDSname" SG_ 20654972 Demo_Switch_ServiceCode "FDS_Demo_SWITCH";
BA_ "AfdxSignalType" SG_ 20654972 Demo_Switch_ServiceCode 3;
BA_ "AfdxFSaddr" SG_ 20654972 Demo_Switch_TxNodeID 7;
BA_ "AfdxFDSaddr" SG_ 20654972 Demo_Switch_TxNodeID 68;
BA_ "AfdxFDSlength" SG_ 20654972 Demo_Switch_TxNodeID 20;
BA_ "AfdxFDSname" SG_ 20654972 Demo_Switch_TxNodeID "FDS_Demo_SWITCH";
BA_ "AfdxSignalType" SG_ 20654972 Demo_Switch_TxNodeID 3;
BA_ "AfdxFSaddr" SG_ 20654972 FS_FDS_Demo_Switch 7;
BA_ "AfdxFDSaddr" SG_ 20654972 FS_FDS_Demo_Switch 68;
BA_ "AfdxFDSlength" SG_ 20654972 FS_FDS_Demo_Switch 20;
BA_ "AfdxFDSname" SG_ 20654972 FS_FDS_Demo_Switch "FDS_Demo_SWITCH";
BA_ "AfdxSignalType" SG_ 20654972 FS_FDS_Demo_Switch 6;
BA_ "AfdxFDSaddr" SG_ 20654972 Demo_Long_float 8;
BA_ "AfdxFDSlength" SG_ 20654972 Demo_Long_float 20;
BA_ "AfdxFDSname" SG_ 20654972 Demo_Long_float "FDS_Demo_LONG";
BA_ "AfdxSignalType" SG_ 20654972 Demo_Long_float 2;
BA_ "AfdxFDSaddr" SG_ 20654972 Demo_Long_MsgCode 8;
BA_ "AfdxFDSlength" SG_ 20654972 Demo_Long_MsgCode 20;
BA_ "AfdxFDSname" SG_ 20654972 Demo_Long_MsgCode "FDS_Demo_LONG";
BA_ "AfdxSignalType" SG_ 20654972 Demo_Long_MsgCode 3;
BA_ "AfdxFDSaddr" SG_ 20654972 Demo_Long_ServiceCode 8;
BA_ "AfdxFDSlength" SG_ 20654972 Demo_Long_ServiceCode 20;
BA_ "AfdxFDSname" SG_ 20654972 Demo_Long_ServiceCode "FDS_Demo_LONG";
BA_ "AfdxSignalType" SG_ 20654972 Demo_Long_ServiceCode 3;
BA_ "AfdxFDSaddr" SG_ 20654972 Demo_Long_TxNodeID 8;
BA_ "AfdxFDSlength" SG_ 20654972 Demo_Long_TxNodeID 20;
BA_ "AfdxFDSname" SG_ 20654972 Demo_Long_TxNodeID "FDS_Demo_LONG";
BA_ "AfdxSignalType" SG_ 20654972 Demo_Long_TxNodeID 3;
BA_ "AfdxFDSaddr" SG_ 20654972 FS_FDS_Demo_LONG 8;
BA_ "AfdxFDSlength" SG_ 20654972 FS_FDS_Demo_LONG 20;
BA_ "AfdxFDSname" SG_ 20654972 FS_FDS_Demo_LONG "FDS_Demo_LONG";
BA_ "AfdxSignalType" SG_ 20654972 FS_FDS_Demo_LONG 6;
BA_ "AfdxFSaddr" SG_ 20654972 Demo_LAT_float 5;
BA_ "AfdxFDSaddr" SG_ 20654972 Demo_LAT_float 28;
BA_ "AfdxFDSlength" SG_ 20654972 Demo_LAT_float 20;
BA_ "AfdxFDSname" SG_ 20654972 Demo_LAT_float "FDS_Demo_LAT";
BA_ "AfdxSignalType" SG_ 20654972 Demo_LAT_float 2;
BA_ "AfdxFSaddr" SG_ 20654972 Demo_LAT_MsgCode 5;
BA_ "AfdxFDSaddr" SG_ 20654972 Demo_LAT_MsgCode 28;
BA_ "AfdxFDSlength" SG_ 20654972 Demo_LAT_MsgCode 20;
BA_ "AfdxFDSname" SG_ 20654972 Demo_LAT_MsgCode "FDS_Demo_LAT";
BA_ "AfdxSignalType" SG_ 20654972 Demo_LAT_MsgCode 3;
BA_ "AfdxFSaddr" SG_ 20654972 Demo_LAT_ServiceCode 5;
BA_ "AfdxFDSaddr" SG_ 20654972 Demo_LAT_ServiceCode 28;
BA_ "AfdxFDSlength" SG_ 20654972 Demo_LAT_ServiceCode 20;
BA_ "AfdxFDSname" SG_ 20654972 Demo_LAT_ServiceCode "FDS_Demo_LAT";
BA_ "AfdxSignalType" SG_ 20654972 Demo_LAT_ServiceCode 3;
BA_ "AfdxFSaddr" SG_ 20654972 Demo_LAT_TxNodeID 5;
BA_ "AfdxFDSaddr" SG_ 20654972 Demo_LAT_TxNodeID 28;
BA_ "AfdxFDSlength" SG_ 20654972 Demo_LAT_TxNodeID 20;
BA_ "AfdxFDSname" SG_ 20654972 Demo_LAT_TxNodeID "FDS_Demo_LAT";
BA_ "AfdxSignalType" SG_ 20654972 Demo_LAT_TxNodeID 3;
BA_ "AfdxFSaddr" SG_ 20654972 FS_FDS_Demo_Lat 5;
BA_ "AfdxFDSaddr" SG_ 20654972 FS_FDS_Demo_Lat 28;
BA_ "AfdxFDSlength" SG_ 20654972 FS_FDS_Demo_Lat 20;
BA_ "AfdxFDSname" SG_ 20654972 FS_FDS_Demo_Lat "FDS_Demo_LAT";
BA_ "AfdxSignalType" SG_ 20654972 FS_FDS_Demo_Lat 6;
BA_ "AfdxFSaddr" SG_ 20654972 Demo_ALT_float 6;
BA_ "AfdxFDSaddr" SG_ 20654972 Demo_ALT_float 48;
BA_ "AfdxFDSlength" SG_ 20654972 Demo_ALT_float 20;
BA_ "AfdxFDSname" SG_ 20654972 Demo_ALT_float "FDS_Demo_ALT";
BA_ "AfdxSignalType" SG_ 20654972 Demo_ALT_float 2;
BA_ "AfdxFSaddr" SG_ 20654972 Demo_ALT_MsgCode 6;
BA_ "AfdxFDSaddr" SG_ 20654972 Demo_ALT_MsgCode 48;
BA_ "AfdxFDSlength" SG_ 20654972 Demo_ALT_MsgCode 20;
BA_ "AfdxFDSname" SG_ 20654972 Demo_ALT_MsgCode "FDS_Demo_ALT";
BA_ "AfdxSignalType" SG_ 20654972 Demo_ALT_MsgCode 3;
BA_ "AfdxFSaddr" SG_ 20654972 Demo_ALT_ServiceCode 6;
BA_ "AfdxFDSaddr" SG_ 20654972 Demo_ALT_ServiceCode 48;
BA_ "AfdxFDSlength" SG_ 20654972 Demo_ALT_ServiceCode 20;
BA_ "AfdxFDSname" SG_ 20654972 Demo_ALT_ServiceCode "FDS_Demo_ALT";
BA_ "AfdxSignalType" SG_ 20654972 Demo_ALT_ServiceCode 3;
BA_ "AfdxFSaddr" SG_ 20654972 TxNodeID 6;
BA_ "AfdxFDSaddr" SG_ 20654972 TxNodeID 48;
BA_ "AfdxFDSlength" SG_ 20654972 TxNodeID 20;
BA_ "AfdxFDSname" SG_ 20654972 TxNodeID "FDS_Demo_ALT";
BA_ "AfdxSignalType" SG_ 20654972 TxNodeID 3;
BA_ "AfdxFSaddr" SG_ 20654972 FS_New_Signal3 6;
BA_ "AfdxFDSaddr" SG_ 20654972 FS_New_Signal3 48;
BA_ "AfdxFDSlength" SG_ 20654972 FS_New_Signal3 20;
BA_ "AfdxFDSname" SG_ 20654972 FS_New_Signal3 "FDS_Demo_ALT";
BA_ "AfdxSignalType" SG_ 20654972 FS_New_Signal3 6;
VAL_ 20654972 FS_FDS_Demo_Switch 48 "NCD" 12 "FT" 3 "NO" 0 "ND" ;
VAL_ 20654972 FS_FDS_Demo_LONG 48 "NCD" 12 "FT" 3 "NO" 0 "ND" ;
VAL_ 20654972 FS_FDS_Demo_Lat 48 "NCD" 12 "FT" 3 "NO" 0 "ND" ;
VAL_ 20654972 FS_New_Signal3 48 "NCD" 12 "FT" 3 "NO" 0 "ND" ;
SIG_VALTYPE_ 20654972 Demo_Long_float : 1;
SIG_VALTYPE_ 20654972 Demo_LAT_float : 1;
SIG_VALTYPE_ 20654972 Demo_ALT_float : 1;
