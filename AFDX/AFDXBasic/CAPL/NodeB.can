/*@!Encoding:1252*/
/**************************************************************************************************
 Description: Example file for AFDX Demo / SimpleDemo.cfg.
 -------------------------------------------------------------------------------------------------
      C O P Y R I G H T 
 ------------------------------------------------------------------------------------------------- 
  Copyright (c) 2014 by Vector Informatik GmbH. All rights reserved. 
  
  This software is copyright protected and proprietary to Vector Informatik GmbH. 
  Vector Informatik GmbH grants to you only those rights as set out in the license conditions. 
  All other rights remain with Vector Informatik GmbH. 
  
  REMOVAL OF THESE COMMENTS IS A VIOLATION OF THE COPYRIGHT AGREEMENT. 
 *************************************************************************************************/

includes
{
  #include "AFDX/Utils.cin"
}

on signal_change IOM_DEMO_VFG_OIL_TEMP_A_31
{
  // display the signal value in the "IOM_APP2" section
  @NodeB::VFG_OIL_TEMP_B_31 = this;
}

on signal_change IOM_DEMO_VFG_OIL_TEMP_A_32
{
  // display the signal value in the "IOM_APP2" section
  @NodeB::VFG_OIL_TEMP_B_32 = this;
}

on signal_change IOM_DEMO_VFG_OIL_TEMP_A_33
{
  // display the signal value in the "IOM_APP2" section
  @NodeB::VFG_OIL_TEMP_B_33 = this;
}

on a664Message msgChannel1.*
{
  // check if the packet has been received by the node
  if (this.DIR == rx)
  {
    @NodeB::RxPacketCount = @NodeB::RxPacketCount + 1;
  } // if
}
