/*@!Encoding:1252*/
variables 
{
  message BrakeState msg_BrakeState;
}

on preStart
{
}

on start
{
}

on sysvar sysvar::Brakes::BrakePressure
{
  write("ENGINE: Brake pressure applied");
  msg_BrakeState.BrakePressure = @this;
  output(msg_BrakeState);
}