/*@!Encoding:1252*/
/**
 * This ECU simulates the engine of a car.
 * It's job is to notice physical brake pressure and to send out the according message.
**/

variables 
{
  message BrakeState msg_BrakeState;
}

/**
 * In the event that the physical brake pressure changes, a message is sent to the CAN bus.
 * This message contains the brake pressure in percentage.
**/
on sysvar sysvar::Brakes::BrakePressure
{
  write("ENGINE: Brake pressure applied");
  msg_BrakeState.BrakePressure = @this;
  output(msg_BrakeState);
}