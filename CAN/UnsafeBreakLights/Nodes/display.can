/*@!Encoding:1252*/
/**
 * This ECU is responsible to show the effects of messages on the CAN bus.
 * It does not have a physical equivalent.
 * It's only purpose is to showcase effects for this simulation.
**/

variables 
{
  const long kOFF = 0;
  const long kON = 1;

  int gDebugCounter = 0;
}

/**
 * Sets the debug level of the logs on startup.
**/
on start
{
  setwriteDbgLevel(0); // set DbgLevel = 1 to get more information in Write-Window 
  write("Press key 1 to set DbgLevel = 1 for more information in the Write-Window");
  write("Press key 0 to set DbgLevel = 0 for less information in the Write-Window");
}

/**
 * Once a BrakeState message is received, the ECU checks if the contained pressure is above 0%.
 * If this is the case, the brake lights are turned on.
 * If not, they are turned off.
**/
on message BrakeState
{
  if (this.BrakePressure > 0)
  {
    @sysvar::Lights::BrakeLight = 1;
  } else {
    @sysvar::Lights::BrakeLight = 0;
  }
}

/**
 * Once a LightState message is received, the ECU changes the display of lights accordingly.
**/
on message LightState 
{
  gDebugCounter++;

  if (this.dir == RX)
  {
    SetLightDsp(this.HeadLight,this.FlashLight);

    if(gDebugCounter == 10)
    {
      writeDbgLevel(1,"LightState RX received by node %NODE_NAME%");
      gDebugCounter = 0;
    }    
  }
  else
  {
    if(gDebugCounter == 10)
    {
      writeDbgLevel(1,"Error: LightState TX received by node %NODE_NAME%"); 
      gDebugCounter = 0; 
    }
  }
}

/**
 * Helper method to set the display of lights.
**/
SetLightDsp (long headLight, long hazardFlasher)
{
  if(headLight == kON) 
  {
    if(hazardFlasher == kON) 
    {
      @sysvar::Lights::LightDisplay = 7;
    } 
    else if(hazardFlasher == kOFF) 
    {
      @sysvar::Lights::LightDisplay = 4;
    }
  }
  else if(headLight == kOFF) 
  {
    if(hazardFlasher == kON)  
    {
      @sysvar::Lights::LightDisplay = 3;
    } 
    else if(hazardFlasher == kOFF) 
    {
      @sysvar::Lights::LightDisplay = 0; 
    }
  }
}

/**
 * Sets the debug log level to 0.
**/
on key '0'
{
  setwriteDbgLevel(0);
}

/**
 * Sets the debug log level to 1.
**/
on key '1'
{
  setwriteDbgLevel(1);
}