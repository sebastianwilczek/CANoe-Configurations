/*@!Encoding:1252*/
variables
{
}

export testfunction StopTesterPresent ()
{
    DiagStopTesterPresent("Engine");
}

