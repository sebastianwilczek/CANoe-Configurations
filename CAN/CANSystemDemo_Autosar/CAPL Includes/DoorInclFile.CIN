variables
{
  // additionally Variables for Node-Simulation
  msTimer tMoveUpTimer;
  msTimer tMoveDownTimer;

  int gPosWN;
  const int cMoveTime = 100; //ms

  int gMoveDown = 0;
  int gMoveUp	= 0;

  const int gTrue  = 1;
  const int gFalse = 0;

  long gWakeUpDspTime = 1500;
}


SetMoveTimer ()
{
  setTimer(tMoveDownTimer,cMoveTime);
  setTimer(tMoveUpTimer  ,cMoveTime);
}


