
variables
{
  dword gBusContext_Comfort;
  dword gBusContext_PowerTrain;
  char gComfort[32]     = "Comfort";
  char gPowerTrain[32]  = "PowerTrain";
  char gPanelName[20] = "NetworkManagement";
}
on preStart 
{
   // Get the bus context of both busses  
  gBusContext_Comfort   = GetBusNameContext(gComfort);
  gBusContext_PowerTrain = GetBusNameContext(gPowerTrain);
 
  if(  gBusContext_Comfort != 0 )
  {
    Nm_SetAutoStartParam(0);
    ILSetAutoStartParam(0);
  }
  
  if(  gBusContext_PowerTrain != 0 )
  {
    Nm_SetAutoStartParam(0);
    ILSetAutoStartParam(0);
  }
}

on start
{   
  int ret;
 
  if(  gBusContext_Comfort != 0 )
  {
    setBusContext(gBusContext_Comfort);
    ret = sysSetVariableInt("NMTester","NodeId_%NODE_NAME%_Comfort",Nm_GetLocalNodeIdentifier());
    TraceNMState(getBusContext(), Nm_GetState());
  }
  
  if(  gBusContext_PowerTrain != 0 )
  {
    setBusContext(gBusContext_PowerTrain);
    ret = sysSetVariableInt("NMTester","NodeId_%NODE_NAME%_PowerTrain",Nm_GetLocalNodeIdentifier());
    TraceNMState(getBusContext(), Nm_GetState());
  }
}

void TraceNMState(dword buscontext,int state)
{
  char info[30];
  int red;
  int green; 
  int blue;
  
  switch( state )
  {
      case 0: strncpy(info,"UNINIT",30);red=255; green=255; blue=255; break;
      case 1: strncpy(info,"BUS_SLEEP",30);red=183; green=48; blue=48; break;
      case 2: strncpy(info,"PREPARE_BUS_SLEEP",30);red=255; green=255; blue=0; break;
      case 3: strncpy(info,"READY_SLEEP",30); red=255; green=255; blue=0;break;
      case 4: strncpy(info,"NORMAL_OPERATION",30);red=0; green=255; blue=0; break;
      case 5: strncpy(info,"REPEAT_MESSAGE",30);	red=152;green=251;blue=152; break;
      case 8: strncpy(info,"Disabled",30);	red=183; green=48; blue=48; break;
      default:strncpy(info,"Unknown state",30);red=255; green=255; blue=255; break;
   } 
  
  if(  getBusContext() == gBusContext_Comfort  )
  {
    sysSetVariableString("NMTester","NetworkState_%NODE_NAME%_Comfort", info); 
    SetStateDisplayColor( "NMMode%NODE_NAME%Comfort", red,  green,  blue);
  }
  else if(  getBusContext() == gBusContext_PowerTrain  )
  {
    sysSetVariableString("NMTester","NetworkState_%NODE_NAME%_PowerTrain", info); 
    SetStateDisplayColor( "NMMode%NODE_NAME%PowerTrain", red,  green,  blue);
  }
}

void SetStateDisplayColor (char control[], int red, int green, int blue)
{
  SetControlForeColor( gPanelName, control, MakeRGB(red, green, blue));
}

Nm_StateChangeNotification( long previousState, long currentState)
{
     TraceNMState(GetBusContext(),currentState);
}