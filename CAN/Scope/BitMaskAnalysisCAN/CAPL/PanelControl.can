/*@!Encoding:1252*/
includes
{
  
}

variables
{
  
}

on sysvar_change (sysvar::TransitionTimeMeasurement::SignalUsedForMeasurement | sysvar::TransitionTimeMeasurement::ThresholdInPercent)
{
  switch(@sysvar::TransitionTimeMeasurement::SignalUsedForMeasurement)
  {
    case 0: 
        if(@sysvar::TransitionTimeMeasurement::ThresholdInPercent == 0)
        {
          @sysvar::TransitionTimeMeasurement::ThresholdStart = 2630;
          @sysvar::TransitionTimeMeasurement::ThresholdEnd   = 3590;
        }
        else
        {
          @sysvar::TransitionTimeMeasurement::ThresholdStart = 10;
          @sysvar::TransitionTimeMeasurement::ThresholdEnd = 90;
        }
        break;
    case 1: 
        if(@sysvar::TransitionTimeMeasurement::ThresholdInPercent == 0)
        {
         @sysvar::TransitionTimeMeasurement::ThresholdStart = 1565;
         @sysvar::TransitionTimeMeasurement::ThresholdEnd   = 2485;
        }
        else
        {
          @sysvar::TransitionTimeMeasurement::ThresholdStart = 10;
          @sysvar::TransitionTimeMeasurement::ThresholdEnd   = 90;
        }
        break;
    case 2: 
        if(@sysvar::TransitionTimeMeasurement::ThresholdInPercent == 0)
        {
         @sysvar::TransitionTimeMeasurement::ThresholdStart = 186;
         @sysvar::TransitionTimeMeasurement::ThresholdEnd   = 2073;
        }
        else
        {
          @sysvar::TransitionTimeMeasurement::ThresholdStart = 10;
          @sysvar::TransitionTimeMeasurement::ThresholdEnd   = 90;
        }
        break;
        
  }
}