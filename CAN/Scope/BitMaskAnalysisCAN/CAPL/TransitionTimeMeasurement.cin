/*@!Encoding:1252*/

includes
{  
}

variables
{
   ScopeAnalyseHandle userHandle;
   char startFieldName[32];
   char endFieldName[32];
   char signalName[32];
}


long DoTransitionTimeMeasurement(char nodeName[], long flags, dword startItem, dword endItem, long thresholdStart, long thresholdEnd)
{
  ScopeBitTransitionTimeResult result;
  char id[128];
  long rc;
  userHandle.Handle = 999;
  rc = 1;
  rc = testGetWaitScopeSignalTransitionTime(nodeName, startItem, endItem, flags, thresholdStart, thresholdEnd, result, userHandle);
  snprintf(id, 128, "NodeName = \"%s\"", nodeName);
  AddTransitionMeasurementResults(result, id, "Transition Measurement Result", flags, startItem, endItem);
  return rc;
}

long DoTransitionTimeMeasurement(long flags, dword startItem, dword endItem, long thresholdStart, long thresholdEnd)
{
  ScopeBitTransitionTimeResult result;
  char id[128];
  long rc;
  rc = 1;
  userHandle.Handle = 999;
  rc = testGetWaitScopeSignalTransitionTime(canTestMessage, startItem, endItem, flags, thresholdStart, thresholdEnd, result, userHandle);
  snprintf(id, 128, "CAN ID = %x", canTestMessage.ID);
  AddTransitionMeasurementResults(result,id, "Transition Measurement Result", flags, startItem, endItem);
  return rc;
}

testfunction AddTransitionMeasurementResults(ScopeBitTransitionTimeResult result, char prefix[], char name[], long flags, dword startItem, dword endItem)
{
  const long bufLength = 512;
  char buffer[bufLength], buffer1[bufLength];
  GetBitFieldName(startFieldName, 32, startItem);
  GetBitFieldName(endFieldName, 32, endItem);
  
  
  switch(@sysvar::TransitionTimeMeasurement::SignalUsedForMeasurement)
  {
    case 0:strncpy(signalName, "CAN High", 32);break;
    case 1:strncpy(signalName, "CAN Low", 32);break;
    case 2:strncpy(signalName, "CAN Diff", 32);break;
  }
  
  TestReportAddMiscInfoBlock("Transition time measurement result:");
  snprintf(buffer1, bufLength, "%s signal = \"%s\" startField = \"%s\" endField = \"%s\" minValue = %2.2f ns maxValue = %2.2f ns averageValue = %2.2f ns  stdDeviation = %2.2f ns scopeSamplingPeriod = %2.2f ns Edges =%d Frames = %d ",prefix, signalName, startFieldName, endFieldName, result.minValue , result.maxValue, result.averageValue, result.stdDeviation, result.scopeSamplingPeriod, result.countAnalyzedEdges, result.countAnalyzedFrames);
  TestReportAddMiscInfo(name, buffer1);
}
