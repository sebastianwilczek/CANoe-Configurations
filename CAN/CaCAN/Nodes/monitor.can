/*@!Encoding:1252*/
/**
 * This ECU establishes a trust relationship with other ECUs.
 * It monitors messages on the CAN bus, sending error frames when it sees unauthenticated messages.
 * The resulting collision stops the malicious message from taking effect.
 * THIS IS NOT IMPLEMENTED HERE, THIS IS A PROOF OF CONCEPT!
 * If a message is noticed, only a log is printed.
**/

variables
{
  int64 sharedSecrets[int64]; 
  long authCodes[int64]; 
  long randomNonce1;
  long randomNonce2;
  long digest1;
  long digest2;
  long receivedAuth;
  message CaCAN_Nonce msg_CaCAN_Nonce;
  message CaCAN_AuthRequest msg_CaCAN_AuthRequest;
}

/**
 * On start, all shared secrets with other ECUs are loaded into memory.
**/
on preStart
{
  sharedSecrets[1] = 84364362;
  write("MONITOR: Node surveillance initialized");
}

/**
 * On start, a random nonce is sent out to the CAN bus.
 * Afterwards, a hash is calculated for every shared secrets combined with the random nonce.
 * The hash is then sent to the CAN bus to be confirmed by the target ECU.
**/
on start
{
  //send out random nonce for digest
  randomNonce1 = random(4294967295);
  msg_CaCAN_Nonce.Authentication_1 = randomNonce1;
  randomNonce2 = random(4294967295);
  msg_CaCAN_Nonce.Authentication_2 = randomNonce2;
  output(msg_CaCAN_Nonce);
  write("MONITOR: Sent out random nonce");
  
  //calculate digest
  digest1 = hash(randomNonce1+sharedSecrets[1]);
  digest2 = hash(randomNonce2+sharedSecrets[1]);
  
  //wait for nodes to finish calculation
  
  //send out auth request with part of digest
  msg_CaCAN_AuthRequest.Authentication_1 = digest1;
  output(msg_CaCAN_AuthRequest);
}

/**
 * Once the ECU receives a reply to CaCAN authentication, it checks if the received hash is the same it calculated.
 * If yes, a trust relationship is established between the monitor and the replying ECU.
**/
on message CaCAN_AuthReply
{
  if(digest2 == this.Authentication_2)
  {
    write("MONITOR: Received correct digest. Shared secret established.");
  } else {
    write("MONITOR: Could not validate digest. Potential compromised ECU");
  }
}

/**
 * Once the monitor receives a BrakeState message, it computes the hash of the message using the pressure, the random nonce and the shared secret of the engine ECU.
 * If the authentication code is not the same as the calculated hash, it destroys the message by sending an error frame.
 * THIS IS NOT IMPLEMENTED HERE, PROOF OF CONCEPT.
 * This implementation only prints a log to showcase whether a message was deemed legitimate or not.
**/
on message BrakeState
{
  receivedAuth = hash(this.BrakePressure + randomNonce1 + randomNonce2 + sharedSecrets[1]) % 256;
  if(receivedAuth < 0)
  {  
    receivedAuth = receivedAuth+256;
  }
  if(this.CaCAN_Auth == receivedAuth)
  {
    write("MONITOR: Legitimate brake message.");
  } else {
    write("MONITOR: Unauthorized brake message. Potentially compromised ECU. Sending error frame IN THEORY.");
  }
}

/**
 * Helper functions to hash a long value.
 * PROOF OF CONCEPT IMPLEMENTATION, NOT CRYPTOPGRAPHIC!
 * DO NOT USE IN PRACTISE!
**/
long hash(long data)
{
  return data * 5325 % 4294967295;
}