/*@!Encoding:1252*/
variables
{
  int64 sharedSecrets[int64]; 
  long authCodes[int64]; 
  long randomNonce1;
  long randomNonce2;
  long digest1;
  long digest2;
  long receivedAuth;
  message CaCAN_Nonce msg_CaCAN_Nonce;
  message CaCAN_AuthRequest msg_CaCAN_AuthRequest;
}

on preStart
{
  sharedSecrets[1] = 84364362;
  write("MONITOR: Node surveillance initialized");
}

on start
{
  //send out random nonce for digest
  randomNonce1 = random(4294967295);
  msg_CaCAN_Nonce.Authentication_1 = randomNonce1;
  randomNonce2 = random(4294967295);
  msg_CaCAN_Nonce.Authentication_2 = randomNonce2;
  output(msg_CaCAN_Nonce);
  write("MONITOR: Sent out random nonce");
  
  //calculate digest
  digest1 = hash(randomNonce1+sharedSecrets[1]);
  digest2 = hash(randomNonce2+sharedSecrets[1]);
  
  //wait for nodes to finish calculation
  
  //send out auth request with part of digest
  msg_CaCAN_AuthRequest.Authentication_1 = digest1;
  output(msg_CaCAN_AuthRequest);
}

on message CaCAN_AuthReply
{
  if(digest2 == this.Authentication_2)
  {
    write("MONITOR: Received correct digest. Shared secret established.");
  } else {
    write("MONITOR: Could not validate digest. Potential compromised ECU");
  }
}

on message BrakeState
{
  receivedAuth = hash(this.BrakePressure + randomNonce1 + randomNonce2 + sharedSecrets[1]) % 256;
  if(receivedAuth < 0)
  {  
    receivedAuth = receivedAuth+256;
  }
  if(this.CaCAN_Auth == receivedAuth)
  {
    write("MONITOR: Legitimate brake message.");
    write("MONITOR: Legitimate brake message.");
    write("MONITOR: Legitimate brake message.");
    write("MONITOR: Legitimate brake message.");
    write("MONITOR: Legitimate brake message.");
    write("MONITOR: Legitimate brake message.");
    write("MONITOR: Legitimate brake message.");
    write("MONITOR: Legitimate brake message.");
    write("MONITOR: Legitimate brake message.");
    write("MONITOR: Legitimate brake message.");
    write("MONITOR: Legitimate brake message.");
    write("MONITOR: Legitimate brake message.");
    write("MONITOR: Legitimate brake message.");
    write("MONITOR: Legitimate brake message.");
    write("MONITOR: Legitimate brake message.");
  } else {
    write("MONITOR: Unauthorized brake message. Potentially compromised ECU. Sending error frame IN THEORY");
  }
}

long hash(long data)
{
  return data * 5325 % 4294967295;
}