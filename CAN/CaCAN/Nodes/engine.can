/*@!Encoding:1252*/
/**
 * This ECU simulates the engine of a car.
 * It's job is to notice physical brake pressure and to send out the according message.
 * CaCAN authentication is built into this ECU.
**/

variables 
{
  int64 sharedSecret; 
  long randomNonce1;
  long randomNonce2;
  long digest1;
  long digest2;
  
  message CaCAN_AuthReply msg_CaCAN_AuthReply;
  message BrakeState msg_BrakeState;
}

/**
 * On start, the shared secret is written to memory.
 * The shared secret is the same as the one in memory of the monitor ECU.
**/
on preStart
{
  sharedSecret = 84364362;
}

/**
 * On start of the monitor ECU a random nonce is sent out.
 * This ECU takes the random nonce and computes a hash from the nonce and the shared secret.
**/
on message CaCAN_Nonce
{
  write("ENGINE: Received nonce");
  randomNonce1 = this.Authentication_1;
  randomNonce2 = this.Authentication_2;
  digest1 = hash(randomNonce1+sharedSecret);
  digest2 = hash(randomNonce2+sharedSecret);
}

/**
 * The monitor ECU sends out a part of the hash computed by both ECUs.
 * If the first part matches, this ECU replies with the second part.
**/
on message CaCAN_AuthRequest
{
  if(digest1 == this.Authentication_1){
    write("ENGINE: Received correct digest from monitor, responding with rest of digest");
    msg_CaCAN_AuthReply.Authentication_2 = digest2;
    output(msg_CaCAN_AuthReply);
  } else {
    write("ENGINE: Digest received by monitor mismatch. Error establishing authentication");
  }
}

/**
 * In the event that the physical brake pressure changes, a message is sent to the CAN bus.
 * This message contains the brake pressure in percentage.
 * It also contains an 8 bit hash of the brake pressure, the random nonce and the shared secret.
**/
on sysvar sysvar::Brakes::BrakePressure
{
  write("ENGINE: Brake pressure applied");
  msg_BrakeState.BrakePressure = @this;
  msg_BrakeState.CaCAN_Auth = (hash(msg_BrakeState.BrakePressure + randomNonce1 + randomNonce2 + sharedSecret) % 256);
  output(msg_BrakeState);
}

/**
 * Helper functions to hash a long value.
 * PROOF OF CONCEPT IMPLEMENTATION, NOT CRYPTOPGRAPHIC!
 * DO NOT USE IN PRACTISE!
**/
long hash(long data)
{
  return data * 5325 % 4294967295;
}