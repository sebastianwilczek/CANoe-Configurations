/*@!Encoding:1252*/
variables 
{
}

on preStart
{
}

on start
{
}

on message BrakeState
{
  // engine state received
  if (this.BrakePressure > 0)
  {
    @sysvar::Lights::BrakeLight = 1;
  } else {
    @sysvar::Lights::BrakeLight = 0;
  }
}