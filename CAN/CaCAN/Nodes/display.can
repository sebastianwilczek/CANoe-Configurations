/*@!Encoding:1252*/
/**
 * This ECU is responsible to show the effects of messages on the CAN bus.
 * It does not have a physical equivalent.
 * It's only purpose is to showcase effects for this simulation.
**/

/**
 * Once a BrakeState message is received, the ECU checks if the contained pressure is above 0%.
 * If this is the case, the brake lights are turned on.
 * If not, they are turned off.
**/
on message BrakeState
{
  if (this.BrakePressure > 0)
  {
    @sysvar::Lights::BrakeLight = 1;
  } else {
    @sysvar::Lights::BrakeLight = 0;
  }
}