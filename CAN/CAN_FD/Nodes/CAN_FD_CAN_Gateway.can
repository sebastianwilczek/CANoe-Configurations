/*@!Encoding:1252*/
includes
{
 
}

variables
{
  const int cCANFDChannel = 1;
  const int cCANChannel = 2;
}

on message EngineData
{
  // CAN FD data routed to CAN. Frame based.
  $Comfort::Gateway::Gateway_2::EngSpeed   = this.EngSpeed;
  $Comfort::Gateway::Gateway_2::EngineTemp = this.EngTemp;
  
}

on message Gateway_2
{
  // CAN data routed to CAN FD. Frame based.
  $Powertrain::Engine::ABSdata::CarSpeed = this.CarSpeed.phys;
}

on signal Comfort::Gateway::Gateway_1::Gear
{
  // CAN data routed to CAN FD. Signal based.
  $Powertrain::Engine::GearBoxInfo::Gear = this;
  $Powertrain::Engine::EngineData::Gear = this;
}


