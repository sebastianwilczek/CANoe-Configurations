/*@!Encoding:1252*/
includes
{
  
}

variables
{
  
}

on key '1'
{
  message EngineData data;
  output(data);
}

