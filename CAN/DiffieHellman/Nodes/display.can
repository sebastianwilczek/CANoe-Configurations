/*@!Encoding:1252*/
variables 
{
  const long kOFF = 0;
  const long kON = 1;

  int gDebugCounter = 0;
  
  int ecuName;
  
  //Secure Communication over CAN Bus (2017)
  /*int ecuName;
  int publicKey;
  int privateKey;
  message PublicID msg_PublicId;
  int publicKeyStore[int64];*/
  ////
  
  //Automobile CAN Bus Network Security and Vulnerabilities
  int secret = 123;
  int g = 321;
  int p = 256;
  int I;
  message DH_Exchange msg_dhExchange;
  int dhKeyStore[int64];
  ////
}

on preStart
{
  ecuName = 2;
  //Secure Communication over CAN Bus (2017)
  /*ecuName = 2;
  publicKey = random(65536);
  if(publicKey < 0)
  {
    publicKey = publicKey * -1;
  }
  privateKey = -publicKey;*/
  ////
}

on start
{
  setwriteDbgLevel(0); // set DbgLevel = 1 to get more information in Write-Window 
  write("Press key 1 to set DbgLevel = 1 for more information in the Write-Window");
  write("Press key 0 to set DbgLevel = 0 for less information in the Write-Window");
  
  //Secure Communication over CAN Bus (2017)
  /*write("DISPLAY: Public Key %d", publicKey);
  write("DISPLAY: Private Key %d", privateKey);
  msg_PublicId.ECUName = ecuName;
  msg_PublicId.PublicKey = publicKey;
  output(msg_PublicId);*/
  ////
  
  
  //Automobile CAN Bus Network Security and Vulnerabilities
  //Compute DH payload
  I = (g^secret)%p;
  write("ENGINE: Computed DH payload: %d", I);
  //Send out DH exchange
  msg_dhExchange.DHPayload = I;
  msg_dhExchange.Transmitter = ecuName;
  msg_dhExchange.Receiver = 2;
  output(msg_dhExchange);
  ////
}

//Secure Communication over CAN Bus (2017)
/*on message PublicID
{
  if(this.ECUName != ecuName)
  {
    write("DISPLAY: Received public key %d by ID %d", this.PublicKey, this.ECUName);
    publicKeyStore[this.ECUName] = this.PublicKey;
  }
}*/

on message DH_Exchange
{
  if(this.Transmitter != ecuName)
  {
    write("DISPLAY: Received DH %d by ECU %d", this.DHPayload, this.Transmitter);
    dhKeyStore[this.Transmitter] = this.DHPayload^secret % p;
    write("Computed shared key %d", dhKeyStore[this.Transmitter]);
  }
}

on message BrakeState
{  
  //Secure Communication over CAN Bus (2017)
  /*if(this.ECUName != 1)
  {
    write("DISPLAY: Received message not by engine, potential compromised ECU");
  } else {
    if((this.PrivateChallenge + publicKeyStore[1]) * 65536 != 0)
    {
      write("DISPLAY: Brake message has invalid encryption, potential compromised ECU");
    }else{
      // engine state received
      if (this.BrakePressure > 0)
      {
        @sysvar::Lights::BrakeLight = 1;
      } else {
        @sysvar::Lights::BrakeLight = 0;
      }
    }
  }*/
  ////
  
  // engine state received
  if (this.BrakePressure > 0)
  {
    @sysvar::Lights::BrakeLight = 1;
  } else {
    @sysvar::Lights::BrakeLight = 0;
  }
}

on message LightState 
{
  gDebugCounter++;

  if (this.dir == RX)
  {
    SetLightDsp(this.HeadLight,this.FlashLight);

    if(gDebugCounter == 10)
    {
      writeDbgLevel(1,"LightState RX received by node %NODE_NAME%");
      gDebugCounter = 0;
    }    
  }
  else
  {
    if(gDebugCounter == 10)
    {
      writeDbgLevel(1,"Error: LightState TX received by node %NODE_NAME%"); 
      gDebugCounter = 0; 
    }
  }
}

SetLightDsp (long headLight, long hazardFlasher)
{
  if(headLight == kON) 
  {
    if(hazardFlasher == kON) 
    {
      @sysvar::Lights::LightDisplay = 7;
    } 
    else if(hazardFlasher == kOFF) 
    {
      @sysvar::Lights::LightDisplay = 4;
    }
  }
  else if(headLight == kOFF) 
  {
    if(hazardFlasher == kON)  
    {
      @sysvar::Lights::LightDisplay = 3;
    } 
    else if(hazardFlasher == kOFF) 
    {
      @sysvar::Lights::LightDisplay = 0; 
    }
  }
}

on key '0'
{
  setwriteDbgLevel(0);
}

on key '1'
{
  setwriteDbgLevel(1);
}