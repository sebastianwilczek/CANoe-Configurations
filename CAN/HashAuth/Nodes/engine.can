/*@!Encoding:1252*/
variables 
{
  int groupId = 1;
  int counter = 0;
  int64 sharedKey = 84364362;
  message BrakeState msg_BrakeState;
}

on preStart
{
  
}

on start
{
}

on sysvar sysvar::Brakes::BrakePressure
{
  write("ENGINE: Brake pressure applied");
  msg_BrakeState.BrakePressure = @this;
  msg_BrakeState.Hash = hash(@this);
  output(msg_BrakeState);
  counter++;
}

int64 hash(int64 data)
{
  return (groupId + sharedKey + counter + data) * 5325 % 16777216;
}