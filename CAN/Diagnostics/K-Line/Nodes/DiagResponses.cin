/*@!Encoding:1252*/
on diagRequest *
{
  diagResponse this resp;
  BYTE serviceCode;
  long primitiveSize;
  int i, ret;
  DWORD reasonOut[1];
  
  primitiveSize = DiagGetPrimitiveSize(this);

  if( this.GetPrimitiveByte(0) == 0x82)
  {
    return; // Ignore StopCommunication!
  }

  if (DiagIsRaw(this))
  {
    DiagSendNegativeResponse( this, 0x12);
    return;
  }

  ret = DiagCheckValidPrimitive(this, reasonOut);
  if (ret == 1)
  {
    if (1 == diagGetSuppressResp(this))
    {
      return; // Do not send a positive response!
    }

    DiagSendResponse( resp);
  } 
  else
  {
    diagSendNegativeResponse( this, 0x12);
  }
}
