/*@!Encoding:1252*/

variables
{
	enum eKLineInitType
  {
    FIVE_BAUD = 1,
    FAST,
    NONE
  };
  
  enum waitRetValue
  {
    TIMEOUT = 0,
    EVENT_OCCURED = 1,
    TIMEOUT_ERROR = -92
  };
  
  const long kReturnSuccess = 0;
  
  BYTE gKLine_ReportBytes = 0;
  
  dword gMsgChannel = 0;
  
  const long kRetSuccess = 0;
  const long kRetFail = -1;
  
  char cIniTypeNames[4][20] = { "", "5 Baud Init", "Fast Init", "No Init" };
  
  enum eKlineBusErrors
  {
     NO_ERROR                = 0,
     CHECKSUM_ERROR          = 1,
     FMT_ERROR_ONEBYTE       = 2,
     FMT_ERROR_THREEBYTE     = 3,
     LENGTH_ERROR_SHORT      = 4,
     LENGTH_ERROR_LONG       = 5,
     WRONG_TESTER_ADDRESS    = 6,
     WRONG_ECU_ADDRESS       = 7,
     WRONG_ECU_ADDRESS_SC    = 8
  }; 
  
  enum DiagConnectionStates
  {
    CS_Closed         = 0,  /// Channel not opened yet or already closed
    CS_Opened         = 1,  /// Channel opened but no request successfully send yet or the attempt to send a request failed
    CS_Connected      = 2,  /// Request successfully send, no response received yet or expected response missed
    CS_Online         = 3,  /// Request and response successfully send and received
    CS_ClosePending   = 4,  /// Close requested but still pending, CS_Closed will follow
    CS_ConnectPending = 5,  /// StartCommunication requested but still pending, if succeed CS_Connected will follow, otherwise CS_Opened
    CS_EndDiagChannelConnectionState = 6
  };
  
  enum writeSeverity
  {
    SUCCESS = 0,
    INFORMATION,
    WARNING,
    ERROR
  };
  
  dword gKLine_PatchFrame = 0;
  
  const byte cSidStartCom   = 0x81;
  const byte cRSidStartCom  = 0xC1;
  const byte cSidStopCom    = 0x82;
  const byte cRSidStopCom   = 0xC2;
}


