/*@!Encoding:1252*/
variables
{
  enum bool {true=1, false=0};

  // Common Negative Response Codes (NRCs)
  const cNRC_GeneralReject=0x10;
  const cNRC_ServiceNotSupported=0x11;
  const cNRC_SubfunctionNotSupported=0x12;
  const cNRC_IncorrectMessageLengthOrInvalidFormat=0x13;
  const cNRC_BusyRepeatRequest=0x21;
  const cNRC_ConditionsNotCorrectOrRequestSequenceError=0x22;
  const cNRC_RequestSequenceError=0x24;
  const cNRC_RequestOutOfRange=0x31;
  const cNRC_SecurityAccessDenied=0x33;
  const cNRC_InvalidKey=0x35;
  const cNRC_RequestCorrectlyReceivedResponsePending=0x78;
  
  // Access modes for DiagGetParameter
  const cParamAccessNumerical = 0;
  const cParamAccessPhysical = 1;
  const cParamAccessCoded = 2;

  // Fault Memory types
  enum eFaultmemType {
    Undefined=0, KWP=2, UDS=3        // Enum contains size of DTC as value
  };
  
  // Send modes for UUDT
  enum eDIDSendMode {Slow=0x01, Medium=0x02, Fast=0x03, Off=0x04, Once=0xF2};
  
  // This timeout is used just to force CANoe to continue, i.e. normally a TestWaitForDiag...
  // function will return much earlier due to diagnostic level timing!
  const cApplicationTimeoutMs = 5000; 
}

