/*@!Encoding:1252*/
variables 
{
  const long kOFF = 0;
  const long kON = 1;

  int gDebugCounter = 0;
  
  //Secure Communication over CAN Bus (2017)
  int ecuName;
  int publicKey;
  int privateKey;
  message PublicID msg_PublicId;
  int publicKeyStore[int64];
  ////
}

on preStart
{
  //Secure Communication over CAN Bus (2017)
  ecuName = 2;
  publicKey = random(65536);
  if(publicKey < 0)
  {
    publicKey = publicKey * -1;
  }
  privateKey = -publicKey;
  ////
}

on start
{
  setwriteDbgLevel(0); // set DbgLevel = 1 to get more information in Write-Window 
  write("Press key 1 to set DbgLevel = 1 for more information in the Write-Window");
  write("Press key 0 to set DbgLevel = 0 for less information in the Write-Window");
  
  //Secure Communication over CAN Bus (2017)
  write("DISPLAY: Public Key %d", publicKey);
  write("DISPLAY: Private Key %d", privateKey);
  msg_PublicId.ECUName = ecuName;
  msg_PublicId.PublicKey = publicKey;
  output(msg_PublicId);
  ////
}

//Secure Communication over CAN Bus (2017)
on message PublicID
{
  if(this.ECUName != ecuName)
  {
    write("DISPLAY: Received public key %d by ID %d", this.PublicKey, this.ECUName);
    publicKeyStore[this.ECUName] = this.PublicKey;
  }
}

on message BrakeState
{  
  if(this.ECUName != 1)
  {
    write("DISPLAY: Received message not by engine, potential compromised ECU");
  } else {
    if((this.PrivateChallenge + publicKeyStore[1]) * 65536 != 0)
    {
      write("DISPLAY: Brake message has invalid encryption, potential compromised ECU");
    }else{
      // engine state received
      if (this.BrakePressure > 0)
      {
        @sysvar::Lights::BrakeLight = 1;
      } else {
        @sysvar::Lights::BrakeLight = 0;
      }
    }
    
  }
  
  
}

on message LightState 
{
  gDebugCounter++;

  if (this.dir == RX)
  {
    SetLightDsp(this.HeadLight,this.FlashLight);

    if(gDebugCounter == 10)
    {
      writeDbgLevel(1,"LightState RX received by node %NODE_NAME%");
      gDebugCounter = 0;
    }    
  }
  else
  {
    if(gDebugCounter == 10)
    {
      writeDbgLevel(1,"Error: LightState TX received by node %NODE_NAME%"); 
      gDebugCounter = 0; 
    }
  }
}

SetLightDsp (long headLight, long hazardFlasher)
{
  if(headLight == kON) 
  {
    if(hazardFlasher == kON) 
    {
      @sysvar::Lights::LightDisplay = 7;
    } 
    else if(hazardFlasher == kOFF) 
    {
      @sysvar::Lights::LightDisplay = 4;
    }
  }
  else if(headLight == kOFF) 
  {
    if(hazardFlasher == kON)  
    {
      @sysvar::Lights::LightDisplay = 3;
    } 
    else if(hazardFlasher == kOFF) 
    {
      @sysvar::Lights::LightDisplay = 0; 
    }
  }
}

on key '0'
{
  setwriteDbgLevel(0);
}

on key '1'
{
  setwriteDbgLevel(1);
}