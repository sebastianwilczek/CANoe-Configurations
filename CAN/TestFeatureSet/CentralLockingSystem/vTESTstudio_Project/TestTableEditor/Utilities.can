/*@!Encoding:1252*/
includes
{
  
}

variables
{
  
}

// Simulates increasing/decreasing velocity slowly as if controlled by driver.
export testfunction AccelerateDecelerateToTargetSpeed(float targetSpeed)
{
	float currentSpeed;

  TestStep("Speed Change", "Requested speed is %f", targetSpeed);
  currentSpeed = $VehicleMotion::Velocity;
  if (targetSpeed > currentSpeed) 
  {
    // Accelerate
    TestStep("Speed Change", "Accelerating...");
    @sysvar::SystemUnderTest::Accelerate = 1;
    @sysvar::SystemUnderTest::Decelerate = 0;
    
    do 
    {
      testWaitForTimeout(100);
      currentSpeed = $VehicleMotion::Velocity;
      
      TestStep("Speed Change", "Current speed is %f km/h", currentSpeed);
    } 
    while (targetSpeed > currentSpeed);
    
    @sysvar::SystemUnderTest::Accelerate = 0;
  }
  else if (targetSpeed < currentSpeed) 
  {
    TestStep("Speed Change", "Decelerating...");
    // decelerate
    @sysvar::SystemUnderTest::Accelerate = 0;
    @sysvar::SystemUnderTest::Decelerate = 1;
    
    do 
    {
      testWaitForTimeout(100);
      currentSpeed = $VehicleMotion::Velocity;
      
      TestStep("Speed Change", "Current speed is %f km/h", currentSpeed);
    } 
    while (targetSpeed < currentSpeed);
    
    @sysvar::SystemUnderTest::Decelerate = 0;
  }
  TestStep("Speed Change", "Reached speed is %f", currentSpeed);
}