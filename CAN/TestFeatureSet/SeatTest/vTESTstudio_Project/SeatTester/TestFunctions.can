/*@!Encoding:1252*/
includes
{
  
}

variables
{
  
}

export void AddEngineerInfoToReport(char title[], char value[])
{
  TestReportAddEngineerInfo(title, value);
}

export void AddSUTInfoToReport(char title[], char value[])
{
  testReportAddSUTInfo(title, value);
}

export testfunction ResetLongitudinalAdjustment()
{
  $LongitudinalAdjustmentForward = 0;
  $LongitudinalAdjustmentBackward = 0;
}

export testfunction ResetHeightAdjustment()
{
  $HeightAdjustmentUp = 0;
  $HeightAdjustmentDown = 0;
}