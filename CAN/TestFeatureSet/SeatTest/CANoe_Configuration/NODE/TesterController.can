/*@@includes:*/
includes
{
#include "TesterLib.cin"
}
/*@@end*/

/*@@var:*/
/*----------------------------------------------------------------------------
|
| Modulname : Tester.can
|-----------------------------------------------------------------------------
|*****************************************************************************
|-----------------------------------------------------------------------------
|               A U T H O R   I D E N T I T Y
|-----------------------------------------------------------------------------
| Author               Initials         Company
| ------               --------         -------
| Alexander Büttner      Br             Vector Informatik GmbH
|-----------------------------------------------------------------------------
|               R E V I S I O N   H I S T O R Y
|-----------------------------------------------------------------------------
| Date         Ver    Author  Description
| ---------    ---    ------  ------------------------------------------------
| 05.03.07     1.0     Br     build
|----------------------------------------------------------------------------
*/
variables
{
  // 
  // see #include "TesterLib.cin"
  // 
}
/*@@end*/

/*@@key:'a':*/
on key 'a'
{
  GetSeatVariant();
}
/*@@end*/

/*@@diagResponse:Seat_Variant_Lesen:*/
on diagResponse Seat_Variant_Lesen
{
  DiagGetParameter( this,"Seat_Variant",gSeatVarBuff,elcount(gSeatVarBuff));
  SysSetVariableString( sysvar::Test::SeatVariant, gSeatVarBuff);
}
/*@@end*/

/*@@sysvarChange:Test::SeatGetVariant:*/
on sysvar sysvar::Test::SeatGetVariant
{
  if ( 0 != @this)
  {
    GetSeatVariant();

    @this = 0;
  }
}
/*@@end*/

/*@@caplFunc:GetSeatVariant():*///function
void GetSeatVariant()
{
  // /////////////////////////////////////////////////////////////////// 
  // Sets the ECU with which the tester should communicate from now on.
  DiagSetTarget(gTarget);
  
  ReadSeatVariant();
}
/*@@end*/

/*@@msg:CAN1.Seat::SeatMsg (0x205):*/
on message SeatMsg
{
  @Test::SeatHeightUpperLimit = this.Height_Block && this.Height_Pos == kMAX_DIST;
  @Test::SeatHeightLowerLimit = this.Height_Block && this.Height_Pos == kMIN_DIST;
  @Test::SeatLongitudinalUpperLimit = this.Longitudinal_Block && this.Longitudinal_Pos == kMAX_DIST;
  @Test::SeatLongitudinalLowerLimit = this.Longitudinal_Block && this.Longitudinal_Pos == kMIN_DIST;
}
/*@@end*/

/*@@sysvarChange:Test::SeatPosDown:*/
on sysvar sysvar::Test::SeatPosDown
{
  $ControlMsg::HeightAdjustmentDown  = @this;
}
/*@@end*/

/*@@sysvarChange:Test::SeatPosUp:*/
on sysvar sysvar::Test::SeatPosUp
{
  $ControlMsg::HeightAdjustmentUp  = @this;
}
/*@@end*/

/*@@sysvarChange:Test::SeatPosForward:*/
on sysvar sysvar::Test::SeatPosForward
{
  $ControlMsg::LongitudinalAdjustmentForward  = @this;
}
/*@@end*/

/*@@sysvarChange:Test::SeatPosBackward:*/
on sysvar sysvar::Test::SeatPosBackward
{
  $ControlMsg::LongitudinalAdjustmentBackward = @this;
}
/*@@end*/

/*@@stop:StopMeasurement:*/
on stopMeasurement
{
  ClearControlVariables();
}
/*@@end*/

/*@@caplFunc:ClearControlVariables():*///function
void ClearControlVariables()
{
  SysSetVariableString( sysvar::Test::SeatVariant, "");
  @sysvar::Test::SeatGetVariant = 0;
}
/*@@end*/

/*@@preStart:PreStart:*/
on preStart
{
  ClearControlVariables();
}
/*@@end*/

/*@@caplFunc:ReadSeatVariant():*///function
void ReadSeatVariant()
{
  // /////////////////////////////////////////////////////////////////// 
  // Read Seat-Variant
  DiagSendRequest(dr_ReadSeatVari);  //  Sends the request object to the SUT.
}
/*@@end*/

