/*@!Encoding:1252*/
/*----------------------------------------------------------------------------
|
| Modulname : TesterController.can
|-----------------------------------------------------------------------------
|*****************************************************************************
|-----------------------------------------------------------------------------
|               A U T H O R   I D E N T I T Y
|-----------------------------------------------------------------------------
| Author               Initials         Company
| ------               --------         -------
| Alexander Büttner      Br             Vector Informatik GmbH
|-----------------------------------------------------------------------------
|               R E V I S I O N   H I S T O R Y
|-----------------------------------------------------------------------------
| Date         Ver    Author  Description
| ---------    ---    ------  ------------------------------------------------
| 05.03.07     1.0     Br     build
|----------------------------------------------------------------------------
*/
variables
{
  // /////////////////////////////////////////////////////////////////// 
  // 
  const int kSIZE = 255;
  const int kDIAG_TIMEOUT = 1000;  // ms
  const int kWAIT_TIMEOUT = 5000;  // ms
  const int kFALSE = 0;
  const int kTRUE  = 1;
  const int kMIN_DIST = 0;
  const int kMAX_DIST = 20;

  // /////////////////////////////////////////////////////////////////// 
  // CycleTimeViolation 
  float gNoCheck = 0;   //in ms
  float gMinRelCycleTime = 80;   //in ms
  float gMaxRelCycleTime = 120;  //in ms
  
  char gCycCheckBuffer[kSIZE];
    
  dword gCheckControlMsgID;
  dword gCheckID_ControlMsg;
  dword gCheckID_SeatMsg;  

  // /////////////////////////////////////////////////////////////////// 
  // Name of SUT with which the tester should communicate via diagnostric.
  char gTarget[kSIZE] = "Vector_Seat"; 
  char gSeatVarBuff[kSIZE];

  // /////////////////////////////////////////////////////////////////// 
  // Diagnostic send requests
  DiagRequest Sitzungen_starten_Starten  dr_StartSession;
  DiagRequest Seat_Variant_Lesen         dr_ReadSeatVari;
  DiagRequest Serial_Number_Lesen        dr_ReadSerNr;
  DiagRequest Manufacturer_Date_Lesen    dr_ReadManufData;
  DiagRequest STOP_SESSION_Beenden       dr_StopDiag;

  char supplierBuff[kSIZE];
  char dateYearBuff[kSIZE];
  char dateMonthBuff[kSIZE];
  char dateDayBuff[kSIZE];
  char serNumBuff[kSIZE];
}

