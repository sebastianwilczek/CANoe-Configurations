/*@@var:*/
variables 
{
}
/*@@end*/

/*@@sysvarChange:Engine::EngineStateSwitch:*/
on sysvar sysvar::Engine::EngineStateSwitch
{
 $EngineState::OnOff = @this;
  if(@this)
    $EngineState::EngineSpeed = @sysvar::Engine::EngineSpeedEntry;
  else
    $EngineState::EngineSpeed = 0;
}
/*@@end*/

/*@@sysvarChange:Engine::EngineSpeedEntry:*/
on sysvar sysvar::Engine::EngineSpeedEntry
{
  if(@sysvar::Engine::EngineStateSwitch) 
  {
    $EngineState::EngineSpeed = @this;
  }
}
/*@@end*/

