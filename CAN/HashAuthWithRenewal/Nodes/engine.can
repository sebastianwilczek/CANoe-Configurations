/*@!Encoding:1252*/
/**
 * This ECU simulates the engine of a car.
 * It's job is to notice physical brake pressure and to send out the according message.
**/

variables 
{
  int groupId = 1;
  int counter = 0;
  int keyCounter = 0;
  int64 presharedKey = 84364362;
  int64 generatedKey;
  int64 randomValue;
  message BrakeState msg_BrakeState;
  message KeyRenew msg_KeyRenew;
}

/**
 * Before starting, the ECU generates a key to be used in later exchanges.
**/
on preStart
{
  generatedKey = generateKey(presharedKey, 0);
  write("ENGINE: First generated key: %d", generatedKey);
}

/**
 * Pressing the 'r' key starts the key renewal procedure.
**/
on key 'r'
{
  write("ENGINE: Signaling new key generation");
  renewKey();
  write("ENGINE: New key is %d", generatedKey);
}

/**
 * In the event that the physical brake pressure changes, a message is sent to the CAN bus.
 * This message contains the brake pressure in percentage.
 * It also contains the hash of the pressure in combination with the counter, the group ID and the generated key.
**/
on sysvar sysvar::Brakes::BrakePressure
{
  msg_BrakeState.BrakePressure = @this;
  msg_BrakeState.Hash = hash(@this);
  output(msg_BrakeState);
  counter++;
}

/**
 * Helper method to create a hash from the counter, the group ID and the generated key in combination with input data.
 * THIS IS NOT CRYPTOGRAPHIC, PROOF OF CONCEPT!
 * DO NOT USE IN PRACTISE!
**/
int64 hash(int64 data)
{
  return (groupId + generatedKey + counter + data) * 5325 % 16777216;
}

/**
 * Helper method to create a new key from an existing key, a counter and a random value.
 * THIS IS NOT CRYPTOGRAPHIC, PROOF OF CONCEPT!
 * DO NOT USE IN PRACTISE!
**/
int64 keyRenewHash(int64 genKey, int64 rValue, int c)
{
  return (genKey + rValue + c) * 5325 % 16777216;
}

/**
 * Increases the key counter.
 * Then it generates a random value.
 * The counter, the random value and the hash of the old generated key with the counter and the random value are sent to the CAN bus.
 * Then, a new key is generated from the old generated key and the new random value.
**/
renewKey()
{
  keyCounter++;
  randomValue = random(65536);
  write("ENGINE: Sending new message for key generation: C=%d", keyCounter);
  write("ENGINE: Sending new message for key generation: R=%d", randomValue);
  write("ENGINE: Sending new message for key generation: K=%d", generatedKey);
  msg_KeyRenew.Counter = keyCounter;
  msg_KeyRenew.RandomValue = randomValue;
  msg_KeyRenew.Hash = keyRenewHash(generatedKey, randomValue, keyCounter);
  output(msg_KeyRenew);
  generatedKey = generateKey(generatedKey, randomValue);
}

/**
 * Generates a new key from an old key and a random value.
 * THIS IS NOT CRYPTOGRAPHIC, PROOF OF CONCEPT!
 * DO NOT USE IN PRACTISE!
**/
int64 generateKey(int64 previousKey, int64 randomValue)
{
  return (previousKey + randomValue + keyCounter) % 100000000;
}