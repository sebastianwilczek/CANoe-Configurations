/*@@includes:*/
includes
{
  /* You can source out constants, variables and functions 
     that are needed identically in multiple CAPL programs.*/
  #include "..\CAPL Includes\DoorInclFile.CIN"
}
/*@@end*/

/*@@var:*/
variables
{
}
/*@@end*/

/*@@startStart:Start:*/
on start
{
  // set to 2 to get more information into write-window
  setWriteDbgLevel(1);
  writeDbgLevel(2,"%NODE_NAME%");

  SetMoveTimer();
}
/*@@end*/

/*@@timer:tMoveDownTimer:*/
on timer tMoveDownTimer
{
  if(gPosWN > 15 || gPosWN < 0 ) runError(1003,1003);

  if(gPosWN < 15  && gMoveDown == gTrue)
  { 
    $DOOR_r::WN_Position = gPosWN;
    gPosWN++;
  }

  setTimer(this,cMoveTime);
}
/*@@end*/

/*@@timer:tMoveUpTimer:*/
on timer tMoveUpTimer
{
  if(gPosWN > 15 || gPosWN < 0) runError(1004,1004);
  
  if(gPosWN > 0 && gMoveUp == gTrue) 
  {
    gPosWN--;
    $DOOR_r::WN_Position = gPosWN;
  }

  setTimer(this,cMoveTime);
}
/*@@end*/

/*@@msg:CAN1.Comfort::Console_1 (0x1A0):*/
on Message Console_1
{
  if(this.WN_right_up)
  { 
    gMoveUp = gTrue;
    ReinitSleepTimer();
  }
  else gMoveUp = gFalse;


  if(this.WN_right_down)
  {
    gMoveDown = gTrue;
    ReinitSleepTimer();
  }
  else gMoveDown = gFalse;
}
/*@@end*/

/*@@timer:tWakeUpDsp:*/
on timer tWakeUpDsp
{
  @sysvar::NMTester::NMWakeUpDsp28 = 0;
}
/*@@end*/

/*@@preStart:PreStart:*/
on preStart
{
  canOffline(3);
}
/*@@end*/

/*@@msg:CAN1.Comfort::Gateway_1 (0x110):*/
on message Gateway_1
{
   if(this.Ig_15  == 1)  canOnline(3);
   if(this.Ig_15R == 1)  canOnline(3);
}
/*@@end*/

/*@@sysvarUpdate:NMTester::NMOnOff28:*/
on sysvar_update sysvar::NMTester::NMOnOff28
{
  dword var;

  if(@this) 
  {
    SilentNM();
    var = canOffline(3); 
  }
  else 
  {
    TalkNM();
    var = canOnline(3); 
  } 
}
/*@@end*/

/*@@sysvarUpdate:NMTester::NMSleep28:*/
on sysvar_update sysvar::NMTester::NMSleep28
{
  if(@this)
  {
    // Set Sleep indication.
    //---------------------
    GotoMode_BusSleep();
  }
}
/*@@end*/

/*@@sysvarUpdate:NMTester::NMWakeUp28:*/
on sysvar_update sysvar::NMTester::NMWakeUp28
{
  GotoMode_Awake();
  @sysvar::NMTester::NMWakeUpDsp28 = 1;

  WakeUpDsp(); 

  ReinitSleepTimer();
}
/*@@end*/

