/*@!Encoding:1252*/
variables
{
  // additionally Variables for Node-Simulation
  msTimer tMoveUpTimer;
  msTimer tMoveDownTimer;

  int gPosWN;
  const int cMoveTime = 100; //ms

  int gMoveDown = 0;
  int gMoveUp	= 0;

  const int gTrue  = 1;
  const int gFalse = 0;

  msTimer tWakeUpDsp; 
  long gWakeUpDspTime = 1500;
}

WakeUpDsp ()
{
  cancelTimer(tWakeUpDsp);
  setTimer(tWakeUpDsp,gWakeUpDspTime); 
}

SetMoveTimer ()
{
  setTimer(tMoveDownTimer,cMoveTime);
  setTimer(tMoveUpTimer  ,cMoveTime);
}

on sysvar_update sysvar::NMTester::NMSleepAll
{
  if(@sysvar::NMTester::NMSleepAll)
  {
    // Set Sleep indication.
    GotoMode_BusSleep();
  }
}

