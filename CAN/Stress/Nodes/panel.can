/*@@var:*/
variables 
{
}
/*@@end*/

/*@@msg:AnalyzeIds::AnlyzInfo6 (0x706):*/
/*on message AnlyzInfo6
{
   @sysvar::Stress::Float6 = this.I6CurrentCycle.phys;
   output(this);
}*/
/*@@end*/

/*@@sysvarChange:CycleTimes::HiPrStress1_TxRq:*/
on sysvar CycleTimes::HiPrStress1_TxRq
{
   @sysvar::Stress::Float6 = @sysvarfloat::CycleTimes::HiPrStress1_TxRq;
}
/*@@end*/

/*@@sysvarChange:CycleTimes::HiPrStress1:*/
on sysvar CycleTimes::HiPrStress1
{
   @sysvar::Stress::Float1 = @sysvarfloat::CycleTimes::HiPrStress1; 
}
/*@@end*/

/*@@sysvarChange:CycleTimes::HiPrStress3:*/
on sysvar CycleTimes::HiPrStress3
{
   @sysvar::Stress::Float3 = @sysvarfloat::CycleTimes::HiPrStress3;
}
/*@@end*/

/*@@sysvarChange:CycleTimes::Stress1:*/
on sysvar CycleTimes::Stress1
{
   @sysvar::Stress::Float4 = @sysvarfloat::CycleTimes::Stress1;
}
/*@@end*/

/*@@sysvarChange:CycleTimes::Stress2:*/
on sysvar CycleTimes::Stress2
{
   @sysvar::Stress::Float5 = @sysvarfloat::CycleTimes::Stress2;
}
/*@@end*/

/*@@sysvarChange:CycleTimes::HiPrStress2:*/
on sysvar CycleTimes::HiPrStress2
{
   @sysvar::Stress::Float2 = @sysvarfloat::CycleTimes::HiPrStress2;
}
/*@@end*/

