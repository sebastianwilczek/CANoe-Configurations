/*@@var:*/
variables
{
/*----------------------------------------------------------------------------
    CAPL program to measure cycle times of messages
    
    For operation following DBC is needed: anlyzeIds.dbc 

|-----------------------------------------------------------------------------
|               A U T H O R   I D E N T I T Y
|-----------------------------------------------------------------------------
|   Author             Initials
|   ------             --------
|   Marc    Lobmeyer   Lm              Vector Informatik GmbH
|   Thomas  Riegraf    Ri              Vector Informatik GmbH
|-----------------------------------------------------------------------------
|               R E V I S I O N   H I S T O R Y
|-----------------------------------------------------------------------------
| Date         Ver  Author  Description
| ---------    ---  ------  --------------------------------------------------
| 14/4/99     1.0  Ri      Creation
|-----------------------------------------------------------------------------
|               C O P Y R I G H T
|-----------------------------------------------------------------------------
| Copyright (c) 1994 - 1999 by Vector Informatik GmbH.  All rights reserved.
 ----------------------------------------------------------------------------*/

   long gLastTimes[2032];
   long gLastTimesTxRq[2032];
}
/*@@end*/

/*@@msg:CAN1.*:*/
on message CAN1.*
{
  // change here Ids you want to observe: DBC names allowed
  //  message MyFirstIdToAnalyze     msgOnInfo1;
  message HiPrStress1     msgOnInfo1;
  message HiPrStress2     msgOnInfo2;
  message HiPrStress3     msgOnInfo3;
  message Stress1         msgOnInfo4;  
  message Stress2         msgOnInfo5;
  message HiPrStress1     msgOnInfoTxRq1;  // txRq Cycle

  long timeValTxRq;
  long timeVal;

  timeValTxRq = (this.time - (gLastTimesTxRq[this.id]));
  timeVal     = (this.time - (gLastTimes[this.id]));

  // processing of TXREQUEST frames
  if (this.dir == TXREQUEST)
  {  
    if (this.id ==  msgOnInfoTxRq1.Id)  @sysvarfloat::CycleTimes::HiPrStress1_TxRq = (timeValTxRq);
    
    gLastTimesTxRq[this.id] = this.time; 
    return;
  }

  // processing of standard frames
  if (this.id ==  msgOnInfo1.Id)  @sysvarfloat::CycleTimes::HiPrStress1 = (timeVal);
  if (this.id ==  msgOnInfo2.Id)  @sysvarfloat::CycleTimes::HiPrStress2 = (timeVal);
  if (this.id ==  msgOnInfo3.Id)  @sysvarfloat::CycleTimes::HiPrStress3 = (timeVal);
  if (this.id ==  msgOnInfo4.Id)  @sysvarfloat::CycleTimes::Stress1 = (timeVal);
  if (this.id ==  msgOnInfo5.Id)  @sysvarfloat::CycleTimes::Stress2 = (timeVal);
  gLastTimes[this.id] = this.time;
}
/*@@end*/

