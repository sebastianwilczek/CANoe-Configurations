/*@!Encoding:1252*/
includes
{
  
  #include "Include\GT.cin"
}

variables
{
  //Global Time constants
  const byte GT_MASTER = 0;
  const byte GT_DOMAIN = 1;
  const byte GT_SGW = 0;
  const byte GT_CRC = 1;
  const long GT_CAN_ID = 0x123;
  const byte GT_VERBOSE = 1;
  
  mstimer demoTimer, startTimer;
  int64 currentLocalTime;
  const long cDemoTimerCycle = 1000;
}

on start
{
  startTimer.set(300);
}

on timer startTimer
{
  //Start the demo timer
  demoTimer.set(cDemoTimerCycle);
  currentLocalTime = timeNowInt64();
}

on timer demoTimer
{
  int64 calcTime;
  
  calcTime = GT_SLAVE_TIME_TO_MASTER_TIME_NS(currentLocalTime + cDemoTimerCycle * 1e6); 
  writeLineEx(-3, 0, "GT SLAVE \"%NODE_NAME%\" TIMER EVENT: Local slave time is %fs, calculated Master time is %fs, difference: %fs.",timenowint64()/1e9, calcTime / 1e9, (timenowint64() - calcTime) / 1e9);
  
  this.set(cDemoTimerCycle);
  currentLocalTime = timeNowInt64();
}