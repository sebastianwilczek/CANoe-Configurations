/*@!Encoding:1252*/
includes
{
  #include "Include\GT.cin"
}

variables
{ 
  //Global Time constants
  const byte GT_MASTER = 1;
  const byte GT_DOMAIN = 1;
  const byte GT_SGW = 0;
  const byte GT_CRC = 1;
  const long GT_CAN_ID = 0x123;
  const byte GT_VERBOSE = 1;
}

on start
{
  GT_MASTER_START();
}