/*@@var:*/
variables
{
}
/*@@end*/

/*@@msg:0x64:*/
on message 0x64
{
  message can1.0x64 msg;
  msg.RTR = 0;

  // On a remote-request (i.e. stimulation) ...
  if (this.RTR == 1)
  {
    // .. send the dataframe (which will be disturbed by CANstress)
    output(msg);
  }
}
/*@@end*/

