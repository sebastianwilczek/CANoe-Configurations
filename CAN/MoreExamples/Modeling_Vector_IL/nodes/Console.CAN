/*@@var:*/
/* ------- Sendmodul --- begin generated Comment ----
| CAPL template for CANoe IL models
| ActiveX based generation
| Functionality is done in CANoe directly - you can add application code for this node
   ---------- end generated Comment---- */

variables
{
  //Please insert your code below this comment

}
/*@@end*/

/*@@preStart:PreStart:*/
on preStart
{
  //Please insert your code below this comment
  
}
/*@@end*/

/*@@startStart:Start:*/
on start
{
  //Please insert your code below this comment
  
}
/*@@end*/

/*@@stop:StopMeasurement:*/
on stopMeasurement
{
  //Please insert your code below this comment
  
}
/*@@end*/

