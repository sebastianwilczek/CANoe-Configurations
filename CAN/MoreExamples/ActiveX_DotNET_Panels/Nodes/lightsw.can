/*@@var:*/
variables 
{
  msTimer tTurnLightFrequency;
  int gTurnLightFrequency = 500;
  int gTurnLightStatus = 0;

  int gDebugCounter = 0;
}
/*@@end*/

/*@@startStart:Start:*/
on start
{
  setWriteDbgLevel(0); // set DbgLevel = 1 to get more information in Write-Window
  write("Press key 1 to set DbgLevel = 1 for more information in the Write-Window");
  write("Press key 0 to set DbgLevel = 0 for less information in the Write-Window");
}
/*@@end*/

/*@@msg:CAN1.easy::LightState (0x321):*/
on message LightState 
{
  gDebugCounter++;
  
  if (this.dir == TX)
  {
    if(gDebugCounter == 10)
    {
      writeDbgLevel(1," LightState reflected from real board (REAL)");
      gDebugCounter = 0;
    }     
  }
  if(this.dir == TXREQUEST)
  {
    if(gDebugCounter == 10)
    {
      writeDbgLevel(1," LightState (TxRequest) reflected from real board (REAL)");
      gDebugCounter = 0;
    } 
  }
  if (this.dir == RX)
  {
    if(gDebugCounter == 10)
    {
      writeDbgLevel(1," Error: LightState reflected from real board as RX(REAL)");
      gDebugCounter = 0;
    }
  }
}
/*@@end*/

/*@@timer:tTurnLightFrequency:*/
on timer tTurnLightFrequency
{
  gTurnLightStatus = (gTurnLightStatus == 1 ? 0 : 1);
  $LightState::TurnSignal = gTurnLightStatus;
  SetTimer(this, gTurnLightFrequency);
}
/*@@end*/

/*@@key:'0':*/
on key '0'
{
  setwriteDbgLevel(0);
}
/*@@end*/

/*@@key:'1':*/
on key '1'
{
  setwriteDbgLevel(1);
}
/*@@end*/

/*@@sysvarChange:Lights::TurnSignal:*/
on sysvar sysvar::Lights::TurnSignal
{
  if(@sysvar::Lights::TurnSignal)
  {
    gTurnLightStatus = 1;
    $LightState::TurnSignal = gTurnLightStatus;
    SetTimer(tTurnLightFrequency, gTurnLightFrequency);
  }
  else
  {
    cancelTimer(tTurnLightFrequency);
    gTurnLightStatus = 0;
    $LightState::TurnSignal = gTurnLightStatus;
  }
}
/*@@end*/

