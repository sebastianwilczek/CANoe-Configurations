/*@@var:*/
variables 
{
  const long kOFF = 0;
  const long kON = 1;

  int gDebugCounter = 0;
}
/*@@end*/

/*@@msg:CAN1.easy::LightState (0x321):*/
on message LightState 
{
  gDebugCounter++;

  if(this.dir == RX)
  {
    if (!this.SIMULATED)    
    {      
      if(gDebugCounter == 10)
      {
        writeDbgLevel(1," LightState received from real system");
        gDebugCounter = 0;
      }    
    }
    else
    {
      if(gDebugCounter == 10)
      {
        writeDbgLevel(1," LightState received from simulated system");
        gDebugCounter = 0;
      }  
    }
  SetLightDsp(this.OnOff,this.TurnSignal);
  }
  else
  {
    if(gDebugCounter == 10)
    {
      writeDbgLevel(1," LightState received as TX"); 
      gDebugCounter = 0; 
    }
  }
}
/*@@end*/

/*@@startStart:Start:*/
on start
{
  setwriteDbgLevel(0); // set DbgLevel = 1 to get more information in Write-Window 
}
/*@@end*/

/*@@key:'0':*/
on key '0'
{
  setwriteDbgLevel(0);
}
/*@@end*/

/*@@key:'1':*/
on key '1'
{
  setwriteDbgLevel(1);
}
/*@@end*/

/*@@caplFunc:SetLightDsp(long,long):*///function
SetLightDsp (long light, long trunInd)
{
  if(light == kON) 
  {
    if(trunInd == kON)  @sysvar::Lights::LightDisplay = 7;
    else if(trunInd == kOFF)  @sysvar::Lights::LightDisplay = 4;  
  }
  else if(light == kOFF) 
  {
    if(trunInd == kON)  @sysvar::Lights::LightDisplay = 3;
    else if(trunInd == kOFF)  @sysvar::Lights::LightDisplay = 0; 
  }
}
/*@@end*/

/*@@sysvarChange:Engine::MotorSwitch:*/
on sysvar sysvar::Engine::MotorSwitch
{
  $MotorState::OnOff = @this;
  if(@this)
    $MotorState::EngineSpeed = @sysvar::Engine::EngineSpeedEntry;
  else
    $MotorState::EngineSpeed = 0;
}
/*@@end*/

/*@@sysvarChange:Engine::EngineSpeedEntry:*/
on sysvar sysvar::Engine::EngineSpeedEntry
{
  if(@sysvar::Engine::MotorSwitch) 
  {
    $MotorState::EngineSpeed = @this;
  }
}
/*@@end*/

