variables
{
  message InspectMessage gMsgInspect;
  message BreakPointMessage gMsgBreakPoint;
  message BreakPointMessage2 gMsgBreakPoint2;
 
  msTimer tSignalUpdateBreakPoint;
  
  byte gBreakPointMsgByte0 ; 
  byte gBreakPointMsgByte1 ; 
  byte gBreakPointMsgByte2 ; 
  byte gBreakPointMsgByte3 ; 
  byte gBreakPointMsgByte4 ; 
  byte gBreakPointMsgByte5 ; 
  byte gBreakPointMsgByte6 ; 
  byte gBreakPointMsgByte7 ; 

  byte gInspectMsgByte0 ; 
  byte gInspectMsgByte1 ; 
  byte gInspectMsgByte2 ; 
  byte gInspectMsgByte3 ; 
  byte gInspectMsgByte4 ; 
  byte gInspectMsgByte5 ; 
  byte gInspectMsgByte6 ; 
  byte gInspectMsgByte7 ; 
}	

on message InspectMessage
{
  gMsgInspect = this;
  
  gInspectMsgByte0 = gMsgInspect.SigInspect0;
  gInspectMsgByte1 = gMsgInspect.SigInspect1;
  gInspectMsgByte2 = gMsgInspect.SigInspect2;
  gInspectMsgByte3 = gMsgInspect.SigInspect3;
  gInspectMsgByte4 = gMsgInspect.SigInspect4;
  gInspectMsgByte5 = gMsgInspect.SigInspect5;
  gInspectMsgByte6 = gMsgInspect.SigInspect6;
  gInspectMsgByte7 = gMsgInspect.SigInspect7;

  // Inspect() function will update 
  // the variables in the debugger window
  if(@sysvar::Inspect::InspectOnOff)
  {
    inspect();
  }
}

on start
{
  @sysvar::Inspect::InspectOnOff = 0;
  @sysvar::BreakPoint::TimerBreakPoint = 0;
  @sysvar::BreakPoint::MessageBreakPointOnOff = 0;
  @sysvar::BreakPoint::SignalBreakPoint = 0;
  setTimer(tSignalUpdateBreakPoint,2000);
}

on message BreakPointMessage
{
  int CAPLError; 
  int SigPointValue; 

  SigPointValue = this.SigBPoint0; 

  if(@sysvar::BreakPoint::SetError)
  { 
    if(SigPointValue == 0 && @sysvar::BreakPoint::SignalBreakPoint) 
    {
      halt();
    }
    CAPLError = (1.0/this.SigBPoint0);  // Diff through 0
  }
}

on timer tSignalUpdateBreakPoint
{
  if(@sysvar::BreakPoint::TimerBreakPoint) 
  {
    @sysvar::BreakPoint::TimerBreakPoint = 0;
  }
  setTimer(this,2000);
}

on message BreakPointMessage2
{
  gMsgBreakPoint2 = this;
  
  // halt() function will halt the simulation, if the 
  // message comes into the on message handler 
  if(@sysvar::BreakPoint::MessageBreakPointOnOff) 
  {
    @sysvar::BreakPoint::MessageBreakPointOnOff = 0; 
    halt();
  }
  
  saveMessageBytes();
}

void saveMessageBytes()
{
  gBreakPointMsgByte0 = gMsgBreakPoint2.SigBPoint0;
  gBreakPointMsgByte1 = gMsgBreakPoint2.SigBPoint1;
  gBreakPointMsgByte2 = gMsgBreakPoint2.SigBPoint2;
  gBreakPointMsgByte3 = gMsgBreakPoint2.SigBPoint3;
  gBreakPointMsgByte4 = gMsgBreakPoint2.SigBPoint4;
  gBreakPointMsgByte5 = gMsgBreakPoint2.SigBPoint5;
  gBreakPointMsgByte6 = gMsgBreakPoint2.SigBPoint6;
  gBreakPointMsgByte7 = gMsgBreakPoint2.SigBPoint7;
}