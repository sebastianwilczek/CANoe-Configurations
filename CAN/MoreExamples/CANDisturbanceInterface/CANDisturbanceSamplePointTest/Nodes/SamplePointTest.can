/*@!Encoding:1252*/
includes
{
  #include "CANDisturbanceCaplLibs\CANdisturbance.cin"
}

variables
{
  //--------------------------------------------------------------------------------------------
  //VH6501 frame trigger and frame sequence 
  //--------------------------------------------------------------------------------------------
  canDisturbanceFrameTrigger  frmTrigger;
  canDisturbanceFrameSequence frmSequence;
  
  //--------------------------------------------------------------------------------------------
  //Message used for sample point test
  //--------------------------------------------------------------------------------------------
  message 0x0   spTestMsg;
  
  //--------------------------------------------------------------------------------------------
  //Trigger message to start sample point test
  //--------------------------------------------------------------------------------------------
  message 0x100 triggerMsg;
  
  //--------------------------------------------------------------------------------------------
  //Interface bit timing settings
  //--------------------------------------------------------------------------------------------
  CANSettings arbSettingsSpTest;
  CANSettings dbrSettingsSpTest;
  CANSettings defaultArbSettings;
  CANSettings defaultDbrSettings;
  
  //--------------------------------------------------------------------------------------------
  //Ticks for arbitration phase to calculate the sample point 
  //--------------------------------------------------------------------------------------------
  int         bitArbTicksAll;
  int         bitArbTicksRemained;  
  int         arbSPMeasurementDone;
  
  //--------------------------------------------------------------------------------------------
  //Ticks for data phase to calculate the sample point 
  //--------------------------------------------------------------------------------------------
  int         bitDataTicksAll;
  int         bitDataTicksRemained;  
  int         dbrSPMeasurementDone;
  
  //--------------------------------------------------------------------------------------------
  //Control to start sample point test
  //--------------------------------------------------------------------------------------------  
  int         correctFrameWasSeen; //0 - frame with id 0x0 was not seen; 1 - frame with id 0x0 was seen start
  int         startSPTest;         //0 - sample point test is not started; 1 - sample point test is started
  
  //--------------------------------------------------------------------------------------------
  //Controll values
  //--------------------------------------------------------------------------------------------  
  int channelIsForCANFDConfigured;

  //--------------------------------------------------------------------------------------------
  //Last used prescales
  //--------------------------------------------------------------------------------------------  
  int arbPrescaler;
  int dataPrescaler;
  
  msTimer timer1;
  //-----------------------------------
}

on timer timer1
{
  @sysvar::CanDisturbanceTest::SamplePoint::PrescalerData        = dataPrescaler;
  @sysvar::CanDisturbanceTest::SamplePoint::PrescalerArbitration = arbPrescaler;
}

on start
{
  canFdGetConfiguration(1, defaultArbSettings, defaultDbrSettings);
  channelIsForCANFDConfigured = (defaultArbSettings.flags & 0x100) > 0 ? 1 : 0; //Is CANFD configured  
  defaultArbSettings.flags = 0;
  defaultDbrSettings.flags = 0;
  arbSPMeasurementDone = 0;
  dbrSPMeasurementDone = 0;
  startSPTest = 0;
  
  if(channelIsForCANFDConfigured == 1)
  {
    @sysvar::CanDisturbanceTest::SamplePoint::QuarzFrequency = sysvar::CanDisturbanceTest::SamplePoint::QuarzFrequency::CAN_FD_80_MHz;
  }
  else
  {
    @sysvar::CanDisturbanceTest::SamplePoint::QuarzFrequency = sysvar::CanDisturbanceTest::SamplePoint::QuarzFrequency::CAN_16_MHz;
  }
  
}


void ConfigureTriggerForArbSPMeasurement()
{
  long result;
  int i;
  //Configure SOF Trigger
  frmTrigger.TriggerFieldType   = @sysvar::CanDisturbance::Enums::FieldType::EndOfFrame;
  frmTrigger.TriggerFieldOffset = 11;
  
  spTestMsg.FDF = channelIsForCANFDConfigured;
  spTestMsg.BRS = 0;
  
  //Cofigure sequence to send
  frmSequence.SetMessage(@sysvar::CANDisturbanceInterface1::DeviceNo, spTestMsg);  
  frmTrigger.SetMessage(triggerMsg, @sysvar::CANDisturbanceInterface1::DeviceNo, 0);
  if(channelIsForCANFDConfigured == 1)
  {
    bitArbTicksAll = frmSequence.CRC.BitSequence[6].segmentLength[0];    
  }
  else
  {
    bitArbTicksAll = frmSequence.CRCDelimiter.BitSequence[0].segmentLength[0];
  }
  
  
  result = canDisturbanceTriggerEnable(@sysvar::CANDisturbanceInterface1::DeviceNo, frmTrigger, frmSequence);  
}

void ConfigureTriggerForDbrSPMeasurement()
{
  long result;
  int i;
  //Configure SOF Trigger
  frmTrigger.TriggerFieldType   = @sysvar::CanDisturbance::Enums::FieldType::EndOfFrame;
  frmTrigger.TriggerFieldOffset = 11;
  
  spTestMsg.FDF = channelIsForCANFDConfigured;
  spTestMsg.BRS = 1;
  
  //Cofigure sequence to send
  frmSequence.SetMessage(@sysvar::CANDisturbanceInterface1::DeviceNo, spTestMsg);
  frmTrigger.SetMessage(triggerMsg, @sysvar::CANDisturbanceInterface1::DeviceNo, 0);
  
  bitDataTicksAll = frmSequence.CRC.BitSequence[3].segmentLength[0];
  
  result = canDisturbanceTriggerEnable(@sysvar::CANDisturbanceInterface1::DeviceNo, frmTrigger, frmSequence);  
}

on sysvar sysvar::CANDisturbanceInterface1::DeviceSettings
{
  if(@sysvar::CANDisturbanceInterface1::DeviceSettings == sysvar::CANDisturbanceInterface1::DeviceSettings::NotPending)
  {
    if(startSPTest == 0)
    {
      if(arbSPMeasurementDone == 0)
      {
        startSPTest = 1;
      }
      else if(dbrSPMeasurementDone == 0)
      {
        startSPTest = 1;
      }
    }
  }
}

on sysvar sysvar::CanDisturbanceTest::SamplePoint::StartSamplePointTest
{
  if(@this == 1)
  {
    struct SamplePointTestMeasurementData data;
    arbSPMeasurementDone = 0;
    dbrSPMeasurementDone = 0;
    startSPTest = 0;
    
    bitArbTicksAll = 0;
    bitArbTicksRemained = 0;
    
    bitDataTicksAll = 0;
    bitDataTicksRemained = 0;
    
    canFdSetConfiguration(1, defaultArbSettings, defaultDbrSettings);
    canFdGetConfiguration(1, arbSettingsSpTest, dbrSettingsSpTest);
    channelIsForCANFDConfigured = (arbSettingsSpTest.flags & 0x100) > 0 ? 1 : 0; //Is CANFD configured  
    arbSettingsSpTest.flags = 0;
    dbrSettingsSpTest.flags = 0;
    
    arbPrescaler = 1;
    dataPrescaler = 1;
    
    UpdateSysVars(eArbitrationPhase, data);
    UpdateSysVars(eDataPhase, data);
    
    ConfigureTriggerForArbSPMeasurement();
  }
}

//---------------------------------------------------------------------------------------------------------
//Message used to shorten the bits 
//---------------------------------------------------------------------------------------------------------
on message 0x0
{
 correctFrameWasSeen = 1;
}
//---------------------------------------------------------------------------------------------------------

on sysvar CANDisturbanceInterface1::Trigger::State
{
  long result;
  
  if(@this == sysvar::CANDisturbanceInterface1::Trigger::State::Idle)
  {
    if(startSPTest == 1 && correctFrameWasSeen == 1)
    {
      if(arbSPMeasurementDone == 0)
      {
        if(channelIsForCANFDConfigured == 1)
        {
          CommonCANDisturbanceLibrary_Shorten_Bit(frmSequence.CRC, 6, 1);
          CommonCANDisturbanceLibrary_Lengthen_Bit(frmSequence.CRC, 5, 1);
          CommonCANDisturbanceLibrary_Set_Bit_Value_To(frmSequence.CRC, 5, eRecessiveStressSegmentValue);
        }
        else
        {
          CommonCANDisturbanceLibrary_Shorten_Bit(frmSequence.CRCDelimiter, 0, 1);
          CommonCANDisturbanceLibrary_Set_Bit_Value_To(frmSequence.CRCDelimiter, 0, eRecessiveStressSegmentValue);
          CommonCANDisturbanceLibrary_Lengthen_Bit(frmSequence.AckSlot, 0, 1);
        }
        result = canDisturbanceTriggerEnable(@sysvar::CANDisturbanceInterface1::DeviceNo,frmTrigger, frmSequence);
      }
      else if(dbrSPMeasurementDone == 0)
      {
          CommonCANDisturbanceLibrary_Shorten_Bit(frmSequence.CRC, 3, 1);
          CommonCANDisturbanceLibrary_Lengthen_Bit(frmSequence.CRC, 2, 1);
          CommonCANDisturbanceLibrary_Set_Bit_Value_To(frmSequence.CRC, 2, eRecessiveStressSegmentValue);
          result = canDisturbanceTriggerEnable(@sysvar::CANDisturbanceInterface1::DeviceNo,frmTrigger, frmSequence);
      }
    }
  }
}

void UpdateSysVars(enum CANFramePhase phase, struct SamplePointTestMeasurementData mesData)
{
  if(phase == eArbitrationPhase)
  {
    @sysvar::CanDisturbanceTest::MeasurementDataPhasen.ArbitrationPhase.MeasuredSamplePoint = mesData.MeasuredSamplePoint;
    @sysvar::CanDisturbanceTest::MeasurementDataPhasen.ArbitrationPhase.CalculatedSP        = mesData.CalculatedSP   ;
    @sysvar::CanDisturbanceTest::MeasurementDataPhasen.ArbitrationPhase.SamplePointMin      = mesData.SamplePointMin ;
    @sysvar::CanDisturbanceTest::MeasurementDataPhasen.ArbitrationPhase.SamplePointMax      = mesData.SamplePointMax ;
    @sysvar::CanDisturbanceTest::MeasurementDataPhasen.ArbitrationPhase.TqError             = mesData.TqError        ;
    @sysvar::CanDisturbanceTest::MeasurementDataPhasen.ArbitrationPhase.TqSyncInPercent     = mesData.TqSyncInPercent;
    @sysvar::CanDisturbanceTest::MeasurementDataPhasen.ArbitrationPhase.TicksRemained       = mesData.TicksRemained  ;
    @sysvar::CanDisturbanceTest::MeasurementDataPhasen.ArbitrationPhase.TicksAll            = mesData.TicksAll       ;
    @sysvar::CanDisturbanceTest::MeasurementDataPhasen.ArbitrationPhase.Tseg1               = mesData.Tseg1          ;
    @sysvar::CanDisturbanceTest::MeasurementDataPhasen.ArbitrationPhase.Tseg2               = mesData.Tseg2          ;
    @sysvar::CanDisturbanceTest::MeasurementDataPhasen.ArbitrationPhase.TqAll               = mesData.TqAll          ;
  }
  else
  {
    @sysvar::CanDisturbanceTest::MeasurementDataPhasen.DataPhase.MeasuredSamplePoint = mesData.MeasuredSamplePoint;
    @sysvar::CanDisturbanceTest::MeasurementDataPhasen.DataPhase.CalculatedSP        = mesData.CalculatedSP   ;
    @sysvar::CanDisturbanceTest::MeasurementDataPhasen.DataPhase.SamplePointMin      = mesData.SamplePointMin ;
    @sysvar::CanDisturbanceTest::MeasurementDataPhasen.DataPhase.SamplePointMax      = mesData.SamplePointMax ;
    @sysvar::CanDisturbanceTest::MeasurementDataPhasen.DataPhase.TqError             = mesData.TqError        ;
    @sysvar::CanDisturbanceTest::MeasurementDataPhasen.DataPhase.TqSyncInPercent     = mesData.TqSyncInPercent;
    @sysvar::CanDisturbanceTest::MeasurementDataPhasen.DataPhase.TicksRemained       = mesData.TicksRemained  ;
    @sysvar::CanDisturbanceTest::MeasurementDataPhasen.DataPhase.TicksAll            = mesData.TicksAll       ;
    @sysvar::CanDisturbanceTest::MeasurementDataPhasen.DataPhase.Tseg1               = mesData.Tseg1          ;
    @sysvar::CanDisturbanceTest::MeasurementDataPhasen.DataPhase.Tseg2               = mesData.Tseg2          ;
    @sysvar::CanDisturbanceTest::MeasurementDataPhasen.DataPhase.TqAll               = mesData.TqAll          ;
  }
}

void ConfigureNewBitTimingsForArbitrationPhase(struct SamplePointTestMeasurementData data)
{
  //-------------------------------------------------------------------------------------------------------------------------------
  //Set new values to CAN Disturbance Interface 
  //-------------------------------------------------------------------------------------------------------------------------------
  if(arbSPMeasurementDone == 0)
  {
     arbSettingsSpTest.tseg1  = data.Tseg1;
     arbSettingsSpTest.tseg2  = data.Tseg2;
     arbSettingsSpTest.sjw    = data.Tseg2;    
     canFdSetConfiguration(1, arbSettingsSpTest, dbrSettingsSpTest);
     writeEx(-3, 1, "======= Arbitration Sample Point found: =======");
     writeEx(-3, 1, "Arb. SettingSP =%f TSEG1 = %d TSEG2 = %d",  (arbSettingsSpTest.tseg1 + 1) * 100.0 /  (arbSettingsSpTest.tseg1 + 1 +  arbSettingsSpTest.tseg2), arbSettingsSpTest.tseg1, arbSettingsSpTest.tseg2);
  }
  //-------------------------------------------------------------------------------------------------------------------------------
}

on can1.errorFrame
{
  struct SamplePointTestMeasurementData mesDataArb;
  struct SamplePointTestMeasurementData mesDataData;
  word ecc;

  if(startSPTest == 1)
  {
    startSPTest = 0;
    
    
    if(arbSPMeasurementDone == 0)
    {
      if(channelIsForCANFDConfigured)
      {
        bitArbTicksRemained = frmSequence.CRC.BitSequence[6].segmentLength[0];
      }
      else
      {
       bitArbTicksRemained = frmSequence.CRCDelimiter.BitSequence[0].segmentLength[0];
      }
    }
    else if(dbrSPMeasurementDone == 0)
    {
      bitDataTicksRemained = frmSequence.CRC.BitSequence[3].segmentLength[0];      
    }
  
    if(arbSPMeasurementDone == 0)
    {
      CommonCANDisturbanceLibrary_Calculate_SamplePoint_For(arbSettingsSpTest.baudrate, 
                         @sysvar::CanDisturbanceTest::SamplePoint::PrescalerArbitration, 
                         @sysvar::CanDisturbanceTest::SamplePoint::QuarzFrequency,
                         mesDataArb,
                         bitArbTicksRemained+1,
                         bitArbTicksAll);
      
      UpdateSysVars(eArbitrationPhase, mesDataArb);
      
      ConfigureNewBitTimingsForArbitrationPhase(mesDataArb);
      
      arbSPMeasurementDone = 1;
      startSPTest = 0; 
      correctFrameWasSeen = 0;
      if(channelIsForCANFDConfigured == 1)
      {
        ConfigureTriggerForDbrSPMeasurement();
      }
    }
    else if(dbrSPMeasurementDone == 0)
    {
      startSPTest = 0; 
      
      //Sample point could be not correct reduce sample point 
      ecc = (this.ErrorCode >> 6) & 0x3f;

      //If we get an CRC error, we are wrong with the sample point, and mesuread the sample point from the Vector CAN Interface
      //Reduce the sample point to the next possible value.

      if(ecc != 1 || correctFrameWasSeen == 0)
      {
        dbrSPMeasurementDone = 0;
        dbrSettingsSpTest.tseg1    = dbrSettingsSpTest.tseg1  - 1.0;
        dbrSettingsSpTest.tseg2    = dbrSettingsSpTest.tseg2  + 1.0;
        dbrSettingsSpTest.sjw      = dbrSettingsSpTest.tseg2;
        writeEx(-3, 1, "Try to find data phase sample point with following settings:");
        writeEx(-3, 1, "Arb. SettingSP =%f TSEG1 = %d TSEG2 = %d",  (arbSettingsSpTest.tseg1 + 1) * 100.0 /  (arbSettingsSpTest.tseg1 + 1 +  arbSettingsSpTest.tseg2), arbSettingsSpTest.tseg1, arbSettingsSpTest.tseg2);
        writeEx(-3, 1, "Try to send Frame with SP =%f TSEG1 = %d TSEG2 = %d", (dbrSettingsSpTest.tseg1 + 1) * 100.0 /  (dbrSettingsSpTest.tseg1 + 1 +  dbrSettingsSpTest.tseg2), dbrSettingsSpTest.tseg1, dbrSettingsSpTest.tseg2);
        
        canFdSetConfiguration(1, arbSettingsSpTest, dbrSettingsSpTest);
        canFdGetConfiguration(1, arbSettingsSpTest,dbrSettingsSpTest);
        arbSettingsSpTest.flags = 0;
        dbrSettingsSpTest.flags = 0;
        ConfigureTriggerForDbrSPMeasurement();
      }
      else
      {
        
        CommonCANDisturbanceLibrary_Calculate_SamplePoint_For(dbrSettingsSpTest.baudrate, 
                           @sysvar::CanDisturbanceTest::SamplePoint::PrescalerData, 
                           @sysvar::CanDisturbanceTest::SamplePoint::QuarzFrequency,
                           mesDataData,
                           bitDataTicksRemained+1,
                           bitDataTicksAll);
        writeEx(-3, 1, "======= Data Sample Point found: =======");
        writeEx(-3, 1, "Data. Setting SP =%f TSEG1 = %d TSEG2 = %d",  (dbrSettingsSpTest.tseg1 + 1) * 100.0 /  (dbrSettingsSpTest.tseg1 + 1 +  dbrSettingsSpTest.tseg2), dbrSettingsSpTest.tseg1, dbrSettingsSpTest.tseg2);
        
        
        UpdateSysVars(eDataPhase, mesDataData);
        
        dbrSPMeasurementDone = 1;
      }
    }
  }
}

int UpdateArbSettings()
{
  int result;
  if(arbSPMeasurementDone == 1)    
  {
    struct SamplePointTestMeasurementData data;
    result = CommonCANDisturbanceLibrary_Calculate_SamplePoint_For(arbSettingsSpTest.baudrate, 
                                                                   @sysvar::CanDisturbanceTest::SamplePoint::PrescalerArbitration, 
                                                                   @sysvar::CanDisturbanceTest::SamplePoint::QuarzFrequency, 
                                                                   data, 
                                                                   bitArbTicksRemained + 1,
                                                                   bitArbTicksAll);
    if(result == 1)
    {
      UpdateSysVars(eArbitrationPhase, data);
    }
  }
  return result;
}

int UpdateDataSettings()
{
  int result;
  if(dbrSPMeasurementDone == 1)    
  {
    struct SamplePointTestMeasurementData data;
    result = CommonCANDisturbanceLibrary_Calculate_SamplePoint_For(dbrSettingsSpTest.baudrate, 
                                                                   @sysvar::CanDisturbanceTest::SamplePoint::PrescalerData, 
                                                                   @sysvar::CanDisturbanceTest::SamplePoint::QuarzFrequency, 
                                                                   data,
                                                                   bitDataTicksRemained + 1, 
                                                                   bitDataTicksAll);
    if(result == 1)
    {
      UpdateSysVars(eDataPhase, data);
    }
  }
  return result;
}

on sysvar sysvar::CanDisturbanceTest::SamplePoint::PrescalerArbitration
{
  int result;
  result = UpdateArbSettings();
  if(result < 0)
  {
    setTimer(timer1, 100);
  }
  else
  {
    arbPrescaler = @this;
  }
}

on sysvar sysvar::CanDisturbanceTest::SamplePoint::PrescalerData
{
  int result;
  
  result = UpdateDataSettings();
  
  if(result < 0)
  {
    setTimer(timer1, 100);    
  }
  else
  {
    dataPrescaler = @this;
  }
}

on sysvar sysvar::CanDisturbanceTest::SamplePoint::QuarzFrequency
{
  UpdateArbSettings();
  
  if(channelIsForCANFDConfigured == 1)
  {
    UpdateDataSettings();
  }
}
