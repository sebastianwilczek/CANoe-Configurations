/*@!Encoding:1252*/
includes
{
  
}

variables
{
  long deviceID;
}

on preStart
{
  deviceID = @sysvar::CANDisturbanceInterface1::DeviceNo;
}


//////////////////////////////////////////////////////////////////////////////////
//Trigger now with sequence
//////////////////////////////////////////////////////////////////////////////////


/// <TriggerNowSeq>
on sysvar sysvar::CanDisturbanceConfigurationSysVars::TriggerNowSeq1
{
  if(@sysvar::CanDisturbanceConfigurationSysVars::TriggerNowSeq1 == 1)
  {
    CanDisturbanceSequence  sequence;
    long                    result;
    
    //Clear sequence 
    sequence.Clear();
    
    //configure a sequence one bit long and send a dominant bit
    result = sequence.AppendToSequence(320, 'd');
    
    if(result == 1)
    {
      result= canDisturbanceTriggerNow(deviceID, sequence);
      
      if(result == 1)
      {
        write("Trigger now is configured."); 
      }
      else
      {
        write("Error by configuration of trigger now %d", result);
      }
    }
  }
}

/// <TriggerNowSeq>
on sysvar sysvar::CanDisturbanceConfigurationSysVars::TriggerNowSeq2
{
  if(@sysvar::CanDisturbanceConfigurationSysVars::TriggerNowSeq2 == 1)
  {
    CanDisturbanceSequence            sequence;
    CanDisturbanceTriggerRepetitions  repetitions;
    long                              result;
    
    //Clear sequence 
    sequence.Clear();
    
    //configure a sequence one bit long and send a dominant bit
    result = sequence.AppendToSequence(320, 'd');
    
    if(result == 1)
    {
      //Define two repetitions and one cycle with a 1 ms hold off time 
      repetitions.Cycles = 1;
      repetitions.HoldOffCycles = 1;
      repetitions.HoldOffRepetitions = 1;
      repetitions.Repetitions = 2;

      
      result= canDisturbanceTriggerNow(deviceID, sequence, repetitions);
      
      if(result == 1)
      {
        write("Trigger now is configured."); 
      }
      else
      {
        write("Error by configuration of trigger now %d", result);
      }
    }
  }
}

//////////////////////////////////////////////////////////////////////////////////

/// <TriggerNowFrame>

on sysvar sysvar::CanDisturbanceConfigurationSysVars::TriggerNowFrame1
{
  if(@sysvar::CanDisturbanceConfigurationSysVars::TriggerNowFrame1 == 1)
  {
    canDisturbanceFrameSequence frameSequence;
    message 0x100               msgFrameSeq;
    long                        result;

    //set message to sequence
    frameSequence.SetMessage(deviceID, msgFrameSeq); 
    result = canDisturbanceTriggerNow(deviceID, frameSequence); //output the sequence once
    if(result == 1)
    {
      write("Trigger now is configured."); 
    }
    else
    {
      write("Error by configuration of trigger now %d", result);
    }
  }
}

/// <TriggerNowFrame>
on sysvar sysvar::CanDisturbanceConfigurationSysVars::TriggerNowFrame2
{
  if(@sysvar::CanDisturbanceConfigurationSysVars::TriggerNowFrame2 == 1)
  {
    canDisturbanceFrameSequence       frameSequence;
    canDisturbanceTriggerRepetitions  repetitions;
    message 0x100                     msgFrameSeq;
    long                              result;
    
    
    //set message to sequence
    frameSequence.SetMessage(deviceID, msgFrameSeq); 
    
    //Define two repetitions and one cycle with a 1 ms hold off time 
    repetitions.Cycles = 1;
    repetitions.HoldOffCycles = 1;
    repetitions.HoldOffRepetitions = 1;
    repetitions.Repetitions = 2;
    
    //output the sequence twice
    result = canDisturbanceTriggerNow(deviceID, frameSequence, repetitions); 
    
    if(result == 1)
    {
      write("Trigger now is configured."); 
    }
    else
    {
      write("Error by configuration of trigger now %d", result);
    }

  }
}
