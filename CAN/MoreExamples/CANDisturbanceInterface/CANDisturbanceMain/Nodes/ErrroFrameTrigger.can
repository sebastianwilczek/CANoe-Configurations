/*@!Encoding:1252*/
includes
{
}

variables
{
  long deviceID;
}

on preStart
{
   deviceID = @sysvar::CANDisturbanceInterface1::DeviceNo;
}

on sysvar sysvar::CanDisturbanceConfigurationSysVars::SendErrorFrame
{
  if(@sysvar::CanDisturbanceConfigurationSysVars::SendErrorFrame == 1)
  {
    output(errorframe);
  }
}

//////////////////////////////////////////////////////////////////////////////////
//Error frame trigger with sequence
//////////////////////////////////////////////////////////////////////////////////

/// <ErrFrameTriggerSequence>
on sysvar sysvar::CanDisturbanceConfigurationSysVars::EnableErrorFrameTriggerSeq1
{
  if(@sysvar::CanDisturbanceConfigurationSysVars::EnableErrorFrameTriggerSeq1 == 1)
  {
    CanDisturbanceErrorFrameTrigger errFrameTrigger;
    CanDisturbanceSequence          sequence;
    long                            result;

    //Clear sequence 
    sequence.Clear();

    //configure a sequence one bit long and send a dominant bit 
    result = sequence.AppendToSequence(320, 'd');
    
    if(result == 1)
    {
      if(@sysvar::CanDisturbanceConfigurationSysVars::ErrorFrameTriggerPhase == 0)
      {
        errFrameTrigger.ErrorFramePhase = @sysvar::CanDisturbance::Enums::ErrorFramePhase::ErrorFlag;
        errFrameTrigger.Offset = @sysvar::CanDisturbanceConfigurationSysVars::ErrFrameTriggerOffset;
        if(errFrameTrigger.Offset < 6)
        {
          errFrameTrigger.Offset = 6;
          @sysvar::CanDisturbanceConfigurationSysVars::ErrFrameTriggerOffset = 6;
        }
      }
      else
      {
        errFrameTrigger.ErrorFramePhase = @sysvar::CanDisturbance::Enums::ErrorFramePhase::ErrorDelimiter;
        errFrameTrigger.Offset = @sysvar::CanDisturbanceConfigurationSysVars::ErrFrameTriggerOffset;
      }
      
      errFrameTrigger.Offset = @sysvar::CanDisturbanceConfigurationSysVars::ErrFrameTriggerOffset;
      
      result = canDisturbanceTriggerEnable(deviceID, errFrameTrigger, sequence);
    
      if(result == 1)
      {
        write("Error frame trigger configured."); 
      }
      else
      {
        write("Error by configuration of error frame trigger %d", result);
      }
    }
  }
}

/// <ErrFrameTriggerSequence>
on sysvar sysvar::CanDisturbanceConfigurationSysVars::EnableErrorFrameTriggerSeq2
{
  if(@sysvar::CanDisturbanceConfigurationSysVars::EnableErrorFrameTriggerSeq2 == 1)
  {
    CanDisturbanceErrorFrameTrigger  errFrameTrigger;
    CanDisturbanceSequence           sequence;
    CanDisturbanceTriggerRepetitions repetitions;
    long                             result;

    //Clear sequence 
    sequence.Clear();

    //configure a sequence one bit long and send a dominant bit 
    result = sequence.AppendToSequence(320, 'd');
    
    if(result == 1)
    {
      if(@sysvar::CanDisturbanceConfigurationSysVars::ErrorFrameTriggerPhase == 0)
      {
        errFrameTrigger.ErrorFramePhase = @sysvar::CanDisturbance::Enums::ErrorFramePhase::ErrorFlag;
        errFrameTrigger.Offset = @sysvar::CanDisturbanceConfigurationSysVars::ErrFrameTriggerOffset;
        if(errFrameTrigger.Offset < 6)
        {
          errFrameTrigger.Offset = 6;
          @sysvar::CanDisturbanceConfigurationSysVars::ErrFrameTriggerOffset = 6;
        }
      }
      else
      {
        errFrameTrigger.ErrorFramePhase = @sysvar::CanDisturbance::Enums::ErrorFramePhase::ErrorDelimiter;
        errFrameTrigger.Offset = @sysvar::CanDisturbanceConfigurationSysVars::ErrFrameTriggerOffset;
      }
      
      //Define two repetitions and one cycle with a 1 ms hold off time 
      repetitions.Cycles = 1;
      repetitions.HoldOffCycles = 1;
      repetitions.HoldOffRepetitions = 1;
      repetitions.Repetitions = 2;
      
      result = canDisturbanceTriggerEnable(deviceID, errFrameTrigger, sequence, repetitions);
    
      if(result == 1)
      {
        write("Error frame trigger configured."); 
      }
      else
      {
        write("Error by configuration of error frame trigger %d", result);
      }
    }
  }
}

/// <ErrFrameTriggerSequence>
on sysvar sysvar::CanDisturbanceConfigurationSysVars::EnableErrorFrameTriggerSeq3
{
  if(@sysvar::CanDisturbanceConfigurationSysVars::EnableErrorFrameTriggerSeq3 == 1)
  {
    CanDisturbanceErrorFrameTrigger  errFrameTrigger;
    CanDisturbanceSequence           sequence;
    CanDisturbanceTriggerRepetitions repetitions;
    long                             result;

    //Clear sequence 
    sequence.Clear();

    //configure a sequence one bit long and send a dominant bit 
    result = sequence.AppendToSequence(320, 'd');
    
    if(result == 1)
    {
      if(@sysvar::CanDisturbanceConfigurationSysVars::ErrorFrameTriggerPhase == 0)
      {
        errFrameTrigger.ErrorFramePhase = @sysvar::CanDisturbance::Enums::ErrorFramePhase::ErrorFlag;
        errFrameTrigger.Offset = @sysvar::CanDisturbanceConfigurationSysVars::ErrFrameTriggerOffset;
        if(errFrameTrigger.Offset < 6)
        {
          errFrameTrigger.Offset = 6;
          @sysvar::CanDisturbanceConfigurationSysVars::ErrFrameTriggerOffset = 6;
        }
      }
      else
      {
        errFrameTrigger.ErrorFramePhase = @sysvar::CanDisturbance::Enums::ErrorFramePhase::ErrorDelimiter;
        errFrameTrigger.Offset = @sysvar::CanDisturbanceConfigurationSysVars::ErrFrameTriggerOffset;
      }
      
      //Define two repetitions and one cycle with a 1 ms hold off time 
      repetitions.Cycles = 1;
      repetitions.HoldOffCycles = 1;
      repetitions.HoldOffRepetitions = 1;
      repetitions.Repetitions = 2;
    
      result = canDisturbanceTriggerEnable(deviceID, errFrameTrigger, sequence, repetitions, @sysvar::CanDisturbanceConfigurationSysVars::TriggerEnable);
    
      if(result == 1)
      {
        write("Error frame trigger configured."); 
      }
      else
      {
        write("Error by configuration of error frame trigger %d", result);
      }
    }
  }
}

//////////////////////////////////////////////////////////////////////////////////

//////////////////////////////////////////////////////////////////////////////////
//Error frame trigger with frame sequence
//////////////////////////////////////////////////////////////////////////////////

/// <ErrFrameTriggerFrameSequence>
on sysvar sysvar::CanDisturbanceConfigurationSysVars::EnableErrorFrameTriggerFrame1
{
  if(@sysvar::CanDisturbanceConfigurationSysVars::EnableErrorFrameTriggerFrame1 == 1)
  {
    CanDisturbanceErrorFrameTrigger errFrameTrigger;
    CanDisturbanceFrameSequence     frameSequence;
    message 0x100                   msgFrameSeq;
    long                            result;

    //create the frame sequence based on a message 
    frameSequence.SetMessage(deviceID, msgFrameSeq);
    
    if(@sysvar::CanDisturbanceConfigurationSysVars::ErrorFrameTriggerPhase == 0)
    {
      errFrameTrigger.ErrorFramePhase = @sysvar::CanDisturbance::Enums::ErrorFramePhase::ErrorFlag;
      errFrameTrigger.Offset = @sysvar::CanDisturbanceConfigurationSysVars::ErrFrameTriggerOffset;
      if(errFrameTrigger.Offset < 6)
      {
        errFrameTrigger.Offset = 6;
        @sysvar::CanDisturbanceConfigurationSysVars::ErrFrameTriggerOffset = 6;
      }
    }
    else
    {
      errFrameTrigger.ErrorFramePhase = @sysvar::CanDisturbance::Enums::ErrorFramePhase::ErrorDelimiter;
      errFrameTrigger.Offset = @sysvar::CanDisturbanceConfigurationSysVars::ErrFrameTriggerOffset;
    }

    result = canDisturbanceTriggerEnable(deviceID, errFrameTrigger, frameSequence);
    
    if(result == 1)
    {
      write("Error frame trigger configured."); 
    }
    else
    {
      write("Error by configuration of error frame trigger %d", result);
    }
  }
}

/// <ErrFrameTriggerFrameSequence>
on sysvar sysvar::CanDisturbanceConfigurationSysVars::EnableErrorFrameTriggerFrame2
{
  if(@sysvar::CanDisturbanceConfigurationSysVars::EnableErrorFrameTriggerFrame2 == 1)
  {
    CanDisturbanceErrorFrameTrigger  errFrameTrigger;
    CanDisturbanceFrameSequence      frameSequence;
    CanDisturbanceTriggerRepetitions repetitions;
    message 0x100                    msgFrameSeq;
    long                             result;
    
    //create the frame sequence based on a message 
    frameSequence.SetMessage(deviceID, msgFrameSeq);
    
    if(@sysvar::CanDisturbanceConfigurationSysVars::ErrorFrameTriggerPhase == 0)
    {
      errFrameTrigger.ErrorFramePhase = @sysvar::CanDisturbance::Enums::ErrorFramePhase::ErrorFlag;
      errFrameTrigger.Offset = @sysvar::CanDisturbanceConfigurationSysVars::ErrFrameTriggerOffset;
      if(errFrameTrigger.Offset < 6)
      {
        errFrameTrigger.Offset = 6;
        @sysvar::CanDisturbanceConfigurationSysVars::ErrFrameTriggerOffset = 6;
      }
    }
    else
    {
      errFrameTrigger.ErrorFramePhase = @sysvar::CanDisturbance::Enums::ErrorFramePhase::ErrorDelimiter;
      errFrameTrigger.Offset = @sysvar::CanDisturbanceConfigurationSysVars::ErrFrameTriggerOffset;
    }
    
    
    //Define two repetitions and one cycle with a 1 ms hold off time 
    repetitions.Cycles = 1;
    repetitions.HoldOffCycles = 1;
    repetitions.HoldOffRepetitions = 1;
    repetitions.Repetitions = 2;
    
    result = canDisturbanceTriggerEnable(deviceID, errFrameTrigger, frameSequence, repetitions);
    
    if(result == 1)
    {
      write("Error frame trigger configured."); 
    }
    else
    {
      write("Error by configuration of error frame trigger %d", result);
    }
  }
}

/// <ErrFrameTriggerFrameSequence>
on sysvar sysvar::CanDisturbanceConfigurationSysVars::EnableErrorFrameTriggerFrame3
{
  if(@sysvar::CanDisturbanceConfigurationSysVars::EnableErrorFrameTriggerFrame3 == 1)
  {
    CanDisturbanceErrorFrameTrigger  errFrameTrigger;
    CanDisturbanceFrameSequence      frameSequence;
    CanDisturbanceTriggerRepetitions repetitions;
    message 0x100                    msgFrameSeq;
    long                             result;
    
    //create the frame sequence based on a message 
    frameSequence.SetMessage(deviceID, msgFrameSeq);
    
    if(@sysvar::CanDisturbanceConfigurationSysVars::ErrorFrameTriggerPhase == 0)
    {
      errFrameTrigger.ErrorFramePhase = @sysvar::CanDisturbance::Enums::ErrorFramePhase::ErrorFlag;
      errFrameTrigger.Offset = @sysvar::CanDisturbanceConfigurationSysVars::ErrFrameTriggerOffset;
      if(errFrameTrigger.Offset < 6)
      {
        errFrameTrigger.Offset = 6;
        @sysvar::CanDisturbanceConfigurationSysVars::ErrFrameTriggerOffset = 6;
      }
    }
    else
    {
      errFrameTrigger.ErrorFramePhase = @sysvar::CanDisturbance::Enums::ErrorFramePhase::ErrorDelimiter;
      errFrameTrigger.Offset = @sysvar::CanDisturbanceConfigurationSysVars::ErrFrameTriggerOffset;
    }
    
    
    //Define two repetitions and one cycle with a 1 ms hold off time 
    repetitions.Cycles = 1;
    repetitions.HoldOffCycles = 1;
    repetitions.HoldOffRepetitions = 1;
    repetitions.Repetitions = 2;
    
    result = canDisturbanceTriggerEnable(deviceID, errFrameTrigger, frameSequence, repetitions, @sysvar::CanDisturbanceConfigurationSysVars::TriggerEnable);
    
    if(result == 1)
    {
      write("Error frame trigger configured."); 
    }
    else
    {
      write("Error by configuration of error frame trigger %d", result);
    }
    
    
  }
}


