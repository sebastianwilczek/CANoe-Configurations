/*@!Encoding:1252*/
includes
{
  
}

variables
{
  long deviceID;
}

on preStart
{
   deviceID = @sysvar::CANDisturbanceInterface1::DeviceNo;
}


//////////////////////////////////////////////////////////////////////////////////
//External trigger with sequence
//////////////////////////////////////////////////////////////////////////////////

/// <ExtTriggerSequence>
on sysvar sysvar::CanDisturbanceConfigurationSysVars::EnableExternalTriggerSeq1
{
  if(@sysvar::CanDisturbanceConfigurationSysVars::EnableExternalTriggerSeq1 == 1)
  {
    CanDisturbanceExternalTrigger  extTrigger;
    CanDisturbanceSequence         sequence;
    long                           result;
    
    //Clear sequence 
    sequence.Clear();
    
    //configure a sequence one bit long and send a dominant bit 
    result = sequence.AppendToSequence(320, 'd');
    
    if(result == 1)
    {
      if(@sysvar::CanDisturbanceConfigurationSysVars::ExtDINChannel == 0)
      {
        extTrigger.DIOChannel = sysvar::CanDisturbance::Enums::DIOChannel::DIN0; 
      }
      else
      {
        extTrigger.DIOChannel = sysvar::CanDisturbance::Enums::DIOChannel::DIN1; 
      }
      
      if(@sysvar::CanDisturbanceConfigurationSysVars::ActiveHighLow == sysvar::CanDisturbanceConfigurationSysVars::ActiveHighLow::ActiveLow)
      {
        extTrigger.TriggerType = sysvar::CanDisturbance::Enums::DIOLevel::ActiveLow;
      }
      else if(@sysvar::CanDisturbanceConfigurationSysVars::ActiveHighLow == sysvar::CanDisturbanceConfigurationSysVars::ActiveHighLow::ActiveHigh)
      {
        extTrigger.TriggerType = sysvar::CanDisturbance::Enums::DIOLevel::ActiveHigh;
      }
    
      result = canDisturbanceTriggerEnable(deviceID,extTrigger, sequence);
    
      if(result == 1)
      {
         write("External trigger configured."); 
      }
      else
      {
        write("Error by configuration of external trigger %d", result);
      }
    }
  }
}

/// <ExtTriggerSequence>
on sysvar sysvar::CanDisturbanceConfigurationSysVars::EnableExternalTriggerSeq2
{
  if(@sysvar::CanDisturbanceConfigurationSysVars::EnableExternalTriggerSeq2 == 1)
  {
    CanDisturbanceExternalTrigger    extTrigger;
    CanDisturbanceSequence           sequence;
    CanDisturbanceTriggerRepetitions repetitions;
    long                             result;
    
    //Clear sequence 
    sequence.Clear();
    
    //configure a sequence one bit long and send a dominant bit 
    result = sequence.AppendToSequence(320, 'd');
    
    if(result == 1)
    {
      //Define two repetitions and one cycle with a 1 ms hold off time 
      repetitions.Cycles = 1;
      repetitions.HoldOffCycles = 1;
      repetitions.HoldOffRepetitions = 1;
      repetitions.Repetitions = 2;
      
      if(@sysvar::CanDisturbanceConfigurationSysVars::ExtDINChannel == 0)
      {
        extTrigger.DIOChannel = sysvar::CanDisturbance::Enums::DIOChannel::DIN0; 
      }
      else
      {
        extTrigger.DIOChannel = sysvar::CanDisturbance::Enums::DIOChannel::DIN1; 
      }
      
      if(@sysvar::CanDisturbanceConfigurationSysVars::ActiveHighLow == sysvar::CanDisturbanceConfigurationSysVars::ActiveHighLow::ActiveLow)
      {
        extTrigger.TriggerType = sysvar::CanDisturbance::Enums::DIOLevel::ActiveLow;
      }
      else if(@sysvar::CanDisturbanceConfigurationSysVars::ActiveHighLow == sysvar::CanDisturbanceConfigurationSysVars::ActiveHighLow::ActiveHigh)
      {
        extTrigger.TriggerType = sysvar::CanDisturbance::Enums::DIOLevel::ActiveHigh;
      }
            
      result = canDisturbanceTriggerEnable(deviceID,extTrigger, sequence, repetitions);
    
      if(result == 1)
      {
         write("External trigger configured."); 
      }
      else
      {
        write("Error by configuration of external trigger %d", result);
      }
    }
  }
}

/// <ExtTriggerFrameSeq>
//////////////////////////////////////////////////////////////////////////////////


//////////////////////////////////////////////////////////////////////////////////
//External trigger with frame sequence
//////////////////////////////////////////////////////////////////////////////////

on sysvar sysvar::CanDisturbanceConfigurationSysVars::EnableExternalTriggerFrame1
{
  if(@sysvar::CanDisturbanceConfigurationSysVars::EnableExternalTriggerFrame1 == 1)
  {
    CanDisturbanceExternalTrigger    extTrigger;
    CanDisturbanceFrameSequence      frameSequence;
    message  0x100                   msgFrameSeq;
    long                             result;

    frameSequence.SetMessage(deviceID, msgFrameSeq);

    if(@sysvar::CanDisturbanceConfigurationSysVars::ExtDINChannel == 0)
    {
      extTrigger.DIOChannel = sysvar::CanDisturbance::Enums::DIOChannel::DIN0; 
    }
    else
    {
      extTrigger.DIOChannel = sysvar::CanDisturbance::Enums::DIOChannel::DIN1; 
    }
    
    if(@sysvar::CanDisturbanceConfigurationSysVars::ActiveHighLow == sysvar::CanDisturbanceConfigurationSysVars::ActiveHighLow::ActiveLow)
    {
      extTrigger.TriggerType = sysvar::CanDisturbance::Enums::DIOLevel::ActiveLow;
    }
    else if(@sysvar::CanDisturbanceConfigurationSysVars::ActiveHighLow == sysvar::CanDisturbanceConfigurationSysVars::ActiveHighLow::ActiveHigh)
    {
      extTrigger.TriggerType = sysvar::CanDisturbance::Enums::DIOLevel::ActiveHigh;
    }
    
    result = canDisturbanceTriggerEnable(deviceID, extTrigger, frameSequence);

    if(result == 1)
    {
      write("External trigger configured."); 
    }
    else
    {
      write("Error by configuration of external trigger %d", result);
    }

  }
    
  
  
}

/// <ExtTriggerFrameSeq>
on sysvar sysvar::CanDisturbanceConfigurationSysVars::EnableExternalTriggerFrame2
{
  if(@sysvar::CanDisturbanceConfigurationSysVars::EnableExternalTriggerFrame2 == 1)
  {  
    CanDisturbanceExternalTrigger    extTrigger;
    CanDisturbanceFrameSequence      frameSequence;
    CanDisturbanceTriggerRepetitions repetitions;
    message  0x100                   msgFrameSeq;
    long                             result;

    frameSequence.SetMessage(deviceID, msgFrameSeq);

    if(@sysvar::CanDisturbanceConfigurationSysVars::ExtDINChannel == 0)
    {
      extTrigger.DIOChannel = sysvar::CanDisturbance::Enums::DIOChannel::DIN0; 
    }
    else
    {
      extTrigger.DIOChannel = sysvar::CanDisturbance::Enums::DIOChannel::DIN1; 
    }
    
    if(@sysvar::CanDisturbanceConfigurationSysVars::ActiveHighLow == sysvar::CanDisturbanceConfigurationSysVars::ActiveHighLow::ActiveLow)
    {
      extTrigger.TriggerType = sysvar::CanDisturbance::Enums::DIOLevel::ActiveLow;
    }
    else if(@sysvar::CanDisturbanceConfigurationSysVars::ActiveHighLow == sysvar::CanDisturbanceConfigurationSysVars::ActiveHighLow::ActiveHigh)
    {
      extTrigger.TriggerType = sysvar::CanDisturbance::Enums::DIOLevel::ActiveHigh;
    }
    
    repetitions.Cycles = 1;
    repetitions.HoldOffCycles = 1;
    repetitions.HoldOffRepetitions = 100;
    repetitions.Repetitions = 10;
    
    result = canDisturbanceTriggerEnable(deviceID, extTrigger, frameSequence, repetitions);

    if(result == 1)
    {
      write("External trigger configured."); 
    }
    else
    {
      write("Error by configuration of external trigger %d", result);
    }
  }
}

//////////////////////////////////////////////////////////////////////////////////