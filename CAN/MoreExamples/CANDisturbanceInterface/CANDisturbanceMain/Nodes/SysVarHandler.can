/*@!Encoding:1252*/
on sysvar sysvar::CANDisturbanceInterface1::Trigger::State
{
  char buffer[1024];
  char triggerSource[1024];
  
  sysGetVariableDescriptionForValue(sysvar::CANDisturbanceInterface1::Trigger::State, @sysvar::CANDisturbanceInterface1::Trigger::State, buffer, elCount(buffer));
  sysGetVariableDescriptionForValue(sysvar::CanDisturbance::Enums::TriggerSource, @sysvar::CANDisturbanceInterface1::Trigger::Source, triggerSource, elCount(triggerSource));
  write("==========  Trigger State changed  ==========");
  write("State changed to %s (%d)", buffer, @sysvar::CANDisturbanceInterface1::Trigger::State);
  write("CycleCount = %d Repetitions = %d", @sysvar::CANDisturbanceInterface1::Trigger::Cycle, @sysvar::CANDisturbanceInterface1::Trigger::Count);
  write("TriggerSource = %s (%d)", triggerSource, @sysvar::CANDisturbanceInterface1::Trigger::Source );
  write("=============================================");
}

on sysvar sysvar::CanBusControl::ResetCan
{
  if(@sysvar::CanBusControl::ResetCan == 1)
  {
    resetCan();
  }
  
}