/*@!Encoding:1252*/
includes
{

}

variables
{
  long deviceID;
}

on preStart
{
   deviceID = @sysvar::CANDisturbanceInterface1::DeviceNo;
}

//////////////////////////////////////////////////////////////////////////////////
//Combined frame trigger with sequence
//////////////////////////////////////////////////////////////////////////////////
/// <CombFrameTriggerWitSequence>
on sysvar sysvar::CanDisturbanceConfigurationSysVars::EnableCombFrameTriggerSeq1
{
  if(@sysvar::CanDisturbanceConfigurationSysVars::EnableCombFrameTriggerSeq1 == 1)
  {
    CanDisturbanceCombinedFrameTrigger combFrameTrigger;
    CanDisturbanceFrameTrigger         frameTrigger[2];
    CanDisturbanceSequence             sequence;
    message  0x100                     msgFrameTrigger1;
    message  0x200                     msgFrameTrigger2;
    long                               result;
    long                               validityMask;
    
    //Clear sequence 
    sequence.Clear();
    
    //Clear all configured frame trigger
    combFrameTrigger.Clear();
    
    //ID must standard ID and a CAN message must on the bus
    validityMask = @sysvar::CanDisturbance::Enums::ValidityMaskFlags::IDBase 
                   | @sysvar::CanDisturbance::Enums::ValidityMaskFlags::IDE 
                   | @sysvar::CanDisturbance::Enums::ValidityMaskFlags::FDF ; 
    
    
    //configure first frame trigger 
    frameTrigger[0].SetMessage(msgFrameTrigger1, deviceID, validityMask);
    result = combFrameTrigger.AddFrameTrigger(frameTrigger[0]);       
    
    if(result == 1)
    {
      //configure second frame trigger 
      frameTrigger[1].SetMessage(msgFrameTrigger2, deviceID, validityMask);
      result = combFrameTrigger.AddFrameTrigger(frameTrigger[1]);       
      
      if(result == 1)
      {
        //configure trigger position for all frame trigger
        combFrameTrigger.TriggerFieldType  =              
          @sysvar::CanDisturbance::Enums::FieldType::DataByte1;
        combFrameTrigger.TriggerFieldOffset = 2;
        
        //configure a sequence 320 FPGA ticks long and send a recessive bit
        result = sequence.AppendToSequence(320, 'R');
        
        if(result == 1)
        {
          //configure trigger
          result = canDisturbanceTriggerEnable(deviceID, combFrameTrigger, sequence);
          
          if(result == 1)
          {
            write("%d combined frame trigger configured", 
                      combFrameTrigger.CountOfFrameTrigger);
          }
          else
          {
            write("Error by configuration of combined frame trigger %d", result);
          }
        }
        else
        {
          write("Error by appending sequence value %d", result);
        }
      }
      else
      {
        write("Error by add the second frame trigger %d", result);
      }
    }
    else
    {
      write("Error by add the first frame trigger %d", result);
    }
  }
}

/// <CombFrameTriggerWitSequence>
on sysvar sysvar::CanDisturbanceConfigurationSysVars::EnableCombFrameTriggerSeq2
{
  if(@sysvar::CanDisturbanceConfigurationSysVars::EnableCombFrameTriggerSeq2 == 1)
  {
    CanDisturbanceCombinedFrameTrigger combFrameTrigger;
    CanDisturbanceFrameTrigger         frameTrigger[2];
    CanDisturbanceSequence             sequence;
    CanDisturbanceTriggerRepetitions   repetitions;
    message   0x100x                   msgFrameTrigger1;
    message   0x200x                   msgFrameTrigger2;
    long                               result;
    long                               validityMask;
    
    //Clear sequence 
    sequence.Clear();
    
    //Clear all configured frame trigger
    combFrameTrigger.Clear();
    
    //Set Trigger messages 0x200 to CAN FD message
    msgFrameTrigger2.FDF = 1;
    
    //ID must extend ID and a CAN FD message must on the bus
    validityMask = @sysvar::CanDisturbance::Enums::ValidityMaskFlags::IDBase
                   | @sysvar::CanDisturbance::Enums::ValidityMaskFlags::IDExtended
                   | @sysvar::CanDisturbance::Enums::ValidityMaskFlags::IDE 
                   | @sysvar::CanDisturbance::Enums::ValidityMaskFlags::FDF; 
      
    //configure first frame trigger 
    frameTrigger[0].SetMessage(msgFrameTrigger1, deviceID, validityMask);
    result = combFrameTrigger.AddFrameTrigger(frameTrigger[0]);       
    
    if(result == 1)
    {
      //configure second frame trigger 
      frameTrigger[1].SetMessage(msgFrameTrigger2, deviceID, validityMask);
      result = combFrameTrigger.AddFrameTrigger(frameTrigger[1]);       
      
      if(result == 1)
      {
        //configure trigger position for all frame trigger
        combFrameTrigger.TriggerFieldType  =                     
           @sysvar::CanDisturbance::Enums::FieldType::DataByte1;
        combFrameTrigger.TriggerFieldOffset = 2;
        
        
        //Define two repetitions and one cycle with a 1 ms hold off time 
        repetitions.Cycles = 1;
        repetitions.HoldOffCycles = 1;
        repetitions.HoldOffRepetitions = 1;
        repetitions.Repetitions = 2;
        
        //configure a sequence 320 FPGA ticks long and send a recessive bit
        result = sequence.AppendToSequence(320, 'R');
        
        if(result == 1)
        {
          //configure trigger
          result = canDisturbanceTriggerEnable(deviceID, combFrameTrigger, sequence, 
                                               repetitions);
          if(result == 1)
          {
            write("%d combined frame trigger configured", 
                      combFrameTrigger.CountOfFrameTrigger);
          }
          else
          {
            write("Error by configuration of combined frame trigger %d", result);
          }
        }
        else
        {
          write("Error by appending sequence value %d", result);
        }
      }
      else
      {
        write("Error by add the second frame trigger %d", result);
      }
    }
    else
    {
      write("Error by add the first frame trigger %d", result);
    }
  }
}

/// <CombFrameTriggerWitSequence>
on sysvar sysvar::CanDisturbanceConfigurationSysVars::EnableCombFrameTriggerSeq3
{
  if(@sysvar::CanDisturbanceConfigurationSysVars::EnableCombFrameTriggerSeq3 == 1)
  {
    CanDisturbanceCombinedFrameTrigger combFrameTrigger;
    CanDisturbanceFrameTrigger         frameTrigger[2];
    CanDisturbanceSequence             sequence;
    CanDisturbanceTriggerRepetitions   repetitions;
    message   0x100x                   msgFrameTrigger1;
    message   0x200x                   msgFrameTrigger2;
    long                               result;
    long                               validityMask;
    
    //Clear sequence 
    sequence.Clear();
    
    //Clear all configured frame trigger
    combFrameTrigger.Clear();
    
    //Set Trigger messages 0x200 to CAN FD message
    msgFrameTrigger2.FDF = 1;
    
    //ID must extend ID and a CAN FD message must on the bus
    validityMask = @sysvar::CanDisturbance::Enums::ValidityMaskFlags::IDBase
                   | @sysvar::CanDisturbance::Enums::ValidityMaskFlags::IDExtended
                   | @sysvar::CanDisturbance::Enums::ValidityMaskFlags::IDE 
                   | @sysvar::CanDisturbance::Enums::ValidityMaskFlags::FDF; 
      
    //configure first frame trigger 
    frameTrigger[0].SetMessage(msgFrameTrigger1, deviceID, validityMask);
    result = combFrameTrigger.AddFrameTrigger(frameTrigger[0]);       
    
    if(result == 1)
    {
      //configure second frame trigger 
      frameTrigger[1].SetMessage(msgFrameTrigger2, deviceID, validityMask);
      result = combFrameTrigger.AddFrameTrigger(frameTrigger[1]);       
      
      if(result == 1)
      {
        //configure trigger position for all frame trigger
        combFrameTrigger.TriggerFieldType  =                     
           @sysvar::CanDisturbance::Enums::FieldType::DataByte1;
        combFrameTrigger.TriggerFieldOffset = 2;
        
        
        //Define two repetitions and one cycle with a 1 ms hold off time 
        repetitions.Cycles = 1;
        repetitions.HoldOffCycles = 1;
        repetitions.HoldOffRepetitions = 1;
        repetitions.Repetitions = 2;
        
        //configure a sequence 320 FPGA ticks long and send a recessive bit
        result = sequence.AppendToSequence(320, 'R');
        
        if(result == 1)
        {
          //configure trigger
          result = canDisturbanceTriggerEnable(deviceID, combFrameTrigger, sequence, 
                                               repetitions, @sysvar::CanDisturbanceConfigurationSysVars::TriggerEnable);
          if(result == 1)
          {
            write("%d combined frame trigger configured", 
                      combFrameTrigger.CountOfFrameTrigger);
          }
          else
          {
            write("Error by configuration of combined frame trigger %d", result);
          }
        }
        else
        {
            write("Error by appending sequence value %d", result);
        }
      }
      else
      {
          write("Error by add the second frame trigger %d", result);
      }
    }
    else
    {
        write("Error by add the first frame trigger %d", result);
    }
  }
}


//////////////////////////////////////////////////////////////////////////////////

//////////////////////////////////////////////////////////////////////////////////
//Combined frame trigger with frame sequence
//////////////////////////////////////////////////////////////////////////////////
/// <CombFrameTriggerFrameSequence>
on sysvar sysvar::CanDisturbanceConfigurationSysVars::EnableComFrameTriggerFrameSeq1
{
  if(@sysvar::CanDisturbanceConfigurationSysVars::EnableComFrameTriggerFrameSeq1 == 1)
  {
    CanDisturbanceCombinedFrameTrigger combFrameTrigger;
    CanDisturbanceFrameTrigger         frameTrigger[2];
    CanDisturbanceFrameSequence        frameSequence;
    long                               validityMask;
    message  0x100                     msgFrameTrigger1;
    message  0x200                     msgFrameTrigger2;
    message  0x300                     msgForFrameSeq;
    long                               result;
    
    //Clear all configured frame trigger
    combFrameTrigger.Clear();
     
    //ID must standard ID and a CAN message must on the bus
    validityMask = @sysvar::CanDisturbance::Enums::ValidityMaskFlags::IDBase 
                   | @sysvar::CanDisturbance::Enums::ValidityMaskFlags::IDE 
                   | @sysvar::CanDisturbance::Enums::ValidityMaskFlags::FDF;
    
    //configure first frame trigger 
    frameTrigger[0].SetMessage(msgFrameTrigger1, deviceID, validityMask);
    result = combFrameTrigger.AddFrameTrigger(frameTrigger[0]);       
    
    if(result == 1)
    {
      //configure second frame trigger 
      frameTrigger[1].SetMessage(msgFrameTrigger2, deviceID, validityMask);
      result = combFrameTrigger.AddFrameTrigger(frameTrigger[1]);       
      
      if(result == 1)
      {
        //configure trigger position for 2nd IFS bit for all frame trigger
        combFrameTrigger.TriggerFieldType  =              
                @sysvar::CanDisturbance::Enums::FieldType::EndOfFrame;
        combFrameTrigger.TriggerFieldOffset = 9;
        
        //configure a sequence one bit long and send a dominant bit 
        frameSequence.SetMessage(deviceID, msgForFrameSeq);
        
        
        //configure trigger
        result = canDisturbanceTriggerEnable(deviceID, combFrameTrigger, frameSequence);
        
        if(result == 1)
        {
          write("%d combined frame trigger configured", 
                           combFrameTrigger.CountOfFrameTrigger);
        }
        else
        {
          write("Error by configuration of combined frame trigger %d", result);
        }
      }
      else
      {
        write("Error by add second frame trigger %d", result);
      }
    }
    else
    {
      write("Error by add first frame trigger %d", result);
    }
    
  }
}

/// <CombFrameTriggerFrameSequence>
on sysvar sysvar::CanDisturbanceConfigurationSysVars::EnableComFrameTriggerFrameSeq2
{
  if(@sysvar::CanDisturbanceConfigurationSysVars::EnableComFrameTriggerFrameSeq2 == 1)
  {
    CanDisturbanceCombinedFrameTrigger combFrameTrigger;
    CanDisturbanceFrameTrigger         frameTrigger[2];
    CanDisturbanceFrameSequence        frameSequence;
    CanDisturbanceTriggerRepetitions   repetitions;
    long                               validityMask;
    message  0x100x                    msgFrameTrigger1;
    message  0x200x                    msgFrameTrigger2;
    message  0x300x                    msgForFrameSeq;
    long                               result;
    
    //Clear all configured frame trigger
    combFrameTrigger.clear();
    
    //Set Trigger messages 0x200 to CAN FD message
    msgFrameTrigger2.FDF = 1;
    
    //ID must extended ID and a CAN message must on the bus
    validityMask = @sysvar::CanDisturbance::Enums::ValidityMaskFlags::IDBase 
                   | @sysvar::CanDisturbance::Enums::ValidityMaskFlags::IDExtended
                   | @sysvar::CanDisturbance::Enums::ValidityMaskFlags::IDE 
                   | @sysvar::CanDisturbance::Enums::ValidityMaskFlags::FDF;
    
  
    //configure first frame trigger 
    frameTrigger[0].SetMessage(msgFrameTrigger1, deviceID, validityMask);
    result = combFrameTrigger.AddFrameTrigger(frameTrigger[0]);       
    
    if(result == 1)
    {
      //configure second frame trigger 
      frameTrigger[1].SetMessage(msgFrameTrigger2, deviceID, validityMask);
      result = combFrameTrigger.AddFrameTrigger(frameTrigger[1]);       
      
      if(result == 1)
      {
         //configure trigger position for 2nd IFS bit for all frame trigger
        combFrameTrigger.TriggerFieldType  =              
              @sysvar::CanDisturbance::Enums::FieldType::EndOfFrame;
        combFrameTrigger.TriggerFieldOffset = 9;
        
        //Define two repetitions and one cycle with a 1 ms hold off time 
        repetitions.Cycles = 1;
        repetitions.HoldOffCycles = 1;
        repetitions.HoldOffRepetitions = 1;
        repetitions.Repetitions = 2;
        
        frameSequence.SetMessage(deviceID, msgForFrameSeq);
        
        //configure trigger
        result = canDisturbanceTriggerEnable(deviceID,combFrameTrigger, frameSequence, 
                                             repetitions);
        
        if(result == 1)
        {
          write("%d combined frame trigger configured", 
                    combFrameTrigger.CountOfFrameTrigger);
        }
        else
        {
          write("Error by configuration of combined frame trigger %d", result);
        }
      }
      else
      {
        write("Error by add first frame trigger %d", result);
      }      
    }
    else
    {
      write("Error by add first frame trigger %d", result);
    }
  }
}

/// <CombFrameTriggerFrameSequence>
on sysvar sysvar::CanDisturbanceConfigurationSysVars::EnableComFrameTriggerFrameSeq3
{
  if(@sysvar::CanDisturbanceConfigurationSysVars::EnableComFrameTriggerFrameSeq3 == 1)
  {
    CanDisturbanceCombinedFrameTrigger combFrameTrigger;
    CanDisturbanceFrameTrigger         frameTrigger[2];
    CanDisturbanceFrameSequence        frameSequence;
    CanDisturbanceTriggerRepetitions   repetitions;
    long                               validityMask;
    message  0x100x                    msgFrameTrigger1;
    message  0x200x                    msgFrameTrigger2;
    message  0x300x                    msgForFrameSeq;
    long                               result;
    
    //Clear all configured frame trigger
    combFrameTrigger.clear();
    
    //Set Trigger messages 0x200 to CAN FD message
    msgFrameTrigger2.FDF = 1;
    
    //ID must extended ID and a CAN message must on the bus
    validityMask = @sysvar::CanDisturbance::Enums::ValidityMaskFlags::IDBase 
                   | @sysvar::CanDisturbance::Enums::ValidityMaskFlags::IDExtended
                   | @sysvar::CanDisturbance::Enums::ValidityMaskFlags::IDE 
                   | @sysvar::CanDisturbance::Enums::ValidityMaskFlags::FDF;
    
  
    //configure first frame trigger 
    frameTrigger[0].SetMessage(msgFrameTrigger1, deviceID, validityMask);
    result = combFrameTrigger.AddFrameTrigger(frameTrigger[0]);       
    
    if(result == 1)
    {
      //configure second frame trigger 
      frameTrigger[1].SetMessage(msgFrameTrigger2, deviceID, validityMask);
      result = combFrameTrigger.AddFrameTrigger(frameTrigger[1]);       
      
      if(result == 1)
      {
         //configure trigger position for 2nd IFS bit for all frame trigger
        combFrameTrigger.TriggerFieldType  =              
              @sysvar::CanDisturbance::Enums::FieldType::EndOfFrame;
        combFrameTrigger.TriggerFieldOffset = 9;
        
        //Define two repetitions and one cycle with a 1 ms hold off time 
        repetitions.Cycles = 1;
        repetitions.HoldOffCycles = 1;
        repetitions.HoldOffRepetitions = 1;
        repetitions.Repetitions = 2;
        
        frameSequence.SetMessage(deviceID, msgForFrameSeq);
        
        //configure trigger
        result = canDisturbanceTriggerEnable(deviceID,combFrameTrigger, frameSequence, 
                                             repetitions, @sysvar::CanDisturbanceConfigurationSysVars::TriggerEnable);
        
        if(result == 1)
        {
          write("%d combined frame trigger configured", 
                    combFrameTrigger.CountOfFrameTrigger);
        }
        else
        {
          write("Error by configuration of combined frame trigger %d", result);
        }
      }
      else
      {
        write("Error by add first frame trigger %d", result);
      }      
    }
    else
    {
      write("Error by add first frame trigger %d", result);
    }
    
  }
}

//////////////////////////////////////////////////////////////////////////////////