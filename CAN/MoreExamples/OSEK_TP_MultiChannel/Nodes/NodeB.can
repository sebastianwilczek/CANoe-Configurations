/*@@includes:*/
includes
{
  #include "GenericNode.cin"
}
/*@@end*/

/*@@var:*/
variables
{
}
/*@@end*/


