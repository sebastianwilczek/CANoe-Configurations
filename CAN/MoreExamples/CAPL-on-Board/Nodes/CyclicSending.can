variables
{
  timer t1;
}

on start
{
  setTimer(t1, 0, @sysvar::kCycleTime*1000);
}

on timer t1
{
  long counter  =  0;
  message CAN%CHANNEL%.CyclicMessage msg;
  
  counter++;
  msg.SendCount = counter;
  
  output(msg);
  setTimer(t1, 0, @sysvar::kCycleTime*1000);
}

