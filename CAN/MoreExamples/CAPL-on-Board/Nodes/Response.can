/*@@var:*/
variables
{
}
/*@@end*/

/*@@msg:CAN4.CycleAndResponse::CyclicMessage (0x100):*/
on message CAN%CHANNEL%.CyclicMessage
{
  message CAN%CHANNEL%.ResponseMessage msg;

  if (this.DIR == RX) 
  {
    msg.ResponseCount = this.SendCount;
    output(msg);
  }
}
/*@@end*/

