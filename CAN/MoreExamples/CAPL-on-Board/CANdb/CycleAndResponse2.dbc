VERSION "HIPBNYYYYYYYYYYYYYYYYYYYYYYYYYYYNNNNNNNNNN/4/%%%/4/'%**4NNN///"

NS_ :

BS_:

BU_: Response CyclicSending

BO_ 256 CyclicMessage: 4 CyclicSending
 SG_ SendCount : 0|32@1+ (1,0) [0|4294967295] ""  Response

BO_ 258 ResponseMessage: 4 Response
 SG_ ResponseCount : 0|32@1+ (1,0) [0|4294967295] "" Vector__XXX
