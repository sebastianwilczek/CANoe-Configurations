VERSION "HIPBNYYYYYYYYYYYYYYYYYYYYYYYYYYYNNNNNNNNNN/4/%%%/4/'%**4NNN///"

NS_ :

BS_:

BU_: Response CyclicSending

BO_ 256 CyclicMessage: 4 CyclicSending
 SG_ SendCount : 0|32@1+ (1,0) [0|4294967295] ""  Response

BO_ 258 ResponseMessage: 4 Response
 SG_ ResponseCount : 0|32@1+ (1,0) [0|4294967295] "" Vector__XXX

EV_ CAN2: 0 [0|0] "" 2 1 DUMMY_NODE_VECTOR0 Vector__XXX;

EV_ CAN1: 0 [0|0] "" 1 2 DUMMY_NODE_VECTOR0 Vector__XXX;
