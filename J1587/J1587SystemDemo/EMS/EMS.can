/*@@var:*/
/*
 * EMS - Engine Managment System                   Version 1.1
 *
 * Copyright 2005, Vector Informatik GmbH - All right reserved
 *
 * History:
 * 1.0 (Jr) Created 
 * 1.1 (Pr) Added diagnostics & send txt messages capabilities
 */
variables
{
  // Constants
  const int  kNullAddr    = 0xfe;   // Null address
  const int  kGlobalAddr  = 0xff;   // Global address
  const int  kSuccess     = 0;      // Nodelayer function returns 0 on success

  const int  kInitialized = 0;      // 
  const int  kOnline      = 1;      // 
  const int  kOffline     = 2;      // 

  const int  kCtrlModePedal  = 0;   // Engine is controller by Accelerator Pedal
  const int  kCtrlModeSpeed  = 1;   // Engine is controlled by speed from another ECU
  const int  kCtrlModeTorque = 2;   // Eninge is controlled by torque from another ECU
  
  const int  kMaxDiagCodes = 100;   // Max. no. of DC's

  // Display states
  const BYTE  kDisplayed       = 0;
  const BYTE  kTimeout         = 1;
  const BYTE  kWaitForResponse = 2;

  char gNodeName[32] = "EMS";  // Name of the node, is used for output to write window
  char gMake[6]      = "VECTR";

  // Simulation constants
  const float kMaxSpeed  = 2400.0; // Max. engine speed [rpm]
  const float kIdleSpeed =  600.0; // Idle speed [rpm]
  const float kMaxTorque = 1650.0; // Max. engine torque [Nm]

  // Communication variables
  BYTE  gECU_MID  = kNullAddr;    // Address of this ECU
  BYTE  gECUState = kInitialized; // Communication state of the ECU

  // Display text messages variables
  BYTE 	gEDDPresent     = 0;
  BYTE  gDisplayColumns = 0;
  BYTE	gDisplayRows    = 0;
  BYTE	gDisplayState   = kWaitForResponse;

  // Diagnostics variables
  DWORD gtimeActiveInact[kMaxDiagCodes]; // Time to last Active->Inactive Transition of a specific DC
  DWORD gtimeInactActive[kMaxDiagCodes]; // Time to last Inactive->Active Transition of a specific DC
  DWORD gtimeLastDiag15s[kMaxDiagCodes]; // Time to last show-up of a DC corresponding to an on-request PID

  BYTE  gDiagCodesCount = 0;             // Number of DC's in the table
  BYTE  gDCTimerActive  = 0;  

  // DC table storage
  BYTE gDiagnosticCodeSIDPID[kMaxDiagCodes];  
  BYTE gOccurrenceCountIncluded[kMaxDiagCodes];
  BYTE gCurrentStatusOfFault[kMaxDiagCodes];
  BYTE gTypeOfDiagnosticCode[kMaxDiagCodes];
  BYTE gLowCharacterIDForAStdDiagCode[kMaxDiagCodes];
  BYTE gFailureModeIdentifierFMI[kMaxDiagCodes];
  BYTE gOccurrenceCount[kMaxDiagCodes];
  BYTE gDLC[kMaxDiagCodes];
  BYTE gCycleTime[kMaxDiagCodes]; // Cycle time of the corresponding PID

  J1587Param EngineSpeed                      TX_EngineSpeed;  // TX Buffer: Engine Speed
  J1587Param EngineCoolantTemperature         TX_EngineTemp;   // TX Buffer: Engine Coolant Temperature
  J1587Param OutputTorque                     TX_OutputTorque; // TX Buffer: Engine Output Torque
  J1587Param PercentAcceleratorPedalPosition  TX_PedalPos;     // TX Buffer: Accelerator Pedal Position
  
  J1587Param RequestP2                        TX_RequestP2;
  J1587Param TextMessageToDisplay             TX_Display;

  J1587Param TrmitterSysDiagCodeOccCntTable   TX_DiagCodeTable;
  J1587Param TrmitterSysDiagCodeOccCntTable   TX_ActiveDiagCodeTable;
  J1587Param TrmitterSysDiagCodeOccCntTable   TX_SingleDiagCodeTable;
  J1587Param DiagnosticDataCountClearResponse TX_DiagCodeResponse;

  msTimer EngineSpeedTimer;
  msTimer EngineTempTimer;
  msTimer OutputTorqueTimer;
  msTimer PedalPosTimer;
  msTimer DisplayTimer;
  msTimer DCTimer;

  // Simulation variables
  float gPedalPosition     = 0.0; // Accelerator pedal position in [%]
  float gActualSpeed       = 0.0; // Actual engine speed in [rpm]
  float gActualTorque      = 0.0; // Actual engine torque [Nm]
  float gActualTorqueMode  = 1;
  float gActualCoolangTemp = 0.0; // Coolang Temperature in [°C]
  BYTE  gCalcSpeed         = 1;   // 1 = calc speed, 0 = speed is set by transmission
  BYTE  gABSActive         = 0;

  int   gControlMode = kCtrlModePedal;
  float gSpeedLimit  = kIdleSpeed;     // Speed limit in mode kCtrlModeSpeed
  float gTorqueLimit = 0;              // Torque limit in mode kCtrlModeTorque

  const int   kSystemTime     = 100;                     // System time in [ms]
  const float kSystemTimeSec  = kSystemTime / 1000.0;    // System time in [sec]
  const float kDisplayTimeSec = 1.;                      // Display time of a msg in [sec]
  const float kTimeoutTimeSec = 10.;                     // Display msg acknowledge timeout [s]
  const float kTimeoutTime    = kTimeoutTimeSec * 1000.; // Display msg acknowledge timeout [ms]

  msTimer SystemTimer; // System timer

  // Definition of debugging constants
  const int kDbgInfo    = 10;
  const int kDbgWarning = 5;
  const int kDbgError   = 1;
  const int kDbgQuiet   = 0;

  // General global variables
  int gDbgLevel = kDbgWarning; // Set debug level for output to write window
}
/*@@end*/

/*@@startStart:Start:*/
on start
{
  if (getValue( EvEMS_Enable ) == 1) {
    EMSInit();
    EMSStartUp();
  }
}
/*@@end*/

/*@@timer:SystemTimer:*/
/*
 * This system timer calulates the simualted values.
 *
 * Note: This is not a physically correct calcluation of an
 *       Engine. It just calculates some realistic looking values.
 */
on timer SystemTimer
{
  float targetSpeed;

  //
  // calculate speed and torque
  //
  switch(gControlMode) {
    //
    // Pedal controlled
    //
    case kCtrlModePedal:
      gPedalPosition = getValue( EvEMS_Accelerator );
      targetSpeed    = kIdleSpeed + (kMaxSpeed - kIdleSpeed) * (gPedalPosition / 100.0);

      if (getValue(EvEMS_SimulationMode) == EvEMS_SimulationMode::SpeedIsInput) {
        gActualSpeed = getValue( EvEMS_EngineSpeed );
      }
      else {
        gActualSpeed = utilRange( calcSpeedFromTargetSpeed( targetSpeed, gActualSpeed ), kIdleSpeed, kMaxSpeed );
      }

      // calculate new torque values
      gActualTorque = utilRange( calcTorque( targetSpeed, gActualSpeed, gPedalPosition ), 0, kMaxTorque );

      break;
    //
    // Speed controlled
    //
    case kCtrlModeSpeed:
      if (gActualSpeed > gSpeedLimit) {
        gActualSpeed  = utilRange( calcSpeedFromTargetSpeed( kIdleSpeed, gActualSpeed ), kIdleSpeed, kMaxSpeed );
        gActualTorque = utilRange( calcTorque( targetSpeed, gActualSpeed, gPedalPosition ), 0, kMaxTorque );
      }
      else {
        gActualSpeed  = utilRange( calcSpeedFromTargetSpeed( kMaxSpeed, gActualSpeed ), kIdleSpeed, kMaxSpeed );
        gActualTorque = 0;
      }
      break;
    //
    // Torque controlled
    //
    case kCtrlModeTorque:
      if (gActualTorque > gTorqueLimit) {
        gActualSpeed  = utilRange( calcSpeedFromTargetSpeed( kIdleSpeed, gActualSpeed ), kIdleSpeed, kMaxSpeed );
        gActualTorque = utilRange( calcTorque( kIdleSpeed, gActualSpeed, 0.0 ), 0, kMaxTorque );
      }
      else {
        gActualSpeed  = utilRange( calcSpeedFromTargetSpeed( kMaxSpeed, gActualSpeed ), kIdleSpeed, kMaxSpeed );
        gActualTorque = utilRange( calcTorque( kMaxSpeed, gActualSpeed, 100.0 ), 0, kMaxTorque );
      }
      break;
  }

  // calculate ECU Temperature
  gActualCoolangTemp = utilRange( gActualCoolangTemp + (gActualSpeed - kIdleSpeed * 3 / 2) * 0.0001, 20, 120 );

  // update envVars
  putValue( EvEMS_Torque, gActualTorque );
  if (getValue(EvEMS_SimulationMode) == EvEMS_SimulationMode::SpeedIsOutput) {
    putValue( EvEMS_EngineSpeed, gActualSpeed );
  }
  putValue( EvEMS_EngineCoolantTemp, gActualCoolangTemp );

  // update TX signals
  TX_EngineSpeed.EngineSpeed.phys                  = gActualSpeed;
  TX_EngineTemp.EngineCoolantTemperature.phys      = gActualCoolangTemp;
  TX_OutputTorque.OutputTorque.phys                = gActualTorque / kMaxTorque * 100.0;
  TX_PedalPos.PercentAcceleratorPedalPosition.phys = gPedalPosition;

  if (gDisplayState != kWaitForResponse && gECUState == kOnline) {
    SendDisplayMsg();
  }

  setTimer( SystemTimer, kSystemTime );
}
/*@@end*/

/*@@caplFunc:calcTorque(float,float,float):*///function
/*
 * Calculate the torque at a given speed.
 *
 * Note: This is not a physically correct calcluation of an
 *       Engine. It just calculates some realistic looking values.
 */
float calcTorque( float targetSpeed, float speed, float accel )
{
  float torque;
  float diff;
  float torquePercent[7] = { 0.3, 0.95, 0.90, 0.80, 0.6, 0.4, 0.01 };
  int   i;
   
  if ((speed > 0) && (speed < kMaxSpeed)) {
    i = ((speed - kIdleSpeed) / (kMaxSpeed - kIdleSpeed)) * elCount(torquePercent);

    if (i < 0) {
      i = 0;
    }

    if (i < elCount(torquePercent)) {
      torque = kMaxTorque * torquePercent[i] * accel / 100.0;
    }
    else {
      torque = kMaxTorque * torquePercent[elCount(torquePercent)-1] * accel / 100.0;
    }

    if (targetSpeed >= speed) {
      diff = targetSpeed - speed;
     // if (diff < 300) {
     //   torque *= 0.01 * utilRange( diff, 0.0, 300.0 );
     // }
    }
    else {
      torque = 0;
    }
  }
  else {
    torque = kMaxTorque * torquePercent[elCount(torquePercent)-1] * accel / 100.0;
  }

  return torque;
}
/*@@end*/

/*@@caplFunc:EMSInit():*///function
/*
 * Initialize the EMS
 */
void EMSInit()
{
  gECU_MID = EMS.NmStationAddress;

  TX_EngineSpeed.J1587_MID = kNullAddr;
  TX_EngineSpeed.EngineSpeed.phys = 0;

  TX_EngineTemp.J1587_MID                     = kNullAddr;
  TX_EngineTemp.EngineCoolantTemperature.phys = gActualCoolangTemp;

  TX_OutputTorque.J1587_MID         = kNullAddr;
  TX_OutputTorque.OutputTorque.phys = gActualTorque / kMaxTorque * 100.0;

  TX_PedalPos.J1587_MID                            = kNullAddr;
  TX_PedalPos.PercentAcceleratorPedalPosition.phys = gPedalPosition;

  TX_Display.J1587_MID				          = kNullAddr;
  TX_Display.J1587_ReceiverMID				  = 0x7F;
  TX_Display.AbortMessage                     = 0;
  TX_Display.LanguageSelection                = 0;
  TX_Display.PredefinedMessage                = 0;
  TX_Display.MessageDisplayTime               = kDisplayTimeSec;
  TX_Display.MessagePriority                  = 7;
  TX_Display.SendAcknowldgUponDisplayOfMsg    = 1;
  TX_Display.SendOperatorAckOfReceiptOfMsg    = 0;
  TX_Display.SendReceivedAckForEachNetworkMsg = 0;
  TX_Display.SoundBeeperOnDisplay             = 0;

  TX_DiagCodeTable.J1587_MID       = kNullAddr;
  TX_ActiveDiagCodeTable.J1587_MID = kNullAddr;
  TX_SingleDiagCodeTable.J1587_MID = kNullAddr;
  TX_DiagCodeResponse.J1587_MID    = kNullAddr;
}
/*@@end*/

/*@@caplFunc:EMSShutDown():*///function
/*
 * Shut down EMS
 *
 * Send cannot claim address and stop sending messages
 */
void EMSShutDown()
{
  cancelTimer( SystemTimer );

  EMSChangeState( kOffline );
  putValue( EvEMS_Enable, 0 );
}
/*@@end*/

/*@@caplFunc:EMSStartUp():*///function
/*
 * Start up EMS
 *
 * Begin address claiming. After successfully claiming
 * an address, start sending cyclic messages.
 */
void EMSStartUp()
{
  putValue( EvEMS_Enable, 1 );

  setTimer( SystemTimer, kSystemTime );

  EMSChangeState( kOnline );
}
/*@@end*/

/*@@caplFunc:utilMax(float,float):*///function
/*
 * Clip the value to the range of min and max
 */
float utilMax( float a, float b)
{
  if (a > b) {
    return a;
  }
  else {
    return b;
  }
}
/*@@end*/

/*@@caplFunc:utilMin(float,float):*///function
/*
 * Clip the value to the range of min and max
 */
float utilMin( float a, float b)
{
  if (a > b) {
    return b;
  }
  else {
    return a;
  }
}
/*@@end*/

/*@@caplFunc:utilRange(float,float,float):*///function
/*
 * Clip the value to the range of min and max
 */
float utilRange( float value, float min, float max )
{
  if (value < min) return min;
  if (value > max) return max;

  return value;
}
/*@@end*/

/*@@caplFunc:EMSChangeState(byte):*///function
/*
 * Change the state of the ECU
 */
void EMSChangeState( BYTE newState )
{
  if (newState == kInitialized) {
    // stop everthing immediately
    cancelTimer( EngineSpeedTimer );
    cancelTimer( EngineTempTimer );
    cancelTimer( OutputTorqueTimer );
    cancelTimer( PedalPosTimer  );

    gECUState = kInitialized;
    return;
  }

  switch( gECUState ) {
    case kInitialized:
    case kOffline:
      if (newState == kOnline) {
        EnterOnline();
        gECUState = newState;
      }
      break;
    case kOnline:
      if (newState == kOffline) {
        EnterOffline();
        gECUState = newState;
      }
      break;
  }
}
/*@@end*/

/*@@caplFunc:EnterOnline():*///function
/*
 * Enter online state
 */
void EnterOnline()
{
  // set source addresses of TX messages
  TX_EngineSpeed.J1587_MID         = gECU_MID;
  TX_EngineTemp.J1587_MID          = gECU_MID;
  TX_OutputTorque.J1587_MID        = gECU_MID;
  TX_PedalPos.J1587_MID            = gECU_MID;
  TX_Display.J1587_MID             = gECU_MID;
  TX_DiagCodeTable.J1587_MID       = gECU_MID;
  TX_ActiveDiagCodeTable.J1587_MID = gECU_MID;
  TX_SingleDiagCodeTable.J1587_MID = gECU_MID;
  TX_DiagCodeResponse.J1587_MID    = gECU_MID;
  TX_RequestP2.J1587_MID           = gECU_MID;

  // start timer for cyclic messages
  setTimer( EngineSpeedTimer , TX_EngineSpeed.J1587CycleTime );
  setTimer( EngineTempTimer  , TX_EngineTemp.J1587CycleTime );
  setTimer( OutputTorqueTimer, TX_OutputTorque.J1587CycleTime );
  setTimer( PedalPosTimer    , TX_PedalPos.J1587CycleTime );
  gDCTimerActive = 0;

  putValue( EvEMS_MID, gECU_MID );

  writeDbgLevel( kDbgInfo, "<%s> online with address %d", gNodeName, gECU_MID );
  
  // look out for an Electronic Dash Display on the bus
  TX_RequestP2.RequestedPID = 227;
  output(TX_RequestP2);
}
/*@@end*/

/*@@caplFunc:EnterOffline():*///function
/*
 * Enter offline state
 */
void EnterOffline()
{
  cancelTimer( EngineSpeedTimer );
  cancelTimer( EngineTempTimer );
  cancelTimer( OutputTorqueTimer );
  cancelTimer( PedalPosTimer  );

  if (gDCTimerActive) {
    cancelTimer( DCTimer );
    gDCTimerActive = 0;
  }

  if (gEDDPresent == 1) {
    cancelTimer(DisplayTimer);
    gEDDPresent = 0;
  }	

  // send address claiming PG with NULL address
  putValue( EvEMS_MID, kNullAddr );
  putValue( EvEMS_Torque, 0 );
  putValue( EvEMS_EngineSpeed, 0 );
  putValue( EvEMS_EngineCoolantTemp, 0 );

  writeDbgLevel( kDbgInfo, "<%s> offline", gNodeName );
}
/*@@end*/

/*@@preStart:PreStart:*/
on preStart
{
  setWriteDbgLevel( gDbgLevel );
}
/*@@end*/

/*@@timer:EngineSpeedTimer:*/
/*
 * Timer for EngineSpeedTimer transmit
 */
on timer EngineSpeedTimer
{
  output( TX_EngineSpeed );

  setTimer( EngineSpeedTimer, TX_EngineSpeed.J1587CycleTime );
}
/*@@end*/

/*@@envVar:EvEMS_Enable:*/
on envVar EvEMS_Enable
{
  if (getValue( this )) {
    EMSInit();
    EMSStartUp();
  }
  else {
    EMSShutDown();
  }
}
/*@@end*/

/*@@key:CursorUp:*/
/*
 * Accelarate with CursorUp key
 */
on key CursorUp
{
  float value;
  
  value = getValue( EvEMS_Accelerator );
  if (value <= 90) {
    putValue( EvEMS_Accelerator, value + 10 );
  }
  else {
    putValue( EvEMS_Accelerator, 100 );
  }
}
/*@@end*/

/*@@key:CursorDown:*/
/*
 * Slower with CursorDown key
 */
on key CursorDown
{
  float value;
  
  value = getValue( EvEMS_Accelerator );
  if (value >= 10) {
    putValue( EvEMS_Accelerator, value - 10 );
  }
  else {
    putValue( EvEMS_Accelerator, 0 );
  }
}
/*@@end*/

/*@@caplFunc:calcSpeedFromTargetSpeed(float,float):*///function
/*
 *
 */
float calcSpeedFromTargetSpeed( float targetSpeed, float actualSpeed )
{
  float diff;

  if (targetSpeed > actualSpeed) {
    diff = targetSpeed - actualSpeed;
    if (diff < 300) {
      actualSpeed += (diff * 0.33);
    }
    else {
      actualSpeed += 100.0;
    }
  }
  else {
    diff = actualSpeed - targetSpeed;
    if (diff < 300) {
      actualSpeed -= (diff * 0.17);
    }
    else {
      actualSpeed -= 50.0;
    }
  }

  return actualSpeed;
}
/*@@end*/

/*@@timer:EngineTempTimer:*/
/*
 * Timer for EngineTempTimer transmit
 */
on timer EngineTempTimer
{
  output( TX_EngineTemp );

  setTimer( EngineTempTimer, TX_EngineTemp.J1587CycleTime );
}
/*@@end*/

/*@@timer:OutputTorqueTimer:*/
/*
 * Timer for OutputTorqueTimer transmit
 */
on timer OutputTorqueTimer
{
  output( TX_OutputTorque );

  setTimer( OutputTorqueTimer, TX_OutputTorque.J1587CycleTime );
}
/*@@end*/

/*@@timer:PedalPosTimer:*/
/*
 * Timer for PedalPosTimer transmit
 */
on timer PedalPosTimer
{
  output( TX_PedalPos );

  setTimer( PedalPosTimer, TX_PedalPos.J1587CycleTime );
}
/*@@end*/

/*@@caplFunc:SendDisplayMsg():*///function
/*
 * Send text message to display
 */
void SendDisplayMsg()
{
  int i, row_pos, column_pos;
  char text[32];
  strncpy(text, "Engine Speed: ", elCount(text));

  for (i = 0; i < strlen(text); i++) {
    TX_Display.byte(4+i) = text[i];
  }

  row_pos = (float)gDisplayRows/2.;
  column_pos = (float)gDisplayColumns/2. - (float)strlen(text)/2. + 1;

  TX_Display.DisplayCompleteMessage = 0;
  TX_Display.MessageRowLineNumber = row_pos;
  TX_Display.MessageColumnNumber = column_pos;
  TX_Display.DLC = 4 + i;

  output(TX_Display);

  text[0] = 0;

  ltoa(TX_EngineSpeed.EngineSpeed.phys, text, 10);
  strncat(text, " rpm", elCount(text));

  for (i = 0; i < strlen(text); i++) {
    TX_Display.byte(4+i) = text[i];
  }

  row_pos = row_pos = (float)gDisplayRows/2. + 1;
  column_pos = (float)gDisplayColumns/2. - (float)strlen(text)/2. + 1;

  TX_Display.DisplayCompleteMessage = 1;
  TX_Display.MessageRowLineNumber = row_pos;
  TX_Display.MessageColumnNumber = column_pos >= 1? column_pos : 1;
  TX_Display.DLC = 4 + i;

  output(TX_Display);
  gDisplayState = kWaitForResponse;
  cancelTimer(DisplayTimer);
  setTimer(DisplayTimer, kTimeoutTime);
}
/*@@end*/

/*@@timer:DisplayTimer:*/
/*
 * Timer for display text message timeout
 */
on timer DisplayTimer
{
  gDisplayState = kTimeout;
}
/*@@end*/

/*@@j1587Param:J1587::TextMessageDisplayType (0xE3):*/
on J1587Param TextMessageDisplayType
{
  if (gEDDPresent == 0) {
    gEDDPresent = 1;
    gDisplayRows = this.NumberOfRowsInTheDisplay;
    gDisplayColumns = this.NumberOfColumnsInTheDisplay;
    gDisplayState = kDisplayed;
  }
}
/*@@end*/

/*@@j1587Param:J1587::TextMessageAcknowledged (0xE1):*/
on J1587Param TextMessageAcknowledged
{
  if (this.MID == gECU_MID) {
    if (this.MessageDisplayed == 1) {
      gDisplayState = kDisplayed;
    }
    else {
      gDisplayState = kTimeout;
    }
  }
}
/*@@end*/

/*@@timer:DCTimer:*/
/*
 * Send diagnostic table (Transmitter System Diagnostic Code and Occurrence Count Table)
 */
on timer DCTimer
{
  dcUpdateTable(0);

  if (dcIsAnyActive() && gECUState == kOnline) {
    output(TX_ActiveDiagCodeTable);
  }

  setTimer(DCTimer, 1000);
}
/*@@end*/

/*@@caplFunc:dcSetActive(byte,byte,byte,byte,byte,byte):*///function
/*
 * Activate a DC
 */
void dcSetActive (BYTE DiagnosticCodeSIDPID, BYTE OccurrenceCountIncluded, BYTE TypeOfDiagnosticCode, BYTE LowCharacterIDForAStdDiagCode, BYTE FailureModeIdentifierFMI, BYTE CycleTime)
{
  int i = 0;
  dword cur_time;
  BYTE status_changed = 0;
  BYTE new_code = 1;

  status_changed = 0;
  new_code = 1;

  for (i = 0; i < gDiagCodesCount; i++) {
    if (gDiagnosticCodeSIDPID[i] == DiagnosticCodeSIDPID && gTypeOfDiagnosticCode[i] == TypeOfDiagnosticCode && gLowCharacterIDForAStdDiagCode[i] == LowCharacterIDForAStdDiagCode && gFailureModeIdentifierFMI[i] == FailureModeIdentifierFMI) {
      new_code = 0;
      break;  
    }
  }

  gDiagnosticCodeSIDPID[i] = DiagnosticCodeSIDPID;
  gOccurrenceCountIncluded[i] = OccurrenceCountIncluded;
  if (gCurrentStatusOfFault[i] == 1) {
    gCurrentStatusOfFault[i] = 0;
    status_changed = 1;
  }
  else {
    status_changed = 0;
  }

  gTypeOfDiagnosticCode[i] = TypeOfDiagnosticCode;
  gLowCharacterIDForAStdDiagCode[i] = LowCharacterIDForAStdDiagCode;
  gFailureModeIdentifierFMI[i] = FailureModeIdentifierFMI;

  gDLC[i] = OccurrenceCountIncluded == 0 ? 2 : 3;
  gCycleTime[i] = CycleTime;
  gOccurrenceCount[i]++;
  
  TX_SingleDiagCodeTable.CurrentStatusOfFault          = 0; // active
  TX_SingleDiagCodeTable.DiagnosticCodeSIDPID          = DiagnosticCodeSIDPID;
  TX_SingleDiagCodeTable.FailureModeIdentifierFMI      = FailureModeIdentifierFMI;
  TX_SingleDiagCodeTable.LowCharacterIDForAStdDiagCode = LowCharacterIDForAStdDiagCode;
  TX_SingleDiagCodeTable.OccurrenceCountIncluded       = OccurrenceCountIncluded;
  TX_SingleDiagCodeTable.TypeOfDiagnosticCode          = TypeOfDiagnosticCode;
  TX_SingleDiagCodeTable.DLC                           = 2;

  if (OccurrenceCountIncluded == 1) {
    TX_SingleDiagCodeTable.byte(2) = gOccurrenceCount[i];
    TX_SingleDiagCodeTable.DLC = 3;
  }

  if (new_code == 1) {
    gDiagCodesCount++;
    
    if (gECUState == kOnline) {
      output(TX_SingleDiagCodeTable);
      if (!gDCTimerActive) {
        setTimer(DCTimer, 1);
        gDCTimerActive = 1;
      }
    }
    gtimeInactActive[i] = timeNOW();
  }
  else {
    if (status_changed == 1) {
      cur_time = timeNOW();
      if (cur_time > gtimeInactActive[i] + 100000) {
        if (gECUState == kOnline) {
          output(TX_SingleDiagCodeTable);
        }
        gtimeInactActive[i] = timeNOW();
      }
    }
  } 
}
/*@@end*/

/*@@caplFunc:dcSetInactive(byte,byte,byte,byte):*///function
/*
 * Set a DC inactive
 */
void dcSetInactive (BYTE DiagnosticCodeSIDPID, BYTE TypeOfDiagnosticCode, BYTE LowCharacterIDForAStdDiagCode, BYTE FailureModeIdentifierFMI)
{
  int i;
  dword cur_time;
  BYTE status_changed = 0;

  // Determine if PID/SID of DC is present and if status is active
  for (i = 0; i < gDiagCodesCount; i++) {
    if (gCurrentStatusOfFault[i] == 0 && gDiagnosticCodeSIDPID[i] == DiagnosticCodeSIDPID && gTypeOfDiagnosticCode[i] == TypeOfDiagnosticCode && gLowCharacterIDForAStdDiagCode[i] == LowCharacterIDForAStdDiagCode  && gFailureModeIdentifierFMI[i] == FailureModeIdentifierFMI) {
      break;
    }
  }
  
  if (i != gDiagCodesCount) {
    // current status inactive
    gCurrentStatusOfFault[i] = 1;
    status_changed = 1;
  }
  else {
    status_changed = 0;
  }
  
  cur_time = timeNOW();
  
  // time to last active->inactive transition >= 1 second?
  if (cur_time > gtimeActiveInact[i] + 100000 && status_changed) {
    
    TX_SingleDiagCodeTable.CurrentStatusOfFault          = 1; // inactive
    TX_SingleDiagCodeTable.DiagnosticCodeSIDPID          = gDiagnosticCodeSIDPID[i];
    TX_SingleDiagCodeTable.FailureModeIdentifierFMI      = gFailureModeIdentifierFMI[i];
    TX_SingleDiagCodeTable.LowCharacterIDForAStdDiagCode = gLowCharacterIDForAStdDiagCode[i];
    TX_SingleDiagCodeTable.OccurrenceCountIncluded       = gOccurrenceCountIncluded[i];
    TX_SingleDiagCodeTable.TypeOfDiagnosticCode          = gTypeOfDiagnosticCode[i];
    TX_SingleDiagCodeTable.DLC                           = 2;

    if (gOccurrenceCountIncluded[i] == 1) {
      TX_SingleDiagCodeTable.byte(2) = gOccurrenceCount[i];
      TX_SingleDiagCodeTable.DLC = 3;
    }

    if (gECUState == kOnline) {
      output(TX_SingleDiagCodeTable);
    }

    gtimeActiveInact[i] = timeNOW();
  }
}
/*@@end*/

/*@@caplFunc:dcUpdateTable(byte):*///function
/*
 * Update the DC table
 */
void dcUpdateTable (BYTE on_request)
{
  int i;
  DWORD cur_time;
  TX_DiagCodeTable.DLC = 0;
  cur_time = timeNOW();

  // Update whole table (active & inactive DC's)
  for (i = 0; i < gDiagCodesCount; i++) {
    if (gCycleTime[i] != 0 || (gCycleTime[i] == 0 && cur_time >= gtimeLastDiag15s[i]+1500000) || on_request == 1) {
      if (gCycleTime[i] == 0 && cur_time >= gtimeLastDiag15s[i]+1500000 && on_request == 0) {
        gtimeLastDiag15s[i] = timeNOW();
      }
      TX_DiagCodeTable.byte(TX_DiagCodeTable.DLC) = gDiagnosticCodeSIDPID[i];
      TX_DiagCodeTable.byte(TX_DiagCodeTable.DLC + 1) = gFailureModeIdentifierFMI[i] + 16*gLowCharacterIDForAStdDiagCode[i] + 32*gTypeOfDiagnosticCode[i] + 64*gCurrentStatusOfFault[i] + 128*gOccurrenceCountIncluded[i];
      if (gOccurrenceCountIncluded[i] == 1) {
        TX_DiagCodeTable.byte(TX_DiagCodeTable.DLC + 2) = gOccurrenceCount[i];
        TX_DiagCodeTable.DLC += 3;
      }
      else {
        TX_DiagCodeTable.DLC += 2;
      }
    }
  }

  // Update only active DC's
  TX_ActiveDiagCodeTable.DLC = 0;
  for (i = 0; i < gDiagCodesCount; i++) {
    if ((gCycleTime[i] != 0 || (gCycleTime[i] == 0 && cur_time >= gtimeLastDiag15s[i]+1500000) || on_request == 1) && gCurrentStatusOfFault[i] == 0) {
      if (gCycleTime[i] == 0 && cur_time >= gtimeLastDiag15s[i]+1500000 && on_request == 0)
        gtimeLastDiag15s[i] = timeNOW();
        TX_ActiveDiagCodeTable.byte(TX_ActiveDiagCodeTable.DLC) = gDiagnosticCodeSIDPID[i];
        TX_ActiveDiagCodeTable.byte(TX_ActiveDiagCodeTable.DLC + 1) = gFailureModeIdentifierFMI[i] + 16*gLowCharacterIDForAStdDiagCode[i] + 32*gTypeOfDiagnosticCode[i] + 64*gCurrentStatusOfFault[i] + 128*gOccurrenceCountIncluded[i];
        if (gOccurrenceCountIncluded[i] == 1) {
          TX_ActiveDiagCodeTable.byte(TX_ActiveDiagCodeTable.DLC + 2) = gOccurrenceCount[i];
          TX_ActiveDiagCodeTable.DLC += 3;
        }
      else {
        TX_ActiveDiagCodeTable.DLC += 2;
      }
    }
  }
}
/*@@end*/

/*@@j1587Param:J1587::DiagnosticDataRequest_ClearCount (0xC3):*/
on J1587Param DiagnosticDataRequest_ClearCount
{
  int SIDPID;
  char descMsg[32];

  if (this.TargetMID == gECU_MID) {
    SIDPID = this.TypeOfDiagnosticCode == 1 ? this.SIDorPID : this.SIDorPID + 256;
    if (SIDPID == TX_EngineSpeed.J1587_PID || SIDPID == TX_EngineTemp.J1587_PID
        || SIDPID == 96 || SIDPID == 131) {
      if (dcIsCodePresent(this.SIDorPID, this.TypeOfDiagnosticCode, this.LowCharacterIDForAStdDiagCode, this.FailureModeIdentifierFMI)) {
        strncpy(descMsg, "consult OEM", elCount(descMsg));
        dcSendDataResponse(this.SIDorPID, this.DiagnosticCodeBits, this.TypeOfDiagnosticCode, this.LowCharacterIDForAStdDiagCode, this.FailureModeIdentifierFMI, descMsg);
      }
    }
  }
}
/*@@end*/

/*@@j1587Param:J1587::RequestP1 (0x0):*/
on J1587Param RequestP1
{
  if (this.RequestedPID == TX_DiagCodeTable.J1587_PID) {
    dcUpdateTable(1);
    output(TX_DiagCodeTable);
  }
}
/*@@end*/

/*@@caplFunc:dcSendDataResponse(byte,byte,byte,byte,byte,char[]):*///function
/*
 * Send diagnostic data response (Diagnostic Data/Count Clear Response)
 */
void dcSendDataResponse (BYTE SIDPID, BYTE DiagCodeChar, BYTE TypeOfDiagCode, BYTE LowCharId, BYTE FMI, char Data[])
{
  int i;

  TX_DiagCodeResponse.DiagnosticCodeSIDPID          = SIDPID;
  TX_DiagCodeResponse.DiagnosticCodeBits            = DiagCodeChar;
  TX_DiagCodeResponse.LowCharacterIDForAStdDiagCode = LowCharId;
  TX_DiagCodeResponse.FailureModeIdentifierFMI      = FMI;
  TX_DiagCodeResponse.TypeOfDiagnosticCode          = TypeOfDiagCode;
  TX_DiagCodeResponse.J1587_ReceiverMID             = 0x7F;
  
  switch (DiagCodeChar) {
    case 0x00:
      TX_DiagCodeResponse.DLC = 2 + strlen(Data);
      for (i = 0; i < strlen(Data); i++) {
        TX_DiagCodeResponse.byte(2+i) = Data[i];
      }
      break;
    case 0x03:
      TX_DiagCodeResponse.DLC = 7 + strlen(Data);
      for (i = 0; i < 5; i++) {
        TX_DiagCodeResponse.byte(2+i) = gMake[i];
      }
      for (i = 0; i < strlen(Data); i++) {
        TX_DiagCodeResponse.byte(7+i) = Data[i];
      }
      break;
    case 0x01:
      dcClearOC(SIDPID, TypeOfDiagCode, LowCharId, FMI);
      break;
    case 0x02:
      dcClearOC(-1, 0, 0, 0); // clear all OC's
      break;
  }

  if (gECUState == kOnline) {
    output(TX_DiagCodeResponse);
  }
}
/*@@end*/

/*@@envVar:EvEMS_EngineSpeedError:*/
on envVar EvEMS_EngineSpeedError
{
  BYTE FMI = 2;

  if (getValue(this) == 1) {
    dcSetActive(TX_EngineSpeed.J1587_PID, 0, 1, 0, FMI, 1);
  }
  else {
    dcSetInactive(TX_EngineSpeed.J1587_PID, 1, 0, FMI);
  }
}
/*@@end*/

/*@@caplFunc:dcIsAnyActive():*///function
/*
 * Determine if any active diag code is present
 */
int dcIsAnyActive()
{
  int i;
  for (i = 0; i < gDiagCodesCount; i++) {
    if (gCurrentStatusOfFault[i] == 0) {
      return 1;
    }
  }
  return 0;
}
/*@@end*/

/*@@envVar:EvEMS_EngineCoolantTempError:*/
on envVar EvEMS_EngineCoolantTempError
{
  BYTE FMI = 1;

  if (getValue(this) == 1) {
    dcSetActive(TX_EngineTemp.J1587_PID, 1, 1, 0, FMI, 1);
  }
  else {
    dcSetInactive(TX_EngineTemp.J1587_PID, 1, 0, FMI);
  }
}
/*@@end*/

/*@@envVar:EvEMS_EngExhaustGasPressError:*/
on envVar EvEMS_EngExhaustGasPressError
{
  BYTE FMI = 0;

  if (getValue(this) == 1) {
    dcSetActive(131, 1, 1, 0, FMI, 1);
  }
  else {
    dcSetInactive(131, 1, 0, FMI);
  }
}
/*@@end*/

/*@@envVar:EvEMS_EngFuelLeakageError:*/
on envVar EvEMS_EngFuelLeakageError
{
  BYTE FMI = 10;

  if (getValue(this) == 1) {
    dcSetActive(96, 0, 1, 0, FMI, 1);
  }
  else {
    dcSetInactive(96, 1, 0, FMI);
  }
}
/*@@end*/

/*@@caplFunc:dcIsCodePresent(byte,byte,byte,byte):*///function
/*
 *  Determine if a specific DC is present
 */
int dcIsCodePresent(BYTE SIDPID, BYTE TypeOfDiagCode, BYTE LowCharId, BYTE FMI)
{
  int i;
  for (i = 0; i < gDiagCodesCount; i++) {
    if (gDiagnosticCodeSIDPID[i]          == SIDPID 
     && gTypeOfDiagnosticCode[i]          == TypeOfDiagCode
     && gLowCharacterIDForAStdDiagCode[i] == LowCharId
     && gFailureModeIdentifierFMI[i]      == FMI) {
      return 1;
    }
  }
  return 0;      
}
/*@@end*/

/*@@caplFunc:dcClearOC(int,byte,byte,byte):*///function
/*
 *  Clear Occurrence Count(s)
 */
void dcClearOC(int SIDPID, BYTE TypeOfDiagCode, BYTE LowCharId, BYTE FMI)
{
  int i, clearAll;
  clearAll = 0;
  if (SIDPID == -1) { // clear all 
    clearAll = 1;
  }
  for (i = 0; i < gDiagCodesCount; i++) {
    if ((gDiagnosticCodeSIDPID[i]            == (BYTE)SIDPID 
        && gTypeOfDiagnosticCode[i]          == TypeOfDiagCode
        && gLowCharacterIDForAStdDiagCode[i] == LowCharId
        && gFailureModeIdentifierFMI[i]      == FMI)
     || clearAll) {
      gOccurrenceCount[i] = 0;
    }
  }
}
/*@@end*/

/*@@j1587Param:J1587::ComponentSpecificParamRequest (0x80):*/
on J1587Param ComponentSpecificParamRequest
{
  if (this.ParameterNumber == TX_DiagCodeTable.J1587_PID && this.MID == gECU_MID) {
    dcUpdateTable(1);
    output(TX_DiagCodeTable);
  }
}
/*@@end*/

