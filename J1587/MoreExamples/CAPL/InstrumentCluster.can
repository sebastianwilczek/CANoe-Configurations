/*@@var:*/
/*
 * InstruementCluster                              Version 1.0
 *
 * Copyright 2005, Vector Informatik GmbH - All right reserved
 *
 * This CAPL programm demonstrates how to receive J1587 parameters
 * in CAPL.
 *
 * History:
 * 1.0 (Jr) Created 
 */
variables
{
  char gNodeName[32] = "InstruementCluster";
}
/*@@end*/

/*@@j1587Param:J1587::EngineSpeed (0xBE):*/
on J1587Param EngineSpeed
{
  int i;

  if (i++ % 10 == 0) {
    write( "<%s> Engine Speed %f rpm", gNodeName, this.EngineSpeed.phys );
  }
}
/*@@end*/

/*@@j1587Param:J1587::EngineCoolantTemperature (0x6E):*/
on J1587Param EngineCoolantTemperature
{
  write( "<%s> Engine Coolant Temperature %f °F", gNodeName, this.EngineCoolantTemperature.phys );
}
/*@@end*/

/*@@j1587Param:J1587::EngineOilPressure (0x64):*/
on J1587Param EngineOilPressure
{
  write( "<%s> Engine Oil Pressure %f kPa", gNodeName, this.EngineOilPressure.phys );
}
/*@@end*/

