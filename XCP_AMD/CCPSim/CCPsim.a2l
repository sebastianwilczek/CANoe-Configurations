ASAP2_VERSION 1 51
/begin PROJECT CCPSIM ""
/begin MODULE CPP ""
/begin MOD_COMMON "" BYTE_ORDER MSB_LAST /end MOD_COMMON
/begin IF_DATA ASAP1B_CCP
 /begin SOURCE "DAQ List" 0 0 /begin QP_BLOB 0 LENGTH 10 FIRST_PID 0 /end QP_BLOB /end SOURCE
 /begin SOURCE "DAQ List" 0 0 /begin QP_BLOB 1 LENGTH 10 FIRST_PID 10 /end QP_BLOB /end SOURCE
 /begin SOURCE "DAQ List" 0 0 /begin QP_BLOB 2 LENGTH 10 FIRST_PID 20 /end QP_BLOB /end SOURCE
 /begin SOURCE "DAQ List" 0 0 /begin QP_BLOB 3 LENGTH 10 FIRST_PID 30 /end QP_BLOB /end SOURCE
 /begin SOURCE "DAQ List" 0 0 /begin QP_BLOB 4 LENGTH 10 FIRST_PID 40 /end QP_BLOB /end SOURCE
 /begin RASTER "10ms" "10ms" 10 3 10 /end RASTER
 /begin RASTER "100ms" "100ms" 11 3 100 /end RASTER
 /begin RASTER "Key_T" "Key_T" 1 1000 0 /end RASTER
 /begin SEED_KEY "SEEDKEY1.DLL" "SEEDKEY1.DLL" "SEEDKEY1.DLL" /end SEED_KEY
 /begin TP_BLOB 0x201 0x0206 0x0667 0x07E1 0x0039 2 BAUDRATE 500000 SAMPLE_POINT 75 SAMPLE_RATE 1 BTL_CYCLES 8 SJW 2 SYNC_EDGE SINGLE DAQ_MODE BURST CONSISTENCY ODT ADDRESS_EXTENSION DAQ BYTES_ONLY /begin CHECKSUM_PARAM 0x0005 /* Type */ 0xFFFFFFFF /* Limit */ /end CHECKSUM_PARAM /begin DEFINED_PAGES 0 "RAM_PAGE" 0 0x0000 0 RAM RAM_INIT_BY_ECU /end DEFINED_PAGES /begin DEFINED_PAGES 1 "ROM_PAGE" 0 0x0001 0 ROM /end DEFINED_PAGES /begin DEFINED_PAGES 2 "RAM" 0 0x2A24C 3609 RAM /end DEFINED_PAGES /begin DEFINED_PAGES 3 "FLASH" 0 0x2A24C 3609 FLASH /end DEFINED_PAGES OPTIONAL_CMD 0x0F /* SHORT_UPLOAD */ OPTIONAL_CMD 0x23 /* DNLOAD6 */ OPTIONAL_CMD 0x0E /* BUILD_CHECKSUM */ OPTIONAL_CMD 0x11 /* SELECT_CAL_PAGE */ OPTIONAL_CMD 0x09 /* GET_ACTIVE_CAL_PAGE */ OPTIONAL_CMD 0x12 /* GET_SEED */ OPTIONAL_CMD 0x13 /* UNLOCK */ OPTIONAL_CMD 0x08 /* START_STOP_ALL */ OPTIONAL_CMD 0x22 /* PROGRAM_6 */ OPTIONAL_CMD 0x05 /* TEST */ /end TP_BLOB
/end IF_DATA
/begin MOD_PAR ""
 SYSTEM_CONSTANT "AMPL_MAX" "12"
 SYSTEM_CONSTANT "PI" "3.14159"
 SYSTEM_CONSTANT "PI_HALBE" "PI/2" /end MOD_PAR
/begin COMPU_METHOD BitSlice.CONVERSION "@@@@RuleName created by CANape" RAT_FUNC "%6.2" "" COEFFS 0 1 0 0 0 1 /end COMPU_METHOD
/begin COMPU_METHOD Current "Convert Voltage into Current" FORM "%7.3" "" /begin FORMULA "X*X*2" /end FORMULA /end COMPU_METHOD
/begin COMPU_METHOD DigitalFilterConversion "" RAT_FUNC "%3.1" "Volt" COEFFS 0 1000 0 0 0 1 /end COMPU_METHOD
/begin COMPU_METHOD Factor100 "" RAT_FUNC "%3.1" "" COEFFS 0 100 0 0 0 1 /end COMPU_METHOD
/begin COMPU_METHOD HighLow "High/Low for bits" TAB_VERB "%7.3" "" COMPU_TAB_REF HighLow /end COMPU_METHOD
/begin COMPU_VTAB HighLow "High/Low for bits" TAB_VERB 2 0 "Low" 1 "High" DEFAULT_VALUE "" /end COMPU_VTAB
/begin COMPU_METHOD KF8_Conversion "" RAT_FUNC "%3.1" "1/min" COEFFS 0 10 0 0 0 1 /end COMPU_METHOD
/begin COMPU_METHOD KF8_Y_AXIS.CONVERSION "@@@@RuleName created by CANape" RAT_FUNC "%3.1" "Nm" COEFFS 0 10 0 0 0 1 /end COMPU_METHOD
/begin COMPU_METHOD PWM_Level.CONVERSION "@@@@RuleName created by CANape" RAT_FUNC "%3.1" "Volt" COEFFS 0 1 0 0 0 1 /end COMPU_METHOD
/begin COMPU_METHOD Pressure "Convert Voltage into Pressure" RAT_FUNC "%7.3" "" COEFFS 0 8.09998623 0 0 0 1 /end COMPU_METHOD
/begin COMPU_METHOD TestStatus.CONVERSION "@@@@RuleName created by CANape" TAB_VERB "%3.1" "" COMPU_TAB_REF TestStatus.CONVERSION /end COMPU_METHOD
/begin COMPU_VTAB TestStatus.CONVERSION "@@@@RuleName created by CANape" TAB_VERB 4 0 "Off" 1 "Silent" 2 "Pending" 3 "Running" DEFAULT_VALUE "" /end COMPU_VTAB
/begin COMPU_METHOD ampl.CONVERSION "@@@@RuleName created by CANape" RAT_FUNC "%3.1" "Volt" COEFFS 0 1 0 0 0 1 /end COMPU_METHOD
/begin COMPU_METHOD channel1.CONVERSION "@@@@RuleName created by CANape" RAT_FUNC "%3.1" "Volt" COEFFS 0 1 0 0 0 1 /end COMPU_METHOD
/begin COMPU_METHOD channel2.CONVERSION "@@@@RuleName created by CANape" RAT_FUNC "%3.1" "Volt" COEFFS 0 1 0 0 0 1 /end COMPU_METHOD
/begin COMPU_METHOD channel3.CONVERSION "@@@@RuleName created by CANape" RAT_FUNC "%3.1" "Volt" COEFFS 0 1 0 0 0 1 /end COMPU_METHOD
/begin COMPU_METHOD map1Conversion "" RAT_FUNC "%3.1" "cm" COEFFS 0 0.1 0 0 0 1 /end COMPU_METHOD
/begin COMPU_METHOD map1Input_Conversion "" RAT_FUNC "%3.1" "m" COEFFS 0 10 0 0 0 1 /end COMPU_METHOD
/begin COMPU_METHOD offset.CONVERSION "@@@@RuleName created by CANape" RAT_FUNC "%3.1" "Volt" COEFFS 0 1 0 0 0 1 /end COMPU_METHOD
/begin COMPU_METHOD period1.CONVERSION "@@@@RuleName created by CANape" RAT_FUNC "%3.1" "s" COEFFS 0 1 0 0 0 1 /end COMPU_METHOD
/begin COMPU_METHOD DtChannel1.CONVERSION "@@@@RuleName created by CANape" FORM "%3.1" "" /begin FORMULA "time(X1)-time(X1[-1])" /end FORMULA /end COMPU_METHOD
/begin COMPU_METHOD MaxChannel1.CONVERSION "@@@@RuleName created by CANape" FORM "%3.1" "" /begin FORMULA "max(phy(X1))" /end FORMULA /end COMPU_METHOD
/begin COMPU_METHOD MinChannel1.CONVERSION "@@@@RuleName created by CANape" FORM "%3.1" "" /begin FORMULA "min(phy(X1))" /end FORMULA /end COMPU_METHOD
/begin MEASUREMENT BitSlice "Testsignal: 4 Bit on a byte boundary" UWORD BitSlice.CONVERSION 0 0 0 15 BIT_MASK 0x3C0 ECU_ADDRESS 0x12E380 FORMAT "%.3" /end MEASUREMENT
/begin MEASUREMENT BitSlice0 "Testsignal: 5 Bit" UBYTE BitSlice.CONVERSION 0 0 0 31 BIT_MASK 0x1F ECU_ADDRESS 0x12E380 FORMAT "%.3" /end MEASUREMENT
/begin MEASUREMENT BitSlice1 "Testsignal: 5 Bit " UWORD BitSlice.CONVERSION 0 0 0 31 BIT_MASK 0x3E0 ECU_ADDRESS 0x12E380 FORMAT "%.3" /end MEASUREMENT
/begin MEASUREMENT BitSlice2 "Testsignal: 5 Bit " UBYTE BitSlice.CONVERSION 0 0 0 63 BIT_MASK 0xFC ECU_ADDRESS 0x12E381 FORMAT "%.3" /end MEASUREMENT
/begin MEASUREMENT Counter_B4 "Single bit demo signal (bit from a byte shifting)" UBYTE HighLow 0 0 0 1 READ_WRITE BIT_MASK 0x10 ECU_ADDRESS 0x12E379 FORMAT "%.3" /end MEASUREMENT
/begin MEASUREMENT Counter_B5 "Single bit demo signal (bit from a byte shifting)" UBYTE HighLow 0 0 0 1 READ_WRITE BIT_MASK 0x20 ECU_ADDRESS 0x12E379 FORMAT "%.3" /end MEASUREMENT
/begin MEASUREMENT Counter_B6 "Single bit demo signal (bit from a byte shifting)" UBYTE HighLow 0 0 0 1 READ_WRITE BIT_MASK 0x40 ECU_ADDRESS 0x12E379 FORMAT "%.3" /end MEASUREMENT
/begin MEASUREMENT Counter_B7 "Single bit demo signal (bit from a byte shifting)" UBYTE HighLow 0 0 0 1 READ_WRITE BIT_MASK 0x80 ECU_ADDRESS 0x12E379 FORMAT "%.3" /end MEASUREMENT
/begin AXIS_PTS Curve1 "Curve used as axis" 0x2A6DC NO_INPUT_QUANTITY SSV__UBYTE_S 0 BitSlice.CONVERSION 8 0 255 DEPOSIT ABSOLUTE FORMAT "%.3" /end AXIS_PTS
/begin AXIS_PTS Curve2 "Curve used as axis" 0x2A6E4 NO_INPUT_QUANTITY CurveX8ub 0 BitSlice.CONVERSION 8 0 255 DEPOSIT ABSOLUTE FORMAT "%.3" /end AXIS_PTS
/begin AXIS_PTS Curve3 "Curve used as axis" 0x2A6EC NO_INPUT_QUANTITY SSV__UBYTE_S 0 BitSlice.CONVERSION 6 0 255 DEPOSIT ABSOLUTE FORMAT "%.3" /end AXIS_PTS
/begin MEASUREMENT DtChannel1 "Time jitter of channel1" FLOAT32_IEEE DtChannel1.CONVERSION 0 0 0 100 /begin VIRTUAL channel1 /end VIRTUAL FORMAT "%.3" /begin IF_DATA ASAP1B_CCP KP_BLOB 0xFE 0x8 4 /end IF_DATA /end MEASUREMENT
/begin CHARACTERISTIC FW1 "Testparameter (Basis byte5)" VALUE 0x2A2B2 __UBYTE_S 0 BitSlice.CONVERSION 0 255 BIT_MASK 0xFF FORMAT "%.3" /end CHARACTERISTIC
/begin CHARACTERISTIC KF1 "8*8 BYTE fixed axis" MAP 0x2A328 __UBYTE_Z 0 Factor100 0 2.55 BIT_MASK 0xFF
 /begin AXIS_DESCR FIX_AXIS NO_INPUT_QUANTITY BitSlice.CONVERSION 8 0 7 READ_ONLY FORMAT "%.3" FIX_AXIS_PAR_DIST 0 1 8 /end AXIS_DESCR
 /begin AXIS_DESCR FIX_AXIS NO_INPUT_QUANTITY BitSlice.CONVERSION 8 0 7 READ_ONLY FORMAT "%.3" FIX_AXIS_PAR_DIST 0 1 8 /end AXIS_DESCR
 FORMAT "%.3" /end CHARACTERISTIC
/begin CHARACTERISTIC KF2 "8*8 BYTE shared axis Curve1/Curve2" MAP 0x2A2E8 __UBYTE_Z 0 BitSlice.CONVERSION 0 255 BIT_MASK 0xFF
 /begin AXIS_DESCR COM_AXIS NO_INPUT_QUANTITY BitSlice.CONVERSION 8 0 255 DEPOSIT ABSOLUTE FORMAT "%.3" AXIS_PTS_REF Curve1 /end AXIS_DESCR
 /begin AXIS_DESCR COM_AXIS NO_INPUT_QUANTITY BitSlice.CONVERSION 8 0 255 DEPOSIT ABSOLUTE FORMAT "%.3" AXIS_PTS_REF Curve2 /end AXIS_DESCR
 FORMAT "%.3" /end CHARACTERISTIC
/begin CHARACTERISTIC KF3 "8*6 BYTE fixed axis" MAP 0x2A3A8 __UBYTE_Z 0 BitSlice.CONVERSION 0 255 BIT_MASK 0xFF
 /begin AXIS_DESCR FIX_AXIS NO_INPUT_QUANTITY BitSlice.CONVERSION 8 0 7 READ_ONLY FORMAT "%.3" FIX_AXIS_PAR_DIST 0 1 8 /end AXIS_DESCR
 /begin AXIS_DESCR FIX_AXIS NO_INPUT_QUANTITY BitSlice.CONVERSION 6 0 5 READ_ONLY FORMAT "%.3" FIX_AXIS_PAR_DIST 0 1 6 /end AXIS_DESCR
 FORMAT "%.3" /end CHARACTERISTIC
/begin CHARACTERISTIC KF4 "8*6 BYTE shared xaxis Curve1, fixed yaxis" MAP 0x2A3E8 __UBYTE_Z 0 BitSlice.CONVERSION 0 255 BIT_MASK 0xFF
 /begin AXIS_DESCR COM_AXIS NO_INPUT_QUANTITY BitSlice.CONVERSION 8 0 255 DEPOSIT ABSOLUTE FORMAT "%.3" AXIS_PTS_REF Curve1 /end AXIS_DESCR
 /begin AXIS_DESCR FIX_AXIS NO_INPUT_QUANTITY BitSlice.CONVERSION 6 0 5 READ_ONLY FORMAT "%.3" FIX_AXIS_PAR_DIST 0 1 6 /end AXIS_DESCR
 FORMAT "%.3" /end CHARACTERISTIC
/begin CHARACTERISTIC KF5 "8*6 BYTE memory layout MapX8Y6V86ub" MAP 0x2A5B8 MapX8Y6V86ub 0 BitSlice.CONVERSION 0 255 BIT_MASK 0xFF
 /begin AXIS_DESCR STD_AXIS NO_INPUT_QUANTITY BitSlice.CONVERSION 8 0 255 DEPOSIT ABSOLUTE FORMAT "%.3" /end AXIS_DESCR
 /begin AXIS_DESCR STD_AXIS NO_INPUT_QUANTITY BitSlice.CONVERSION 6 0 255 DEPOSIT ABSOLUTE FORMAT "%.3" /end AXIS_DESCR
 FORMAT "%.3" /end CHARACTERISTIC
/begin CHARACTERISTIC KF6 "8*8 BYTE no axis" MAP 0x2A428 __UBYTE_Z 0 BitSlice.CONVERSION 0 255 BIT_MASK 0xFF
 /begin AXIS_DESCR FIX_AXIS NO_INPUT_QUANTITY BitSlice.CONVERSION 8 0 7 READ_ONLY FORMAT "%.0" FIX_AXIS_PAR_DIST 0 1 8 /end AXIS_DESCR
 /begin AXIS_DESCR FIX_AXIS NO_INPUT_QUANTITY BitSlice.CONVERSION 8 0 7 READ_ONLY FORMAT "%.0" FIX_AXIS_PAR_DIST 0 1 8 /end AXIS_DESCR
 FORMAT "%.3" /end CHARACTERISTIC
/begin CHARACTERISTIC KF7 "8*8 BYTE memory layout MapV86ub, shared axis Curve1/Curve1" MAP 0x2A4E8 MapV86ub 0 BitSlice.CONVERSION 0 255 BIT_MASK 0xFF
 /begin AXIS_DESCR COM_AXIS NO_INPUT_QUANTITY BitSlice.CONVERSION 8 0 255 DEPOSIT ABSOLUTE FORMAT "%.3" AXIS_PTS_REF Curve1 /end AXIS_DESCR
 /begin AXIS_DESCR COM_AXIS NO_INPUT_QUANTITY BitSlice.CONVERSION 8 0 255 DEPOSIT ABSOLUTE FORMAT "%.3" AXIS_PTS_REF Curve2 /end AXIS_DESCR
 FORMAT "%.3" /end CHARACTERISTIC
/begin CHARACTERISTIC KF8 "8*6 BYTE memory layout MapV86ub, fixed axis " MAP 0x2A4A8 MapV86ub 0 KF8_Conversion 0 10 BIT_MASK 0xFF
 /begin AXIS_DESCR FIX_AXIS NO_INPUT_QUANTITY KF8_Conversion 8 0 25.5 READ_ONLY FORMAT "%.1" FIX_AXIS_PAR_DIST 0 2 8 /end AXIS_DESCR
 /begin AXIS_DESCR FIX_AXIS NO_INPUT_QUANTITY KF8_Y_AXIS.CONVERSION 6 0 25.5 READ_ONLY FORMAT "%.1" FIX_AXIS_PAR_DIST 0 5 6 /end AXIS_DESCR
 FORMAT "%.2" /end CHARACTERISTIC
/begin CHARACTERISTIC KL1 "16 BYTE curve no axis" VAL_BLK 0x2A5F8 __UBYTE_Z 0 BitSlice.CONVERSION 0 255 BIT_MASK 0xFF MATRIX_DIM 16 1 1 FORMAT "%.3" /end CHARACTERISTIC
/begin MEASUREMENT KL1Output "Value generated from curve KL1" UBYTE BitSlice.CONVERSION 0 0 0 255 BIT_MASK 0xFF ECU_ADDRESS 0x12E384 FORMAT "%.3" /end MEASUREMENT
/begin CHARACTERISTIC KL2 "8 BYTE shared axis Curve2" CURVE 0x2A708 __UBYTE_Z 0 BitSlice.CONVERSION 0 255 BIT_MASK 0xFF
 /begin AXIS_DESCR COM_AXIS NO_INPUT_QUANTITY BitSlice.CONVERSION 8 0 255 DEPOSIT ABSOLUTE FORMAT "%.3" AXIS_PTS_REF Curve2 /end AXIS_DESCR
 FORMAT "%.3" /end CHARACTERISTIC
/begin CHARACTERISTIC KL3 "8 BYTE memory layout CurveX8V8ub" CURVE 0x2A710 CurveX8V8ub 0 BitSlice.CONVERSION 0 255 BIT_MASK 0xFF
 /begin AXIS_DESCR STD_AXIS NO_INPUT_QUANTITY BitSlice.CONVERSION 8 0 255 DEPOSIT ABSOLUTE FORMAT "%.3" /end AXIS_DESCR
 FORMAT "%.3" /end CHARACTERISTIC
/begin CHARACTERISTIC KL4 "8 BYTE memory layout CurveV8ub" VAL_BLK 0x2A720 CurveV8ub 0 BitSlice.CONVERSION 0 255 BIT_MASK 0xFF MATRIX_DIM 8 1 1 FORMAT "%.3" /end CHARACTERISTIC
/begin CHARACTERISTIC KL5 "8 BYTE memory layout CurveV8ub shared xaxis Curve2" CURVE 0x2A730 CurveV8ub 0 BitSlice.CONVERSION 0 255 BIT_MASK 0xFF
 /begin AXIS_DESCR COM_AXIS NO_INPUT_QUANTITY BitSlice.CONVERSION 8 0 255 DEPOSIT ABSOLUTE FORMAT "%.3" AXIS_PTS_REF Curve2 /end AXIS_DESCR
 FORMAT "%.3" /end CHARACTERISTIC
/begin CHARACTERISTIC KL6 "8 BYTE memory layout CurveV8ub fixed axis" CURVE 0x2A738 CurveV8ub 0 BitSlice.CONVERSION 0 255 BIT_MASK 0xFF
 /begin AXIS_DESCR FIX_AXIS NO_INPUT_QUANTITY BitSlice.CONVERSION 8 0 255 READ_ONLY FORMAT "%.3" FIX_AXIS_PAR_DIST 0 8 8 /end AXIS_DESCR
 FORMAT "%.3" /end CHARACTERISTIC
/begin CHARACTERISTIC KL7 "" CURVE 0x2A740 CurveX8V8uwAlternate 0 Factor100 0 500 BIT_MASK 0xFFFF
 /begin AXIS_DESCR STD_AXIS NO_INPUT_QUANTITY Factor100 8 0 655.35 DEPOSIT ABSOLUTE FORMAT "%.3" /end AXIS_DESCR
 FORMAT "%.3" /end CHARACTERISTIC
/begin CHARACTERISTIC KL8 "" CURVE 0x2A760 __UWORD_Z 0 Factor100 0 655.35 BIT_MASK 0xFFFF
 /begin AXIS_DESCR FIX_AXIS NO_INPUT_QUANTITY BitSlice.CONVERSION 8 0 1 READ_ONLY FORMAT "%.3" FIX_AXIS_PAR_DIST 0 1 8 /end AXIS_DESCR
 FORMAT "%.3" /end CHARACTERISTIC
/begin MEASUREMENT MaxChannel1 "Maximum value of channel1" FLOAT32_IEEE MaxChannel1.CONVERSION 0 0 -100 100 /begin VIRTUAL channel1 /end VIRTUAL FORMAT "%.3" /begin IF_DATA ASAP1B_CCP KP_BLOB 0xFE 0x10 4 /end IF_DATA /end MEASUREMENT
/begin MEASUREMENT MinChannel1 "Minimum value of channel1" FLOAT32_IEEE MinChannel1.CONVERSION 0 0 -100 100 /begin VIRTUAL channel1 /end VIRTUAL FORMAT "%.3" /begin IF_DATA ASAP1B_CCP KP_BLOB 0xFE 0x18 4 /end IF_DATA /end MEASUREMENT
/begin MEASUREMENT PWM "Pulse width signal from PWM_level and Triangle" UBYTE HighLow 0 0 0 255 BIT_MASK 0xFF ECU_ADDRESS 0x12E2FE FORMAT "%.0" /end MEASUREMENT
/begin MEASUREMENT PWMFiltered "Low pass filtered PWM signal" UBYTE BitSlice.CONVERSION 0 0 0 255 BIT_MASK 0xFF ECU_ADDRESS 0x12E383 FORMAT "%.3" /end MEASUREMENT
/begin CHARACTERISTIC PWM_Level "" VALUE 0x2A24E __SBYTE_S 0 PWM_Level.CONVERSION -50 50 BIT_MASK 0xFF FORMAT "%.3" /end CHARACTERISTIC
/begin MEASUREMENT ShiftByte "" UBYTE BitSlice.CONVERSION 0 0 0 255 BIT_MASK 0xFF ECU_ADDRESS 0x12E382 FORMAT "%.3" /end MEASUREMENT
/begin MEASUREMENT Shifter_B0 "Single bit demo signal (bit from a byte shifting)" UBYTE HighLow 0 0 0 1 READ_WRITE BIT_MASK 0x1 ECU_ADDRESS 0x12E382 FORMAT "%.3" /end MEASUREMENT
/begin MEASUREMENT Shifter_B1 "Single bit demo signal (bit from a byte shifting)" UBYTE HighLow 0 0 0 1 READ_WRITE BIT_MASK 0x2 ECU_ADDRESS 0x12E382 FORMAT "%.3" /end MEASUREMENT
/begin MEASUREMENT Shifter_B2 "Single bit demo signal (bit from a byte shifting)" UBYTE HighLow 0 0 0 1 READ_WRITE BIT_MASK 0x4 ECU_ADDRESS 0x12E382 FORMAT "%.3" /end MEASUREMENT
/begin MEASUREMENT Shifter_B3 "Single bit demo signal (bit from a byte shifting)" UBYTE HighLow 0 0 0 1 READ_WRITE BIT_MASK 0x8 ECU_ADDRESS 0x12E382 FORMAT "%.3" /end MEASUREMENT
/begin MEASUREMENT TestStatus "2 bit demo signal with symbolic conversion formula" UBYTE TestStatus.CONVERSION 0 0 0 3 READ_WRITE BIT_MASK 0xC0 ECU_ADDRESS 0x12E379 FORMAT "%.0" /end MEASUREMENT
/begin MEASUREMENT Triangle "Triangle test signal used for PWM output PWM" SBYTE BitSlice.CONVERSION 0 0 -50 50 BIT_MASK 0xFF ECU_ADDRESS 0x12E373 FORMAT "%.3" /end MEASUREMENT
/begin CHARACTERISTIC a0 "Digital Filter v=(vin*a0+v*b0)/c0" VALUE 0x2A2A8 __UWORD_S 0 DigitalFilterConversion 0 1 BIT_MASK 0xFFFF FORMAT "%.3" /end CHARACTERISTIC
/begin CHARACTERISTIC ampl "" VALUE 0x2A274 __FLOAT32_IEEE_S 0 ampl.CONVERSION 0 100 FORMAT "%.2" /end CHARACTERISTIC
/begin CHARACTERISTIC b0 "Digital Filter v=(vin*a0+v*b0)/c0" VALUE 0x2A2AC __UWORD_S 0 DigitalFilterConversion 0 1 BIT_MASK 0xFFFF FORMAT "%.3" /end CHARACTERISTIC
/begin MEASUREMENT bit12Counter "Demo signal (12 bit, incrementing)" UWORD BitSlice.CONVERSION 0 0 0 4095 BIT_MASK 0xFFFF ECU_ADDRESS 0x12E380 FORMAT "%.3" /end MEASUREMENT
/begin MEASUREMENT byte1 "Demo, read and write possible" UBYTE BitSlice.CONVERSION 0 0 0 255 READ_WRITE BIT_MASK 0xFF ECU_ADDRESS 0x2A2AA FORMAT "%.3" /end MEASUREMENT
/begin MEASUREMENT byte2 "Demo, read and write possible" UBYTE BitSlice.CONVERSION 0 0 0 255 READ_WRITE BIT_MASK 0xFF ECU_ADDRESS 0x2A2AB FORMAT "%.3" /end MEASUREMENT
/begin MEASUREMENT byte3 "Demo, read and write possible" UBYTE BitSlice.CONVERSION 0 0 0 255 READ_WRITE BIT_MASK 0xFF ECU_ADDRESS 0x2A2AE FORMAT "%.3" /end MEASUREMENT
/begin MEASUREMENT byte4 "Demo, read and write possible" UBYTE BitSlice.CONVERSION 0 0 0 255 READ_WRITE BIT_MASK 0xFF ECU_ADDRESS 0x2A2AF FORMAT "%.3" /end MEASUREMENT
/begin MEASUREMENT byteCounter "Demo signal (byte, incrementing)" UBYTE BitSlice.CONVERSION 0 0 0 255 BIT_MASK 0xFF ECU_ADDRESS 0x12E379 FORMAT "%.3" /end MEASUREMENT
/begin CHARACTERISTIC bytePWMFilter "Filter constant for PWM filter" VALUE 0x2A24F __UBYTE_S 0 BitSlice.CONVERSION 0 100 BIT_MASK 0xFF FORMAT "%.3" /end CHARACTERISTIC
/begin CHARACTERISTIC c0 "Digital Filter v=(vin*a0+v*b0)/c0" VALUE 0x2A2B0 __UWORD_S 0 DigitalFilterConversion 0 1 BIT_MASK 0xFFFF FORMAT "%.3" /end CHARACTERISTIC
/begin MEASUREMENT channel1 "FLOAT demo signal (sine wave)" FLOAT32_IEEE channel1.CONVERSION 0 0 -1e+012 1e+012 READ_WRITE ECU_ADDRESS 0x12E36C FORMAT "%.3" /end MEASUREMENT
/begin MEASUREMENT channel2 "FLOAT demo signal (sine wave)" FLOAT32_IEEE channel2.CONVERSION 0 0 -1e+012 1e+012 ECU_ADDRESS 0x12E360 FORMAT "%.3" /end MEASUREMENT
/begin MEASUREMENT channel3 "FLOAT demo signal (sine wave)" FLOAT32_IEEE channel3.CONVERSION 0 0 -100 100 ECU_ADDRESS 0xED2CC FORMAT "%.3" /end MEASUREMENT
/begin MEASUREMENT dwordCounter "Demo signal (dword, incrementing)" ULONG BitSlice.CONVERSION 0 0 0 255 BIT_MASK 0xFFFFFFFF ECU_ADDRESS 0x12E37C FORMAT "%.3" /end MEASUREMENT
/begin CHARACTERISTIC limit "Limit for channel1" VALUE 0x2A278 __FLOAT32_IEEE_S 0 BitSlice.CONVERSION -1e+012 1e+012 FORMAT "%.3" /end CHARACTERISTIC
/begin CHARACTERISTIC map1 "8*8 BYTE fixed axis" MAP 0x2A368 __UBYTE_Z 0 map1Conversion 0 2550 BIT_MASK 0xFF
 /begin AXIS_DESCR FIX_AXIS map1InputX map1Input_Conversion 8 -12.8 12.7 READ_ONLY FORMAT "%.3" FIX_AXIS_PAR_DIST 0 1 8 /end AXIS_DESCR
 /begin AXIS_DESCR FIX_AXIS map1InputY map1Input_Conversion 8 -12.8 12.7 READ_ONLY FORMAT "%.3" FIX_AXIS_PAR_DIST 0 1 8 /end AXIS_DESCR
 FORMAT "%.3" /end CHARACTERISTIC
/begin CHARACTERISTIC map1Counter "" VALUE 0x2A2B3 __UBYTE_S 0 BitSlice.CONVERSION 0 255 BIT_MASK 0xFF FORMAT "%.3" /end CHARACTERISTIC
/begin MEASUREMENT map1InputX "" UBYTE map1Input_Conversion 0 0 0 25.5 BIT_MASK 0xFF ECU_ADDRESS 0x12E386 FORMAT "%.3" /end MEASUREMENT
/begin MEASUREMENT map1InputY "" UBYTE map1Input_Conversion 0 0 0 25.5 BIT_MASK 0xFF ECU_ADDRESS 0x12E36A FORMAT "%.3" /end MEASUREMENT
/begin MEASUREMENT map1Output "" UBYTE map1Conversion 0 0 0 2550 BIT_MASK 0xFF ECU_ADDRESS 0x12E36B FORMAT "%.3" /end MEASUREMENT
/begin CHARACTERISTIC map4_80_uc "8*8 BYTE memory layout map4_80_uc" MAP 0x2A568 MapX8Y8V88ub 0 BitSlice.CONVERSION 0 255 BIT_MASK 0xFF
 /begin AXIS_DESCR STD_AXIS NO_INPUT_QUANTITY BitSlice.CONVERSION 8 0 255 DEPOSIT ABSOLUTE FORMAT "%.3" /end AXIS_DESCR
 /begin AXIS_DESCR STD_AXIS NO_INPUT_QUANTITY BitSlice.CONVERSION 8 0 255 DEPOSIT ABSOLUTE FORMAT "%.3" /end AXIS_DESCR
 FORMAT "%.3" /end CHARACTERISTIC
/begin CHARACTERISTIC map5_82_uc "8*8 BYTE memory layout MapNxX8NyY8V88uc" MAP 0x2A608 MapNxXNyYVuc 0 BitSlice.CONVERSION 0 255 BIT_MASK 0xFF
 /begin AXIS_DESCR STD_AXIS NO_INPUT_QUANTITY BitSlice.CONVERSION 10 0 255 DEPOSIT ABSOLUTE FORMAT "%.3" /end AXIS_DESCR
 /begin AXIS_DESCR STD_AXIS NO_INPUT_QUANTITY BitSlice.CONVERSION 10 0 255 DEPOSIT ABSOLUTE FORMAT "%.3" /end AXIS_DESCR
 FORMAT "%.3" /end CHARACTERISTIC
/begin MEASUREMENT noise "Random numbers" FLOAT32_IEEE BitSlice.CONVERSION 0 0 0 255 ECU_ADDRESS 0xEE2D4 FORMAT "%.3" /end MEASUREMENT
/begin CHARACTERISTIC offset "Offset for channel1" VALUE 0x2A27C __FLOAT32_IEEE_S 0 offset.CONVERSION -1e+012 1e+012 FORMAT "%.3" /end CHARACTERISTIC
/begin CHARACTERISTIC period1 "Period of channel 1" VALUE 0x2A270 __FLOAT32_IEEE_S 0 period1.CONVERSION 0 100 FORMAT "%.3" /end CHARACTERISTIC
/begin CHARACTERISTIC testbit0 "offset 53" VALUE 0x2A80D __UBYTE_S 0 BitSlice.CONVERSION 0 1 BIT_MASK 0x1 FORMAT "%.3" /end CHARACTERISTIC
/begin CHARACTERISTIC testbit1 "offset 53" VALUE 0x2A80D __UBYTE_S 0 BitSlice.CONVERSION 0 1 BIT_MASK 0x2 FORMAT "%.3" /end CHARACTERISTIC
/begin CHARACTERISTIC testbit2 "offset 53" VALUE 0x2A80D __UBYTE_S 0 BitSlice.CONVERSION 0 1 BIT_MASK 0x4 FORMAT "%.3" /end CHARACTERISTIC
/begin CHARACTERISTIC testbit3 "offset 53" VALUE 0x2A80D __UBYTE_S 0 BitSlice.CONVERSION 0 1 BIT_MASK 0x8 FORMAT "%.3" /end CHARACTERISTIC
/begin CHARACTERISTIC testbit4 "offset 53" VALUE 0x2A80D __UBYTE_S 0 BitSlice.CONVERSION 0 1 BIT_MASK 0x10 FORMAT "%.3" /end CHARACTERISTIC
/begin CHARACTERISTIC testbit5 "offset 6" VALUE 0x2A7DE __UBYTE_S 0 BitSlice.CONVERSION 0 1 BIT_MASK 0x20 FORMAT "%.3" /end CHARACTERISTIC
/begin CHARACTERISTIC testbit6 "offset 7" VALUE 0x2A7DF __UBYTE_S 0 BitSlice.CONVERSION 0 1 BIT_MASK 0x20 FORMAT "%.3" /end CHARACTERISTIC
/begin CHARACTERISTIC testbit7 "offset 7" VALUE 0x2A7DF __UBYTE_S 0 BitSlice.CONVERSION 0 3 BIT_MASK 0xC0 FORMAT "%.3" /end CHARACTERISTIC
/begin CHARACTERISTIC testbitslice0 "offset 43" VALUE 0x2A803 __UBYTE_S 0 BitSlice.CONVERSION -16 15 BIT_MASK 0x1F FORMAT "%.3" /end CHARACTERISTIC
/begin CHARACTERISTIC testbitslice1 "offset 7" VALUE 0x2A7DF __UBYTE_S 0 BitSlice.CONVERSION -16 15 BIT_MASK 0x1F FORMAT "%.3" /end CHARACTERISTIC
/begin CHARACTERISTIC testbitslice2 "offset 10" VALUE 0x2A7E2 __UBYTE_S 0 BitSlice.CONVERSION -32 31 BIT_MASK 0xFC FORMAT "%.3" /end CHARACTERISTIC
/begin CHARACTERISTIC testbyte0 "offset 50" VALUE 0x2A80A __UBYTE_S 0 BitSlice.CONVERSION -128 127 BIT_MASK 0xFF FORMAT "%.3" /end CHARACTERISTIC
/begin CHARACTERISTIC testbyte1 "offset 8" VALUE 0x2A7E0 __UBYTE_S 0 BitSlice.CONVERSION -128 127 BIT_MASK 0xFF FORMAT "%.3" /end CHARACTERISTIC
/begin CHARACTERISTIC testbyte2 "offset15" VALUE 0x2A7E7 __UBYTE_S 0 BitSlice.CONVERSION -128 127 BIT_MASK 0xFF FORMAT "%.3" /end CHARACTERISTIC
/begin CHARACTERISTIC testbyte3 "offset 19" VALUE 0x2A7EB __UBYTE_S 0 BitSlice.CONVERSION -128 127 BIT_MASK 0xFF FORMAT "%.3" /end CHARACTERISTIC
/begin CHARACTERISTIC testbyte4 "offset 33" VALUE 0x2A7F9 __UBYTE_S 0 BitSlice.CONVERSION -128 127 BIT_MASK 0xFF FORMAT "%.3" /end CHARACTERISTIC
/begin CHARACTERISTIC testbyte5 "offset 35" VALUE 0x2A7FB __UBYTE_S 0 BitSlice.CONVERSION -128 127 BIT_MASK 0xFF FORMAT "%.3" /end CHARACTERISTIC
/begin CHARACTERISTIC testbyte6 "offset 42" VALUE 0x2A802 __UBYTE_S 0 BitSlice.CONVERSION -128 127 BIT_MASK 0xFF FORMAT "%.3" /end CHARACTERISTIC
/begin CHARACTERISTIC testbyte7 "offset 44" VALUE 0x2A804 __UBYTE_S 0 BitSlice.CONVERSION -128 127 BIT_MASK 0xFF FORMAT "%.3" /end CHARACTERISTIC
/begin CHARACTERISTIC testdword0 "offset 0" VALUE 0x2A7D8 __UBYTE_S 0 BitSlice.CONVERSION -2147480000 2147480000 BIT_MASK 0xFF FORMAT "%.3" /end CHARACTERISTIC
/begin CHARACTERISTIC testdword1 "offset 20" VALUE 0x2A7EC __UBYTE_S 0 BitSlice.CONVERSION -2147480000 2147480000 BIT_MASK 0xFF FORMAT "%.3" /end CHARACTERISTIC
/begin CHARACTERISTIC testubitslice0 "offset 34" VALUE 0x2A7FA __UBYTE_S 0 BitSlice.CONVERSION 0 31 BIT_MASK 0x1F FORMAT "%.3" /end CHARACTERISTIC
/begin CHARACTERISTIC testubitslice1 "offset 6" VALUE 0x2A7DE __UBYTE_S 0 BitSlice.CONVERSION 0 31 BIT_MASK 0x1F FORMAT "%.3" /end CHARACTERISTIC
/begin CHARACTERISTIC testubitslice2 "offset 11" VALUE 0x2A7E3 __UBYTE_S 0 BitSlice.CONVERSION 0 63 BIT_MASK 0xFC FORMAT "%.3" /end CHARACTERISTIC
/begin CHARACTERISTIC testubyte0 "offset 25" VALUE 0x2A7F1 __UBYTE_S 0 BitSlice.CONVERSION 0 255 BIT_MASK 0xFF FORMAT "%.3" /end CHARACTERISTIC
/begin CHARACTERISTIC testubyte1 "offset 9" VALUE 0x2A7E1 __UBYTE_S 0 BitSlice.CONVERSION 0 255 BIT_MASK 0xFF FORMAT "%.3" /end CHARACTERISTIC
/begin CHARACTERISTIC testubyte2 "offset 12" VALUE 0x2A7E4 __UBYTE_S 0 BitSlice.CONVERSION 0 255 BIT_MASK 0xFF FORMAT "%.3" /end CHARACTERISTIC
/begin CHARACTERISTIC testubyte3 "offset 18" VALUE 0x2A7EA __UBYTE_S 0 BitSlice.CONVERSION 0 255 BIT_MASK 0xFF FORMAT "%.3" /end CHARACTERISTIC
/begin CHARACTERISTIC testubyte4 "offset 24" VALUE 0x2A7F0 __UBYTE_S 0 BitSlice.CONVERSION 0 255 BIT_MASK 0xFF FORMAT "%.3" /end CHARACTERISTIC
/begin CHARACTERISTIC testubyte5 "offset 36" VALUE 0x2A7FC __UBYTE_S 0 BitSlice.CONVERSION 0 255 BIT_MASK 0xFF FORMAT "%.3" /end CHARACTERISTIC
/begin CHARACTERISTIC testubyte6 "offset 37" VALUE 0x2A7FD __UBYTE_S 0 BitSlice.CONVERSION 0 255 BIT_MASK 0xFF FORMAT "%.3" /end CHARACTERISTIC
/begin CHARACTERISTIC testubyte7 "offset45" VALUE 0x2A805 __UBYTE_S 0 BitSlice.CONVERSION 0 255 BIT_MASK 0xFF FORMAT "%.3" /end CHARACTERISTIC
/begin CHARACTERISTIC testudword0 "offset 46" VALUE 0x2A806 __UBYTE_S 0 BitSlice.CONVERSION 0 3294970000 BIT_MASK 0xFF FORMAT "%.3" /end CHARACTERISTIC
/begin CHARACTERISTIC testudword1 "offset 26" VALUE 0x2A7F2 __UBYTE_S 0 BitSlice.CONVERSION 0 4294970000 BIT_MASK 0xFF FORMAT "%.3" /end CHARACTERISTIC
/begin CHARACTERISTIC testuword0 "offset 4" VALUE 0x2A7DC __UBYTE_S 0 BitSlice.CONVERSION 0 65535 BIT_MASK 0xFF FORMAT "%.3" /end CHARACTERISTIC
/begin CHARACTERISTIC testuword1 "offset 13" VALUE 0x2A7E5 __UBYTE_S 0 BitSlice.CONVERSION 0 65535 BIT_MASK 0xFF FORMAT "%.3" /end CHARACTERISTIC
/begin CHARACTERISTIC testuword2 "offset 32" VALUE 0x2A7F8 __UBYTE_S 0 BitSlice.CONVERSION 0 65536 BIT_MASK 0xFF FORMAT "%.3" /end CHARACTERISTIC
/begin CHARACTERISTIC testuword3 "offset 40" VALUE 0x2A800 __UBYTE_S 0 BitSlice.CONVERSION 0 65536 BIT_MASK 0xFF FORMAT "%.3" /end CHARACTERISTIC
/begin CHARACTERISTIC testword0 "offset 51" VALUE 0x2A80B __UBYTE_S 0 BitSlice.CONVERSION -32768 32767 BIT_MASK 0xFF FORMAT "%.3" /end CHARACTERISTIC
/begin CHARACTERISTIC testword1 "offset 16" VALUE 0x2A7E8 __UBYTE_S 0 BitSlice.CONVERSION -32768 32767 BIT_MASK 0xFF FORMAT "%.3" /end CHARACTERISTIC
/begin CHARACTERISTIC testword2 "offset 30" VALUE 0x2A7F6 __UBYTE_S 0 BitSlice.CONVERSION -32768 32767 BIT_MASK 0xFF FORMAT "%.3" /end CHARACTERISTIC
/begin CHARACTERISTIC testword3 "offset 38" VALUE 0x2A7FE __UBYTE_S 0 BitSlice.CONVERSION -32768 32767 BIT_MASK 0xFF FORMAT "%.3" /end CHARACTERISTIC
/begin MEASUREMENT v "Digital Filter Outputvalue" UWORD DigitalFilterConversion 0 0 0 1 BIT_MASK 0xFFFF ECU_ADDRESS 0x12E368 FORMAT "%.3" /end MEASUREMENT
/begin CHARACTERISTIC vin "Digital Filter Inputvalue" VALUE 0xEE2D0 __UWORD_S 0 DigitalFilterConversion 0 1 BIT_MASK 0xFFFF FORMAT "%.3" /end CHARACTERISTIC
/begin MEASUREMENT wordCounter "Demo signal (word, incrementing)" UWORD BitSlice.CONVERSION 0 0 0 65535 BIT_MASK 0xFFFF ECU_ADDRESS 0x12E380 FORMAT "%.3" /end MEASUREMENT
/begin GROUP Axis "Shared Axis for Calibration Maps" ROOT /begin SUB_GROUP /end SUB_GROUP /begin FUNCTION_LIST /end FUNCTION_LIST /begin REF_CHARACTERISTIC Curve1 Curve2 Curve3 /end REF_CHARACTERISTIC /begin REF_MEASUREMENT /end REF_MEASUREMENT /end GROUP
/begin GROUP Bits "Single Bit Values" /begin SUB_GROUP /end SUB_GROUP /begin FUNCTION_LIST /end FUNCTION_LIST /begin REF_CHARACTERISTIC /end REF_CHARACTERISTIC
 /begin REF_MEASUREMENT Counter_B4 Counter_B5 Counter_B6 Counter_B7 ShiftByte Shifter_B0 Shifter_B1 Shifter_B2 Shifter_B3 /end REF_MEASUREMENT
/end GROUP
/begin GROUP Bitslices "Multibit Values" /begin SUB_GROUP /end SUB_GROUP /begin FUNCTION_LIST /end FUNCTION_LIST /begin REF_CHARACTERISTIC /end REF_CHARACTERISTIC /begin REF_MEASUREMENT BitSlice BitSlice0 BitSlice1 BitSlice2 TestStatus /end REF_MEASUREMENT /end GROUP
/begin GROUP Curves "Calibration Curves" ROOT /begin SUB_GROUP /end SUB_GROUP /begin FUNCTION_LIST /end FUNCTION_LIST /begin REF_CHARACTERISTIC KL1 KL2 KL3 KL4 KL5 KL6 KL7 KL8 /end REF_CHARACTERISTIC /begin REF_MEASUREMENT /end REF_MEASUREMENT /end GROUP
/begin GROUP Example_Filter "Digital Filter v=(vin*a0+v*b0)/c0" ROOT /begin SUB_GROUP /end SUB_GROUP /begin FUNCTION_LIST /end FUNCTION_LIST /begin REF_CHARACTERISTIC a0 b0 c0 vin /end REF_CHARACTERISTIC /begin REF_MEASUREMENT v /end REF_MEASUREMENT /end GROUP
/begin GROUP Example_PWM "Generator for a PWM Signal" ROOT /begin SUB_GROUP PWM_Signals PWM_Parameters /end SUB_GROUP /begin FUNCTION_LIST /end FUNCTION_LIST /begin REF_CHARACTERISTIC /end REF_CHARACTERISTIC /begin REF_MEASUREMENT /end REF_MEASUREMENT /end GROUP
/begin GROUP Maps "Calibration Maps" ROOT /begin SUB_GROUP WorkingPoint /end SUB_GROUP /begin FUNCTION_LIST /end FUNCTION_LIST /begin REF_CHARACTERISTIC KF1 KF2 KF3 KF4 KF5 KF6 KF7 KF8 map4_80_uc map5_82_uc /end REF_CHARACTERISTIC /begin REF_MEASUREMENT /end REF_MEASUREMENT /end GROUP
/begin GROUP Measure "Measurement Values" ROOT /begin SUB_GROUP Test_Signals Bitslices Bits /end SUB_GROUP /begin FUNCTION_LIST /end FUNCTION_LIST /begin REF_CHARACTERISTIC /end REF_CHARACTERISTIC /begin REF_MEASUREMENT channel1 channel2 channel3 noise /end REF_MEASUREMENT /end GROUP
/begin GROUP PWM_Parameters "Parametes for PWM Example" /begin SUB_GROUP /end SUB_GROUP /begin FUNCTION_LIST /end FUNCTION_LIST /begin REF_CHARACTERISTIC FW1 PWM_Level bytePWMFilter /end REF_CHARACTERISTIC /begin REF_MEASUREMENT /end REF_MEASUREMENT /end GROUP
/begin GROUP PWM_Signals "Measurement Signals from PWM" /begin SUB_GROUP /end SUB_GROUP /begin FUNCTION_LIST /end FUNCTION_LIST /begin REF_CHARACTERISTIC /end REF_CHARACTERISTIC /begin REF_MEASUREMENT PWM PWMFiltered Triangle /end REF_MEASUREMENT /end GROUP
/begin GROUP Parameters "Calibration Parameters" ROOT /begin SUB_GROUP Test_Parameters /end SUB_GROUP /begin FUNCTION_LIST /end FUNCTION_LIST /begin REF_CHARACTERISTIC ampl limit offset period1 /end REF_CHARACTERISTIC /begin REF_MEASUREMENT /end REF_MEASUREMENT /end GROUP
/begin GROUP Test_Parameters "Test Parameters, BYTE" /begin SUB_GROUP /end SUB_GROUP /begin FUNCTION_LIST /end FUNCTION_LIST
 /begin REF_CHARACTERISTIC testbit0 testbit1 testbit2 testbit3 testbit4 testbit5 testbit6 testbit7 testbitslice0 testbitslice1 testbitslice2 testbyte0 testbyte1 testbyte2 testbyte3 testbyte4 testbyte5 testbyte6 testbyte7 testdword0 testdword1 testubitslice0 testubitslice1 testubitslice2 testubyte0 testubyte1 testubyte2 testubyte3 testubyte4 testubyte5 testubyte6 testubyte7 testudword0 testudword1 testuword0 testuword1 testuword2 testuword3 testword0 testword1 testword2 testword3 /end REF_CHARACTERISTIC
 /begin REF_MEASUREMENT /end REF_MEASUREMENT
/end GROUP
/begin GROUP Test_Signals "Test Signals" /begin SUB_GROUP /end SUB_GROUP /begin FUNCTION_LIST /end FUNCTION_LIST /begin REF_CHARACTERISTIC /end REF_CHARACTERISTIC
 /begin REF_MEASUREMENT KL1Output bit12Counter byte1 byte2 byte3 byte4 byteCounter dwordCounter wordCounter /end REF_MEASUREMENT
/end GROUP
/begin GROUP Virtual "Virtual Signals" ROOT /begin SUB_GROUP /end SUB_GROUP /begin FUNCTION_LIST /end FUNCTION_LIST /begin REF_CHARACTERISTIC /end REF_CHARACTERISTIC /begin REF_MEASUREMENT DtChannel1 MaxChannel1 MinChannel1 /end REF_MEASUREMENT /end GROUP
/begin GROUP WorkingPoint "Example for working point" /begin SUB_GROUP /end SUB_GROUP /begin FUNCTION_LIST /end FUNCTION_LIST /begin REF_CHARACTERISTIC map1 map1Counter /end REF_CHARACTERISTIC /begin REF_MEASUREMENT map1InputX map1InputY map1Output /end REF_MEASUREMENT /end GROUP
/begin RECORD_LAYOUT CurveNxVfloat FNC_VALUES 2 FLOAT32_IEEE ROW_DIR DIRECT NO_AXIS_PTS_X 1 UBYTE ALIGNMENT_BYTE 1 ALIGNMENT_WORD 1 ALIGNMENT_LONG 1 ALIGNMENT_FLOAT32_IEEE 1 ALIGNMENT_FLOAT64_IEEE 1 /end RECORD_LAYOUT
/begin RECORD_LAYOUT CurveNxVub FNC_VALUES 2 UBYTE ROW_DIR DIRECT AXIS_PTS_X 1 UBYTE INDEX_INCR DIRECT /end RECORD_LAYOUT
/begin RECORD_LAYOUT CurveNxVulong FNC_VALUES 2 ULONG ROW_DIR DIRECT NO_AXIS_PTS_X 1 UBYTE ALIGNMENT_BYTE 1 ALIGNMENT_WORD 1 ALIGNMENT_LONG 1 ALIGNMENT_FLOAT32_IEEE 1 ALIGNMENT_FLOAT64_IEEE 1 /end RECORD_LAYOUT
/begin RECORD_LAYOUT CurveNxXVfloat FNC_VALUES 3 FLOAT32_IEEE ROW_DIR DIRECT AXIS_PTS_X 2 FLOAT32_IEEE INDEX_INCR DIRECT NO_AXIS_PTS_X 1 UBYTE ALIGNMENT_BYTE 1 ALIGNMENT_WORD 1 ALIGNMENT_LONG 1 ALIGNMENT_FLOAT32_IEEE 1 ALIGNMENT_FLOAT64_IEEE 1 /end RECORD_LAYOUT
/begin RECORD_LAYOUT CurveNxXVub FNC_VALUES 3 UBYTE ROW_DIR DIRECT AXIS_PTS_X 2 UBYTE INDEX_INCR DIRECT NO_AXIS_PTS_X 1 UBYTE /end RECORD_LAYOUT
/begin RECORD_LAYOUT CurveV8ub FNC_VALUES 1 UBYTE ROW_DIR DIRECT FIX_NO_AXIS_PTS_X 8 /end RECORD_LAYOUT
/begin RECORD_LAYOUT CurveVub FNC_VALUES 1 UBYTE ROW_DIR DIRECT /end RECORD_LAYOUT
/begin RECORD_LAYOUT CurveX8V8ub FNC_VALUES 2 UBYTE ROW_DIR DIRECT AXIS_PTS_X 1 UBYTE INDEX_INCR DIRECT FIX_NO_AXIS_PTS_X 8 /end RECORD_LAYOUT
/begin RECORD_LAYOUT CurveX8V8uwAlternate FNC_VALUES 2 UWORD ALTERNATE_WITH_X DIRECT AXIS_PTS_X 1 UWORD INDEX_INCR DIRECT FIX_NO_AXIS_PTS_X 8 ALIGNMENT_BYTE 1 ALIGNMENT_WORD 1 ALIGNMENT_LONG 1 ALIGNMENT_FLOAT32_IEEE 1 ALIGNMENT_FLOAT64_IEEE 1 /end RECORD_LAYOUT
/begin RECORD_LAYOUT CurveX8ub AXIS_PTS_X 1 UBYTE INDEX_INCR DIRECT FIX_NO_AXIS_PTS_X 8 /end RECORD_LAYOUT
/begin RECORD_LAYOUT MapColRowuw FNC_VALUES 1 UWORD COLUMN_DIR DIRECT /end RECORD_LAYOUT
/begin RECORD_LAYOUT MapNxNyVub FNC_VALUES 3 UBYTE ROW_DIR DIRECT NO_AXIS_PTS_X 1 UBYTE NO_AXIS_PTS_Y 2 UBYTE /end RECORD_LAYOUT
/begin RECORD_LAYOUT MapNxNyXYVub FNC_VALUES 5 UBYTE ROW_DIR DIRECT AXIS_PTS_X 3 UBYTE INDEX_INCR DIRECT AXIS_PTS_Y 4 UBYTE INDEX_INCR DIRECT NO_AXIS_PTS_X 1 UBYTE NO_AXIS_PTS_Y 2 UBYTE /end RECORD_LAYOUT
/begin RECORD_LAYOUT MapNxXNyYVuc FNC_VALUES 5 UBYTE ROW_DIR DIRECT AXIS_PTS_X 2 UBYTE INDEX_INCR DIRECT AXIS_PTS_Y 4 UBYTE INDEX_INCR DIRECT NO_AXIS_PTS_X 1 UBYTE NO_AXIS_PTS_Y 3 UBYTE /end RECORD_LAYOUT
/begin RECORD_LAYOUT MapRowColub FNC_VALUES 1 UBYTE ROW_DIR DIRECT /end RECORD_LAYOUT
/begin RECORD_LAYOUT MapV86ub FNC_VALUES 1 UBYTE ROW_DIR DIRECT FIX_NO_AXIS_PTS_X 8 FIX_NO_AXIS_PTS_Y 6 /end RECORD_LAYOUT
/begin RECORD_LAYOUT MapX8Y6V86ub FNC_VALUES 3 UBYTE ROW_DIR DIRECT AXIS_PTS_X 1 UBYTE INDEX_INCR DIRECT AXIS_PTS_Y 2 UBYTE INDEX_INCR DIRECT FIX_NO_AXIS_PTS_X 8 FIX_NO_AXIS_PTS_Y 6 /end RECORD_LAYOUT
/begin RECORD_LAYOUT MapX8Y8V88ub FNC_VALUES 3 UBYTE ROW_DIR DIRECT AXIS_PTS_X 1 UBYTE INDEX_INCR DIRECT AXIS_PTS_Y 2 UBYTE INDEX_INCR DIRECT FIX_NO_AXIS_PTS_X 8 FIX_NO_AXIS_PTS_Y 8 /end RECORD_LAYOUT
/begin RECORD_LAYOUT MapXYVub FNC_VALUES 3 UBYTE ROW_DIR DIRECT AXIS_PTS_X 1 UBYTE INDEX_INCR DIRECT AXIS_PTS_Y 2 UBYTE INDEX_INCR DIRECT /end RECORD_LAYOUT
/begin RECORD_LAYOUT __UBYTE_Z FNC_VALUES 1 UBYTE ROW_DIR DIRECT /end RECORD_LAYOUT
/begin RECORD_LAYOUT __UWORD_Z FNC_VALUES 1 UWORD ROW_DIR DIRECT /end RECORD_LAYOUT
/begin RECORD_LAYOUT __ULONG_Z FNC_VALUES 1 ULONG ROW_DIR DIRECT /end RECORD_LAYOUT
/begin RECORD_LAYOUT __SBYTE_Z FNC_VALUES 1 SBYTE ROW_DIR DIRECT /end RECORD_LAYOUT
/begin RECORD_LAYOUT __SWORD_Z FNC_VALUES 1 SWORD ROW_DIR DIRECT /end RECORD_LAYOUT
/begin RECORD_LAYOUT __SLONG_Z FNC_VALUES 1 SLONG ROW_DIR DIRECT /end RECORD_LAYOUT
/begin RECORD_LAYOUT __FLOAT32_IEEE_Z FNC_VALUES 1 FLOAT32_IEEE ROW_DIR DIRECT /end RECORD_LAYOUT
/begin RECORD_LAYOUT __FLOAT64_IEEE_Z FNC_VALUES 1 FLOAT64_IEEE ROW_DIR DIRECT /end RECORD_LAYOUT
/begin RECORD_LAYOUT __UBYTE_S FNC_VALUES 1 UBYTE COLUMN_DIR DIRECT /end RECORD_LAYOUT
/begin RECORD_LAYOUT __UWORD_S FNC_VALUES 1 UWORD COLUMN_DIR DIRECT /end RECORD_LAYOUT
/begin RECORD_LAYOUT __ULONG_S FNC_VALUES 1 ULONG COLUMN_DIR DIRECT /end RECORD_LAYOUT
/begin RECORD_LAYOUT __SBYTE_S FNC_VALUES 1 SBYTE COLUMN_DIR DIRECT /end RECORD_LAYOUT
/begin RECORD_LAYOUT __SWORD_S FNC_VALUES 1 SWORD COLUMN_DIR DIRECT /end RECORD_LAYOUT
/begin RECORD_LAYOUT __SLONG_S FNC_VALUES 1 SLONG COLUMN_DIR DIRECT /end RECORD_LAYOUT
/begin RECORD_LAYOUT __FLOAT32_IEEE_S FNC_VALUES 1 FLOAT32_IEEE COLUMN_DIR DIRECT /end RECORD_LAYOUT
/begin RECORD_LAYOUT __FLOAT64_IEEE_S FNC_VALUES 1 FLOAT64_IEEE COLUMN_DIR DIRECT /end RECORD_LAYOUT
/begin RECORD_LAYOUT SSV__UBYTE_S AXIS_PTS_X 1 UBYTE INDEX_INCR DIRECT /end RECORD_LAYOUT
/begin RECORD_LAYOUT SSV__UWORD_S AXIS_PTS_X 1 UWORD INDEX_INCR DIRECT /end RECORD_LAYOUT
/begin RECORD_LAYOUT SSV__ULONG_S AXIS_PTS_X 1 ULONG INDEX_INCR DIRECT /end RECORD_LAYOUT
/begin RECORD_LAYOUT SSV__SBYTE_S AXIS_PTS_X 1 SBYTE INDEX_INCR DIRECT /end RECORD_LAYOUT
/begin RECORD_LAYOUT SSV__SWORD_S AXIS_PTS_X 1 SWORD INDEX_INCR DIRECT /end RECORD_LAYOUT
/begin RECORD_LAYOUT SSV__SLONG_S AXIS_PTS_X 1 SLONG INDEX_INCR DIRECT /end RECORD_LAYOUT
/begin RECORD_LAYOUT SSV__FLOAT32_IEEE_S AXIS_PTS_X 1 FLOAT32_IEEE INDEX_INCR DIRECT /end RECORD_LAYOUT
/begin RECORD_LAYOUT SSV__FLOAT64_IEEE_S AXIS_PTS_X 1 FLOAT64_IEEE INDEX_INCR DIRECT /end RECORD_LAYOUT
/end MODULE
/end PROJECT
