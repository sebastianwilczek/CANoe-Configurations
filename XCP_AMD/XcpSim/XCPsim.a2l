/* generated by ASAP2 Studio 1.2.10.3646 */
ASAP2_VERSION 1 70
/begin PROJECT XCPsim ""
/begin MODULE SIM ""
/begin MOD_PAR ""
 /begin MEMORY_SEGMENT CALRAM "" DATA FLASH INTERN 0x1C0000 0x1286 -1 -1 -1 -1 -1
  /begin IF_DATA XCP
   /begin SEGMENT 0x01 0x02 0x00 0x00 0x00 /begin CHECKSUM XCP_CRC_16_CITT MAX_BLOCK_SIZE 0xFFFF EXTERNAL_FUNCTION "" /end CHECKSUM
    /begin PAGE 0x01 ECU_ACCESS_WITH_XCP_ONLY XCP_READ_ACCESS_WITH_ECU_ONLY XCP_WRITE_ACCESS_NOT_ALLOWED /end PAGE
    /begin PAGE 0x00 ECU_ACCESS_WITH_XCP_ONLY XCP_READ_ACCESS_WITH_ECU_ONLY XCP_WRITE_ACCESS_WITH_ECU_ONLY /end PAGE
   /end SEGMENT
  /end IF_DATA
 /end MEMORY_SEGMENT
 /begin MEMORY_SEGMENT ECUCODE "" CODE FLASH INTERN 0x4C000 0x9CA5D -1 -1 -1 -1 -1
  /begin IF_DATA XCP
   /begin SEGMENT 0x00 0x01 0x00 0x00 0x00 /begin CHECKSUM XCP_CRC_16_CITT MAX_BLOCK_SIZE 0xFFFF EXTERNAL_FUNCTION "" /end CHECKSUM
    /begin PAGE 0x00 ECU_ACCESS_DONT_CARE XCP_READ_ACCESS_DONT_CARE XCP_WRITE_ACCESS_NOT_ALLOWED /end PAGE
   /end SEGMENT
  /end IF_DATA
 /end MEMORY_SEGMENT
/end MOD_PAR
/begin MOD_COMMON "" BYTE_ORDER MSB_LAST ALIGNMENT_BYTE 1 ALIGNMENT_WORD 1 ALIGNMENT_LONG 1 ALIGNMENT_FLOAT32_IEEE 1 ALIGNMENT_FLOAT64_IEEE 1 ALIGNMENT_INT64 1 /end MOD_COMMON
/begin IF_DATA XCP
 /begin PROTOCOL_LAYER 0x0100 0x07D0 0x07D0 0x00 0x00 0x00 0x00 0x00 0x08 0x08 BYTE_ORDER_MSB_LAST ADDRESS_GRANULARITY_BYTE OPTIONAL_CMD PROGRAM_NEXT OPTIONAL_CMD PROGRAM_RESET OPTIONAL_CMD PROGRAM OPTIONAL_CMD PROGRAM_CLEAR OPTIONAL_CMD PROGRAM_START OPTIONAL_CMD ALLOC_ODT_ENTRY OPTIONAL_CMD ALLOC_ODT OPTIONAL_CMD ALLOC_DAQ OPTIONAL_CMD FREE_DAQ OPTIONAL_CMD GET_DAQ_EVENT_INFO OPTIONAL_CMD GET_DAQ_RESOLUTION_INFO OPTIONAL_CMD GET_DAQ_PROCESSOR_INFO OPTIONAL_CMD GET_DAQ_CLOCK OPTIONAL_CMD START_STOP_SYNCH OPTIONAL_CMD START_STOP_DAQ_LIST OPTIONAL_CMD GET_DAQ_LIST_MODE OPTIONAL_CMD SET_DAQ_LIST_MODE OPTIONAL_CMD WRITE_DAQ OPTIONAL_CMD SET_DAQ_PTR OPTIONAL_CMD CLEAR_DAQ_LIST OPTIONAL_CMD GET_CAL_PAGE OPTIONAL_CMD SET_CAL_PAGE OPTIONAL_CMD DOWNLOAD OPTIONAL_CMD BUILD_CHECKSUM OPTIONAL_CMD SHORT_UPLOAD OPTIONAL_CMD UPLOAD OPTIONAL_CMD SET_MTA OPTIONAL_CMD UNLOCK OPTIONAL_CMD GET_SEED OPTIONAL_CMD GET_ID OPTIONAL_CMD GET_COMM_MODE_INFO COMMUNICATION_MODE_SUPPORTED BLOCK SLAVE MASTER 0x2B 0x00 SEED_AND_KEY_EXTERNAL_FUNCTION "SeedNKeyXcp.dll" /end PROTOCOL_LAYER
 /begin DAQ DYNAMIC 0x00 0x06 0x00 OPTIMISATION_TYPE_DEFAULT ADDRESS_EXTENSION_FREE IDENTIFICATION_FIELD_TYPE_RELATIVE_BYTE GRANULARITY_ODT_ENTRY_SIZE_DAQ_BYTE 0x06 OVERLOAD_INDICATION_PID PRESCALER_SUPPORTED RESUME_SUPPORTED /begin STIM GRANULARITY_ODT_ENTRY_SIZE_STIM_BYTE 0x06 /end STIM /begin TIMESTAMP_SUPPORTED 0x0A SIZE_DWORD UNIT_10US /end TIMESTAMP_SUPPORTED /begin EVENT "Key T" "Key T" 0x00 DAQ 0x01 0x00 0x06 0x00 /end EVENT /begin EVENT "10 ms" "10 ms" 0x01 DAQ_STIM 0x01 0x0A 0x06 0x01 /end EVENT /begin EVENT "100ms" "100ms" 0x02 DAQ_STIM 0x01 0x64 0x06 0x02 /end EVENT /begin EVENT "1ms" "1ms" 0x03 DAQ_STIM 0x01 0x01 0x06 0x03 /end EVENT
  /begin EVENT "FilterBypassDaq" "FilterByp" 0x04 DAQ_STIM 0x01 0x0A 0x06 0x04 /end EVENT
  /begin EVENT "FilterBypassStim" "FilterByp" 0x05 STIM 0x01 0x0A 0x06 0x05 /end EVENT
 /end DAQ
 /begin PAG 0x02 /end PAG
 /begin PGM PGM_MODE_ABSOLUTE 0x01 0x00 /begin SECTOR "FLASH" 0x00 0x1C0000 0x1286 0x00 0x00 0x00 /end SECTOR /end PGM
 /begin XCP_ON_CAN 0x0100 CAN_ID_MASTER 0x01 CAN_ID_SLAVE 0x02 BAUDRATE 0x07A120 SAMPLE_POINT 0x4B SAMPLE_RATE SINGLE BTL_CYCLES 0x08 SJW 0x02 SYNC_EDGE SINGLE /end XCP_ON_CAN
 /begin XCP_ON_FLX 0x0100 0x03E8 "XCPsim.xml" "Cluster_1" 0x01 HEADER_NAX_LEN PACKET_ALIGNMENT_8
  /begin INITIAL_CMD_BUFFER 0x00
   /begin LPDU_ID FLX_SLOT_ID FIXED 0xDB OFFSET FIXED 0x00 CYCLE_REPETITION FIXED 0x01 CHANNEL FIXED A /end LPDU_ID
   /begin XCP_PACKET CMD FIXED RES_ERR NOT_ALLOWED EV_SERV NOT_ALLOWED DAQ NOT_ALLOWED STIM NOT_ALLOWED /end XCP_PACKET
   MAX_FLX_LEN_BUF VARIABLE 0xAA /end INITIAL_CMD_BUFFER
  /begin INITIAL_RES_ERR_BUFFER 0x01
   /begin LPDU_ID FLX_SLOT_ID FIXED 0xDC OFFSET FIXED 0x00 CYCLE_REPETITION FIXED 0x01 CHANNEL FIXED A /end LPDU_ID
   /begin XCP_PACKET CMD NOT_ALLOWED RES_ERR FIXED EV_SERV FIXED DAQ NOT_ALLOWED STIM NOT_ALLOWED /end XCP_PACKET
   MAX_FLX_LEN_BUF VARIABLE 0xAA /end INITIAL_RES_ERR_BUFFER
  /begin POOL_BUFFER 0x02 MAX_FLX_LEN_BUF VARIABLE 0xFE
   /begin LPDU_ID FLX_SLOT_ID VARIABLE INITIAL_VALUE 0x5C OFFSET VARIABLE INITIAL_VALUE 0x00 CYCLE_REPETITION FIXED 0x01 CHANNEL FIXED A /end LPDU_ID
   /begin XCP_PACKET CMD NOT_ALLOWED RES_ERR NOT_ALLOWED EV_SERV NOT_ALLOWED DAQ FIXED STIM NOT_ALLOWED /end XCP_PACKET
  /end POOL_BUFFER
  /begin POOL_BUFFER 0x03 MAX_FLX_LEN_BUF VARIABLE 0xFE
   /begin LPDU_ID FLX_SLOT_ID VARIABLE INITIAL_VALUE 0x5D OFFSET VARIABLE INITIAL_VALUE 0x00 CYCLE_REPETITION VARIABLE INITIAL_VALUE 0x01 CHANNEL FIXED A /end LPDU_ID
   /begin XCP_PACKET CMD NOT_ALLOWED RES_ERR NOT_ALLOWED EV_SERV NOT_ALLOWED DAQ FIXED STIM NOT_ALLOWED /end XCP_PACKET
  /end POOL_BUFFER
  /begin POOL_BUFFER 0x04 MAX_FLX_LEN_BUF VARIABLE 0x80
   /begin LPDU_ID FLX_SLOT_ID VARIABLE INITIAL_VALUE 0x5E OFFSET VARIABLE INITIAL_VALUE 0x00 CYCLE_REPETITION VARIABLE INITIAL_VALUE 0x01 CHANNEL FIXED A /end LPDU_ID
   /begin XCP_PACKET CMD NOT_ALLOWED RES_ERR NOT_ALLOWED EV_SERV NOT_ALLOWED DAQ FIXED STIM NOT_ALLOWED /end XCP_PACKET
  /end POOL_BUFFER
  /begin POOL_BUFFER 0x05 MAX_FLX_LEN_BUF VARIABLE 0x80
   /begin LPDU_ID FLX_SLOT_ID VARIABLE INITIAL_VALUE 0x5F OFFSET VARIABLE INITIAL_VALUE 0x00 CYCLE_REPETITION VARIABLE INITIAL_VALUE 0x01 CHANNEL FIXED A /end LPDU_ID
   /begin XCP_PACKET CMD NOT_ALLOWED RES_ERR NOT_ALLOWED EV_SERV NOT_ALLOWED DAQ FIXED STIM NOT_ALLOWED /end XCP_PACKET
  /end POOL_BUFFER
 /end XCP_ON_FLX
 /begin XCP_ON_TCP_IP 0x00 0x15B3 ADDRESS "127.0.0.1" /end XCP_ON_TCP_IP
 /begin XCP_ON_UDP_IP 0x00 0x15B3 ADDRESS "127.0.0.1" /end XCP_ON_UDP_IP
/end IF_DATA
/begin IF_DATA GENERIC_BSW_TEMPLATE_VERSION 0x010234 /end IF_DATA
/begin MEASUREMENT BitSlice "Testsignal: 4 Bit on a byte boundary" UWORD wordCounter.CONVERSION 0 0 0 15 BIT_MASK 0x3C0 ECU_ADDRESS 0x1BE5A0 FORMAT "%.3" SYMBOL_LINK "wordCounter" 0 /end MEASUREMENT
/begin MEASUREMENT BitSlice0 "Testsignal: 5 Bit" UWORD wordCounter.CONVERSION 0 0 0 31 BIT_MASK 0x1F ECU_ADDRESS 0x1BE5A0 FORMAT "%.3" SYMBOL_LINK "wordCounter" 0 /end MEASUREMENT
/begin MEASUREMENT BitSlice1 "Testsignal: 5 Bit " UWORD wordCounter.CONVERSION 0 0 0 31 BIT_MASK 0x3E0 ECU_ADDRESS 0x1BE5A0 FORMAT "%.3" SYMBOL_LINK "wordCounter" 0 /end MEASUREMENT
/begin MEASUREMENT BitSlice2 "Testsignal: 5 Bit " UWORD wordCounter.CONVERSION 0 0 0 63 BIT_MASK 0xFC ECU_ADDRESS 0x1BE5A1 FORMAT "%.3" SYMBOL_LINK "wordCounter" 1 /end MEASUREMENT
/begin MEASUREMENT Counter_B4 "Single bit demo signal (bit from a byte shifting)" UBYTE HighLow 0 0 0 1 BIT_MASK 0x10 ECU_ADDRESS 0x1BE269 FORMAT "%.3" READ_WRITE SYMBOL_LINK "byteCounter" 0 /end MEASUREMENT
/begin MEASUREMENT Counter_B5 "Single bit demo signal (bit from a byte shifting)" UBYTE HighLow 0 0 0 1 BIT_MASK 0x20 ECU_ADDRESS 0x1BE269 FORMAT "%.3" READ_WRITE SYMBOL_LINK "byteCounter" 0 /end MEASUREMENT
/begin MEASUREMENT Counter_B6 "Single bit demo signal (bit from a byte shifting)" UBYTE HighLow 0 0 0 1 BIT_MASK 0x40 ECU_ADDRESS 0x1BE269 FORMAT "%.3" READ_WRITE SYMBOL_LINK "byteCounter" 0 /end MEASUREMENT
/begin MEASUREMENT Counter_B7 "Single bit demo signal (bit from a byte shifting)" UBYTE HighLow 0 0 0 1 BIT_MASK 0x80 ECU_ADDRESS 0x1BE269 FORMAT "%.3" READ_WRITE SYMBOL_LINK "byteCounter" 0 /end MEASUREMENT
/begin AXIS_PTS Curve1 "Curve used as axis" 0x1C07E4 NO_INPUT_QUANTITY SSV__UBYTE_S 0 wordCounter.CONVERSION 8 0 255 DEPOSIT ABSOLUTE FORMAT "%.3" SYMBOL_LINK "curve1_8_uc" 0 /end AXIS_PTS
/begin AXIS_PTS Curve2 "Curve used as axis" 0x1C08EC NO_INPUT_QUANTITY CurveX8ub 0 wordCounter.CONVERSION 8 0 255 DEPOSIT ABSOLUTE FORMAT "%.3" SYMBOL_LINK "curve2_8_uc" 0 /end AXIS_PTS
/begin AXIS_PTS Curve3 "Curve used as axis" 0x1C097C NO_INPUT_QUANTITY SSV__UBYTE_S 0 wordCounter.CONVERSION 6 0 255 DEPOSIT ABSOLUTE FORMAT "%.3" SYMBOL_LINK "curve3_8_uc" 0 /end AXIS_PTS
/begin MEASUREMENT FW1 "Testparameter" UBYTE wordCounter.CONVERSION 0 0 0 255 ECU_ADDRESS 0x1C00AA FORMAT "%.3" READ_WRITE SYMBOL_LINK "byte4" 0 /end MEASUREMENT
/begin CHARACTERISTIC KF1 "8*8 BYTE no axis" MAP 0x1C0550 __UBYTE_Z 0 Factor100 0 2.55
 /begin AXIS_DESCR FIX_AXIS NO_INPUT_QUANTITY wordCounter.CONVERSION 8 0 7 FIX_AXIS_PAR_DIST 0 1 8 FORMAT "%.0" /end AXIS_DESCR
 /begin AXIS_DESCR FIX_AXIS NO_INPUT_QUANTITY wordCounter.CONVERSION 8 0 7 FIX_AXIS_PAR_DIST 0 1 8 FORMAT "%.0" /end AXIS_DESCR
 FORMAT "%.3" SYMBOL_LINK "map3_8_8_uc" 0 /end CHARACTERISTIC
/begin CHARACTERISTIC KF2 "8*8 BYTE shared axis Curve1/Curve1" MAP 0x1C00D0 __UBYTE_Z 0 wordCounter.CONVERSION 0 255
 /begin AXIS_DESCR COM_AXIS NO_INPUT_QUANTITY wordCounter.CONVERSION 8 0 255 AXIS_PTS_REF Curve1 DEPOSIT ABSOLUTE FORMAT "%.3" /end AXIS_DESCR
 /begin AXIS_DESCR COM_AXIS NO_INPUT_QUANTITY wordCounter.CONVERSION 8 0 255 AXIS_PTS_REF Curve2 DEPOSIT ABSOLUTE FORMAT "%.3" /end AXIS_DESCR
 FORMAT "%.3" SYMBOL_LINK "map1_8_8_uc" 0 /end CHARACTERISTIC
/begin CHARACTERISTIC KF3 "8*6 BYTE no axis" MAP 0x1C00D0 __UBYTE_Z 0 wordCounter.CONVERSION 0 255
 /begin AXIS_DESCR FIX_AXIS NO_INPUT_QUANTITY wordCounter.CONVERSION 8 0 7 FIX_AXIS_PAR_DIST 0 1 8 FORMAT "%.0" /end AXIS_DESCR
 /begin AXIS_DESCR FIX_AXIS NO_INPUT_QUANTITY wordCounter.CONVERSION 6 0 5 FIX_AXIS_PAR_DIST 0 1 6 FORMAT "%.0" /end AXIS_DESCR
 FORMAT "%.3" SYMBOL_LINK "map1_8_8_uc" 0 /end CHARACTERISTIC
/begin CHARACTERISTIC KF4 "8*6 BYTE shared axis Curve1" MAP 0x1C00D0 __UBYTE_Z 0 wordCounter.CONVERSION 0 255
 /begin AXIS_DESCR COM_AXIS NO_INPUT_QUANTITY wordCounter.CONVERSION 8 0 255 AXIS_PTS_REF Curve1 DEPOSIT ABSOLUTE FORMAT "%.3" /end AXIS_DESCR
 /begin AXIS_DESCR FIX_AXIS NO_INPUT_QUANTITY wordCounter.CONVERSION 6 0 5 FIX_AXIS_PAR_DIST 0 1 6 FORMAT "%.0" /end AXIS_DESCR
 FORMAT "%.3" SYMBOL_LINK "map1_8_8_uc" 0 /end CHARACTERISTIC
/begin CHARACTERISTIC KF5 "8*6 BYTE memory layout MapX8Y6V86ub" MAP 0x1C0670 MapX8Y6V86ub 0 wordCounter.CONVERSION 0 255
 /begin AXIS_DESCR STD_AXIS NO_INPUT_QUANTITY wordCounter.CONVERSION 8 0 255 DEPOSIT ABSOLUTE FORMAT "%.3" /end AXIS_DESCR
 /begin AXIS_DESCR STD_AXIS NO_INPUT_QUANTITY wordCounter.CONVERSION 6 0 255 DEPOSIT ABSOLUTE FORMAT "%.3" /end AXIS_DESCR
 FORMAT "%.3" SYMBOL_LINK "map_kf5" 0 /end CHARACTERISTIC
/begin CHARACTERISTIC KF6 "8*8 BYTE no axis" MAP 0x1C00D0 __UBYTE_Z 0 wordCounter.CONVERSION 0 255
 /begin AXIS_DESCR FIX_AXIS NO_INPUT_QUANTITY wordCounter.CONVERSION 8 0 7 FIX_AXIS_PAR_DIST 0 1 8 FORMAT "%.0" /end AXIS_DESCR
 /begin AXIS_DESCR FIX_AXIS NO_INPUT_QUANTITY wordCounter.CONVERSION 8 0 7 FIX_AXIS_PAR_DIST 0 1 8 FORMAT "%.0" /end AXIS_DESCR
 FORMAT "%.3" SYMBOL_LINK "map1_8_8_uc" 0 /end CHARACTERISTIC
/begin CHARACTERISTIC KF7 "8*8 BYTE memory layout MapV86ub, shared axis Curve1/Curve1" MAP 0x1C04D0 MapV86ub 0 wordCounter.CONVERSION 0 255
 /begin AXIS_DESCR COM_AXIS NO_INPUT_QUANTITY wordCounter.CONVERSION 8 0 255 AXIS_PTS_REF Curve1 DEPOSIT ABSOLUTE FORMAT "%.3" /end AXIS_DESCR
 /begin AXIS_DESCR COM_AXIS NO_INPUT_QUANTITY wordCounter.CONVERSION 8 0 255 AXIS_PTS_REF Curve2 DEPOSIT ABSOLUTE FORMAT "%.3" /end AXIS_DESCR
 FORMAT "%.3" SYMBOL_LINK "map2_8_8_uc" 0 /end CHARACTERISTIC
/begin CHARACTERISTIC KF8 "8*6 BYTE memory layout MapV86ub, fixed axis " MAP 0x1C0550 MapV86ub 0 KF8_Conversion 0 10
 /begin AXIS_DESCR FIX_AXIS NO_INPUT_QUANTITY KF8_Conversion 8 0 25.5 FIX_AXIS_PAR_DIST 0 2 8 FORMAT "%.1" /end AXIS_DESCR
 /begin AXIS_DESCR FIX_AXIS NO_INPUT_QUANTITY KF8_Y_AXIS.CONVERSION 6 0 25.5 FIX_AXIS_PAR_DIST 0 5 6 FORMAT "%.1" /end AXIS_DESCR
 FORMAT "%.2" SYMBOL_LINK "map3_8_8_uc" 0 /end CHARACTERISTIC
/begin CHARACTERISTIC KL1 "16 BYTE curve" VAL_BLK 0x1C06F0 __UBYTE_Z 0 wordCounter.CONVERSION 0 255 FORMAT "%.3" MATRIX_DIM 16 1 1 SYMBOL_LINK "curve5_16_uc" 0 /end CHARACTERISTIC
/begin CHARACTERISTIC KL2 "8 BYTE shared axis Curve2" CURVE 0x1C07E4 __UBYTE_Z 0 wordCounter.CONVERSION 0 255
 /begin AXIS_DESCR COM_AXIS NO_INPUT_QUANTITY wordCounter.CONVERSION 8 0 255 AXIS_PTS_REF Curve2 DEPOSIT ABSOLUTE FORMAT "%.3" /end AXIS_DESCR
 FORMAT "%.3" SYMBOL_LINK "curve1_8_uc" 0 /end CHARACTERISTIC
/begin CHARACTERISTIC KL3 "8 BYTE CurveX8V8ub" CURVE 0x1C098C CurveX8V8ub 0 wordCounter.CONVERSION 0 255
 /begin AXIS_DESCR STD_AXIS NO_INPUT_QUANTITY wordCounter.CONVERSION 8 0 255 DEPOSIT ABSOLUTE FORMAT "%.3" /end AXIS_DESCR
 FORMAT "%.3" SYMBOL_LINK "curve4_8_uc" 0 /end CHARACTERISTIC
/begin CHARACTERISTIC KL4 "8 BYTE CurveV8ub" VAL_BLK 0x1C098C CurveV8ub 0 wordCounter.CONVERSION 0 255 FORMAT "%.3" MATRIX_DIM 8 1 1 SYMBOL_LINK "curve4_8_uc" 0 /end CHARACTERISTIC
/begin CHARACTERISTIC KL5 "8 BYTE CurveV8ub shared axis Curve2" CURVE 0x1C07E4 CurveV8ub 0 wordCounter.CONVERSION 0 255
 /begin AXIS_DESCR COM_AXIS NO_INPUT_QUANTITY wordCounter.CONVERSION 8 0 255 AXIS_PTS_REF Curve2 DEPOSIT ABSOLUTE FORMAT "%.3" /end AXIS_DESCR
 FORMAT "%.3" SYMBOL_LINK "curve1_8_uc" 0 /end CHARACTERISTIC
/begin CHARACTERISTIC KL6 "8 BYTE CurveV8ub fixed axis" CURVE 0x1C097C CurveV8ub 0 wordCounter.CONVERSION 0 255
 /begin AXIS_DESCR FIX_AXIS NO_INPUT_QUANTITY wordCounter.CONVERSION 8 0 255 FIX_AXIS_PAR_DIST 0 8 8 FORMAT "%.3" /end AXIS_DESCR
 FORMAT "%.3" SYMBOL_LINK "curve3_8_uc" 0 /end CHARACTERISTIC
/begin CHARACTERISTIC KL7 "" CURVE 0x1C0770 CurveX8V8ubAlternate 0 Factor100 0 500
 /begin AXIS_DESCR STD_AXIS NO_INPUT_QUANTITY Factor100 8 0 655.35 DEPOSIT ABSOLUTE FORMAT "%.3" /end AXIS_DESCR
 FORMAT "%.3" SYMBOL_LINK "curve5_16_uc4" 0 /end CHARACTERISTIC
/begin CHARACTERISTIC KL8 "" MAP 0x1C0770 __UBYTE_Z 0 Factor100 0 655.35
 /begin AXIS_DESCR FIX_AXIS NO_INPUT_QUANTITY wordCounter.CONVERSION 2 0 1 FIX_AXIS_PAR_DIST 0 1 2 FORMAT "%.0" /end AXIS_DESCR
 /begin AXIS_DESCR FIX_AXIS NO_INPUT_QUANTITY wordCounter.CONVERSION 8 0 7 FIX_AXIS_PAR_DIST 0 1 8 FORMAT "%.0" /end AXIS_DESCR
 FORMAT "%.3" SYMBOL_LINK "curve5_16_uc4" 0 /end CHARACTERISTIC
/begin MEASUREMENT PWM "Pulse width signal from PWM_level and Triangle" UBYTE HighLow 0 0 0 255 ECU_ADDRESS 0x1BE0CF FORMAT "%.0" SYMBOL_LINK "bytePWM" 0 /end MEASUREMENT
/begin MEASUREMENT PWMFiltered "Low pass filtered PWM signal" UBYTE wordCounter.CONVERSION 0 0 0 255 ECU_ADDRESS 0x1BE5A3 FORMAT "%.3" SYMBOL_LINK "bytePWMFiltered" 0 /end MEASUREMENT
/begin MEASUREMENT PWM_Level "" SBYTE wordCounter.CONVERSION 0 0 -50 50 ECU_ADDRESS 0x1C0003 FORMAT "%.0" READ_WRITE SYMBOL_LINK "sbytePWMLevel" 0 /end MEASUREMENT
/begin MEASUREMENT ShiftByte "" UBYTE wordCounter.CONVERSION 0 0 0 255 ECU_ADDRESS 0x1BE5A2 FORMAT "%.3" SYMBOL_LINK "byteShift" 0 /end MEASUREMENT
/begin MEASUREMENT Shifter_B0 "Single bit demo signal (bit from a byte shifting)" UBYTE HighLow 0 0 0 1 BIT_MASK 0x1 ECU_ADDRESS 0x1BE5A2 FORMAT "%.3" READ_WRITE SYMBOL_LINK "byteShift" 0 /end MEASUREMENT
/begin MEASUREMENT Shifter_B1 "Single bit demo signal (bit from a byte shifting)" UBYTE HighLow 0 0 0 1 BIT_MASK 0x2 ECU_ADDRESS 0x1BE5A2 FORMAT "%.3" READ_WRITE SYMBOL_LINK "byteShift" 0 /end MEASUREMENT
/begin MEASUREMENT Shifter_B2 "Single bit demo signal (bit from a byte shifting)" UBYTE HighLow 0 0 0 1 BIT_MASK 0x4 ECU_ADDRESS 0x1BE5A2 FORMAT "%.3" READ_WRITE SYMBOL_LINK "byteShift" 0 /end MEASUREMENT
/begin MEASUREMENT Shifter_B3 "Single bit demo signal (bit from a byte shifting)" UBYTE HighLow 0 0 0 1 BIT_MASK 0x8 ECU_ADDRESS 0x1BE5A2 FORMAT "%.3" READ_WRITE SYMBOL_LINK "byteShift" 0 /end MEASUREMENT
/begin CHARACTERISTIC Simulator_concept "" VALUE 0x1BF000 __SLONG_S 0 Simulator_concept.CONVERSION -2147483648 2147483647 FORMAT "%.15" /end CHARACTERISTIC
/begin CHARACTERISTIC TestKennfeld "" MAP 0x1C1208 MapNxNyXYVsb 0 wordCounter.CONVERSION 0 255
 /begin AXIS_DESCR STD_AXIS NO_INPUT_QUANTITY wordCounter.CONVERSION 10 0 255 DEPOSIT ABSOLUTE FORMAT "%.3" /end AXIS_DESCR
 /begin AXIS_DESCR STD_AXIS NO_INPUT_QUANTITY wordCounter.CONVERSION 10 0 255 DEPOSIT ABSOLUTE FORMAT "%.3" /end AXIS_DESCR
 FORMAT "%.3" SYMBOL_LINK "TestArray_Max_10_10" 0 /end CHARACTERISTIC
/begin MEASUREMENT TestStatus "2 bit demo signal with symbolic conversion formula" UBYTE TestStatus.CONVERSION 0 0 0 3 BIT_MASK 0xC0 ECU_ADDRESS 0x1BE269 FORMAT "%.0" READ_WRITE SYMBOL_LINK "byteCounter" 0 /end MEASUREMENT
/begin CHARACTERISTIC TestStruct1.s0 "" VALUE 0x1BE110 __ULONG_S 0 TestStructTypes.usTest.CONVERSION 0 4294967295 FORMAT "%.15" /end CHARACTERISTIC
/begin CHARACTERISTIC TestStruct1.s1 "" VALUE 0x1BE118 __FLOAT64_IEEE_S 0 TestStructTypes.usTest.CONVERSION -1.7E+308 1.7E+308 FORMAT "%.15" /end CHARACTERISTIC
/begin CHARACTERISTIC TestStruct2[000].s0 "" VALUE 0x1BE5B8 __ULONG_S 0 TestStructTypes.usTest.CONVERSION 0 4294967295 FORMAT "%.15" /end CHARACTERISTIC
/begin CHARACTERISTIC TestStruct2[000].s1 "" VALUE 0x1BE5C0 __FLOAT64_IEEE_S 0 TestStructTypes.usTest.CONVERSION -1.7E+308 1.7E+308 FORMAT "%.15" /end CHARACTERISTIC
/begin CHARACTERISTIC TestStruct2[001].s0 "" VALUE 0x1BE5C8 __ULONG_S 0 TestStructTypes.usTest.CONVERSION 0 4294967295 FORMAT "%.15" /end CHARACTERISTIC
/begin CHARACTERISTIC TestStruct2[001].s1 "" VALUE 0x1BE5D0 __FLOAT64_IEEE_S 0 TestStructTypes.usTest.CONVERSION -1.7E+308 1.7E+308 FORMAT "%.15" /end CHARACTERISTIC
/begin CHARACTERISTIC TestStructStruct1.TestStruct2.s0 "" VALUE 0x1BE0B8 __ULONG_S 0 TestStructTypes.usTest.CONVERSION 0 4294967295 FORMAT "%.15" /end CHARACTERISTIC
/begin CHARACTERISTIC TestStructStruct1.TestStruct2.s1 "" VALUE 0x1BE0C0 __FLOAT64_IEEE_S 0 TestStructTypes.usTest.CONVERSION -1.7E+308 1.7E+308 FORMAT "%.15" /end CHARACTERISTIC
/begin CHARACTERISTIC TestStructStruct1.doubles "" VALUE 0x1BE0B0 __FLOAT64_IEEE_S 0 TestStructTypes.usTest.CONVERSION -1.7E+308 1.7E+308 FORMAT "%.15" /end CHARACTERISTIC
/begin CHARACTERISTIC TestStructStruct1.ints "" VALUE 0x1BE0A8 __ULONG_S 0 TestStructTypes.usTest.CONVERSION 0 4294967295 FORMAT "%.15" /end CHARACTERISTIC
/begin CHARACTERISTIC TestStructTypes.cTest "" VALUE 0x1BE128 __SBYTE_S 0 TestStructTypes.usTest.CONVERSION -128 127 FORMAT "%.15" /end CHARACTERISTIC
/begin CHARACTERISTIC TestStructTypes.dTest "" VALUE 0x1BE148 __FLOAT64_IEEE_S 0 TestStructTypes.usTest.CONVERSION -1.7E+308 1.7E+308 FORMAT "%.15" /end CHARACTERISTIC
/begin CHARACTERISTIC TestStructTypes.fTest "" VALUE 0x1BE140 __FLOAT32_IEEE_S 0 TestStructTypes.usTest.CONVERSION -3.4E+38 3.4E+38 FORMAT "%.15" /end CHARACTERISTIC
/begin CHARACTERISTIC TestStructTypes.iTest "" VALUE 0x1BE130 __SLONG_S 0 TestStructTypes.usTest.CONVERSION -2147483648 2147483647 FORMAT "%.15" /end CHARACTERISTIC
/begin CHARACTERISTIC TestStructTypes.lTest "" VALUE 0x1BE138 __SLONG_S 0 TestStructTypes.usTest.CONVERSION -2147483648 2147483647 FORMAT "%.15" /end CHARACTERISTIC
/begin CHARACTERISTIC TestStructTypes.sTest "" VALUE 0x1BE12A __SWORD_S 0 TestStructTypes.usTest.CONVERSION -32768 32767 FORMAT "%.15" /end CHARACTERISTIC
/begin CHARACTERISTIC TestStructTypes.ucTest "" VALUE 0x1BE129 __UBYTE_S 0 TestStructTypes.usTest.CONVERSION 0 255 FORMAT "%.15" /end CHARACTERISTIC
/begin CHARACTERISTIC TestStructTypes.uiTest "" VALUE 0x1BE134 __ULONG_S 0 TestStructTypes.usTest.CONVERSION 0 4294967295 FORMAT "%.15" /end CHARACTERISTIC
/begin CHARACTERISTIC TestStructTypes.ulTest "" VALUE 0x1BE13C __ULONG_S 0 TestStructTypes.usTest.CONVERSION 0 4294967295 FORMAT "%.15" /end CHARACTERISTIC
/begin CHARACTERISTIC TestStructTypes.usTest "" VALUE 0x1BE12C __UWORD_S 0 TestStructTypes.usTest.CONVERSION 0 65535 FORMAT "%.15" /end CHARACTERISTIC
/begin MEASUREMENT Triangle "Triangle test signal used for PWM output PWM" SBYTE wordCounter.CONVERSION 0 0 -50 50 ECU_ADDRESS 0x1BE24F FORMAT "%.3" SYMBOL_LINK "sbyteTriangle" 0 /end MEASUREMENT
/begin CHARACTERISTIC a0 "Digital Filter v=(vin*a0+v*b0)/c0" VALUE 0x1C0054 __UWORD_S 0 DigitalFilterConversion 0 1 FORMAT "%.3" SYMBOL_LINK "a" 0 /end CHARACTERISTIC
/begin CHARACTERISTIC ampl "Amplitude of channel 1-3 " VALUE 0x1C002C __FLOAT32_IEEE_S 0 wordCounter.CONVERSION 0 200 FORMAT "%.3" /end CHARACTERISTIC
/begin CHARACTERISTIC ampl_d "" VALUE 0x1C0060 __FLOAT64_IEEE_S 0 TestStructTypes.usTest.CONVERSION 0 100 FORMAT "%.12" /end CHARACTERISTIC
/begin CHARACTERISTIC b0 "Digital Filter v=(vin*a0+v*b0)/c0" VALUE 0x1C00A8 __UWORD_S 0 DigitalFilterConversion 0 1 FORMAT "%.3" SYMBOL_LINK "b" 0 /end CHARACTERISTIC
/begin MEASUREMENT bytePWMFilter "Filter constant for PWM filter" UBYTE wordCounter.CONVERSION 0 0 0 100 ECU_ADDRESS 0x1C003E FORMAT "%.3" READ_WRITE /end MEASUREMENT
/begin CHARACTERISTIC c0 "Digital Filter v=(vin*a0+v*b0)/c0" VALUE 0x1C00AC __UWORD_S 0 DigitalFilterConversion 0 1 FORMAT "%.3" SYMBOL_LINK "c" 0 /end CHARACTERISTIC
/begin MEASUREMENT channel1 "FLOAT demo signal (sine wave)" FLOAT32_IEEE wordCounter.CONVERSION 0 0 -1E+12 1E+12 ECU_ADDRESS 0x1BE234 FORMAT "%.3" /end MEASUREMENT
/begin MEASUREMENT channel2 "FLOAT demo signal (sine wave)" FLOAT32_IEEE wordCounter.CONVERSION 0 0 -1E+12 1E+12 ECU_ADDRESS 0x1BE204 FORMAT "%.3" /end MEASUREMENT
/begin MEASUREMENT channel3 "FLOAT demo signal (sine wave)" FLOAT32_IEEE wordCounter.CONVERSION 0 0 -100 100 ECU_ADDRESS 0x1BD040 FORMAT "%.3" /end MEASUREMENT
/begin MEASUREMENT channel_d "" FLOAT64_IEEE TestStructTypes.usTest.CONVERSION 0 0 -100 100 ECU_ADDRESS 0x1BE208 FORMAT "%.12" /end MEASUREMENT
/begin CHARACTERISTIC curve_kl2 "" CURVE 0x1C09B0 __UBYTE_Z 0 NO_COMPU_METHOD 0 255
 /begin AXIS_DESCR FIX_AXIS NO_INPUT_QUANTITY NO_COMPU_METHOD 8 0 255 FIX_AXIS_PAR_DIST 0 1 8 FORMAT "%.15" /end AXIS_DESCR
 FORMAT "%.15" /end CHARACTERISTIC
/begin MEASUREMENT floatTestParam1 "" FLOAT32_IEEE NO_COMPU_METHOD 0 0 -3.40282346639E+38 3.40282346639E+38 ECU_ADDRESS 0x1BE22C FORMAT "%.15" READ_WRITE /end MEASUREMENT
/begin MEASUREMENT floatTestParam1_mea "" FLOAT32_IEEE NO_COMPU_METHOD 0 0 -3.40282346639E+38 3.40282346639E+38 ECU_ADDRESS 0x1BE22C FORMAT "%.15" SYMBOL_LINK "floatTestParam1" 0 /end MEASUREMENT
/begin MEASUREMENT floatTestParam2 "" FLOAT32_IEEE NO_COMPU_METHOD 0 0 -3.40282346639E+38 3.40282346639E+38 ECU_ADDRESS 0x1BD004 FORMAT "%.15" READ_WRITE /end MEASUREMENT
/begin MEASUREMENT floatTestParam2_mea "" FLOAT32_IEEE NO_COMPU_METHOD 0 0 -3.40282346639E+38 3.40282346639E+38 ECU_ADDRESS 0x1BD004 FORMAT "%.15" SYMBOL_LINK "floatTestParam2" 0 /end MEASUREMENT
/begin MEASUREMENT int16TestParam1 "" SWORD NO_COMPU_METHOD 0 0 -32768 32767 ECU_ADDRESS 0x1BD018 FORMAT "%.15" READ_WRITE /end MEASUREMENT
/begin MEASUREMENT int16TestParam1_mea "" SWORD NO_COMPU_METHOD 0 0 -32768 32767 ECU_ADDRESS 0x1BD018 FORMAT "%.15" SYMBOL_LINK "int16TestParam1" 0 /end MEASUREMENT
/begin MEASUREMENT int16TestParam2 "" SWORD NO_COMPU_METHOD 0 0 -32768 32767 ECU_ADDRESS 0x1BE0CC FORMAT "%.15" READ_WRITE /end MEASUREMENT
/begin MEASUREMENT int16TestParam2_mea "" SWORD NO_COMPU_METHOD 0 0 -32768 32767 ECU_ADDRESS 0x1BE0CC FORMAT "%.15" SYMBOL_LINK "int16TestParam2" 0 /end MEASUREMENT
/begin MEASUREMENT int32TestParam1 "" SLONG NO_COMPU_METHOD 0 0 -2147483648 2147483647 ECU_ADDRESS 0x1BE200 FORMAT "%.15" READ_WRITE /end MEASUREMENT
/begin MEASUREMENT int32TestParam1_mea "" SLONG NO_COMPU_METHOD 0 0 -2147483648 2147483647 ECU_ADDRESS 0x1BE200 FORMAT "%.15" SYMBOL_LINK "int32TestParam1" 0 /end MEASUREMENT
/begin MEASUREMENT int32TestParam2 "" SLONG NO_COMPU_METHOD 0 0 -2147483648 2147483647 ECU_ADDRESS 0x1BD03C FORMAT "%.15" READ_WRITE /end MEASUREMENT
/begin MEASUREMENT int32TestParam2_mea "" SLONG NO_COMPU_METHOD 0 0 -2147483648 2147483647 ECU_ADDRESS 0x1BD03C FORMAT "%.15" SYMBOL_LINK "int32TestParam2" 0 /end MEASUREMENT
/begin CHARACTERISTIC limit "Limit for channel1" VALUE 0x1C0030 __FLOAT32_IEEE_S 0 wordCounter.CONVERSION -1E+12 1E+12 FORMAT "%.3" /end CHARACTERISTIC
/begin CHARACTERISTIC map1_8_8_uc "" MAP 0x1C00D0 __UBYTE_Z 0 NO_COMPU_METHOD 0 255
 /begin AXIS_DESCR FIX_AXIS NO_INPUT_QUANTITY NO_COMPU_METHOD 8 0 255 FIX_AXIS_PAR_DIST 0 1 8 FORMAT "%.15" /end AXIS_DESCR
 /begin AXIS_DESCR FIX_AXIS NO_INPUT_QUANTITY NO_COMPU_METHOD 8 0 255 FIX_AXIS_PAR_DIST 0 1 8 FORMAT "%.15" /end AXIS_DESCR
 FORMAT "%.15" /end CHARACTERISTIC
/begin CHARACTERISTIC map1_8_8_uc_measure "8*8 fixed axis,  permanently morphing" MAP 0x1BE068 __UBYTE_Z 0 NO_COMPU_METHOD 0 255
 /begin AXIS_DESCR FIX_AXIS NO_INPUT_QUANTITY NO_COMPU_METHOD 8 0 255 FIX_AXIS_PAR_DIST 0 1 8 FORMAT "%.15" /end AXIS_DESCR
 /begin AXIS_DESCR FIX_AXIS NO_INPUT_QUANTITY NO_COMPU_METHOD 8 0 255 FIX_AXIS_PAR_DIST 0 1 8 FORMAT "%.15" /end AXIS_DESCR
 FORMAT "%.15" /end CHARACTERISTIC
/begin CHARACTERISTIC map4_80_uc "8*8 BYTE memory layout map4_80_uc" MAP 0x1C05D0 MapX8Y8V88ub 0 wordCounter.CONVERSION 0 255
 /begin AXIS_DESCR STD_AXIS NO_INPUT_QUANTITY wordCounter.CONVERSION 8 0 255 DEPOSIT ABSOLUTE FORMAT "%.3" /end AXIS_DESCR
 /begin AXIS_DESCR STD_AXIS NO_INPUT_QUANTITY wordCounter.CONVERSION 8 0 255 DEPOSIT ABSOLUTE FORMAT "%.3" /end AXIS_DESCR
 FORMAT "%.3" /end CHARACTERISTIC
/begin CHARACTERISTIC map5_82_uc "8*8 BYTE memory layout MapNxX8NyY8V88uc" MAP 0x1C0790 MapNxXNyYVuc 0 wordCounter.CONVERSION 0 255
 /begin AXIS_DESCR STD_AXIS NO_INPUT_QUANTITY wordCounter.CONVERSION 8 0 255 DEPOSIT ABSOLUTE FORMAT "%.3" /end AXIS_DESCR
 /begin AXIS_DESCR STD_AXIS NO_INPUT_QUANTITY wordCounter.CONVERSION 8 0 255 DEPOSIT ABSOLUTE FORMAT "%.3" /end AXIS_DESCR
 FORMAT "%.3" /end CHARACTERISTIC
/begin MEASUREMENT noise "Random numbers" FLOAT32_IEEE wordCounter.CONVERSION 0 0 0 255 ECU_ADDRESS 0x1BE05C FORMAT "%.3" /end MEASUREMENT
/begin MEASUREMENT noiseSignal "White noise wave signal." FLOAT64_IEEE NO_COMPU_METHOD 0 0 -10 10 ECU_ADDRESS 0x1BE1F8 FORMAT "%.15"
 /begin IF_DATA XCP
  /begin DAQ_EVENT FIXED_EVENT_LIST EVENT 0x04 /end DAQ_EVENT
 /end IF_DATA
/end MEASUREMENT
/begin CHARACTERISTIC noiseSignalAmpl "Noise signal amplitude.\n" VALUE 0x1C00A0 __FLOAT64_IEEE_S 0 NO_COMPU_METHOD -10 10 FORMAT "%.15" /end CHARACTERISTIC
/begin CHARACTERISTIC noise_ampl "" VALUE 0x1BE5F0 __FLOAT32_IEEE_S 0 TestStructTypes.usTest.CONVERSION 0 5 FORMAT "%.2" /end CHARACTERISTIC
/begin CHARACTERISTIC offset "Offset for channel1" VALUE 0x1C0034 __FLOAT32_IEEE_S 0 wordCounter.CONVERSION -1E+12 1E+12 FORMAT "%.3" /end CHARACTERISTIC
/begin CHARACTERISTIC period "Period of channel 1-3" VALUE 0x1C0028 __FLOAT32_IEEE_S 0 wordCounter.CONVERSION 0 100 FORMAT "%.3" /end CHARACTERISTIC
/begin CHARACTERISTIC period_d "" VALUE 0x1C0058 __FLOAT64_IEEE_S 0 TestStructTypes.usTest.CONVERSION 0 5 FORMAT "%.12" /end CHARACTERISTIC
/begin MEASUREMENT perlin_noise "Random numbers" FLOAT32_IEEE wordCounter.CONVERSION 0 0 0 255 ECU_ADDRESS 0x1BE230 FORMAT "%.3" /end MEASUREMENT
/begin MEASUREMENT pulseSignal "Pulse wave signal.\nSample rate: 100Hz" FLOAT64_IEEE NO_COMPU_METHOD 0 0 -10 10 ECU_ADDRESS 0x1BD030 FORMAT "%.15"
 /begin IF_DATA XCP
  /begin DAQ_EVENT FIXED_EVENT_LIST EVENT 0x04 /end DAQ_EVENT
 /end IF_DATA
/end MEASUREMENT
/begin CHARACTERISTIC pulseSignalAmpl "Pulse wave signal amplitude.\n" VALUE 0x1C0080 __FLOAT64_IEEE_S 0 NO_COMPU_METHOD -10 10 FORMAT "%.15" /end CHARACTERISTIC
/begin CHARACTERISTIC pulseSignalFreq "Pulse wave signal frequency.\nLimited to half of the sampling rate (50Hz) due to Nyquist sampling criterion.\n" VALUE 0x1C0078 __FLOAT64_IEEE_S 0 NO_COMPU_METHOD 0 50 FORMAT "%.15" /end CHARACTERISTIC
/begin MEASUREMENT pulseSignalPhase "Phase of the pulse wave signal.\nSample rate: 100Hz" FLOAT64_IEEE NO_COMPU_METHOD 0 0 0 1 ECU_ADDRESS 0x1BE598 FORMAT "%.15" SYMBOL_LINK "pulsePhase" 0
 /begin IF_DATA XCP
  /begin DAQ_EVENT FIXED_EVENT_LIST EVENT 0x04 /end DAQ_EVENT
 /end IF_DATA
/end MEASUREMENT
/begin CHARACTERISTIC pulseSignalWidth "Pulse wave signal width\n" VALUE 0x1C0088 __FLOAT64_IEEE_S 0 NO_COMPU_METHOD 0 1 FORMAT "%.15" /end CHARACTERISTIC
/begin MEASUREMENT sineNoiseMixFilterSignal "Sine and noise mix filtered wave signal.\nSample rate: 100Hz" FLOAT64_IEEE NO_COMPU_METHOD 0 0 -10 10 ECU_ADDRESS 0x1BE5E8 FORMAT "%.15" READ_WRITE
 /begin IF_DATA XCP
  /begin DAQ_EVENT FIXED_EVENT_LIST EVENT 0x04 /end DAQ_EVENT
 /end IF_DATA
/end MEASUREMENT
/begin MEASUREMENT sineNoiseMixSignal "Sine and noise mix wave signal.\nSample rate: 100Hz" FLOAT64_IEEE NO_COMPU_METHOD 0 0 -10 10 ECU_ADDRESS 0x1BE050 FORMAT "%.15"
 /begin IF_DATA XCP
  /begin DAQ_EVENT FIXED_EVENT_LIST EVENT 0x04 /end DAQ_EVENT
 /end IF_DATA
/end MEASUREMENT
/begin MEASUREMENT sineSignal "Sine wave signal.\nSample rate: 100Hz" FLOAT64_IEEE NO_COMPU_METHOD 0 0 -10 10 ECU_ADDRESS 0x1BE1F0 FORMAT "%.15"
 /begin IF_DATA XCP
  /begin DAQ_EVENT FIXED_EVENT_LIST EVENT 0x04 /end DAQ_EVENT
 /end IF_DATA
/end MEASUREMENT
/begin CHARACTERISTIC sineSignalAmpl "Sine wave signal amplitude.\n" VALUE 0x1C0070 __FLOAT64_IEEE_S 0 NO_COMPU_METHOD -10 10 FORMAT "%.15" /end CHARACTERISTIC
/begin CHARACTERISTIC sineSignalFreq "Sine wave signal frequency.\nLimited to half of the sampling rate (50Hz) due to Nyquist sampling criterion.\n" VALUE 0x1C0068 __FLOAT64_IEEE_S 0 NO_COMPU_METHOD 0 50 FORMAT "%.15" /end CHARACTERISTIC
/begin MEASUREMENT sineSignalPhase "Phase of the sine wave signal.\nSample rate: 100Hz" FLOAT64_IEEE NO_COMPU_METHOD 0 0 0 1 ECU_ADDRESS 0x1BE1E8 FORMAT "%.15" SYMBOL_LINK "sinePhase" 0
 /begin IF_DATA XCP
  /begin DAQ_EVENT FIXED_EVENT_LIST EVENT 0x04 /end DAQ_EVENT
 /end IF_DATA
/end MEASUREMENT
/begin MEASUREMENT syncArrayStruct.mem_charArray[000] "" SBYTE NO_COMPU_METHOD 0 0 -128 127 ECU_ADDRESS 0x1BE19C FORMAT "%.15" /end MEASUREMENT
/begin MEASUREMENT syncArrayStruct.mem_charArray[001] "" SBYTE NO_COMPU_METHOD 0 0 -128 127 ECU_ADDRESS 0x1BE19D FORMAT "%.15" /end MEASUREMENT
/begin MEASUREMENT syncArrayStruct.mem_doubleArray[000] "" FLOAT64_IEEE NO_COMPU_METHOD 0 0 -1.7E+308 1.7E+308 ECU_ADDRESS 0x1BE180 FORMAT "%.15" /end MEASUREMENT
/begin MEASUREMENT syncArrayStruct.mem_doubleArray[001] "" FLOAT64_IEEE NO_COMPU_METHOD 0 0 -1.7E+308 1.7E+308 ECU_ADDRESS 0x1BE188 FORMAT "%.15" /end MEASUREMENT
/begin MEASUREMENT syncArrayStruct.mem_floatArray[000] "" FLOAT32_IEEE NO_COMPU_METHOD 0 0 -3.4E+38 3.4E+38 ECU_ADDRESS 0x1BE190 FORMAT "%.15" /end MEASUREMENT
/begin MEASUREMENT syncArrayStruct.mem_floatArray[001] "" FLOAT32_IEEE NO_COMPU_METHOD 0 0 -3.4E+38 3.4E+38 ECU_ADDRESS 0x1BE194 FORMAT "%.15" /end MEASUREMENT
/begin MEASUREMENT syncArrayStruct.mem_floatArray[002] "" FLOAT32_IEEE NO_COMPU_METHOD 0 0 -3.4E+38 3.4E+38 ECU_ADDRESS 0x1BE198 FORMAT "%.15" /end MEASUREMENT
/begin MEASUREMENT syncArrayStruct.mem_intArray[000] "" SLONG NO_COMPU_METHOD 0 0 -2147483648 2147483647 ECU_ADDRESS 0x1BE1AC FORMAT "%.15" /end MEASUREMENT
/begin MEASUREMENT syncArrayStruct.mem_intArray[001] "" SLONG NO_COMPU_METHOD 0 0 -2147483648 2147483647 ECU_ADDRESS 0x1BE1B0 FORMAT "%.15" /end MEASUREMENT
/begin MEASUREMENT syncArrayStruct.mem_longArray[000] "" SLONG NO_COMPU_METHOD 0 0 -2147483648 2147483647 ECU_ADDRESS 0x1BE1C0 FORMAT "%.15" /end MEASUREMENT
/begin MEASUREMENT syncArrayStruct.mem_longArray[001] "" SLONG NO_COMPU_METHOD 0 0 -2147483648 2147483647 ECU_ADDRESS 0x1BE1C4 FORMAT "%.15" /end MEASUREMENT
/begin MEASUREMENT syncArrayStruct.mem_shortArray[000] "" SWORD NO_COMPU_METHOD 0 0 -32768 32767 ECU_ADDRESS 0x1BE1A2 FORMAT "%.15" /end MEASUREMENT
/begin MEASUREMENT syncArrayStruct.mem_shortArray[001] "" SWORD NO_COMPU_METHOD 0 0 -32768 32767 ECU_ADDRESS 0x1BE1A4 FORMAT "%.15" /end MEASUREMENT
/begin MEASUREMENT syncArrayStruct.mem_structArray[000].mem_int "" SLONG NO_COMPU_METHOD 0 0 -2147483648 2147483647 ECU_ADDRESS 0x1BE1D4 FORMAT "%.15" /end MEASUREMENT
/begin MEASUREMENT syncArrayStruct.mem_structArray[000].mem_uint "" ULONG NO_COMPU_METHOD 0 0 0 4294967295 ECU_ADDRESS 0x1BE1D8 FORMAT "%.15" /end MEASUREMENT
/begin MEASUREMENT syncArrayStruct.mem_structArray[001].mem_int "" SLONG NO_COMPU_METHOD 0 0 -2147483648 2147483647 ECU_ADDRESS 0x1BE1DC FORMAT "%.15" /end MEASUREMENT
/begin MEASUREMENT syncArrayStruct.mem_structArray[001].mem_uint "" ULONG NO_COMPU_METHOD 0 0 0 4294967295 ECU_ADDRESS 0x1BE1E0 FORMAT "%.15" /end MEASUREMENT
/begin MEASUREMENT syncArrayStruct.mem_ucharArray[000] "" UBYTE NO_COMPU_METHOD 0 0 0 255 ECU_ADDRESS 0x1BE19E FORMAT "%.15" /end MEASUREMENT
/begin MEASUREMENT syncArrayStruct.mem_ucharArray[001] "" UBYTE NO_COMPU_METHOD 0 0 0 255 ECU_ADDRESS 0x1BE19F FORMAT "%.15" /end MEASUREMENT
/begin MEASUREMENT syncArrayStruct.mem_ucharArray[002] "" UBYTE NO_COMPU_METHOD 0 0 0 255 ECU_ADDRESS 0x1BE1A0 FORMAT "%.15" /end MEASUREMENT
/begin MEASUREMENT syncArrayStruct.mem_uintArray[000] "" ULONG NO_COMPU_METHOD 0 0 0 4294967295 ECU_ADDRESS 0x1BE1B4 FORMAT "%.15" /end MEASUREMENT
/begin MEASUREMENT syncArrayStruct.mem_uintArray[001] "" ULONG NO_COMPU_METHOD 0 0 0 4294967295 ECU_ADDRESS 0x1BE1B8 FORMAT "%.15" /end MEASUREMENT
/begin MEASUREMENT syncArrayStruct.mem_uintArray[002] "" ULONG NO_COMPU_METHOD 0 0 0 4294967295 ECU_ADDRESS 0x1BE1BC FORMAT "%.15" /end MEASUREMENT
/begin MEASUREMENT syncArrayStruct.mem_ulongArray[000] "" ULONG NO_COMPU_METHOD 0 0 0 4294967295 ECU_ADDRESS 0x1BE1C8 FORMAT "%.15" /end MEASUREMENT
/begin MEASUREMENT syncArrayStruct.mem_ulongArray[001] "" ULONG NO_COMPU_METHOD 0 0 0 4294967295 ECU_ADDRESS 0x1BE1CC FORMAT "%.15" /end MEASUREMENT
/begin MEASUREMENT syncArrayStruct.mem_ulongArray[002] "" ULONG NO_COMPU_METHOD 0 0 0 4294967295 ECU_ADDRESS 0x1BE1D0 FORMAT "%.15" /end MEASUREMENT
/begin MEASUREMENT syncArrayStruct.mem_ushortArray[000] "" UWORD NO_COMPU_METHOD 0 0 0 65535 ECU_ADDRESS 0x1BE1A6 FORMAT "%.15" /end MEASUREMENT
/begin MEASUREMENT syncArrayStruct.mem_ushortArray[001] "" UWORD NO_COMPU_METHOD 0 0 0 65535 ECU_ADDRESS 0x1BE1A8 FORMAT "%.15" /end MEASUREMENT
/begin MEASUREMENT syncArrayStruct.mem_ushortArray[002] "" UWORD NO_COMPU_METHOD 0 0 0 65535 ECU_ADDRESS 0x1BE1AA FORMAT "%.15" /end MEASUREMENT
/begin MEASUREMENT syncCounter_char "" SBYTE NO_COMPU_METHOD 0 0 -128 127 ECU_ADDRESS 0x1BD01E FORMAT "%.15" /end MEASUREMENT
/begin MEASUREMENT syncCounter_double "" FLOAT64_IEEE NO_COMPU_METHOD 0 0 -1.7E+308 1.7E+308 ECU_ADDRESS 0x1BE210 FORMAT "%.15" /end MEASUREMENT
/begin MEASUREMENT syncCounter_float "" FLOAT32_IEEE NO_COMPU_METHOD 0 0 -3.4E+38 3.4E+38 ECU_ADDRESS 0x1BE5D8 FORMAT "%.15" /end MEASUREMENT
/begin MEASUREMENT syncCounter_int "" SLONG NO_COMPU_METHOD 0 0 -2147483648 2147483647 ECU_ADDRESS 0x1BE5B0 FORMAT "%.15" /end MEASUREMENT
/begin MEASUREMENT syncCounter_long "" SLONG NO_COMPU_METHOD 0 0 -2147483648 2147483647 ECU_ADDRESS 0x1BD020 FORMAT "%.15" /end MEASUREMENT
/begin MEASUREMENT syncCounter_short "" SWORD NO_COMPU_METHOD 0 0 -32768 32767 ECU_ADDRESS 0x1BD00C FORMAT "%.15" /end MEASUREMENT
/begin MEASUREMENT syncCounter_uchar "" UBYTE NO_COMPU_METHOD 0 0 0 255 ECU_ADDRESS 0x1BE22A FORMAT "%.15" /end MEASUREMENT
/begin MEASUREMENT syncCounter_uint "" ULONG NO_COMPU_METHOD 0 0 0 4294967295 ECU_ADDRESS 0x1BE5E4 FORMAT "%.15" /end MEASUREMENT
/begin MEASUREMENT syncCounter_ulong "" ULONG NO_COMPU_METHOD 0 0 0 4294967295 ECU_ADDRESS 0x1BE264 FORMAT "%.15" /end MEASUREMENT
/begin MEASUREMENT syncCounter_ushort "" UWORD NO_COMPU_METHOD 0 0 0 65535 ECU_ADDRESS 0x1BE228 FORMAT "%.15" /end MEASUREMENT
/begin MEASUREMENT syncStructArray[000].mem_char "" SBYTE NO_COMPU_METHOD 0 0 -128 127 ECU_ADDRESS 0x1BE0DC FORMAT "%.15" /end MEASUREMENT
/begin MEASUREMENT syncStructArray[000].mem_double "" FLOAT64_IEEE NO_COMPU_METHOD 0 0 -1.7E+308 1.7E+308 ECU_ADDRESS 0x1BE0D0 FORMAT "%.15" /end MEASUREMENT
/begin MEASUREMENT syncStructArray[000].mem_float "" FLOAT32_IEEE NO_COMPU_METHOD 0 0 -3.4E+38 3.4E+38 ECU_ADDRESS 0x1BE0D8 FORMAT "%.15" /end MEASUREMENT
/begin MEASUREMENT syncStructArray[000].mem_uchar "" UBYTE NO_COMPU_METHOD 0 0 0 255 ECU_ADDRESS 0x1BE0DD FORMAT "%.15" /end MEASUREMENT
/begin MEASUREMENT syncStructArray[001].mem_char "" SBYTE NO_COMPU_METHOD 0 0 -128 127 ECU_ADDRESS 0x1BE0EC FORMAT "%.15" /end MEASUREMENT
/begin MEASUREMENT syncStructArray[001].mem_double "" FLOAT64_IEEE NO_COMPU_METHOD 0 0 -1.7E+308 1.7E+308 ECU_ADDRESS 0x1BE0E0 FORMAT "%.15" /end MEASUREMENT
/begin MEASUREMENT syncStructArray[001].mem_float "" FLOAT32_IEEE NO_COMPU_METHOD 0 0 -3.4E+38 3.4E+38 ECU_ADDRESS 0x1BE0E8 FORMAT "%.15" /end MEASUREMENT
/begin MEASUREMENT syncStructArray[001].mem_uchar "" UBYTE NO_COMPU_METHOD 0 0 0 255 ECU_ADDRESS 0x1BE0ED FORMAT "%.15" /end MEASUREMENT
/begin MEASUREMENT syncStructArray[002].mem_char "" SBYTE NO_COMPU_METHOD 0 0 -128 127 ECU_ADDRESS 0x1BE0FC FORMAT "%.15" /end MEASUREMENT
/begin MEASUREMENT syncStructArray[002].mem_double "" FLOAT64_IEEE NO_COMPU_METHOD 0 0 -1.7E+308 1.7E+308 ECU_ADDRESS 0x1BE0F0 FORMAT "%.15" /end MEASUREMENT
/begin MEASUREMENT syncStructArray[002].mem_float "" FLOAT32_IEEE NO_COMPU_METHOD 0 0 -3.4E+38 3.4E+38 ECU_ADDRESS 0x1BE0F8 FORMAT "%.15" /end MEASUREMENT
/begin MEASUREMENT syncStructArray[002].mem_uchar "" UBYTE NO_COMPU_METHOD 0 0 0 255 ECU_ADDRESS 0x1BE0FD FORMAT "%.15" /end MEASUREMENT
/begin MEASUREMENT syncStructArray[003].mem_char "" SBYTE NO_COMPU_METHOD 0 0 -128 127 ECU_ADDRESS 0x1BE10C FORMAT "%.15" /end MEASUREMENT
/begin MEASUREMENT syncStructArray[003].mem_double "" FLOAT64_IEEE NO_COMPU_METHOD 0 0 -1.7E+308 1.7E+308 ECU_ADDRESS 0x1BE100 FORMAT "%.15" /end MEASUREMENT
/begin MEASUREMENT syncStructArray[003].mem_float "" FLOAT32_IEEE NO_COMPU_METHOD 0 0 -3.4E+38 3.4E+38 ECU_ADDRESS 0x1BE108 FORMAT "%.15" /end MEASUREMENT
/begin MEASUREMENT syncStructArray[003].mem_uchar "" UBYTE NO_COMPU_METHOD 0 0 0 255 ECU_ADDRESS 0x1BE10D FORMAT "%.15" /end MEASUREMENT
/begin CHARACTERISTIC testByte "" VAL_BLK 0x1BD050 __UBYTE_Z 0 NO_COMPU_METHOD 0 255 FORMAT "%.15" MATRIX_DIM 8 1 1 SYMBOL_LINK "testByte000" 0 /end CHARACTERISTIC
/begin CHARACTERISTIC testByte000 "" VALUE 0x1BD050 __UBYTE_S 0 TestStructTypes.usTest.CONVERSION 0 255 FORMAT "%.15" /end CHARACTERISTIC
/begin CHARACTERISTIC testByte000[000] "" VALUE 0x1BD050 __UBYTE_S 0 TestStructTypes.usTest.CONVERSION 0 255 FORMAT "%.15" /end CHARACTERISTIC
/begin CHARACTERISTIC testByte000[001] "" VALUE 0x1BD051 __UBYTE_S 0 TestStructTypes.usTest.CONVERSION 0 255 FORMAT "%.15" /end CHARACTERISTIC
/begin CHARACTERISTIC testByte000[002] "" VALUE 0x1BD052 __UBYTE_S 0 TestStructTypes.usTest.CONVERSION 0 255 FORMAT "%.15" /end CHARACTERISTIC
/begin CHARACTERISTIC testByte000[003] "" VALUE 0x1BD053 __UBYTE_S 0 TestStructTypes.usTest.CONVERSION 0 255 FORMAT "%.15" /end CHARACTERISTIC
/begin CHARACTERISTIC testByte000[004] "" VALUE 0x1BD054 __UBYTE_S 0 TestStructTypes.usTest.CONVERSION 0 255 FORMAT "%.15" /end CHARACTERISTIC
/begin CHARACTERISTIC testByte000[005] "" VALUE 0x1BD055 __UBYTE_S 0 TestStructTypes.usTest.CONVERSION 0 255 FORMAT "%.15" /end CHARACTERISTIC
/begin CHARACTERISTIC testByte000[006] "" VALUE 0x1BD056 __UBYTE_S 0 TestStructTypes.usTest.CONVERSION 0 255 FORMAT "%.15" /end CHARACTERISTIC
/begin CHARACTERISTIC testByte000[007] "" VALUE 0x1BD057 __UBYTE_S 0 TestStructTypes.usTest.CONVERSION 0 255 FORMAT "%.15" /end CHARACTERISTIC
/begin MEASUREMENT triangleSignal "Triangle wave signal.\nSample rate: 100Hz" FLOAT64_IEEE NO_COMPU_METHOD 0 0 -10 10 ECU_ADDRESS 0x1BE150 FORMAT "%.15"
 /begin IF_DATA XCP
  /begin DAQ_EVENT FIXED_EVENT_LIST EVENT 0x04 /end DAQ_EVENT
 /end IF_DATA
/end MEASUREMENT
/begin CHARACTERISTIC triangleSignalAmpl "Triangle wave signal amplitude.\n" VALUE 0x1C0098 __FLOAT64_IEEE_S 0 NO_COMPU_METHOD -10 10 FORMAT "%.15" /end CHARACTERISTIC
/begin CHARACTERISTIC triangleSignalFreq "Triangle wave signal frequency.\nLimited to half of the sampling rate (50Hz) due to Nyquist sampling criterion.\n" VALUE 0x1C0090 __FLOAT64_IEEE_S 0 NO_COMPU_METHOD 0 50 FORMAT "%.15" /end CHARACTERISTIC
/begin MEASUREMENT triangleSignalPhase "Phase of the triangle wave signal.\nSample rate: 100Hz" FLOAT64_IEEE NO_COMPU_METHOD 0 0 0 1 ECU_ADDRESS 0x1BD048 FORMAT "%.15" SYMBOL_LINK "trianglePhase" 0
 /begin IF_DATA XCP
  /begin DAQ_EVENT FIXED_EVENT_LIST EVENT 0x04 /end DAQ_EVENT
 /end IF_DATA
/end MEASUREMENT
/begin MEASUREMENT uint16TestParam1 "" UWORD NO_COMPU_METHOD 0 0 0 65535 ECU_ADDRESS 0x1BD01C FORMAT "%.15" READ_WRITE /end MEASUREMENT
/begin MEASUREMENT uint16TestParam1_mea "" UWORD NO_COMPU_METHOD 0 0 0 65535 ECU_ADDRESS 0x1BD01C FORMAT "%.15" SYMBOL_LINK "uint16TestParam1" 0 /end MEASUREMENT
/begin MEASUREMENT uint16TestParam2 "" UWORD NO_COMPU_METHOD 0 0 0 65535 ECU_ADDRESS 0x1BE5A4 FORMAT "%.15" READ_WRITE /end MEASUREMENT
/begin MEASUREMENT uint16TestParam2_mea "" UWORD NO_COMPU_METHOD 0 0 0 65535 ECU_ADDRESS 0x1BE5A4 FORMAT "%.15" SYMBOL_LINK "uint16TestParam2" 0 /end MEASUREMENT
/begin MEASUREMENT uint32TestParam1 "" ULONG NO_COMPU_METHOD 0 0 0 4294967295 ECU_ADDRESS 0x1BD044 FORMAT "%.15" READ_WRITE /end MEASUREMENT
/begin MEASUREMENT uint32TestParam1_mea "" ULONG NO_COMPU_METHOD 0 0 0 4294967295 ECU_ADDRESS 0x1BD044 FORMAT "%.15" SYMBOL_LINK "uint32TestParam1" 0 /end MEASUREMENT
/begin MEASUREMENT uint32TestParam2 "" ULONG NO_COMPU_METHOD 0 0 0 4294967295 ECU_ADDRESS 0x1BE5DC FORMAT "%.15" READ_WRITE /end MEASUREMENT
/begin MEASUREMENT uint32TestParam2_mea "" ULONG NO_COMPU_METHOD 0 0 0 4294967295 ECU_ADDRESS 0x1BE5DC FORMAT "%.15" SYMBOL_LINK "uint32TestParam2" 0 /end MEASUREMENT
/begin MEASUREMENT v "Digital Filter Outputvalue" UWORD DigitalFilterConversion 0 0 0 1 ECU_ADDRESS 0x1BE224 FORMAT "%.3" READ_WRITE /end MEASUREMENT
/begin MEASUREMENT vin "Digital Filter Inputvalue" UWORD DigitalFilterConversion 0 0 0 1 ECU_ADDRESS 0x1BE058 FORMAT "%.3" READ_WRITE /end MEASUREMENT
/begin COMPU_METHOD Current "Convert Voltage into Current" FORM "%7.3" "" /begin FORMULA "X*X*2" /end FORMULA /end COMPU_METHOD
/begin COMPU_METHOD DigitalFilterConversion "" LINEAR "%3.1" "Volt" COEFFS_LINEAR 0.001 0 /end COMPU_METHOD
/begin COMPU_METHOD Factor100 "" LINEAR "%3.1" "" COEFFS_LINEAR 0.01 0 /end COMPU_METHOD
/begin COMPU_METHOD HighLow "High/Low for bits" TAB_VERB "%7.3" "" COMPU_TAB_REF HighLow /end COMPU_METHOD
/begin COMPU_METHOD KF8_Conversion "" LINEAR "%3.1" "1/min" COEFFS_LINEAR 0.1 0 /end COMPU_METHOD
/begin COMPU_METHOD KF8_Y_AXIS.CONVERSION "" LINEAR "%3.1" "Nm" COEFFS_LINEAR 0.1 0 /end COMPU_METHOD
/begin COMPU_METHOD Pressure "Convert Voltage into Pressure" LINEAR "%7.3" "" COEFFS_LINEAR 0.123457 0 /end COMPU_METHOD
/begin COMPU_METHOD Simulator_concept.CONVERSION "enumeration table" TAB_VERB "" "" COMPU_TAB_REF _ /end COMPU_METHOD
/begin COMPU_METHOD TestStatus.CONVERSION "" TAB_VERB "%3.1" "" COMPU_TAB_REF TestStatus.CONVERSION /end COMPU_METHOD
/begin COMPU_METHOD TestStructTypes.usTest.CONVERSION "" IDENTICAL "%6.2" "" /end COMPU_METHOD
/begin COMPU_METHOD wordCounter.CONVERSION "" IDENTICAL "%6.2f" "" /end COMPU_METHOD
/begin COMPU_VTAB HighLow "High/Low for bits" TAB_VERB 2 0 "Low" 1 "High" DEFAULT_VALUE "" /end COMPU_VTAB
/begin COMPU_VTAB TestStatus.CONVERSION "@@@@RuleName created by CANape" TAB_VERB 4 0 "Off" 1 "Silent" 2 "Pending" 3 "Running" DEFAULT_VALUE "" /end COMPU_VTAB
/begin COMPU_VTAB_RANGE _ "" 6 0 0 "eCalConcept_Simple" 1 1 "eCalConcept_InitRam" 2 2 "eCalConcept_Dynamic" 3 3 "eCalConcept_Incircuit2" 4 4 "eCalConcept_AUTOSAR" 5 5 "eCalConcept_InitRamAddrMapping" DEFAULT_VALUE "" /end COMPU_VTAB_RANGE
/begin RECORD_LAYOUT CurveNxVub AXIS_PTS_X 1 UBYTE INDEX_INCR DIRECT FNC_VALUES 2 UBYTE ROW_DIR DIRECT /end RECORD_LAYOUT
/begin RECORD_LAYOUT CurveNxXVub NO_AXIS_PTS_X 1 UBYTE AXIS_PTS_X 2 UBYTE INDEX_INCR DIRECT FNC_VALUES 3 UBYTE ROW_DIR DIRECT /end RECORD_LAYOUT
/begin RECORD_LAYOUT CurveV8ub FNC_VALUES 1 UBYTE ROW_DIR DIRECT FIX_NO_AXIS_PTS_X 8 /end RECORD_LAYOUT
/begin RECORD_LAYOUT CurveX8V8ub AXIS_PTS_X 1 UBYTE INDEX_INCR DIRECT FNC_VALUES 2 UBYTE ROW_DIR DIRECT FIX_NO_AXIS_PTS_X 8 /end RECORD_LAYOUT
/begin RECORD_LAYOUT CurveX8V8ubAlternate AXIS_PTS_X 1 UWORD INDEX_INCR DIRECT FNC_VALUES 2 UWORD ALTERNATE_WITH_X DIRECT FIX_NO_AXIS_PTS_X 8 /end RECORD_LAYOUT
/begin RECORD_LAYOUT CurveX8ub AXIS_PTS_X 1 UBYTE INDEX_INCR DIRECT FIX_NO_AXIS_PTS_X 8 /end RECORD_LAYOUT
/begin RECORD_LAYOUT MapNxNyVub NO_AXIS_PTS_X 1 UBYTE NO_AXIS_PTS_Y 2 UBYTE FNC_VALUES 3 UBYTE ROW_DIR DIRECT /end RECORD_LAYOUT
/begin RECORD_LAYOUT MapNxNyXYVsb NO_AXIS_PTS_X 1 SBYTE NO_AXIS_PTS_Y 2 SBYTE AXIS_PTS_X 3 SBYTE INDEX_INCR DIRECT AXIS_PTS_Y 4 SBYTE INDEX_INCR DIRECT FNC_VALUES 5 SBYTE ROW_DIR DIRECT ALIGNMENT_BYTE 1 ALIGNMENT_WORD 1 ALIGNMENT_LONG 1 ALIGNMENT_FLOAT32_IEEE 1 ALIGNMENT_FLOAT64_IEEE 1 /end RECORD_LAYOUT
/begin RECORD_LAYOUT MapNxNyXYVub NO_AXIS_PTS_X 1 UBYTE NO_AXIS_PTS_Y 2 UBYTE AXIS_PTS_X 3 UBYTE INDEX_INCR DIRECT AXIS_PTS_Y 4 UBYTE INDEX_INCR DIRECT FNC_VALUES 5 UBYTE ROW_DIR DIRECT /end RECORD_LAYOUT
/begin RECORD_LAYOUT MapNxXNyYVuc NO_AXIS_PTS_X 1 UBYTE AXIS_PTS_X 2 UBYTE INDEX_INCR DIRECT NO_AXIS_PTS_Y 3 UBYTE AXIS_PTS_Y 4 UBYTE INDEX_INCR DIRECT FNC_VALUES 5 UBYTE ROW_DIR DIRECT /end RECORD_LAYOUT
/begin RECORD_LAYOUT MapV86ub FNC_VALUES 1 UBYTE ROW_DIR DIRECT FIX_NO_AXIS_PTS_X 8 FIX_NO_AXIS_PTS_Y 6 /end RECORD_LAYOUT
/begin RECORD_LAYOUT MapX8Y6V86ub AXIS_PTS_X 1 UBYTE INDEX_INCR DIRECT AXIS_PTS_Y 2 UBYTE INDEX_INCR DIRECT FNC_VALUES 3 UBYTE ROW_DIR DIRECT FIX_NO_AXIS_PTS_X 8 FIX_NO_AXIS_PTS_Y 6 /end RECORD_LAYOUT
/begin RECORD_LAYOUT MapX8Y8V88ub AXIS_PTS_X 1 UBYTE INDEX_INCR DIRECT AXIS_PTS_Y 2 UBYTE INDEX_INCR DIRECT FNC_VALUES 3 UBYTE ROW_DIR DIRECT FIX_NO_AXIS_PTS_X 8 FIX_NO_AXIS_PTS_Y 8 /end RECORD_LAYOUT
/begin RECORD_LAYOUT MapXYVub AXIS_PTS_X 1 UBYTE INDEX_INCR DIRECT AXIS_PTS_Y 2 UBYTE INDEX_INCR DIRECT FNC_VALUES 3 UBYTE ROW_DIR DIRECT /end RECORD_LAYOUT
/begin RECORD_LAYOUT SSV__A_INT64_S AXIS_PTS_X 1 A_INT64 INDEX_INCR DIRECT /end RECORD_LAYOUT
/begin RECORD_LAYOUT SSV__A_UINT64_S AXIS_PTS_X 1 A_UINT64 INDEX_INCR DIRECT /end RECORD_LAYOUT
/begin RECORD_LAYOUT SSV__FLOAT32_IEEE_S AXIS_PTS_X 1 FLOAT32_IEEE INDEX_INCR DIRECT /end RECORD_LAYOUT
/begin RECORD_LAYOUT SSV__FLOAT64_IEEE_S AXIS_PTS_X 1 FLOAT64_IEEE INDEX_INCR DIRECT /end RECORD_LAYOUT
/begin RECORD_LAYOUT SSV__SBYTE_S AXIS_PTS_X 1 SBYTE INDEX_INCR DIRECT /end RECORD_LAYOUT
/begin RECORD_LAYOUT SSV__SLONG_S AXIS_PTS_X 1 SLONG INDEX_INCR DIRECT /end RECORD_LAYOUT
/begin RECORD_LAYOUT SSV__SWORD_S AXIS_PTS_X 1 SWORD INDEX_INCR DIRECT /end RECORD_LAYOUT
/begin RECORD_LAYOUT SSV__UBYTE_S AXIS_PTS_X 1 UBYTE INDEX_INCR DIRECT /end RECORD_LAYOUT
/begin RECORD_LAYOUT __FLOAT32_IEEE_S FNC_VALUES 1 FLOAT32_IEEE COLUMN_DIR DIRECT /end RECORD_LAYOUT
/begin RECORD_LAYOUT __FLOAT64_IEEE_S FNC_VALUES 1 FLOAT64_IEEE COLUMN_DIR DIRECT /end RECORD_LAYOUT
/begin RECORD_LAYOUT __SBYTE_S FNC_VALUES 1 SBYTE COLUMN_DIR DIRECT /end RECORD_LAYOUT
/begin RECORD_LAYOUT __SLONG_S FNC_VALUES 1 SLONG COLUMN_DIR DIRECT /end RECORD_LAYOUT
/begin RECORD_LAYOUT __SWORD_S FNC_VALUES 1 SWORD COLUMN_DIR DIRECT /end RECORD_LAYOUT
/begin RECORD_LAYOUT __UBYTE_S FNC_VALUES 1 UBYTE COLUMN_DIR DIRECT /end RECORD_LAYOUT
/begin RECORD_LAYOUT __UBYTE_Z FNC_VALUES 1 UBYTE ROW_DIR DIRECT /end RECORD_LAYOUT
/begin RECORD_LAYOUT __ULONG_S FNC_VALUES 1 ULONG COLUMN_DIR DIRECT /end RECORD_LAYOUT
/begin RECORD_LAYOUT __UWORD_S FNC_VALUES 1 UWORD COLUMN_DIR DIRECT /end RECORD_LAYOUT
/begin GROUP Arrays "Kommentar" ROOT
 /begin REF_CHARACTERISTIC testByte testByte000 testByte000[000] testByte000[001] testByte000[002] testByte000[003] testByte000[004] testByte000[005] testByte000[006] testByte000[007] /end REF_CHARACTERISTIC
/end GROUP
/begin GROUP Axis "Shared Axis for Calibration Maps" ROOT /begin REF_CHARACTERISTIC Curve1 Curve2 Curve3 /end REF_CHARACTERISTIC /end GROUP
/begin GROUP Bits "Single Bit Values"
 /begin REF_MEASUREMENT Counter_B4 Counter_B5 Counter_B6 Counter_B7 ShiftByte Shifter_B0 Shifter_B1 Shifter_B2 Shifter_B3 /end REF_MEASUREMENT
/end GROUP
/begin GROUP Bitslices "Multibit Values" /begin REF_MEASUREMENT BitSlice BitSlice0 BitSlice1 BitSlice2 TestStatus /end REF_MEASUREMENT /end GROUP
/begin GROUP BypassParameters "Test parameters for bypassing"
 /begin REF_MEASUREMENT floatTestParam1 floatTestParam1_mea floatTestParam2 floatTestParam2_mea int16TestParam1 int16TestParam1_mea int16TestParam2 int16TestParam2_mea int32TestParam1 int32TestParam1_mea int32TestParam2 int32TestParam2_mea uint16TestParam1 uint16TestParam1_mea uint16TestParam2 uint16TestParam2_mea uint32TestParam1 uint32TestParam1_mea uint32TestParam2 uint32TestParam2_mea /end REF_MEASUREMENT
/end GROUP
/begin GROUP Counters "Counter test signals" /end GROUP
/begin GROUP Curves "Calibration Curves" ROOT /begin REF_CHARACTERISTIC KL1 KL2 KL3 KL4 KL5 KL6 KL7 KL8 curve_kl2 /end REF_CHARACTERISTIC /end GROUP
/begin GROUP Example_Bypass "Test signals and parameters for bypassing" ROOT
 /begin REF_CHARACTERISTIC noiseSignalAmpl pulseSignalAmpl pulseSignalFreq pulseSignalWidth sineSignalAmpl sineSignalFreq triangleSignalAmpl triangleSignalFreq /end REF_CHARACTERISTIC
 /begin REF_MEASUREMENT noiseSignal pulseSignal pulseSignalPhase sineNoiseMixFilterSignal sineNoiseMixSignal sineSignal sineSignalPhase triangleSignal triangleSignalPhase /end REF_MEASUREMENT
 /begin SUB_GROUP BypassParameters Counters /end SUB_GROUP
/end GROUP
/begin GROUP Example_Double "Kommentar" ROOT /begin REF_CHARACTERISTIC ampl_d period_d /end REF_CHARACTERISTIC /begin REF_MEASUREMENT channel_d syncCounter_uint /end REF_MEASUREMENT /end GROUP
/begin GROUP Example_Filter "Digital Filter v=(vin*a0+v*b0)/c0" ROOT /begin REF_CHARACTERISTIC a0 b0 c0 /end REF_CHARACTERISTIC
 /begin REF_MEASUREMENT syncCounter_double syncCounter_ulong syncCounter_ushort v vin /end REF_MEASUREMENT
/end GROUP
/begin GROUP Example_PWM "Generator for a PWM Signal" ROOT
 /begin REF_MEASUREMENT syncArrayStruct.mem_charArray[000] syncArrayStruct.mem_charArray[001] syncArrayStruct.mem_doubleArray[000] syncArrayStruct.mem_doubleArray[001] syncArrayStruct.mem_floatArray[000] syncArrayStruct.mem_floatArray[001] syncArrayStruct.mem_floatArray[002] syncArrayStruct.mem_intArray[000] syncArrayStruct.mem_intArray[001] syncArrayStruct.mem_longArray[000] syncArrayStruct.mem_longArray[001] syncArrayStruct.mem_shortArray[000] syncArrayStruct.mem_shortArray[001] syncArrayStruct.mem_structArray[000].mem_int syncArrayStruct.mem_structArray[000].mem_uint syncArrayStruct.mem_structArray[001].mem_int syncArrayStruct.mem_structArray[001].mem_uint syncArrayStruct.mem_ucharArray[000] syncArrayStruct.mem_ucharArray[001] syncArrayStruct.mem_ucharArray[002] syncArrayStruct.mem_uintArray[000] syncArrayStruct.mem_uintArray[001] syncArrayStruct.mem_uintArray[002] syncArrayStruct.mem_ulongArray[000] syncArrayStruct.mem_ulongArray[001] syncArrayStruct.mem_ulongArray[002] syncArrayStruct.mem_ushortArray[000] syncArrayStruct.mem_ushortArray[001] syncArrayStruct.mem_ushortArray[002] syncCounter_long syncCounter_uchar /end REF_MEASUREMENT
 /begin SUB_GROUP PWM_Parameters PWM_Signals /end SUB_GROUP
/end GROUP
/begin GROUP Lost_Found "" ROOT /end GROUP
/begin GROUP Maps "Calibration Maps" ROOT
 /begin REF_CHARACTERISTIC KF1 KF2 KF3 KF4 KF5 KF6 KF7 KF8 TestKennfeld map1_8_8_uc map1_8_8_uc_measure map4_80_uc map5_82_uc /end REF_CHARACTERISTIC
 /begin SUB_GROUP WorkingPoint /end SUB_GROUP
/end GROUP
/begin GROUP Measure "Measurement Values" ROOT /begin REF_MEASUREMENT channel1 channel2 channel3 noise perlin_noise /end REF_MEASUREMENT /begin SUB_GROUP Bits Bitslices Sync_Measure Test_Signals /end SUB_GROUP /end GROUP
/begin GROUP PWM_Parameters "Parametes for PWM Example"
 /begin REF_MEASUREMENT FW1 PWM_Level bytePWMFilter syncCounter_char syncCounter_short syncStructArray[000].mem_char syncStructArray[000].mem_double syncStructArray[000].mem_float syncStructArray[000].mem_uchar syncStructArray[001].mem_char syncStructArray[001].mem_double syncStructArray[001].mem_float syncStructArray[001].mem_uchar syncStructArray[002].mem_char syncStructArray[002].mem_double syncStructArray[002].mem_float syncStructArray[002].mem_uchar syncStructArray[003].mem_char syncStructArray[003].mem_double syncStructArray[003].mem_float syncStructArray[003].mem_uchar /end REF_MEASUREMENT
/end GROUP
/begin GROUP PWM_Signals "Measurement Signals from PWM" /begin REF_MEASUREMENT PWM PWMFiltered Triangle syncCounter_float syncCounter_int /end REF_MEASUREMENT /end GROUP
/begin GROUP Parameters "Calibration Parameters" ROOT /begin REF_CHARACTERISTIC ampl limit noise_ampl offset period /end REF_CHARACTERISTIC /begin SUB_GROUP Test_Parameters /end SUB_GROUP /end GROUP
/begin GROUP Simulator_Behavior "" ROOT /begin REF_CHARACTERISTIC Simulator_concept /end REF_CHARACTERISTIC /end GROUP
/begin GROUP Structure_in_Structure "Kommentar"
 /begin REF_CHARACTERISTIC TestStruct1.s0 TestStruct1.s1 TestStruct2[000].s0 TestStruct2[000].s1 TestStruct2[001].s0 TestStruct2[001].s1 TestStructStruct1.TestStruct2.s0 TestStructStruct1.TestStruct2.s1 TestStructStruct1.doubles TestStructStruct1.ints /end REF_CHARACTERISTIC
/end GROUP
/begin GROUP Structures "Examples for structures" ROOT
 /begin REF_CHARACTERISTIC TestStructTypes.cTest TestStructTypes.dTest TestStructTypes.fTest TestStructTypes.iTest TestStructTypes.lTest TestStructTypes.sTest TestStructTypes.ucTest TestStructTypes.uiTest TestStructTypes.ulTest TestStructTypes.usTest /end REF_CHARACTERISTIC
 /begin SUB_GROUP Structure_in_Structure /end SUB_GROUP
/end GROUP
/begin GROUP Sync_Measure "Measures which start at value zero at start of measurement"
 /begin REF_MEASUREMENT syncArrayStruct.mem_charArray[000] syncArrayStruct.mem_charArray[001] syncArrayStruct.mem_doubleArray[000] syncArrayStruct.mem_doubleArray[001] syncArrayStruct.mem_floatArray[000] syncArrayStruct.mem_floatArray[001] syncArrayStruct.mem_floatArray[002] syncArrayStruct.mem_intArray[000] syncArrayStruct.mem_intArray[001] syncArrayStruct.mem_longArray[000] syncArrayStruct.mem_longArray[001] syncArrayStruct.mem_shortArray[000] syncArrayStruct.mem_shortArray[001] syncArrayStruct.mem_structArray[000].mem_int syncArrayStruct.mem_structArray[000].mem_uint syncArrayStruct.mem_structArray[001].mem_int syncArrayStruct.mem_structArray[001].mem_uint syncArrayStruct.mem_ucharArray[000] syncArrayStruct.mem_ucharArray[001] syncArrayStruct.mem_ucharArray[002] syncArrayStruct.mem_uintArray[000] syncArrayStruct.mem_uintArray[001] syncArrayStruct.mem_uintArray[002] syncArrayStruct.mem_ulongArray[000] syncArrayStruct.mem_ulongArray[001] syncArrayStruct.mem_ulongArray[002] syncArrayStruct.mem_ushortArray[000] syncArrayStruct.mem_ushortArray[001] syncArrayStruct.mem_ushortArray[002] syncCounter_char syncCounter_double syncCounter_float syncCounter_int syncCounter_long syncCounter_short syncCounter_uchar syncCounter_uint syncCounter_ulong syncCounter_ushort syncStructArray[000].mem_char syncStructArray[000].mem_double syncStructArray[000].mem_float syncStructArray[000].mem_uchar syncStructArray[001].mem_char syncStructArray[001].mem_double syncStructArray[001].mem_float syncStructArray[001].mem_uchar syncStructArray[002].mem_char syncStructArray[002].mem_double syncStructArray[002].mem_float syncStructArray[002].mem_uchar syncStructArray[003].mem_char syncStructArray[003].mem_double syncStructArray[003].mem_float syncStructArray[003].mem_uchar /end REF_MEASUREMENT
/end GROUP
/end MODULE
/end PROJECT
