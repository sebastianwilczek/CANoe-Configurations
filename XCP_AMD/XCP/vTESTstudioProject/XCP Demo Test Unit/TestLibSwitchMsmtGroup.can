/*@!Encoding:1252*/
includes
{
  
}

variables
{
  
}

void OnXcpDisconnect(char ecuQualifier[])
{
  testSupplyTextEvent("XcpSim disconnected"); 
}

void OnXcpConnect(char ecuQualifier[])
{
  testSupplyTextEvent("XcpSim connected");
}

export testcase SwitchMeasurementGroups()
{
  long isMsmtGroupDAQActivated;
  long isMsmtGroupPollingDAQActivated;
  
  //-----Test Step 1-----
  TestStep("Test Step 1", "Disconnect device");
  xcpDisconnect("XcpSim");
  if( testWaitForTextEvent("XcpSim disconnected", 1000) == 1)
  {
    testStepPass("Test Step 1 passed: device disconnected.");
    //-----Test Step 2-----
    testStep("Test Step 2", "Activate Measurement Group \"MG DAQ\"");
    isMsmtGroupDAQActivated = xcpActivateMeasurementGroup("XcpSim", "MG DAQ");
    testWaitForTimeout(10);
    if(isMsmtGroupDAQActivated == 0)
    {
      testStepPass("Test Step 2 passed: Measurement Group \"MG DAQ\" activated.");
      //-----Test Step 3-----
      testStep("Test Step 3", "Connect device");
      xcpConnect("XcpSim"); 
      if( testWaitForTextEvent("XcpSim connected", 1000) == 1)
      {
        testStepPass("Test Step 3 passed: device connected.");
        testWaitForTimeout(5000);  
             
        //-----Test Step 4-----
        TestStep("Test Step 4", "Disconnect device");
        xcpDisconnect("XcpSim");
        if( testWaitForTextEvent("XcpSim disconnected", 1000) == 1)
        {
          testStepPass("Test Step 4 passed: device disconnected.");     
          //-----Test Step 5-----
          testStep("Test Step 5", "Activate Measurement Group \"MG Polling & DAQ\"");
          isMsmtGroupPollingDAQActivated = xcpActivateMeasurementGroup("XcpSim", "MG Polling & DAQ");
          testWaitForTimeout(10);
          if(isMsmtGroupPollingDAQActivated == 0)
          {
            testStepPass("Test Step 5 passed: Measurement Group \"MG Polling & DAQ\" activated.");
            //-----Test Step 6-----
            testStep("Test Step 6", "Connect device");
            xcpConnect("XcpSim");
            if( testWaitForTextEvent("XcpSim connected", 1000) == 1)
            {
               testStepPass("Test Step 6 passed: device connected.");
            }
            else
            {
              testStepFail("Test Step 6 failed", "connect device failed.");
            }
          }
          else
          {
             testStepFail("Test Step 5 failed", "failed activating Measurement Group \"MG Polling & DAQ\" with error code = %d.", isMsmtGroupPollingDAQActivated);
          }  
        }
        else
        {
          testStepFail("Test Step 4 failed", " disconnect device failed.");
        } 
      }
      else
      {
        testStepFail("Test Step 3 failed", "connect device failed.");
      }
    }
    else
    {
      testStepFail("Test Step 2 failed", "failed activating Measurement Group \"MG DAQ\" with error code = %d.", isMsmtGroupDAQActivated);
    }   
  }
  else
  {
    testStepFail("Test Step 1 failed", " disconnect device failed.");
  }
}


