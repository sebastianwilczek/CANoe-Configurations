/* generated by ASAP2 Updater Version 5.2.20 */ ASAP2_VERSION 1 60
/begin PROJECT example_Si2 ""
/begin MODULE CPP ""
/begin MOD_PAR "" /end MOD_PAR
/begin MOD_COMMON "" BYTE_ORDER MSB_LAST /end MOD_COMMON
/begin IF_DATA XCP
 /begin PROTOCOL_LAYER 0x100 0x7D0 0x2710 0x0 0x0 0x0 0x0 0x0 0x8 0x8 BYTE_ORDER_MSB_LAST ADDRESS_GRANULARITY_BYTE OPTIONAL_CMD GET_COMM_MODE_INFO OPTIONAL_CMD GET_ID OPTIONAL_CMD UNLOCK OPTIONAL_CMD SET_MTA OPTIONAL_CMD UPLOAD OPTIONAL_CMD SHORT_UPLOAD OPTIONAL_CMD TRANSPORT_LAYER_CMD OPTIONAL_CMD DOWNLOAD OPTIONAL_CMD DOWNLOAD_MAX OPTIONAL_CMD GET_PAG_PROCESSOR_INFO OPTIONAL_CMD SET_DAQ_PTR OPTIONAL_CMD WRITE_DAQ OPTIONAL_CMD SET_DAQ_LIST_MODE OPTIONAL_CMD GET_DAQ_LIST_MODE OPTIONAL_CMD START_STOP_DAQ_LIST OPTIONAL_CMD START_STOP_SYNCH OPTIONAL_CMD GET_DAQ_RESOLUTION_INFO OPTIONAL_CMD FREE_DAQ OPTIONAL_CMD ALLOC_DAQ OPTIONAL_CMD ALLOC_ODT OPTIONAL_CMD ALLOC_ODT_ENTRY /end PROTOCOL_LAYER
 /begin DAQ DYNAMIC 0x0 0x1 0x0 OPTIMISATION_TYPE_DEFAULT ADDRESS_EXTENSION_FREE IDENTIFICATION_FIELD_TYPE_ABSOLUTE GRANULARITY_ODT_ENTRY_SIZE_DAQ_BYTE 0x7 OVERLOAD_INDICATION_PID /begin EVENT "EV_CANDRV" "EV_CANDRV" 0x1 DAQ 0x0 0x0 0x6 0x0 /end EVENT /begin EVENT "EV_CANIF" "EV_CANIF" 0x2 DAQ 0x0 0x0 0x6 0x0 /end EVENT /begin EVENT "EV_CANSM" "EV_CANSM" 0x3 DAQ 0x0 0x0 0x6 0x0 /end EVENT /begin EVENT "EV_CANNM" "EV_CANNM" 0x5 DAQ 0x0 0x0 0x6 0x0 /end EVENT /begin EVENT "EV_NM" "EV_NM" 0x10 DAQ 0x0 0x0 0x6 0x0 /end EVENT /begin EVENT "EV_COMM" "EV_COMM" 0x6 DAQ 0x0 0x0 0x6 0x0 /end EVENT /begin EVENT "EV_ECUM" "EV_ECUM" 0x7 DAQ 0x0 0x0 0x6 0x0 /end EVENT /begin EVENT "EV_CANTP" "EV_CANTP" 0x4 DAQ 0x0 0x0 0x6 0x0 /end EVENT /begin EVENT "EV_COM" "EV_COM" 0xF DAQ 0x0 0x0 0x6 0x0 /end EVENT /begin EVENT "EV_VMM" "EV_VMM" 0xE DAQ 0x0 0x0 0x6 0x0 /end EVENT /end DAQ
 /begin XCP_ON_CAN 0x100 CAN_ID_MASTER 0x703 CAN_ID_SLAVE 0x704 BAUDRATE 0x7A120 SAMPLE_POINT 0x57 SAMPLE_RATE SINGLE BTL_CYCLES 0x8 SJW 0x1 SYNC_EDGE SINGLE MAX_DLC_REQUIRED /end XCP_ON_CAN
/end IF_DATA
/begin MEASUREMENT kGENyVersion "MICROSAR BSW" UBYTE uint8 0 0 0 255 FORMAT "%.15 " ECU_ADDRESS 0xBD6C0 MATRIX_DIM 10 1 1 /end MEASUREMENT
/begin MEASUREMENT lastInitObject[kCanNumberOfMaxUsedControllers] "MICROSAR BSW" UBYTE uint8 0 0 0 255 FORMAT "%.15 "
 /begin IF_DATA XCP
  /begin DAQ_EVENT FIXED_EVENT_LIST EVENT 0x1 /end DAQ_EVENT
 /end IF_DATA
 ECU_ADDRESS 0x104EE0 MATRIX_DIM 1 1 1 SYMBOL_LINK "lastInitObject" 0 /end MEASUREMENT
/begin MEASUREMENT canInterruptCounter[kCanNumberOfMaxUsedControllers] "MICROSAR BSW" UBYTE uint8 0 0 0 255 FORMAT "%.15 "
 /begin IF_DATA XCP
  /begin DAQ_EVENT FIXED_EVENT_LIST EVENT 0x1 /end DAQ_EVENT
 /end IF_DATA
 ECU_ADDRESS 0x104EDF MATRIX_DIM 1 1 1 SYMBOL_LINK "canInterruptCounter" 0 /end MEASUREMENT
/begin MEASUREMENT canStatus[kCanNumberOfMaxUsedControllers] "MICROSAR BSW" UBYTE CanStatusType 0 0 0 255 FORMAT "%.15 "
 /begin IF_DATA XCP
  /begin DAQ_EVENT FIXED_EVENT_LIST EVENT 0x1 /end DAQ_EVENT
 /end IF_DATA
 ECU_ADDRESS 0x104F58 MATRIX_DIM 1 1 1 SYMBOL_LINK "canStatus" 0 /end MEASUREMENT
/begin MEASUREMENT CanActiveSendPdu[kCanNumberOfUsedTxCANObjects] "MICROSAR BSW" UWORD PduIdType 0 0 0 65535 FORMAT "%.15 "
 /begin IF_DATA XCP
  /begin DAQ_EVENT FIXED_EVENT_LIST EVENT 0x1 /end DAQ_EVENT
 /end IF_DATA
 ECU_ADDRESS 0x104F5A MATRIX_DIM 1 1 1 SYMBOL_LINK "CanActiveSendPdu" 0 /end MEASUREMENT
/begin MEASUREMENT CanActiveSendState[kCanNumberOfUsedTxCANObjects] "MICROSAR BSW" UBYTE uint8 0 0 0 255 FORMAT "%.15 "
 /begin IF_DATA XCP
  /begin DAQ_EVENT FIXED_EVENT_LIST EVENT 0x1 /end DAQ_EVENT
 /end IF_DATA
 ECU_ADDRESS 0x104EDE MATRIX_DIM 1 1 1 SYMBOL_LINK "CanActiveSendState" 0 /end MEASUREMENT
/begin MEASUREMENT CanIf_ControllerMode[CANIF_MAX_CONTROLLER_TABLESIZE] "MICROSAR BSW" UBYTE CanIf_ControllerModeType 0 0 0 255 FORMAT "%.15 "
 /begin IF_DATA XCP
  /begin DAQ_EVENT FIXED_EVENT_LIST EVENT 0x2 /end DAQ_EVENT
 /end IF_DATA
 ECU_ADDRESS 0xE2BF4 MATRIX_DIM 1 1 1 SYMBOL_LINK "CanIf_ControllerMode" 0 /end MEASUREMENT
/begin MEASUREMENT CanIf_ChannelMode[CANIF_MAX_CONTROLLER_TABLESIZE] "MICROSAR BSW" UBYTE CanIf_PduGetModeType 0 0 0 255 FORMAT "%.15 "
 /begin IF_DATA XCP
  /begin DAQ_EVENT FIXED_EVENT_LIST EVENT 0x2 /end DAQ_EVENT
 /end IF_DATA
 ECU_ADDRESS 0x104ED4 MATRIX_DIM 1 1 1 SYMBOL_LINK "CanIf_ChannelMode" 0 /end MEASUREMENT
/begin MEASUREMENT CanIf_TxQueueCounter[CANIF_MAX_CONTROLLER_TABLESIZE] "MICROSAR BSW" UWORD PduIdType 0 0 0 65535 FORMAT "%.15 "
 /begin IF_DATA XCP
  /begin DAQ_EVENT FIXED_EVENT_LIST EVENT 0x2 /end DAQ_EVENT
 /end IF_DATA
 ECU_ADDRESS 0x104E64 MATRIX_DIM 1 1 1 SYMBOL_LINK "CanIf_TxQueueCounter" 0 /end MEASUREMENT
/begin MEASUREMENT CanSm_IsInitialized "MICROSAR BSW" UBYTE CanSm_IsInitialized 0 0 0 255 FORMAT "%.15 "
 /begin IF_DATA XCP
  /begin DAQ_EVENT FIXED_EVENT_LIST EVENT 0x3 /end DAQ_EVENT
 /end IF_DATA
 ECU_ADDRESS 0xE2C4C /end MEASUREMENT
/begin MEASUREMENT CanSM_EnableSetBusSleep[CanSMCountOfCanNetworks] "MICROSAR BSW" UBYTE CanSM_EnableSetBusSleep 0 0 0 255 FORMAT "%.15 "
 /begin IF_DATA XCP
  /begin DAQ_EVENT FIXED_EVENT_LIST EVENT 0x3 /end DAQ_EVENT
 /end IF_DATA
 ECU_ADDRESS 0x104E38 MATRIX_DIM 1 1 1 SYMBOL_LINK "CanSM_EnableSetBusSleep" 0 /end MEASUREMENT
/begin MEASUREMENT CanSM_ClusterState[0].CanSm_BorTimer "MICROSAR BSW" UWORD CanSM_BorTimerType 0 0 0 65535 FORMAT "%.15 "
 /begin IF_DATA XCP
  /begin DAQ_EVENT FIXED_EVENT_LIST EVENT 0x3 /end DAQ_EVENT
 /end IF_DATA
 ECU_ADDRESS 0x0 /end MEASUREMENT
/begin MEASUREMENT CanSM_ClusterState[0].CanSm_BorCounter "MICROSAR BSW" UBYTE CanSM_BorCounterType 0 0 0 255 FORMAT "%.15 "
 /begin IF_DATA XCP
  /begin DAQ_EVENT FIXED_EVENT_LIST EVENT 0x3 /end DAQ_EVENT
 /end IF_DATA
 ECU_ADDRESS 0x0 /end MEASUREMENT
/begin MEASUREMENT CanSM_ClusterState[0].CanSm_NwSmErrorCounter "MICROSAR BSW" UBYTE uint8 0 0 0 255 FORMAT "%.15 "
 /begin IF_DATA XCP
  /begin DAQ_EVENT FIXED_EVENT_LIST EVENT 0x3 /end DAQ_EVENT
 /end IF_DATA
 ECU_ADDRESS 0x0 /end MEASUREMENT
/begin MEASUREMENT CanSM_ClusterState[0].CanSm_RequestedComMode "MICROSAR BSW" UBYTE ComM_ModeType 0 0 0 255 FORMAT "%.15 "
 /begin IF_DATA XCP
  /begin DAQ_EVENT FIXED_EVENT_LIST EVENT 0x3 /end DAQ_EVENT
 /end IF_DATA
 ECU_ADDRESS 0x0 /end MEASUREMENT
/begin MEASUREMENT CanSM_ClusterState[0].CanSM_CommState "MICROSAR BSW" UBYTE ComM_ModeType 0 0 0 255 FORMAT "%.15 "
 /begin IF_DATA XCP
  /begin DAQ_EVENT FIXED_EVENT_LIST EVENT 0x3 /end DAQ_EVENT
 /end IF_DATA
 ECU_ADDRESS 0x0 /end MEASUREMENT
/begin MEASUREMENT CanSM_ClusterState[0].CanSm_BorState "MICROSAR BSW" UBYTE CanSM_BusOffRecoveryStateType 0 0 0 65535 FORMAT "%.15 "
 /begin IF_DATA XCP
  /begin DAQ_EVENT FIXED_EVENT_LIST EVENT 0x3 /end DAQ_EVENT
 /end IF_DATA
 ECU_ADDRESS 0x0 /end MEASUREMENT
/begin MEASUREMENT CanSM_ClusterState[0].CanSm_BusOffEventOccurred "MICROSAR BSW" UBYTE CanSm_BusOffEventType 0 0 0 255 FORMAT "%.15 "
 /begin IF_DATA XCP
  /begin DAQ_EVENT FIXED_EVENT_LIST EVENT 0x3 /end DAQ_EVENT
 /end IF_DATA
 ECU_ADDRESS 0x0 /end MEASUREMENT
/begin MEASUREMENT CanNm_CommState "MICROSAR BSW" UBYTE uint8 0 0 0 255 FORMAT "%.15 "
 /begin IF_DATA XCP
  /begin DAQ_EVENT FIXED_EVENT_LIST EVENT 0x5 /end DAQ_EVENT
 /end IF_DATA
 ECU_ADDRESS 0x104E3A MATRIX_DIM 1 1 1 /end MEASUREMENT
/begin MEASUREMENT CanNm_MsgTimer "MICROSAR BSW" UWORD CanNm_TimerCounterType 0 0 0 65535 FORMAT "%.15 "
 /begin IF_DATA XCP
  /begin DAQ_EVENT FIXED_EVENT_LIST EVENT 0x5 /end DAQ_EVENT
 /end IF_DATA
 ECU_ADDRESS 0x104E60 MATRIX_DIM 1 1 1 /end MEASUREMENT
/begin MEASUREMENT CanNm_MsgTimeoutTimer "MICROSAR BSW" UWORD CanNm_TimerCounterType 0 0 0 65535 FORMAT "%.15 "
 /begin IF_DATA XCP
  /begin DAQ_EVENT FIXED_EVENT_LIST EVENT 0x5 /end DAQ_EVENT
 /end IF_DATA
 ECU_ADDRESS 0x104E5C MATRIX_DIM 1 1 1 /end MEASUREMENT
/begin MEASUREMENT CanNm_NetworkRestartFlag "MICROSAR BSW" UBYTE uint8 0 0 0 255 FORMAT "%.15 "
 /begin IF_DATA XCP
  /begin DAQ_EVENT FIXED_EVENT_LIST EVENT 0x5 /end DAQ_EVENT
 /end IF_DATA
 ECU_ADDRESS 0x104E62 MATRIX_DIM 1 1 1 /end MEASUREMENT
/begin MEASUREMENT CanNm_TxControlStateRequest "MICROSAR BSW" UBYTE uint8 0 0 0 255 FORMAT "%.15 "
 /begin IF_DATA XCP
  /begin DAQ_EVENT FIXED_EVENT_LIST EVENT 0x5 /end DAQ_EVENT
 /end IF_DATA
 ECU_ADDRESS 0x104E4E MATRIX_DIM 1 1 1 /end MEASUREMENT
/begin MEASUREMENT CanNm_TimeoutTimer "MICROSAR BSW" UWORD CanNm_TimerCounterType 0 0 0 65535 FORMAT "%.15 "
 /begin IF_DATA XCP
  /begin DAQ_EVENT FIXED_EVENT_LIST EVENT 0x5 /end DAQ_EVENT
 /end IF_DATA
 ECU_ADDRESS 0x104E5E MATRIX_DIM 1 1 1 /end MEASUREMENT
/begin MEASUREMENT CanNm_WaitBusSleepTimer "MICROSAR BSW" UWORD CanNm_TimerCounterType 0 0 0 65535 FORMAT "%.15 "
 /begin IF_DATA XCP
  /begin DAQ_EVENT FIXED_EVENT_LIST EVENT 0x5 /end DAQ_EVENT
 /end IF_DATA
 ECU_ADDRESS 0x104E4A MATRIX_DIM 1 1 1 /end MEASUREMENT
/begin MEASUREMENT CanNm_RepeatMsgTimer "MICROSAR BSW" UWORD CanNm_TimerCounterType 0 0 0 65535 FORMAT "%.15 "
 /begin IF_DATA XCP
  /begin DAQ_EVENT FIXED_EVENT_LIST EVENT 0x5 /end DAQ_EVENT
 /end IF_DATA
 ECU_ADDRESS 0x104E4C MATRIX_DIM 1 1 1 /end MEASUREMENT
/begin MEASUREMENT CanNm_NmState "MICROSAR BSW" UBYTE Nm_StateType 0 0 0 255 FORMAT "%.15 "
 /begin IF_DATA XCP
  /begin DAQ_EVENT FIXED_EVENT_LIST EVENT 0x5 /end DAQ_EVENT
 /end IF_DATA
 ECU_ADDRESS 0x104E58 MATRIX_DIM 1 1 1 /end MEASUREMENT
/begin MEASUREMENT ComM_Inhibition.ComM_ECUGroupClassification "MICROSAR BSW" UBYTE ComM_InhibitionStatusType 0 0 0 255 FORMAT "%.15 "
 /begin IF_DATA XCP
  /begin DAQ_EVENT FIXED_EVENT_LIST EVENT 0x6 /end DAQ_EVENT
 /end IF_DATA
 ECU_ADDRESS 0x104CE0 /end MEASUREMENT
/begin MEASUREMENT ComM_Inhibition.ComM_InhibitCnt "MICROSAR BSW" UWORD uint16 0 0 0 65535 FORMAT "%.15 "
 /begin IF_DATA XCP
  /begin DAQ_EVENT FIXED_EVENT_LIST EVENT 0x6 /end DAQ_EVENT
 /end IF_DATA
 ECU_ADDRESS 0x104CE2 /end MEASUREMENT
/begin MEASUREMENT ComM_UserReqFullComArray "MICROSAR BSW" UBYTE uint8 0 0 0 255 FORMAT "%.15 "
 /begin IF_DATA XCP
  /begin DAQ_EVENT FIXED_EVENT_LIST EVENT 0x6 /end DAQ_EVENT
 /end IF_DATA
 ECU_ADDRESS 0x104CD2 MATRIX_DIM 1 1 1 /end MEASUREMENT
/begin MEASUREMENT ComM_Inhibition.ComM_InhibitionStatus "MICROSAR BSW" UBYTE ComM_InhibitionStatusType 0 0 0 255 FORMAT "%.15 "
 /begin IF_DATA XCP
  /begin DAQ_EVENT FIXED_EVENT_LIST EVENT 0x6 /end DAQ_EVENT
 /end IF_DATA
 DISPLAY_IDENTIFIER ComM_Inhibition.ComM_InhibitionStatus[COMM_ACTIVE_CHANNEL] ECU_ADDRESS 0x104CE4 MATRIX_DIM 1 1 1 /end MEASUREMENT
/begin MEASUREMENT ComM_FrShutdown[COMM_ACTIVE_CHANNEL] "MICROSAR BSW" UBYTE ComM_FrShutdownType 0 0 0 255 FORMAT "%.15 "
 /begin IF_DATA XCP
  /begin DAQ_EVENT FIXED_EVENT_LIST EVENT 0x6 /end DAQ_EVENT
 /end IF_DATA
 ECU_ADDRESS 0x104CD4 MATRIX_DIM 1 1 1 SYMBOL_LINK "ComM_FrShutdown" 0 /end MEASUREMENT
/begin MEASUREMENT ComM_BusSmState[COMM_ACTIVE_CHANNEL] "MICROSAR BSW" UBYTE ComM_ModeType 0 0 0 255 FORMAT "%.15 "
 /begin IF_DATA XCP
  /begin DAQ_EVENT FIXED_EVENT_LIST EVENT 0x6 /end DAQ_EVENT
 /end IF_DATA
 ECU_ADDRESS 0x104CD5 MATRIX_DIM 1 1 1 SYMBOL_LINK "ComM_BusSmState" 0 /end MEASUREMENT
/begin MEASUREMENT ComM_MinFullComModeTime[COMM_ACTIVE_CHANNEL] "MICROSAR BSW" UWORD uint16 0 0 0 65535 FORMAT "%.15 "
 /begin IF_DATA XCP
  /begin DAQ_EVENT FIXED_EVENT_LIST EVENT 0x6 /end DAQ_EVENT
 /end IF_DATA
 ECU_ADDRESS 0x104CEA MATRIX_DIM 1 1 1 SYMBOL_LINK "ComM_MinFullComModeTime" 0 /end MEASUREMENT
/begin MEASUREMENT ComM_NmLightTimeout[COMM_ACTIVE_CHANNEL] "MICROSAR BSW" UWORD uint16 0 0 0 65535 FORMAT "%.15 "
 /begin IF_DATA XCP
  /begin DAQ_EVENT FIXED_EVENT_LIST EVENT 0x6 /end DAQ_EVENT
 /end IF_DATA
 ECU_ADDRESS 0x104CE8 MATRIX_DIM 1 1 1 SYMBOL_LINK "ComM_NmLightTimeout" 0 /end MEASUREMENT
/begin MEASUREMENT ComM_ActiveComMode "MICROSAR BSW" UBYTE ComM_SubModeType 0 0 0 255 FORMAT "%.15 "
 /begin IF_DATA XCP
  /begin DAQ_EVENT FIXED_EVENT_LIST EVENT 0x6 /end DAQ_EVENT
 /end IF_DATA
 ECU_ADDRESS 0x104CF0 MATRIX_DIM 1 1 1 /end MEASUREMENT
/begin MEASUREMENT ComM_BusComModeReq "MICROSAR BSW" UBYTE ComM_SubModeType 0 0 0 255 FORMAT "%.15 "
 /begin IF_DATA XCP
  /begin DAQ_EVENT FIXED_EVENT_LIST EVENT 0x6 /end DAQ_EVENT
 /end IF_DATA
 ECU_ADDRESS 0x104CD8 MATRIX_DIM 1 1 1 /end MEASUREMENT
/begin MEASUREMENT EcuM_ModuleState_t "MICROSAR BSW" UBYTE EcuM_StateType 0 0 0 255 FORMAT "%.15 "
 /begin IF_DATA XCP
  /begin DAQ_EVENT FIXED_EVENT_LIST EVENT 0x7 /end DAQ_EVENT
 /end IF_DATA
 ECU_ADDRESS 0xE32B9 /end MEASUREMENT
/begin MEASUREMENT EcuM_AppMode_t "MICROSAR BSW" UBYTE AppModeType 0 0 0 255 FORMAT "%.15 "
 /begin IF_DATA XCP
  /begin DAQ_EVENT FIXED_EVENT_LIST EVENT 0x7 /end DAQ_EVENT
 /end IF_DATA
 ECU_ADDRESS 0xE32D8 /end MEASUREMENT
/begin MEASUREMENT EcuM_ShutdownTarget_t "MICROSAR BSW" UBYTE EcuM_StateType 0 0 0 255 FORMAT "%.15 "
 /begin IF_DATA XCP
  /begin DAQ_EVENT FIXED_EVENT_LIST EVENT 0x7 /end DAQ_EVENT
 /end IF_DATA
 ECU_ADDRESS 0xE32C4 /end MEASUREMENT
/begin MEASUREMENT EcuM_WakeupReaction_t "MICROSAR BSW" UBYTE EcuM_WakeupReactionType 0 0 0 255 FORMAT "%.15 "
 /begin IF_DATA XCP
  /begin DAQ_EVENT FIXED_EVENT_LIST EVENT 0x7 /end DAQ_EVENT
 /end IF_DATA
 ECU_ADDRESS 0xE32D7 /end MEASUREMENT
/begin MEASUREMENT EcuM_PendingWakeups_t "MICROSAR BSW" ULONG EcuM_WakeupSourceType 0 0 0 4294967295 FORMAT "%.15 "
 /begin IF_DATA XCP
  /begin DAQ_EVENT FIXED_EVENT_LIST EVENT 0x7 /end DAQ_EVENT
 /end IF_DATA
 ECU_ADDRESS 0xE32BC /end MEASUREMENT
/begin MEASUREMENT EcuM_RunRequestCounter_t "MICROSAR BSW" UBYTE EcuM_UserType 0 0 0 255 FORMAT "%.15 "
 /begin IF_DATA XCP
  /begin DAQ_EVENT FIXED_EVENT_LIST EVENT 0x7 /end DAQ_EVENT
 /end IF_DATA
 ECU_ADDRESS 0xE32B4 /end MEASUREMENT
/begin MEASUREMENT EcuM_PostRunRequestCounter_t "MICROSAR BSW" UBYTE EcuM_UserType 0 0 0 255 FORMAT "%.15 "
 /begin IF_DATA XCP
  /begin DAQ_EVENT FIXED_EVENT_LIST EVENT 0x7 /end DAQ_EVENT
 /end IF_DATA
 ECU_ADDRESS 0xE32B7 /end MEASUREMENT
/begin MEASUREMENT EcuM_LastShutdownTarget_t.DefaultState_t "MICROSAR BSW" UBYTE EcuM_StateType 0 0 0 255 FORMAT "%.15 "
 /begin IF_DATA XCP
  /begin DAQ_EVENT FIXED_EVENT_LIST EVENT 0x7 /end DAQ_EVENT
 /end IF_DATA
 ECU_ADDRESS 0xE32DC /end MEASUREMENT
/begin MEASUREMENT EcuM_LastShutdownTarget_t.DefaultSleepMode_u8 "MICROSAR BSW" UBYTE uint8 0 0 0 255 FORMAT "%.15 "
 /begin IF_DATA XCP
  /begin DAQ_EVENT FIXED_EVENT_LIST EVENT 0x7 /end DAQ_EVENT
 /end IF_DATA
 ECU_ADDRESS 0xE32DD /end MEASUREMENT
/begin MEASUREMENT EcuM_FsmState_t "MICROSAR BSW" SLONG EcuM_InternalStateType 0 0 0 255 FORMAT "%.15 "
 /begin IF_DATA XCP
  /begin DAQ_EVENT FIXED_EVENT_LIST EVENT 0x7 /end DAQ_EVENT
 /end IF_DATA
 ECU_ADDRESS 0xE32E0 /end MEASUREMENT
/begin MEASUREMENT EcuM_NvM_JobStatus_t "MICROSAR BSW" UBYTE NvM_RequestResultType 0 0 0 255 FORMAT "%.15 "
 /begin IF_DATA XCP
  /begin DAQ_EVENT FIXED_EVENT_LIST EVENT 0x7 /end DAQ_EVENT
 /end IF_DATA
 ECU_ADDRESS 0xE32B6 /end MEASUREMENT
/begin MEASUREMENT com_LMgt_Status "MICROSAR BSW" SLONG Com_StatusType 0 0 0 255 FORMAT "%.15 "
 /begin IF_DATA XCP
  /begin DAQ_EVENT FIXED_EVENT_LIST EVENT 0xF /end DAQ_EVENT
 /end IF_DATA
 ECU_ADDRESS 0xE3284 /end MEASUREMENT
/begin MEASUREMENT com_LMgt_RxPduGroupState[COM_MAXRXIPDUCNT] "MICROSAR BSW" UBYTE uint8 0 0 0 255 FORMAT "%.15 "
 /begin IF_DATA XCP
  /begin DAQ_EVENT FIXED_EVENT_LIST EVENT 0xF /end DAQ_EVENT
 /end IF_DATA
 ECU_ADDRESS 0x104D16 MATRIX_DIM 1 1 1 SYMBOL_LINK "com_LMgt_RxPduGroupState" 0 /end MEASUREMENT
/begin MEASUREMENT com_LMgt_TxPduGroupState[COM_MAXTXIPDUCNT] "MICROSAR BSW" UBYTE uint8 0 0 0 255 FORMAT "%.15 "
 /begin IF_DATA XCP
  /begin DAQ_EVENT FIXED_EVENT_LIST EVENT 0xF /end DAQ_EVENT
 /end IF_DATA
 ECU_ADDRESS 0x104D10 MATRIX_DIM 4 1 1 SYMBOL_LINK "com_LMgt_TxPduGroupState" 0 /end MEASUREMENT
/begin MEASUREMENT com_RxDlMon_TimeoutCnt[COM_MAXRXIPDUCNT] "MICROSAR BSW" UWORD uint16 0 0 0 65535 FORMAT "%.15 "
 /begin IF_DATA XCP
  /begin DAQ_EVENT FIXED_EVENT_LIST EVENT 0xF /end DAQ_EVENT
 /end IF_DATA
 ECU_ADDRESS 0x104D14 MATRIX_DIM 1 1 1 SYMBOL_LINK "com_RxDlMon_TimeoutCnt" 0 /end MEASUREMENT
/begin MEASUREMENT com_TxModeHdlr_TransmitRequest[COM_MAXTXIPDUCNT] "MICROSAR BSW" UBYTE boolean 0 0 0 255 FORMAT "%.15 "
 /begin IF_DATA XCP
  /begin DAQ_EVENT FIXED_EVENT_LIST EVENT 0xF /end DAQ_EVENT
 /end IF_DATA
 ECU_ADDRESS 0x104D00 MATRIX_DIM 4 1 1 SYMBOL_LINK "com_TxModeHdlr_TransmitRequest" 0 /end MEASUREMENT
/begin MEASUREMENT com_TxModeHdlr_CurrentTxMode[COM_MAXTXIPDUCNT] "MICROSAR BSW" UWORD Com_TxModeHdlr_TxModeHdlType 0 0 0 65535 FORMAT "%.15 "
 /begin IF_DATA XCP
  /begin DAQ_EVENT FIXED_EVENT_LIST EVENT 0xF /end DAQ_EVENT
 /end IF_DATA
 ECU_ADDRESS 0x104CF8 MATRIX_DIM 4 1 1 SYMBOL_LINK "com_TxModeHdlr_CurrentTxMode" 0 /end MEASUREMENT
/begin MEASUREMENT com_TxDlMon_TimeoutCnt[COM_MAXTXIPDUCNT] "MICROSAR BSW" UWORD uint16 0 0 0 65535 FORMAT "%.15 "
 /begin IF_DATA XCP
  /begin DAQ_EVENT FIXED_EVENT_LIST EVENT 0xF /end DAQ_EVENT
 /end IF_DATA
 ECU_ADDRESS 0x104D40 MATRIX_DIM 4 1 1 SYMBOL_LINK "com_TxDlMon_TimeoutCnt" 0 /end MEASUREMENT
/begin MEASUREMENT Vmm_InitState "MICROSAR BSW" UBYTE Vmm_InitStateType 0 0 0 255 FORMAT "%.15 "
 /begin IF_DATA XCP
  /begin DAQ_EVENT FIXED_EVENT_LIST EVENT 0xE /end DAQ_EVENT
 /end IF_DATA
 ECU_ADDRESS 0xE32E5 /end MEASUREMENT
/begin MEASUREMENT Vmm_BusSMInitFlag[VMM_ChannelCount] "MICROSAR BSW" UBYTE boolean 0 0 0 255 FORMAT "%.15 "
 /begin IF_DATA XCP
  /begin DAQ_EVENT FIXED_EVENT_LIST EVENT 0xE /end DAQ_EVENT
 /end IF_DATA
 ECU_ADDRESS 0x1047D2 MATRIX_DIM 1 1 1 SYMBOL_LINK "Vmm_BusSMInitFlag" 0 /end MEASUREMENT
/begin MEASUREMENT Vmm_ComCtrlComRx[VMM_ChannelCount] "MICROSAR BSW" UBYTE boolean 0 0 0 255 FORMAT "%.15 "
 /begin IF_DATA XCP
  /begin DAQ_EVENT FIXED_EVENT_LIST EVENT 0xE /end DAQ_EVENT
 /end IF_DATA
 ECU_ADDRESS 0x1047D5 MATRIX_DIM 1 1 1 SYMBOL_LINK "Vmm_ComCtrlComRx" 0 /end MEASUREMENT
/begin MEASUREMENT Vmm_ComCtrlComTx[VMM_ChannelCount] "MICROSAR BSW" UBYTE boolean 0 0 0 255 FORMAT "%.15 "
 /begin IF_DATA XCP
  /begin DAQ_EVENT FIXED_EVENT_LIST EVENT 0xE /end DAQ_EVENT
 /end IF_DATA
 ECU_ADDRESS 0x1047D6 MATRIX_DIM 1 1 1 SYMBOL_LINK "Vmm_ComCtrlComTx" 0 /end MEASUREMENT
/begin MEASUREMENT Vmm_ComTxState[VMM_ChannelCount] "MICROSAR BSW" UBYTE boolean 0 0 0 255 FORMAT "%.15 "
 /begin IF_DATA XCP
  /begin DAQ_EVENT FIXED_EVENT_LIST EVENT 0xE /end DAQ_EVENT
 /end IF_DATA
 ECU_ADDRESS 0x1047D3 MATRIX_DIM 1 1 1 SYMBOL_LINK "Vmm_ComTxState" 0 /end MEASUREMENT
/begin MEASUREMENT Vmm_ComRxState[VMM_ChannelCount] "MICROSAR BSW" UBYTE boolean 0 0 0 255 FORMAT "%.15 "
 /begin IF_DATA XCP
  /begin DAQ_EVENT FIXED_EVENT_LIST EVENT 0xE /end DAQ_EVENT
 /end IF_DATA
 ECU_ADDRESS 0x1047D4 MATRIX_DIM 1 1 1 SYMBOL_LINK "Vmm_ComRxState" 0 /end MEASUREMENT
/begin MEASUREMENT Vmm_BusSMDMState[VMM_ChannelCount] "MICROSAR BSW" UBYTE boolean 0 0 0 255 FORMAT "%.15 "
 /begin IF_DATA XCP
  /begin DAQ_EVENT FIXED_EVENT_LIST EVENT 0xE /end DAQ_EVENT
 /end IF_DATA
 ECU_ADDRESS 0x1047D7 MATRIX_DIM 1 1 1 SYMBOL_LINK "Vmm_BusSMDMState" 0 /end MEASUREMENT
/begin COMPU_METHOD boolean "" TAB_VERB "%.1" "" COMPU_TAB_REF boolean /end COMPU_METHOD
/begin COMPU_METHOD uint8 "" IDENTICAL "%4.0" "" /end COMPU_METHOD
/begin COMPU_METHOD uint16 "" IDENTICAL "%4.0" "" /end COMPU_METHOD
/begin COMPU_METHOD uint32 "" IDENTICAL "%4.0" "" /end COMPU_METHOD
/begin COMPU_METHOD sint8 "" IDENTICAL "%4.0" "" /end COMPU_METHOD
/begin COMPU_METHOD sint16 "" IDENTICAL "%4.0" "" /end COMPU_METHOD
/begin COMPU_METHOD sint32 "" IDENTICAL "%4.0" "" /end COMPU_METHOD
/begin COMPU_METHOD PduIdType "" IDENTICAL "%4.0" "" /end COMPU_METHOD
/begin COMPU_METHOD CanStatusType "" TAB_VERB "%.1" "" COMPU_TAB_REF CanStatusType /end COMPU_METHOD
/begin COMPU_METHOD CanIf_ControllerModeType "" TAB_VERB "%.1" "" COMPU_TAB_REF CanIf_ControllerModeType /end COMPU_METHOD
/begin COMPU_METHOD CanIf_PduGetModeType "" TAB_VERB "%.1" "" COMPU_TAB_REF CanIf_PduGetModeType /end COMPU_METHOD
/begin COMPU_METHOD CanSm_IsInitialized "" TAB_VERB "%.1" "" COMPU_TAB_REF CanSm_IsInitialized /end COMPU_METHOD
/begin COMPU_METHOD CanSM_EnableSetBusSleep "" TAB_VERB "%.1" "" COMPU_TAB_REF CanSM_EnableSetBusSleep /end COMPU_METHOD
/begin COMPU_METHOD CanSM_BusOffRecoveryStateType "" TAB_VERB "%.1" "" COMPU_TAB_REF CanSM_BusOffRecoveryStateType /end COMPU_METHOD
/begin COMPU_METHOD CanSm_BusOffEventType "" TAB_VERB "%.1" "" COMPU_TAB_REF CanSm_BusOffEventType /end COMPU_METHOD
/begin COMPU_METHOD CanSM_BorTimerType "" IDENTICAL "%4.0" "" /end COMPU_METHOD
/begin COMPU_METHOD CanSM_BorCounterType "" IDENTICAL "%4.0" "" /end COMPU_METHOD
/begin COMPU_METHOD Nm_StateType "" TAB_VERB "%.1" "" COMPU_TAB_REF Nm_StateType /end COMPU_METHOD
/begin COMPU_METHOD CanNm_TimerCounterType "" IDENTICAL "%4.0" "" /end COMPU_METHOD
/begin COMPU_METHOD Nm_NetCoordStateType "" TAB_VERB "%.1" "" COMPU_TAB_REF Nm_NetCoordStateType /end COMPU_METHOD
/begin COMPU_METHOD Nm_TimerCounterType "" IDENTICAL "%4.0" "" /end COMPU_METHOD
/begin COMPU_METHOD Nm_NetworkCoordType "" IDENTICAL "%4.0" "" /end COMPU_METHOD
/begin COMPU_METHOD ComM_DcmReqStateType "" TAB_VERB "%.1" "" COMPU_TAB_REF ComM_DcmReqStateType /end COMPU_METHOD
/begin COMPU_METHOD ComM_SubModeType "" TAB_VERB "%.1" "" COMPU_TAB_REF ComM_SubModeType /end COMPU_METHOD
/begin COMPU_METHOD ComM_ModeType "" TAB_VERB "%.1" "" COMPU_TAB_REF ComM_ModeType /end COMPU_METHOD
/begin COMPU_METHOD ComM_FrShutdownType "" TAB_VERB "%.1" "" COMPU_TAB_REF ComM_FrShutdownType /end COMPU_METHOD
/begin COMPU_METHOD ComM_InhibitionStatusType "" IDENTICAL "%4.0" "" /end COMPU_METHOD
/begin COMPU_METHOD AppModeType "" IDENTICAL "%4.0" "" /end COMPU_METHOD
/begin COMPU_METHOD EcuM_UserType "" IDENTICAL "%4.0" "" /end COMPU_METHOD
/begin COMPU_METHOD EcuM_StateType "" TAB_VERB "%.1" "" COMPU_TAB_REF EcuM_StateType /end COMPU_METHOD
/begin COMPU_METHOD EcuM_WakeupReactionType "" TAB_VERB "%.1" "" COMPU_TAB_REF EcuM_WakeupReactionType /end COMPU_METHOD
/begin COMPU_METHOD NvM_RequestResultType "" TAB_VERB "%.1" "" COMPU_TAB_REF NvM_RequestResultType /end COMPU_METHOD
/begin COMPU_METHOD EcuM_InternalStateType "" TAB_VERB "%.1" "" COMPU_TAB_REF EcuM_InternalStateType /end COMPU_METHOD
/begin COMPU_METHOD EcuM_WakeupSourceType "" TAB_VERB "%.1" "" COMPU_TAB_REF EcuM_WakeupSourceType /end COMPU_METHOD
/begin COMPU_METHOD Com_TxModeHdlr_TxModeHdlType "" IDENTICAL "%4.0" "" /end COMPU_METHOD
/begin COMPU_METHOD Com_StatusType "" TAB_VERB "%.1" "" COMPU_TAB_REF Com_StatusType /end COMPU_METHOD
/begin COMPU_METHOD Vmm_InitStateType "" TAB_VERB "%.1" "" COMPU_TAB_REF Vmm_InitStateType /end COMPU_METHOD
/begin COMPU_VTAB boolean "MICROSAR BSW" TAB_VERB 3 0 "FALSE" 1 "TRUE" 2 "UNDEFINED" DEFAULT_VALUE "" /end COMPU_VTAB
/begin COMPU_VTAB CanStatusType "MICROSAR BSW" TAB_VERB 2 1 "kCanHwIsInit" 254 "kCanHwIsUninit" DEFAULT_VALUE "" /end COMPU_VTAB
/begin COMPU_VTAB CanIf_ControllerModeType "MICROSAR BSW" TAB_VERB 4 0 "CANIF_CS_UNINIT" 1 "CANIF_CS_STOPPED" 2 "CANIF_CS_STARTED" 3 "CANIF_CS_SLEEP" DEFAULT_VALUE "" /end COMPU_VTAB
/begin COMPU_VTAB CanIf_PduGetModeType "MICROSAR BSW" TAB_VERB 6 0 "CANIF_GET_OFFLINE" 1 "CANIF_GET_RX_ONLINE" 2 "CANIF_GET_TX_ONLINE" 3 "CANIF_GET_ONLINE" 4 "CANIF_GET_OFFLINE_ACTIVE" 5 "CANIF_GET_OFFLINE_ACTIVE_RX_ONLINE" DEFAULT_VALUE "" /end COMPU_VTAB
/begin COMPU_VTAB CanSm_IsInitialized "MICROSAR BSW" TAB_VERB 3 0 "CANSM_INITFUNCTION_NOT_CALLED" 1 "CANSM_INITFUNCTION_CALLED" 2 "CANSM_PROCEED_INITIALIZATION" DEFAULT_VALUE "" /end COMPU_VTAB
/begin COMPU_VTAB CanSM_EnableSetBusSleep "MICROSAR BSW" TAB_VERB 2 0 "CANSM_SET_BUS_SLEEP_MODE" 1 "CANSM_PREVENT_BUS_SLEEP_MODE" DEFAULT_VALUE "" /end COMPU_VTAB
/begin COMPU_VTAB CanSM_BusOffRecoveryStateType "MICROSAR BSW" TAB_VERB 7 0 "CANSM_BOR_IDLE" 1 "CANSM_BOR_CHECK_INIT" 2 "CANSM_BOR_NO_BUS_OFF" 3 "CANSM_BOR_STATE_TXOFF" 4 "CANSM_BOR_STATE_CHECK" 5 "CANSM_BOR_TXOFF_L2" 6 "CANSM_BOR_CHECK_L2" DEFAULT_VALUE "" /end COMPU_VTAB
/begin COMPU_VTAB CanSm_BusOffEventType "MICROSAR BSW" TAB_VERB 2 0 "FALSE" 1 "TRUE" DEFAULT_VALUE "" /end COMPU_VTAB
/begin COMPU_VTAB Nm_StateType "MICROSAR BSW" TAB_VERB 7 0 "NM_STATE_UNINIT" 1 "NM_STATE_BUS_SLEEP" 2 "NM_STATE_PREPARE_BUS_SLEEP" 3 "NM_STATE_READY_SLEEP" 4 "NM_STATE_NORMAL_OPERATION" 5 "NM_STATE_REPEAT_MESSAGE" 6 "NM_STATE_SYNCHRONIZE" DEFAULT_VALUE "" /end COMPU_VTAB
/begin COMPU_VTAB Nm_NetCoordStateType "MICROSAR BSW" TAB_VERB 6 0 "NM_UNINITIALIZED" 1 "NM_AWAKE" 2 "NM_SLEEP_WAITANNOUNCESLEEP" 3 "NM_SLEEP_WAITTOKEN" 4 "NM_SLEEP_WAITTOKENLOSS" 5 "NM_SLEEP_WAITSLEEP" DEFAULT_VALUE "" /end COMPU_VTAB
/begin COMPU_VTAB ComM_DcmReqStateType "MICROSAR BSW" TAB_VERB 2 0 "COMM_DCM_REQ_INACTIVE" 1 "COMM_DCM_REQ_ACTIVE" DEFAULT_VALUE "" /end COMPU_VTAB
/begin COMPU_VTAB ComM_SubModeType "MICROSAR BSW" TAB_VERB 4 0 "COMM_NO_COM" 1 "COMM_SI_COM" 2 "COMM_READY_TO_SLEEP" 3 "COMM_NETWORK_REQUESTED" DEFAULT_VALUE "" /end COMPU_VTAB
/begin COMPU_VTAB ComM_ModeType "MICROSAR BSW" TAB_VERB 3 0 "COMM_NO_COMMUNICATION" 1 "COMM_SILENT_COMMUNICATION" 2 "COMM_FULL_COMMUNICATION" DEFAULT_VALUE "" /end COMPU_VTAB
/begin COMPU_VTAB ComM_FrShutdownType "MICROSAR BSW" TAB_VERB 2 0 "COMM_FR_SHUTDOWN_ACTIVE" 1 "COMM_FR_SHUTDOWN_DEACTIVE" DEFAULT_VALUE "" /end COMPU_VTAB
/begin COMPU_VTAB EcuM_StateType "MICROSAR BSW" TAB_VERB 22 16 "ECUM_STATE_STARTUP" 17 "ECUM_STATE_STARTUP_ONE" 18 "ECUM_STATE_STARTUP_TWO" 32 "ECUM_STATE_WAKEUP" 33 "ECUM_STATE_WAKEUP_ONE" 34 "ECUM_STATE_WAKEUP_VALIDATION" 35 "ECUM_STATE_WAKEUP_REACTION" 36 "ECUM_STATE_WAKEUP_TWO" 37 "ECUM_STATE_WAKEUP_WAKESLEEP" 38 "ECUM_STATE_WAKEUP_TTII" 48 "ECUM_STATE_RUN" 50 "ECUM_STATE_APP_RUN" 51 "ECUM_STATE_APP_POST_RUN" 64 "ECUM_STATE_SHUTDOWN" 68 "ECUM_STATE_PREP_SHUTDOWN" 73 "ECUM_STATE_GO_SLEEP" 77 "ECUM_STATE_GO_OFF_ONE" 78 "ECUM_STATE_GO_OFF_TWO" 80 "ECUM_STATE_SLEEP" 144 "ECUM_STATE_RESET" 128 "ECUM_STATE_OFF" 255 "ECUM_STATE_ERROR" DEFAULT_VALUE "" /end COMPU_VTAB
/begin COMPU_VTAB EcuM_WakeupReactionType "MICROSAR BSW" TAB_VERB 3 0 "ECUM_WKACT_RUN" 2 "ECUM_WKACT_TTII" 3 "ECUM_WKACT_SHUTDOWN" DEFAULT_VALUE "" /end COMPU_VTAB
/begin COMPU_VTAB NvM_RequestResultType "MICROSAR BSW" TAB_VERB 5 1 "NVM_REQ_NOT_OK" 2 "NVM_REQ_PENDING" 3 "NVM_REQ_INTEGRITY_FAILED" 4 "NVM_REQ_BLOCK_SKIPPED" 5 "NVM_REQ_NV_INVALIDATED" DEFAULT_VALUE "" /end COMPU_VTAB
/begin COMPU_VTAB EcuM_InternalStateType "MICROSAR BSW" TAB_VERB 10 0 "ECUM_INT_STATE_RUN" 1 "ECUM_INT_STATE_POST_RUN" 2 "ECUM_INT_STATE_PREP_SHUTDOWN" 3 "ECUM_INT_STATE_GO_OFF_ONE" 4 "ECUM_INT_STATE_GO_SLEEP" 5 "ECUM_INT_STATE_FORCE_RESET" 6 "ECUM_INT_STATE_SLEEP" 7 "ECUM_INT_STATE_WAKEUP_VALIDATION" 8 "ECUM_INT_STATE_ERROR" 9 "ECUM_INT_STATE_WAKEUP_REACTION" DEFAULT_VALUE "" /end COMPU_VTAB
/begin COMPU_VTAB EcuM_WakeupSourceType "MICROSAR BSW" TAB_VERB 6 1 "ECUM_WKSOURCE_POWER" 2 "ECUM_WKSOURCE_RESET" 4 "ECUM_WKSOURCE_INTERNAL_RESET" 8 "ECUM_WKSOURCE_INTERNAL_WDG" 16 "ECUM_WKSOURCE_EXTERNAL_WDG" 32 "ECUM_WKSOURCE_CAN" DEFAULT_VALUE "" /end COMPU_VTAB
/begin COMPU_VTAB Com_StatusType "MICROSAR BSW" TAB_VERB 2 0 "COM_UNINIT" 1 "COM_INIT" DEFAULT_VALUE "" /end COMPU_VTAB
/begin COMPU_VTAB Vmm_InitStateType "MICROSAR BSW" TAB_VERB 2 0 "VMM_INIT_STATE_UNINIT" 1 "VMM_INIT_STATE_INIT" DEFAULT_VALUE "" /end COMPU_VTAB
/begin GROUP BswGeneral "MICROSAR BSW" /begin REF_MEASUREMENT kGENyVersion /end REF_MEASUREMENT /end GROUP
/begin GROUP CANDRV "MICROSAR BSW"
 /begin REF_MEASUREMENT lastInitObject[kCanNumberOfMaxUsedControllers] canInterruptCounter[kCanNumberOfMaxUsedControllers] canStatus[kCanNumberOfMaxUsedControllers] CanActiveSendPdu[kCanNumberOfUsedTxCANObjects] CanActiveSendState[kCanNumberOfUsedTxCANObjects] /end REF_MEASUREMENT
/end GROUP
/begin GROUP CANIF "MICROSAR BSW"
 /begin REF_MEASUREMENT CanIf_ControllerMode[CANIF_MAX_CONTROLLER_TABLESIZE] CanIf_ChannelMode[CANIF_MAX_CONTROLLER_TABLESIZE] CanIf_TxQueueCounter[CANIF_MAX_CONTROLLER_TABLESIZE] /end REF_MEASUREMENT
/end GROUP
/begin GROUP CANSM "MICROSAR BSW"
 /begin REF_MEASUREMENT CanSm_IsInitialized CanSM_EnableSetBusSleep[CanSMCountOfCanNetworks] CanSM_ClusterState[0].CanSm_BorTimer CanSM_ClusterState[0].CanSm_BorCounter CanSM_ClusterState[0].CanSm_NwSmErrorCounter CanSM_ClusterState[0].CanSm_RequestedComMode CanSM_ClusterState[0].CanSM_CommState CanSM_ClusterState[0].CanSm_BorState CanSM_ClusterState[0].CanSm_BusOffEventOccurred /end REF_MEASUREMENT
/end GROUP
/begin GROUP CANNM "MICROSAR BSW"
 /begin REF_MEASUREMENT CanNm_CommState CanNm_MsgTimer CanNm_MsgTimeoutTimer CanNm_TxControlStateRequest CanNm_NetworkRestartFlag CanNm_TxControlStateRequest CanNm_TimeoutTimer CanNm_WaitBusSleepTimer CanNm_RepeatMsgTimer CanNm_NmState /end REF_MEASUREMENT
/end GROUP
/begin GROUP NM "MICROSAR BSW" /end GROUP
/begin GROUP COMM "MICROSAR BSW"
 /begin REF_MEASUREMENT ComM_Inhibition.ComM_ECUGroupClassification ComM_Inhibition.ComM_InhibitCnt ComM_UserReqFullComArray ComM_Inhibition.ComM_InhibitionStatus ComM_FrShutdown[COMM_ACTIVE_CHANNEL] ComM_BusSmState[COMM_ACTIVE_CHANNEL] ComM_MinFullComModeTime[COMM_ACTIVE_CHANNEL] ComM_NmLightTimeout[COMM_ACTIVE_CHANNEL] ComM_ActiveComMode ComM_BusComModeReq /end REF_MEASUREMENT
/end GROUP
/begin GROUP ECUM "MICROSAR BSW"
 /begin REF_MEASUREMENT EcuM_ModuleState_t EcuM_AppMode_t EcuM_ShutdownTarget_t EcuM_WakeupReaction_t EcuM_PendingWakeups_t EcuM_RunRequestCounter_t EcuM_PostRunRequestCounter_t EcuM_LastShutdownTarget_t.DefaultState_t EcuM_LastShutdownTarget_t.DefaultSleepMode_u8 EcuM_FsmState_t EcuM_NvM_JobStatus_t /end REF_MEASUREMENT
/end GROUP
/begin GROUP CanTp "MICROSAR BSW" /end GROUP
/begin GROUP Com "MICROSAR BSW"
 /begin REF_MEASUREMENT com_LMgt_Status com_LMgt_RxPduGroupState[COM_MAXRXIPDUCNT] com_LMgt_TxPduGroupState[COM_MAXTXIPDUCNT] com_RxDlMon_TimeoutCnt[COM_MAXRXIPDUCNT] com_TxModeHdlr_TransmitRequest[COM_MAXTXIPDUCNT] com_TxModeHdlr_CurrentTxMode[COM_MAXTXIPDUCNT] com_TxDlMon_TimeoutCnt[COM_MAXTXIPDUCNT] /end REF_MEASUREMENT
/end GROUP
/begin GROUP Vmm "MICROSAR BSW"
 /begin REF_MEASUREMENT Vmm_InitState Vmm_BusSMInitFlag[VMM_ChannelCount] Vmm_ComCtrlComRx[VMM_ChannelCount] Vmm_ComCtrlComTx[VMM_ChannelCount] Vmm_ComTxState[VMM_ChannelCount] Vmm_ComRxState[VMM_ChannelCount] Vmm_BusSMDMState[VMM_ChannelCount] /end REF_MEASUREMENT
/end GROUP
/begin GROUP MICROSAR_BSW "MICROSAR BSW"
 /begin SUB_GROUP BswGeneral CANDRV CANIF CANSM CANNM NM COMM ECUM CanTp Com Vmm /end SUB_GROUP
/end GROUP
/end MODULE
/end PROJECT
