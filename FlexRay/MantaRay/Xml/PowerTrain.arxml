AUTOSAR XML (schema 4-1-2)
package /VehicleProject
  system System
package /NM
  nm config NmConfig: flexray-nm-cluster-coupling=coupled-cluster=PowerTrain
    flexray nm cluster PowerTrain: communication-cluster=PowerTrain, nm-channel-id=0
      6 x flexray nm node:
        BLU: controller=BLU, nm-if-ecu=BLU_FR, rx-nm-pdu=[PDU_NM_BSC, PDU_NM_DashBoard, PDU_NM_Engine, PDU_NM_GearBox, PDU_NM_Tester], tx-nm-pdu=PDU_NM_BLU
        BSC: controller=BSC, nm-if-ecu=BSC_FR, rx-nm-pdu=[PDU_NM_BLU, PDU_NM_DashBoard, PDU_NM_Engine, PDU_NM_GearBox, PDU_NM_Tester], tx-nm-pdu=PDU_NM_BSC
        Dashboard: controller=Dashboard, nm-if-ecu=Dashboard_FR, rx-nm-pdu=[PDU_NM_BLU, PDU_NM_BSC, PDU_NM_Engine, PDU_NM_GearBox, PDU_NM_Tester], tx-nm-pdu=PDU_NM_DashBoard
        Engine: controller=Engine, nm-if-ecu=Engine_FR, rx-nm-pdu=[PDU_NM_BLU, PDU_NM_BSC, PDU_NM_DashBoard, PDU_NM_GearBox, PDU_NM_Tester], tx-nm-pdu=PDU_NM_Engine
        GearBox: controller=GearBox, nm-if-ecu=GearBox_FR, rx-nm-pdu=[PDU_NM_BLU, PDU_NM_BSC, PDU_NM_DashBoard, PDU_NM_Engine, PDU_NM_Tester], tx-nm-pdu=PDU_NM_GearBox
        Tester: controller=Tester, nm-if-ecu=Tester_FR, rx-nm-pdu=[PDU_NM_BLU, PDU_NM_BSC, PDU_NM_DashBoard, PDU_NM_Engine, PDU_NM_GearBox], tx-nm-pdu=PDU_NM_Tester
    nm-if-ecus:
      6 x nm ecu:
        BLU_FR: ecu-instance=BLU
        BSC_FR: ecu-instance=BSC
        Dashboard_FR: ecu-instance=Dashboard
        Engine_FR: ecu-instance=Engine
        GearBox_FR: ecu-instance=GearBox
        Tester_FR: ecu-instance=Tester
package /Cluster
  flexray cluster PowerTrain:  # FrCluster_2
    baudrate=10000000
    protocol-name=FlexRay
    protocol-version=2.1
    action-point-offset=2
    bit=1E-07
    cas-rx-low-max=79
    cold-start-attempts=8
    cycle=0.005
    detect-nit-error=false
    dynamic-slot-idle-phase=1
    listen-noise=2
    macro-per-cycle=3636
    macrotick-duration=1.375E-06
    max-without-clock-correction-fatal=2
    max-without-clock-correction-passive=2
    minislot-action-point-offset=2
    minislot-duration=5
    network-idle-time=11
    network-management-vector-length=0
    number-of-minislots=291
    number-of-static-slots=70
    offset-correction-start=3632
    payload-length-static=13
    sample-clock-period=1.25E-08
    static-slot-duration=31
    symbol-window=0
    sync-frame-id-count-max=15
    transmission-start-sequence-duration=9
    wakeup-rx-idle=59
    wakeup-rx-low=50
    wakeup-rx-window=301
    wakeup-tx-active=60
    wakeup-tx-idle=180
    flexray physical channel Channel_A: channel-name=CHANNEL-A
      comm-connectors:
        BLU/CN_PowerTrain_oChannel_A
        BSC/CN_PowerTrain_oChannel_A
        Dashboard/CN_PowerTrain_oChannel_A
        Engine/CN_PowerTrain_oChannel_A
        GearBox/CN_PowerTrain_oChannel_A
        Tester/CN_PowerTrain_oChannel_A
        ConnectorA_engine_a1d4f8582f750d5f
        ConnectorA_display_e1adcb194b8d5626
        ConnectorA_hacker_e133f31cc6a5f612
        ConnectorA_light_af0908449075eb2f
      frame Frame_2_0_1: from Tester, to BLU BSC Dashboard Engine GearBox, frame-length=26, flexray-absolutely-scheduled-timing{communication-cycle=cycle-repetition={base-cycle=0, cycle-repetition=CYCLE-REPETITION-1}, slot-id=2}, allow-dynamic-l-sdu-length=true, payload-preamble-indicator=true
        carries pdu PDU_TP2_Tester_1_Tp_Tp: packing-byte-order=big-endian, start-position=7, update-indication-bit-position=200
        n pdu PDU_TP2_Tester_1_Tp_Tp: length=25
      frame Frame_4_0_1: from Tester, to BLU BSC Dashboard Engine GearBox, frame-length=26, flexray-absolutely-scheduled-timing{communication-cycle=cycle-repetition={base-cycle=0, cycle-repetition=CYCLE-REPETITION-1}, slot-id=4}, allow-dynamic-l-sdu-length=true, payload-preamble-indicator=true
        carries pdu PDU_TP2_Tester_2_Tp_Tp: packing-byte-order=big-endian, start-position=7, update-indication-bit-position=200
        n pdu PDU_TP2_Tester_2_Tp_Tp: length=25
      frame Frame_13_0_2: from Engine, to Dashboard, frame-length=26, flexray-absolutely-scheduled-timing{communication-cycle=cycle-repetition={base-cycle=0, cycle-repetition=CYCLE-REPETITION-2}, slot-id=13}, allow-dynamic-l-sdu-length=false, payload-preamble-indicator=false
        carries pdu ABSInfo: packing-byte-order=big-endian, start-position=7, update-indication-bit-position=200
        pdu ABSInfo: length=8, transmission-mode-true-timing=cyclic-timing={time-offset=0, time-period=0.01}, unused-bit-pattern=0
          signal CarSpeed: start 7, 16 bit, big-endian, init-value=0, compu {phys=raw*0.5}, to Dashboard
          signal GearLock: start 23, 1 bit, big-endian, init-value=0, compu {0=Cx0_false, 1=Cx1_true}, to Dashboard
          signal Diagnostics: start 31, 8 bit, big-endian, init-value=0, compu {phys=raw}, to Dashboard
          signal AccelerationForce: start 39, 16 bit, big-endian, init-value=0, compu {phys=raw}, to Dashboard
          signal CurGear: start 50, 3 bit, big-endian, init-value=0, compu {phys=raw}, to Dashboard
      frame Frame_16_0_2: from BSC, to Dashboard, frame-length=26, flexray-absolutely-scheduled-timing{communication-cycle=cycle-repetition={base-cycle=0, cycle-repetition=CYCLE-REPETITION-2}, slot-id=16}, allow-dynamic-l-sdu-length=false, payload-preamble-indicator=false
        carries pdu BrakeControl: packing-byte-order=big-endian, start-position=71, update-indication-bit-position=200
        pdu BrakeControl: length=8, transmission-mode-true-timing=cyclic-timing=time-period=0.01, unused-bit-pattern=0  # electrically controlled brake
          signal ESPWarningLamp: start 4, 1 bit, big-endian, init-value=0, compu {0=Cx0_false, 1=Cx1_true} "The signal controls the ESP warning lamp located in the Driver Information Module.", to Dashboard  # The signal controls the ESP warning lamp located in the Driver Information Module.
          signal ASRMode: start 5, 1 bit, big-endian, init-value=0, compu {0=Cx0_false, 1=Cx1_true} "Traction control brake intervention mode (Actual traction control mode).", to Dashboard  # Traction control brake intervention mode (Actual traction control mode).
          signal BrakeWarningLamp: start 6, 1 bit, big-endian, init-value=0, compu {0=Cx0_false, 1=Cx1_true} "The signal controls the BRAKE warning lamp located in the Driver Information Module.", to Dashboard  # The signal controls the BRAKE warning lamp located in the Driver Information Module.
          signal ABSWarningLamp: start 7, 1 bit, big-endian, init-value=0, compu {0=Cx0_false, 1=Cx1_true} "The signal controls the ABS warning lamp located in the Driver Information Module.", to Dashboard  # The signal controls the ABS warning lamp located in the Driver Information Module.
          signal BrakePressure: start 15, 15 bit, big-endian, init-value=0, compu {phys=raw}, to Dashboard
      frame Frame_18_0_1: from BLU, to Tester, frame-length=26, flexray-absolutely-scheduled-timing{communication-cycle=cycle-repetition={base-cycle=0, cycle-repetition=CYCLE-REPETITION-1}, slot-id=18}, allow-dynamic-l-sdu-length=true, payload-preamble-indicator=true
        carries pdu PDU_TP2_BLU_1_Tp_Tp: packing-byte-order=big-endian, start-position=7, update-indication-bit-position=200
        n pdu PDU_TP2_BLU_1_Tp_Tp: length=25
      frame Frame_19_0_1: from BLU, to Tester, frame-length=26, flexray-absolutely-scheduled-timing{communication-cycle=cycle-repetition={base-cycle=0, cycle-repetition=CYCLE-REPETITION-1}, slot-id=19}, allow-dynamic-l-sdu-length=true, payload-preamble-indicator=true
        carries pdu PDU_TP2_BLU_2_Tp_Tp: packing-byte-order=big-endian, start-position=7, update-indication-bit-position=200
        n pdu PDU_TP2_BLU_2_Tp_Tp: length=25
      frame Frame_20_0_1: from BSC, to Tester, frame-length=26, flexray-absolutely-scheduled-timing{communication-cycle=cycle-repetition={base-cycle=0, cycle-repetition=CYCLE-REPETITION-1}, slot-id=20}, allow-dynamic-l-sdu-length=true, payload-preamble-indicator=true
        carries pdu PDU_TP2_BSC_1_Tp_Tp: packing-byte-order=big-endian, start-position=7, update-indication-bit-position=200
        n pdu PDU_TP2_BSC_1_Tp_Tp: length=25
      frame Frame_21_0_1: from BSC, to Tester, frame-length=26, flexray-absolutely-scheduled-timing{communication-cycle=cycle-repetition={base-cycle=0, cycle-repetition=CYCLE-REPETITION-1}, slot-id=21}, allow-dynamic-l-sdu-length=true, payload-preamble-indicator=true
        carries pdu PDU_TP2_BSC_2_Tp_Tp: packing-byte-order=big-endian, start-position=7, update-indication-bit-position=200
        n pdu PDU_TP2_BSC_2_Tp_Tp: length=25
      frame Frame_22_0_1: from Dashboard, to Tester, frame-length=26, flexray-absolutely-scheduled-timing{communication-cycle=cycle-repetition={base-cycle=0, cycle-repetition=CYCLE-REPETITION-1}, slot-id=22}, allow-dynamic-l-sdu-length=true, payload-preamble-indicator=true
        carries pdu PDU_TP2_DashBoard_1_Tp_Tp: packing-byte-order=big-endian, start-position=7, update-indication-bit-position=200
        n pdu PDU_TP2_DashBoard_1_Tp_Tp: length=25
      frame Frame_23_0_1: from Dashboard, to Tester, frame-length=26, flexray-absolutely-scheduled-timing{communication-cycle=cycle-repetition={base-cycle=0, cycle-repetition=CYCLE-REPETITION-1}, slot-id=23}, allow-dynamic-l-sdu-length=true, payload-preamble-indicator=true
        carries pdu PDU_TP2_DashBoard_2_Tp_Tp: packing-byte-order=big-endian, start-position=7, update-indication-bit-position=200
        n pdu PDU_TP2_DashBoard_2_Tp_Tp: length=25
      frame Frame_25_0_2: from BSC, to BLU, frame-length=26, flexray-absolutely-scheduled-timing{communication-cycle=cycle-repetition={base-cycle=0, cycle-repetition=CYCLE-REPETITION-2}, slot-id=25}, allow-dynamic-l-sdu-length=false, payload-preamble-indicator=false
        carries pdu KeyRenewal: packing-byte-order=big-endian, start-position=71, update-indication-bit-position=200
        pdu KeyRenewal: length=17, transmission-mode-true-timing=cyclic-timing={time-offset=0, time-period=0.01}, unused-bit-pattern=0
          signal RandomValue: start 15, 64 bit, big-endian, system signal RandomValue_4b1d31988dbd573c, data-type-policy=OVERRIDE, base-type=New_BaseType, to BLU
          signal Counter: start 7, 8 bit, big-endian, system signal Counter_c1e82ec5951af2a5, data-type-policy=OVERRIDE, base-type=New_BaseType, to BLU
          signal KRHash: start 79, 64 bit, big-endian, system signal KRHash_1ea3ba8a6a1f0394, data-type-policy=OVERRIDE, base-type=New_BaseType, to BLU
      frame Frame_26_0_2: from Engine, to Dashboard, frame-length=26, flexray-absolutely-scheduled-timing{communication-cycle=cycle-repetition={base-cycle=0, cycle-repetition=CYCLE-REPETITION-2}, slot-id=26}, allow-dynamic-l-sdu-length=false, payload-preamble-indicator=false
        carries pdu EngineStatus: packing-byte-order=big-endian, start-position=71, update-indication-bit-position=200
        pdu EngineStatus: length=8, transmission-mode-true-timing=cyclic-timing={time-offset=0, time-period=0.01}, unused-bit-pattern=0
          signal Status: start 7, 2 bit, big-endian, init-value=0, compu {phys=raw}, to Dashboard
          signal BatteryWarningLamp: start 13, 1 bit, big-endian, init-value=0, compu {0=Cx0_false, 1=Cx1_true}, to Dashboard
          signal OilWarningLamp: start 14, 1 bit, big-endian, init-value=0, compu {0=Cx0_false, 1=Cx1_true}, to Dashboard
          signal WaterWarningLamp: start 15, 1 bit, big-endian, init-value=0, compu {0=Cx0_false, 1=Cx1_true}, to Dashboard
          signal ErrorCode: start 23, 6 bit, big-endian, init-value=0, compu {phys=raw}, to Dashboard
      frame Frame_28_0_1: from Engine, to Tester, frame-length=26, flexray-absolutely-scheduled-timing{communication-cycle=cycle-repetition={base-cycle=0, cycle-repetition=CYCLE-REPETITION-1}, slot-id=28}, allow-dynamic-l-sdu-length=true, payload-preamble-indicator=true
        carries pdu PDU_TP2_Engine_1_Tp_Tp: packing-byte-order=big-endian, start-position=7, update-indication-bit-position=200
        n pdu PDU_TP2_Engine_1_Tp_Tp: length=25
      frame Frame_29_0_1: from Engine, to Tester, frame-length=26, flexray-absolutely-scheduled-timing{communication-cycle=cycle-repetition={base-cycle=0, cycle-repetition=CYCLE-REPETITION-1}, slot-id=29}, allow-dynamic-l-sdu-length=true, payload-preamble-indicator=true
        carries pdu PDU_TP2_Engine_2_Tp_Tp: packing-byte-order=big-endian, start-position=7, update-indication-bit-position=200
        n pdu PDU_TP2_Engine_2_Tp_Tp: length=25
      frame Frame_30_0_1: from GearBox, to Tester, frame-length=26, flexray-absolutely-scheduled-timing{communication-cycle=cycle-repetition={base-cycle=0, cycle-repetition=CYCLE-REPETITION-1}, slot-id=30}, allow-dynamic-l-sdu-length=true, payload-preamble-indicator=true
        carries pdu PDU_TP2_GearBox_1_Tp_Tp: packing-byte-order=big-endian, start-position=7, update-indication-bit-position=200
        n pdu PDU_TP2_GearBox_1_Tp_Tp: length=25
      frame Frame_31_0_1: from GearBox, to Tester, frame-length=26, flexray-absolutely-scheduled-timing{communication-cycle=cycle-repetition={base-cycle=0, cycle-repetition=CYCLE-REPETITION-1}, slot-id=31}, allow-dynamic-l-sdu-length=true, payload-preamble-indicator=true
        carries pdu PDU_TP2_GearBox_2_Tp_Tp: packing-byte-order=big-endian, start-position=7, update-indication-bit-position=200
        n pdu PDU_TP2_GearBox_2_Tp_Tp: length=25
      frame Frame_34_0_1: from Engine, to GearBox, frame-length=26, flexray-absolutely-scheduled-timing{communication-cycle=cycle-repetition={base-cycle=0, cycle-repetition=CYCLE-REPETITION-1}, slot-id=34}, allow-dynamic-l-sdu-length=false, payload-preamble-indicator=false
        carries pdu EngineDev2: packing-byte-order=big-endian, start-position=7
        pdu EngineDev2: length=8, transmission-mode-true-timing=cyclic-timing={time-offset=0, time-period=0.005}, unused-bit-pattern=0
          signal SigDev2: start 7, 16 bit, big-endian, init-value=0, compu {phys=raw}, to GearBox
        carries pdu EngineDev3: packing-byte-order=big-endian, start-position=71, update-indication-bit-position=202
        pdu EngineDev3: length=8, transmission-mode-true-timing=cyclic-timing={time-offset=0, time-period=0.005}, unused-bit-pattern=0
          signal SigDev3: start 7, 16 bit, big-endian, init-value=0, compu {phys=raw}, to GearBox
      frame Frame_35_0_1: from GearBox, to Engine, frame-length=26, flexray-absolutely-scheduled-timing{communication-cycle=cycle-repetition={base-cycle=0, cycle-repetition=CYCLE-REPETITION-1}, slot-id=35}, allow-dynamic-l-sdu-length=false, payload-preamble-indicator=false
        carries pdu GearBoxDev1: packing-byte-order=big-endian, start-position=7, update-indication-bit-position=201
        pdu GearBoxDev1: length=12, transmission-mode-true-timing=cyclic-timing=time-period=0.005, unused-bit-pattern=0
          signal New_Element_17031: start 7, 16 bit, big-endian, compu {phys=1}, to Engine
      frame Frame_51_0_2: from BSC, to BLU, frame-length=26, flexray-absolutely-scheduled-timing{communication-cycle=cycle-repetition={base-cycle=0, cycle-repetition=CYCLE-REPETITION-2}, slot-id=51}, allow-dynamic-l-sdu-length=false, payload-preamble-indicator=false
        carries pdu BackLightInfo: packing-byte-order=big-endian, start-position=71, update-indication-bit-position=200
        pdu BackLightInfo: length=4, transmission-mode-true-timing=cyclic-timing={time-offset=0, time-period=0.01}, unused-bit-pattern=0
          signal BackUpLight: start 6, 1 bit, big-endian, init-value=0, compu {0=Cx0_false, 1=Cx1_true}, to BLU
          signal BrakeLight: start 7, 1 bit, big-endian, init-value=0, compu {0=Cx0_false, 1=Cx1_true}, to BLU
          signal Hash: start 5, 28 bit, big-endian, system signal Hash_62e2ee295449cb1a, data-type-policy=OVERRIDE, base-type=New_BaseType, to BLU
      frame Frame_52_0_2: from GearBox, to BSC Engine, frame-length=26, flexray-absolutely-scheduled-timing{communication-cycle=cycle-repetition={base-cycle=0, cycle-repetition=CYCLE-REPETITION-2}, slot-id=52}, allow-dynamic-l-sdu-length=false, payload-preamble-indicator=false
        carries pdu GearBoxInfo: packing-byte-order=big-endian, start-position=71, update-indication-bit-position=200
        pdu GearBoxInfo: length=8, transmission-mode-true-timing=cyclic-timing={time-offset=0, time-period=0.01}, unused-bit-pattern=0
          signal EcoMode: start 3, 2 bit, big-endian, init-value=0, compu {phys=raw}, to BSC Engine
          signal ShiftRequest: start 4, 1 bit, big-endian, init-value=0, compu {0=Cx0_false, 1=Cx1_true}, to BSC Engine
          signal Gear: start 7, 3 bit, big-endian, init-value=0, compu {phys=raw}, to BSC Engine
      frame Frame_71_0_8: from BLU, to BSC Dashboard Engine GearBox Tester, frame-length=8, flexray-absolutely-scheduled-timing{communication-cycle=cycle-repetition={base-cycle=0, cycle-repetition=CYCLE-REPETITION-8}, slot-id=71}, allow-dynamic-l-sdu-length=false, payload-preamble-indicator=false
        carries pdu PDU_NM_BLU: packing-byte-order=big-endian, start-position=7
        nm pdu PDU_NM_BLU: length=8
      frame Frame_71_1_8: from BSC, to BLU Dashboard Engine GearBox Tester, frame-length=8, flexray-absolutely-scheduled-timing{communication-cycle=cycle-repetition={base-cycle=1, cycle-repetition=CYCLE-REPETITION-8}, slot-id=71}, allow-dynamic-l-sdu-length=false, payload-preamble-indicator=false
        carries pdu PDU_NM_BSC: packing-byte-order=big-endian, start-position=7
        nm pdu PDU_NM_BSC: length=8
      frame Frame_71_2_8: from Dashboard, to BLU BSC Engine GearBox Tester, frame-length=8, flexray-absolutely-scheduled-timing{communication-cycle=cycle-repetition={base-cycle=2, cycle-repetition=CYCLE-REPETITION-8}, slot-id=71}, allow-dynamic-l-sdu-length=false, payload-preamble-indicator=false
        carries pdu PDU_NM_DashBoard: packing-byte-order=big-endian, start-position=7
        nm pdu PDU_NM_DashBoard: length=8
      frame Frame_71_3_8: from Engine, to BLU BSC Dashboard GearBox Tester, frame-length=8, flexray-absolutely-scheduled-timing{communication-cycle=cycle-repetition={base-cycle=3, cycle-repetition=CYCLE-REPETITION-8}, slot-id=71}, allow-dynamic-l-sdu-length=false, payload-preamble-indicator=false
        carries pdu PDU_NM_Engine: packing-byte-order=big-endian, start-position=7
        nm pdu PDU_NM_Engine: length=8
      frame Frame_71_4_8: from GearBox, to BLU BSC Dashboard Engine Tester, frame-length=8, flexray-absolutely-scheduled-timing{communication-cycle=cycle-repetition={base-cycle=4, cycle-repetition=CYCLE-REPETITION-8}, slot-id=71}, allow-dynamic-l-sdu-length=false, payload-preamble-indicator=false
        carries pdu PDU_NM_GearBox: packing-byte-order=big-endian, start-position=7
        nm pdu PDU_NM_GearBox: length=8
      frame Frame_71_5_8: from Tester, to BLU BSC Dashboard Engine GearBox, frame-length=8, flexray-absolutely-scheduled-timing{communication-cycle=cycle-repetition={base-cycle=5, cycle-repetition=CYCLE-REPETITION-8}, slot-id=71}, allow-dynamic-l-sdu-length=false, payload-preamble-indicator=false
        carries pdu PDU_NM_Tester: packing-byte-order=big-endian, start-position=7
        nm pdu PDU_NM_Tester: length=8
      frame Frame_76_0_1: from Engine, to GearBox, frame-length=26, flexray-absolutely-scheduled-timing{communication-cycle=cycle-repetition={base-cycle=0, cycle-repetition=CYCLE-REPETITION-1}, slot-id=76}, allow-dynamic-l-sdu-length=false, payload-preamble-indicator=false
        carries pdu EngineDev4: packing-byte-order=big-endian, start-position=7
        pdu EngineDev4: length=8, transmission-mode-true-timing=cyclic-timing={time-offset=0, time-period=0.005}, unused-bit-pattern=0
          signal SigDev4: start 7, 16 bit, big-endian, init-value=0, compu {phys=raw}, to GearBox
        carries pdu EngineDev5: packing-byte-order=big-endian, start-position=71, update-indication-bit-position=202
        pdu EngineDev5: length=8, transmission-mode-true-timing=cyclic-timing={time-offset=0, time-period=0.005}, unused-bit-pattern=0
          signal SigDev5: start 7, 16 bit, big-endian, init-value=0, compu {phys=raw}, to GearBox
      frame Frame_80_0_1: from GearBox, to Engine, frame-length=26, flexray-absolutely-scheduled-timing{communication-cycle=cycle-repetition={base-cycle=0, cycle-repetition=CYCLE-REPETITION-1}, slot-id=80}, allow-dynamic-l-sdu-length=false, payload-preamble-indicator=false
        carries pdu GearBoxDev10: packing-byte-order=big-endian, start-position=7, update-indication-bit-position=201
        pdu GearBoxDev10: length=8, transmission-mode-true-timing=cyclic-timing=time-period=0.05, unused-bit-pattern=0
          signal New_Element_59120: start 7, 16 bit, big-endian, compu {phys=1}, to Engine
        carries pdu GearBoxDev11: packing-byte-order=big-endian, start-position=71, update-indication-bit-position=200
        pdu GearBoxDev11: length=8, transmission-mode-true-timing=cyclic-timing=time-period=0.01, unused-bit-pattern=0
          signal New_Element_73321: start 7, 16 bit, big-endian, compu {phys=1}, to Engine
      frame Frame_81_0_2: from Engine, to GearBox, frame-length=26, flexray-absolutely-scheduled-timing{communication-cycle=cycle-repetition={base-cycle=0, cycle-repetition=CYCLE-REPETITION-2}, slot-id=81}, allow-dynamic-l-sdu-length=false, payload-preamble-indicator=false
        carries pdu EngineDev10: packing-byte-order=big-endian, start-position=7, update-indication-bit-position=201
        pdu EngineDev10: length=8, transmission-mode-true-timing=cyclic-timing=time-period=0.01, unused-bit-pattern=0
          signal New_Element_9074: start 7, 16 bit, big-endian, compu {phys=1}, to GearBox
        carries pdu EngineDev11: packing-byte-order=big-endian, start-position=71, update-indication-bit-position=200
        pdu EngineDev11: length=8, transmission-mode-true-timing=cyclic-timing=time-period=0.04, unused-bit-pattern=0
          signal New_Element_9090: start 7, 16 bit, big-endian, compu {phys=1}, to GearBox
      frame Frame_82_0_2: from BSC, to Engine, frame-length=26, flexray-absolutely-scheduled-timing{communication-cycle=cycle-repetition={base-cycle=0, cycle-repetition=CYCLE-REPETITION-2}, slot-id=82}, allow-dynamic-l-sdu-length=false, payload-preamble-indicator=false
        carries pdu BSCDev10: packing-byte-order=big-endian, start-position=7, update-indication-bit-position=201
        pdu BSCDev10: length=8, transmission-mode-true-timing=cyclic-timing=time-period=0.01, unused-bit-pattern=0
          signal New_Element_18441: start 7, 16 bit, big-endian, compu {phys=1}, to Engine
        carries pdu BSCDev11: packing-byte-order=big-endian, start-position=71, update-indication-bit-position=200
        pdu BSCDev11: length=8, transmission-mode-true-timing=cyclic-timing=time-period=0.04, unused-bit-pattern=0
          signal New_Element_19865: start 7, 16 bit, big-endian, compu {phys=1}, to Engine
      frame Frame_100_0_1: from Tester, to BLU BSC Dashboard Engine GearBox, frame-length=254, flexray-absolutely-scheduled-timing{communication-cycle=cycle-repetition={base-cycle=0, cycle-repetition=CYCLE-REPETITION-1}, slot-id=100}, allow-dynamic-l-sdu-length=true, payload-preamble-indicator=true
        carries pdu PDU_TP_Tester_1_Tp_Tp: packing-byte-order=big-endian, start-position=7
        n pdu PDU_TP_Tester_1_Tp_Tp: length=254
      frame Frame_101_0_1: from Tester, to BLU BSC Dashboard Engine GearBox, frame-length=254, flexray-absolutely-scheduled-timing{communication-cycle=cycle-repetition={base-cycle=0, cycle-repetition=CYCLE-REPETITION-1}, slot-id=101}, allow-dynamic-l-sdu-length=true, payload-preamble-indicator=true
        carries pdu PDU_TP_Tester_2_Tp_Tp: packing-byte-order=big-endian, start-position=7
        n pdu PDU_TP_Tester_2_Tp_Tp: length=254
      frame Frame_140_0_1: from Tester, to BLU BSC Dashboard Engine GearBox, frame-length=20, flexray-absolutely-scheduled-timing{communication-cycle=cycle-repetition={base-cycle=0, cycle-repetition=CYCLE-REPETITION-4}, slot-id=140}, allow-dynamic-l-sdu-length=false, payload-preamble-indicator=false
        carries pdu PDU_DIAG_Tester_1: packing-byte-order=big-endian, start-position=7
        pdu PDU_DIAG_Tester_1: length=20, unused-bit-pattern=0
      frame Frame_141_0_4: from BLU, to Tester, frame-length=20, flexray-absolutely-scheduled-timing{communication-cycle=cycle-repetition={base-cycle=0, cycle-repetition=CYCLE-REPETITION-4}, slot-id=141}, allow-dynamic-l-sdu-length=false, payload-preamble-indicator=false
        carries pdu PDU_DIAG_BLU_1: packing-byte-order=big-endian, start-position=7
        pdu PDU_DIAG_BLU_1: length=20, unused-bit-pattern=0
      frame Frame_141_1_4: from BSC, to Tester, frame-length=20, flexray-absolutely-scheduled-timing{communication-cycle=cycle-repetition={base-cycle=1, cycle-repetition=CYCLE-REPETITION-4}, slot-id=141}, allow-dynamic-l-sdu-length=false, payload-preamble-indicator=false
        carries pdu PDU_DIAG_BSC_1: packing-byte-order=big-endian, start-position=7
        pdu PDU_DIAG_BSC_1: length=20, unused-bit-pattern=0
      frame Frame_141_2_4: from Dashboard, to Tester, frame-length=20, flexray-absolutely-scheduled-timing{communication-cycle=cycle-repetition={base-cycle=2, cycle-repetition=CYCLE-REPETITION-4}, slot-id=141}, allow-dynamic-l-sdu-length=false, payload-preamble-indicator=false
        carries pdu PDU_DIAG_DashBoard_1: packing-byte-order=big-endian, start-position=7
        pdu PDU_DIAG_DashBoard_1: length=20, unused-bit-pattern=0
      frame Frame_141_3_4: from Engine, to Tester, frame-length=20, flexray-absolutely-scheduled-timing{communication-cycle=cycle-repetition={base-cycle=3, cycle-repetition=CYCLE-REPETITION-4}, slot-id=141}, allow-dynamic-l-sdu-length=false, payload-preamble-indicator=false
        carries pdu PDU_DIAG_Engine_1: packing-byte-order=big-endian, start-position=7
        pdu PDU_DIAG_Engine_1: length=20, unused-bit-pattern=0
      frame Frame_142_0_4: from GearBox, to Tester, frame-length=20, flexray-absolutely-scheduled-timing{communication-cycle=cycle-repetition={base-cycle=0, cycle-repetition=CYCLE-REPETITION-4}, slot-id=142}, allow-dynamic-l-sdu-length=false, payload-preamble-indicator=false
        carries pdu PDU_DIAG_GearBox_1: packing-byte-order=big-endian, start-position=7
        pdu PDU_DIAG_GearBox_1: length=20, unused-bit-pattern=0
      frame Frame_150_0_1: from BLU, to Tester, frame-length=254, flexray-absolutely-scheduled-timing{communication-cycle=cycle-repetition={base-cycle=0, cycle-repetition=CYCLE-REPETITION-1}, slot-id=150}, allow-dynamic-l-sdu-length=true, payload-preamble-indicator=true
        carries pdu PDU_TP_BLU_1_Tp_Tp: packing-byte-order=big-endian, start-position=7
        n pdu PDU_TP_BLU_1_Tp_Tp: length=254
      frame Frame_151_0_1: from BLU, to Tester, frame-length=254, flexray-absolutely-scheduled-timing{communication-cycle=cycle-repetition={base-cycle=0, cycle-repetition=CYCLE-REPETITION-1}, slot-id=151}, allow-dynamic-l-sdu-length=true, payload-preamble-indicator=true
        carries pdu PDU_TP_BLU_2_Tp_Tp: packing-byte-order=big-endian, start-position=7
        n pdu PDU_TP_BLU_2_Tp_Tp: length=254
      frame Frame_152_0_1: from BSC, to Tester, frame-length=254, flexray-absolutely-scheduled-timing{communication-cycle=cycle-repetition={base-cycle=0, cycle-repetition=CYCLE-REPETITION-1}, slot-id=152}, allow-dynamic-l-sdu-length=true, payload-preamble-indicator=true
        carries pdu PDU_TP_BSC_1_Tp_Tp: packing-byte-order=big-endian, start-position=7
        n pdu PDU_TP_BSC_1_Tp_Tp: length=254
      frame Frame_153_0_1: from BSC, to Tester, frame-length=254, flexray-absolutely-scheduled-timing{communication-cycle=cycle-repetition={base-cycle=0, cycle-repetition=CYCLE-REPETITION-1}, slot-id=153}, allow-dynamic-l-sdu-length=true, payload-preamble-indicator=true
        carries pdu PDU_TP_BSC_2_Tp_Tp: packing-byte-order=big-endian, start-position=7
        n pdu PDU_TP_BSC_2_Tp_Tp: length=254
      frame Frame_154_0_1: from Dashboard, to Tester, frame-length=254, flexray-absolutely-scheduled-timing{communication-cycle=cycle-repetition={base-cycle=0, cycle-repetition=CYCLE-REPETITION-1}, slot-id=154}, allow-dynamic-l-sdu-length=true, payload-preamble-indicator=true
        carries pdu PDU_TP_DashBoard_1_Tp_Tp: packing-byte-order=big-endian, start-position=7
        n pdu PDU_TP_DashBoard_1_Tp_Tp: length=254
      frame Frame_155_0_1: from Dashboard, to Tester, frame-length=254, flexray-absolutely-scheduled-timing{communication-cycle=cycle-repetition={base-cycle=0, cycle-repetition=CYCLE-REPETITION-1}, slot-id=155}, allow-dynamic-l-sdu-length=true, payload-preamble-indicator=true
        carries pdu PDU_TP_DashBoard_2_Tp_Tp: packing-byte-order=big-endian, start-position=7
        n pdu PDU_TP_DashBoard_2_Tp_Tp: length=254
      frame Frame_156_0_1: from Engine, to Tester, frame-length=254, flexray-absolutely-scheduled-timing{communication-cycle=cycle-repetition={base-cycle=0, cycle-repetition=CYCLE-REPETITION-1}, slot-id=156}, allow-dynamic-l-sdu-length=true, payload-preamble-indicator=true
        carries pdu PDU_TP_Engine_1_Tp_Tp: packing-byte-order=big-endian, start-position=7
        n pdu PDU_TP_Engine_1_Tp_Tp: length=254
      frame Frame_157_0_1: from Engine, to Tester, frame-length=254, flexray-absolutely-scheduled-timing{communication-cycle=cycle-repetition={base-cycle=0, cycle-repetition=CYCLE-REPETITION-1}, slot-id=157}, allow-dynamic-l-sdu-length=true, payload-preamble-indicator=true
        carries pdu PDU_TP_Engine_2_Tp_Tp: packing-byte-order=big-endian, start-position=7
        n pdu PDU_TP_Engine_2_Tp_Tp: length=254
      frame Frame_158_0_1: from GearBox, to Tester, frame-length=254, flexray-absolutely-scheduled-timing{communication-cycle=cycle-repetition={base-cycle=0, cycle-repetition=CYCLE-REPETITION-1}, slot-id=158}, allow-dynamic-l-sdu-length=true, payload-preamble-indicator=true
        carries pdu PDU_TP_GearBox_1_Tp_Tp: packing-byte-order=big-endian, start-position=7
        n pdu PDU_TP_GearBox_1_Tp_Tp: length=254
      frame Frame_159_0_1: from GearBox, to Tester, frame-length=254, flexray-absolutely-scheduled-timing{communication-cycle=cycle-repetition={base-cycle=0, cycle-repetition=CYCLE-REPETITION-1}, slot-id=159}, allow-dynamic-l-sdu-length=true, payload-preamble-indicator=true
        carries pdu PDU_TP_GearBox_2_Tp_Tp: packing-byte-order=big-endian, start-position=7
        n pdu PDU_TP_GearBox_2_Tp_Tp: length=254
      frame BrakeState: from engine hacker, to display, frame-length=8, flexray-absolutely-scheduled-timing{communication-cycle=cycle-repetition={base-cycle=0, cycle-repetition=CYCLE-REPETITION-1}, slot-id=1}
        carries pdu BrakePressure: packing-byte-order=little-endian, start-position=0, update-indication-bit-position=200
        pdu BrakePressure: length=8
package /ECU
  6 x ecu instance, all with com-configuration-rx-time-base=0.001, com-configuration-tx-time-base=0.001:
    BLU: associated-com-i-pdu-group=[BLU_oPowerTrain_Rx, PduGroup_eca7c43a8fe14e2094e1cf36682f738a_Rx]  # Back Light Unit
      flexray communication controller BLU:
        accepted-startup-range=212
        allow-halt-due-to-clock=true
        allow-passive-to-active=0
        cluster-drift-damping=2
        decoding-correction=48
        delay-compensation-a=1
        delay-compensation-b=1
        extern-offset-correction=0
        extern-rate-correction=0
        external-sync=false
        fall-back-internal=false
        key-slot-only-enabled=false
        key-slot-used-for-start-up=false
        key-slot-used-for-sync=false
        latest-tx=249
        listen-timeout=400162
        macro-initial-offset-a=3
        macro-initial-offset-b=3
        maximum-dynamic-payload-length=127
        micro-initial-offset-a=6
        micro-initial-offset-b=6
        micro-per-cycle=200000
        microtick-duration=2.5E-08
        nm-vector-early-update=false
        offset-correction-out=127
        rate-correction-out=81
        samples-per-microtick=2
        two-key-slot-mode=false
        wake-up-pattern=33
      flexray communication connector CN_PowerTrain_oChannel_A: comm-controller=BLU, wake-up-channel=true
    BSC: associated-com-i-pdu-group=[BSC_oPowerTrain_Rx, BSC_oPowerTrain_Tx, PduGroup_cbf9befc7a2040a3b2e8f9ad16ccbfe4_Tx]  # Brake and ESP Control
      flexray communication controller BSC:
        accepted-startup-range=212
        allow-halt-due-to-clock=true
        allow-passive-to-active=0
        cluster-drift-damping=2
        decoding-correction=48
        delay-compensation-a=1
        delay-compensation-b=1
        extern-offset-correction=0
        extern-rate-correction=0
        external-sync=false
        fall-back-internal=false
        key-slot-id=16
        key-slot-only-enabled=false
        key-slot-used-for-start-up=true
        key-slot-used-for-sync=true
        latest-tx=249
        listen-timeout=400162
        macro-initial-offset-a=3
        macro-initial-offset-b=3
        maximum-dynamic-payload-length=127
        micro-initial-offset-a=6
        micro-initial-offset-b=6
        micro-per-cycle=200000
        microtick-duration=2.5E-08
        nm-vector-early-update=false
        offset-correction-out=127
        rate-correction-out=81
        samples-per-microtick=2
        two-key-slot-mode=false
        wake-up-pattern=33
      flexray communication connector CN_PowerTrain_oChannel_A: comm-controller=BSC, wake-up-channel=true
    Dashboard: associated-com-i-pdu-group=Dashboard_oPowerTrain_Rx  # Dash Board
      flexray communication controller Dashboard:
        accepted-startup-range=212
        allow-halt-due-to-clock=true
        allow-passive-to-active=0
        cluster-drift-damping=2
        decoding-correction=48
        delay-compensation-a=1
        delay-compensation-b=1
        extern-offset-correction=0
        extern-rate-correction=0
        external-sync=false
        fall-back-internal=false
        key-slot-only-enabled=false
        key-slot-used-for-start-up=false
        key-slot-used-for-sync=false
        latest-tx=249
        listen-timeout=400162
        macro-initial-offset-a=3
        macro-initial-offset-b=3
        maximum-dynamic-payload-length=127
        micro-initial-offset-a=6
        micro-initial-offset-b=6
        micro-per-cycle=200000
        microtick-duration=2.5E-08
        nm-vector-early-update=false
        offset-correction-out=127
        rate-correction-out=81
        samples-per-microtick=2
        two-key-slot-mode=false
        wake-up-pattern=33
      flexray communication connector CN_PowerTrain_oChannel_A: comm-controller=Dashboard, wake-up-channel=true
    Engine: associated-com-i-pdu-group=[Engine_oPowerTrain_Rx, Engine_oPowerTrain_Tx]  # Engine Control
      flexray communication controller Engine:
        accepted-startup-range=212
        allow-halt-due-to-clock=true
        allow-passive-to-active=0
        cluster-drift-damping=2
        decoding-correction=48
        delay-compensation-a=1
        delay-compensation-b=1
        extern-offset-correction=0
        extern-rate-correction=0
        external-sync=false
        fall-back-internal=false
        key-slot-id=25
        key-slot-only-enabled=false
        key-slot-used-for-start-up=true
        key-slot-used-for-sync=true
        latest-tx=249
        listen-timeout=400162
        macro-initial-offset-a=3
        macro-initial-offset-b=3
        maximum-dynamic-payload-length=127
        micro-initial-offset-a=6
        micro-initial-offset-b=6
        micro-per-cycle=200000
        microtick-duration=2.5E-08
        nm-vector-early-update=false
        offset-correction-out=127
        rate-correction-out=81
        samples-per-microtick=2
        two-key-slot-mode=false
        wake-up-pattern=33
      flexray communication connector CN_PowerTrain_oChannel_A: comm-controller=Engine, wake-up-channel=true
    GearBox: associated-com-i-pdu-group=[GearBox_oPowerTrain_Rx, GearBox_oPowerTrain_Tx]  # Gear Control
      flexray communication controller GearBox:
        accepted-startup-range=212
        allow-halt-due-to-clock=true
        allow-passive-to-active=0
        cluster-drift-damping=2
        decoding-correction=48
        delay-compensation-a=1
        delay-compensation-b=1
        extern-offset-correction=0
        extern-rate-correction=0
        external-sync=false
        fall-back-internal=false
        key-slot-id=52
        key-slot-only-enabled=false
        key-slot-used-for-start-up=true
        key-slot-used-for-sync=true
        latest-tx=249
        listen-timeout=400162
        macro-initial-offset-a=3
        macro-initial-offset-b=3
        maximum-dynamic-payload-length=127
        micro-initial-offset-a=6
        micro-initial-offset-b=6
        micro-per-cycle=200000
        microtick-duration=2.5E-08
        nm-vector-early-update=false
        offset-correction-out=127
        rate-correction-out=81
        samples-per-microtick=2
        two-key-slot-mode=false
        wake-up-pattern=33
      flexray communication connector CN_PowerTrain_oChannel_A: comm-controller=GearBox, wake-up-channel=true
    Tester  # Diagnostics Tester
      flexray communication controller Tester:
        accepted-startup-range=212
        allow-halt-due-to-clock=true
        allow-passive-to-active=0
        cluster-drift-damping=2
        decoding-correction=48
        delay-compensation-a=1
        delay-compensation-b=1
        extern-offset-correction=0
        extern-rate-correction=0
        external-sync=false
        fall-back-internal=false
        key-slot-only-enabled=false
        key-slot-used-for-start-up=false
        key-slot-used-for-sync=false
        latest-tx=249
        listen-timeout=400162
        macro-initial-offset-a=3
        macro-initial-offset-b=3
        maximum-dynamic-payload-length=127
        micro-initial-offset-a=6
        micro-initial-offset-b=6
        micro-per-cycle=200000
        microtick-duration=2.5E-08
        nm-vector-early-update=false
        offset-correction-out=127
        rate-correction-out=81
        samples-per-microtick=2
        two-key-slot-mode=false
        wake-up-pattern=33
      flexray communication connector CN_PowerTrain_oChannel_A: comm-controller=Tester, wake-up-channel=false
package /IPDUGroup
  8 x i signal i pdu group:
    BLU_oPowerTrain_Rx: communication-direction=IN, i-signal-i-pdus=BackLightInfo
    BSC_oPowerTrain_Rx: communication-direction=IN, i-signal-i-pdus=GearBoxInfo
    BSC_oPowerTrain_Tx: communication-direction=OUT, i-signal-i-pdus=[BackLightInfo, BrakeControl, BSCDev10, BSCDev11]
    Dashboard_oPowerTrain_Rx: communication-direction=IN, i-signal-i-pdus=[ABSInfo, BrakeControl, KeyRenewal, EngineDev1, EngineStatus]
    Engine_oPowerTrain_Rx: communication-direction=IN, i-signal-i-pdus=[BSCDev10, BSCDev11, GearBoxDev1, GearBoxDev10, GearBoxDev11, GearBoxInfo]
    Engine_oPowerTrain_Tx: communication-direction=OUT
      i-signal-i-pdus:
        ABSInfo
        KeyRenewal
        EngineDev1
        EngineDev10
        EngineDev11
        EngineDev{2..5}
        EngineStatus
    GearBox_oPowerTrain_Rx: communication-direction=IN, i-signal-i-pdus=[EngineDev10, EngineDev11, EngineDev2, EngineDev3, EngineDev4, EngineDev5]
    GearBox_oPowerTrain_Tx: communication-direction=OUT, i-signal-i-pdus=[GearBoxDev1, GearBoxDev10, GearBoxDev11, GearBoxInfo]
package /PDU
  pdu EngineDev1: length=8, transmission-mode-true-timing=cyclic-timing={time-offset=0, time-period=0.01}, unused-bit-pattern=0
    signal SigDev1: start 7, 16 bit, big-endian, init-value=0, compu {phys=raw}
package /ISignal
  6 x i signal:
    EngForce: init-value=0, length=16, compu {phys=raw}, system-signal=EngForce
    EngPower: init-value=0, length=16, compu {phys=raw*0.01}, system-signal=EngPower
    EngSpeed: init-value=0, length=16, compu {phys=raw}, system-signal=EngSpeed
    EngTemp: init-value=25, length=7, compu {phys=raw*2-50}, system-signal=EngTemp
    IdleRunning: init-value=0, length=1, compu {0=Cx0_false, 1=Cx1_true}, system-signal=IdleRunning
    PetrolLevel: init-value=0, length=8, compu {phys=raw}, system-signal=PetrolLevel
package /Signal
  6 x system signal:
    EngForce
    EngPower
    EngSpeed
    EngTemp
    IdleRunning
    PetrolLevel
package /VectorAutosarExplorerGeneratedObjects/I_SIGNALS
  i signal KeyRenewalHash: data-type-policy=OVERRIDE, length=28, base-type=New_BaseType, system-signal=KeyRenewalHash_bfb1c88b233ba351
package /VectorAutosarExplorerGeneratedObjects/ECU_INSTANCES
  4 x ecu instance, all with diagnostic-address=0:
    engine: associated-com-i-pdu-group=PduGroup_1edd0ad019ea48b897100b60d1a81f14_Tx
      flexray communication controller Controller_engine_c67db1437a07112a:
        accepted-startup-range=212
        allow-halt-due-to-clock=true
        allow-passive-to-active=0
        cluster-drift-damping=2
        decoding-correction=48
        delay-compensation-a=1
        delay-compensation-b=1
        extern-offset-correction=0
        extern-rate-correction=0
        key-slot-id=1
        key-slot-only-enabled=true
        key-slot-used-for-start-up=false
        key-slot-used-for-sync=false
        latest-tx=124
        listen-timeout=401202
        macro-initial-offset-a=11
        macro-initial-offset-b=11
        maximum-dynamic-payload-length=16
        micro-initial-offset-a=31
        micro-initial-offset-b=31
        micro-per-cycle=200000
        microtick-duration=2.5E-08
        offset-correction-out=361
        rate-correction-out=601
        samples-per-microtick=2
        wake-up-pattern=33
      flexray communication connector ConnectorA_engine_a1d4f8582f750d5f: comm-controller=Controller_engine_c67db1437a07112a
    display: associated-com-i-pdu-group=PduGroup_3898a4233059415a860b71286d5f284d_Rx
      flexray communication controller Controller_display_e53693fa5c9b10d2:
        accepted-startup-range=212
        allow-halt-due-to-clock=true
        allow-passive-to-active=0
        cluster-drift-damping=2
        decoding-correction=48
        delay-compensation-a=1
        delay-compensation-b=1
        extern-offset-correction=0
        extern-rate-correction=0
        key-slot-id=1
        key-slot-only-enabled=true
        key-slot-used-for-start-up=false
        key-slot-used-for-sync=false
        latest-tx=124
        listen-timeout=401202
        macro-initial-offset-a=11
        macro-initial-offset-b=11
        maximum-dynamic-payload-length=16
        micro-initial-offset-a=31
        micro-initial-offset-b=31
        micro-per-cycle=200000
        microtick-duration=2.5E-08
        offset-correction-out=361
        rate-correction-out=601
        samples-per-microtick=2
        wake-up-pattern=33
      flexray communication connector ConnectorA_display_e1adcb194b8d5626: comm-controller=Controller_display_e53693fa5c9b10d2
    hacker: associated-com-i-pdu-group=PduGroup_9f004a2ebfce4c2298d744db6d953fe3_Tx
      flexray communication controller Controller_hacker_8ae7e7787053d364:
        accepted-startup-range=212
        allow-halt-due-to-clock=true
        allow-passive-to-active=0
        cluster-drift-damping=2
        decoding-correction=48
        delay-compensation-a=1
        delay-compensation-b=1
        extern-offset-correction=0
        extern-rate-correction=0
        key-slot-id=1
        key-slot-only-enabled=true
        key-slot-used-for-start-up=false
        key-slot-used-for-sync=false
        latest-tx=124
        listen-timeout=401202
        macro-initial-offset-a=11
        macro-initial-offset-b=11
        maximum-dynamic-payload-length=16
        micro-initial-offset-a=31
        micro-initial-offset-b=31
        micro-per-cycle=200000
        microtick-duration=2.5E-08
        offset-correction-out=361
        rate-correction-out=601
        samples-per-microtick=2
        wake-up-pattern=33
      flexray communication connector ConnectorA_hacker_e133f31cc6a5f612: comm-controller=Controller_hacker_8ae7e7787053d364
    light
      flexray communication controller Controller_light_a5850b919223d7e4:
        accepted-startup-range=212
        allow-halt-due-to-clock=true
        allow-passive-to-active=0
        cluster-drift-damping=2
        decoding-correction=48
        delay-compensation-a=1
        delay-compensation-b=1
        extern-offset-correction=0
        extern-rate-correction=0
        key-slot-id=1
        key-slot-only-enabled=true
        key-slot-used-for-start-up=false
        key-slot-used-for-sync=false
        latest-tx=124
        listen-timeout=401202
        macro-initial-offset-a=11
        macro-initial-offset-b=11
        maximum-dynamic-payload-length=16
        micro-initial-offset-a=31
        micro-initial-offset-b=31
        micro-per-cycle=200000
        microtick-duration=2.5E-08
        offset-correction-out=361
        rate-correction-out=601
        samples-per-microtick=2
        wake-up-pattern=33
      flexray communication connector ConnectorA_light_af0908449075eb2f: comm-controller=Controller_light_a5850b919223d7e4
package /VectorAutosarExplorerGeneratedObjects/PDU_GROUP
  5 x i signal i pdu group:
    PduGroup_1edd0ad019ea48b897100b60d1a81f14_Tx: communication-direction=OUT
    PduGroup_9f004a2ebfce4c2298d744db6d953fe3_Tx: communication-direction=OUT
    PduGroup_3898a4233059415a860b71286d5f284d_Rx: communication-direction=IN
    PduGroup_cbf9befc7a2040a3b2e8f9ad16ccbfe4_Tx: communication-direction=OUT
    PduGroup_eca7c43a8fe14e2094e1cf36682f738a_Rx: communication-direction=IN
package /VectorAutosarExplorerGeneratedObjects/BASE_TYPES
  base type New_BaseType: base-type-size=16, base-type-encoding=NONE
package /VectorAutosarExplorerGeneratedObjects/SYSTEM_SIGNALS
  system signal KeyRenewalHash_bfb1c88b233ba351
