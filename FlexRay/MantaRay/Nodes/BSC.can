/*@!Encoding:1252*/
/**
 * This ECU simulates the controls of a car.
 * It's job is to notice physical brake pressure and to send out the according message.
**/

variables
{
  int gBrakePedalStatus       = 0;
  int SystemCheck             = 0;
  const int PRESS             = 1;
  const Int NOPRESS           = 0;
}

/**
 * On starting the car, the brake light signal is set to 0.
**/
on start
{
  $BrakeLight = 0;
}

/**
 * In the event that the physical brake pressure changes, a message is sent to FlexRay.
 * This message contains the brake light signal.
**/
on sysvar sysvar::Panel::BrakeActive
{
  if(@this)  
    gBrakePedalStatus = PRESS;
  else  
    gBrakePedalStatus = NOPRESS;

  $BrakeLight = @this;
}