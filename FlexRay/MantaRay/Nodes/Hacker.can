/*@!Encoding:1252*/
/**
 * This ECU is a simulated, compromised ECU.
 * It's goal is to trigger undesired behaviour in other ECUs connected to the same CAN bus.
 * This particular ECU sends out messages pretending to report an applied brake pressure of 100%.
 * The goal of that is to turn on the brake lights without pressing the physical brakes.
**/

on start
{
  write("HACKER: Hello, I'm a compromised ECU.");
}

/**
 * Pressing the 'h' key sets the BrakeLight signal to one, so that the next FlexRay cycle relays the signal to the target ECU.
**/
on key 'h'
{
  write("HACKER: Sending Brake Light Signal");
  $BrakeLight = 1;
}