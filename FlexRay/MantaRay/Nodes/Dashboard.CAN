/*@!Encoding:1252*/
/*variables
{
  msTimer tConsoleElementsDsp2;
}

on start
{
  // set to 2 to get more information into write-window 
  setWriteDbgLevel(1);
  writeDbgLevel(2,"Dashboard");
}

on timer tConsoleElementsDsp2
{
  // Shows the elements "Oil", "Water" & "Battery" in the Dashboard for a few seconds.
  // When the devices are ok the lights will disappear! 
  @sysvar::Panel::DashboardEngOilDsp_     = 0;
  @sysvar::Panel::DashboardEngWaterDsp_   = 0;
  @sysvar::Panel::DashboardEngBaterryDsp_ = 0;
}

on frPDU BrakeControl
{
  @sysvar::Panel::ABSWarningLampDsp_  = $ABSWarningLamp;
  @sysvar::Panel::ASRModeDsp_          = $ASRMode;  
  @sysvar::Panel::BrakeWarningLampDsp_ = $BrakeWarningLamp; 
  @sysvar::Panel::ESPWarningLampDsp_   = $ESPWarningLamp;
  @sysvar::Panel::BrakePedalPressure   = $BrakePressure;   
}

on frPDU ABSInfo
{
  @sysvar::Panel::CarSpeedDsp_   = $CarSpeed;
  @sysvar::Panel::CarSpeedUSDsp_ = $CarSpeed;
}

on frPDU EngineData
{
  @sysvar::Panel::EngSpeedDsp_    = $EngSpeed;
  @sysvar::Panel::EngTempDsp_     = $EngTemp;
  @sysvar::Panel::PetrolLevelDsp_ = $PetrolLevel;
}

on signal (OilWarningLamp, WaterWarningLamp, BatteryWarningLamp)
{
  @sysvar::Panel::DashboardEngOilDsp_     = $OilWarningLamp;
  @sysvar::Panel::DashboardEngWaterDsp_   = $WaterWarningLamp;
  @sysvar::Panel::DashboardEngBaterryDsp_ = $BatteryWarningLamp;
}
*/
