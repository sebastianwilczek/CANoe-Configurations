/*@!Encoding:1252*/
/*variables
{
  int gGear = 1; // 0 == reverse; 1 == neutral; 2 - 6 == forward
}



on sysvar sysvar::Panel::GearDown
{
  if (!@this) return;
  
  if(gGear == 0) 
  { 
    return;
  }
  
  if(gGear == 1 && $CarSpeed > 5) return;
  else gGear--;
  
  GearShiftText(gGear);

  $Gear = gGear;  
}


on sysvar sysvar::Panel::GearUp
{
  if (!@this) return;
  
  if(gGear == 6) 
  { 
    return; 
  }

  if(gGear == 0 && $CarSpeed > 5) return;
  else gGear++;

  GearShiftText(gGear);

  $Gear = gGear;
}

GearShiftText (int gear)
{
  switch(gear)
  {
    case 0: SysSetVariableString(sysvar::Panel::GearShiftText, "R");  break;
    case 1: SysSetVariableString(sysvar::Panel::GearShiftText,"0");  break; 
    case 2: SysSetVariableString(sysvar::Panel::GearShiftText,"1");  break;
    case 3: SysSetVariableString(sysvar::Panel::GearShiftText,"2");  break;
    case 4: SysSetVariableString(sysvar::Panel::GearShiftText,"3");  break;
    case 5: SysSetVariableString(sysvar::Panel::GearShiftText,"4");  break;
    case 6: SysSetVariableString(sysvar::Panel::GearShiftText,"5");  break; 
  }
  @sysvar::Panel::GearShiftInfo = gear;
}

on start
{
  $Gear = 1;
  SysSetVariableString(sysvar::Panel::GearShiftText, "0"); 
}

on key '+'
{
  gGear = $Gear;

  if ( ((gGear > 0) && (gGear < 6)) || ((gGear == 0) && ($CarSpeed <= 5)) )
  { 
    gGear++;
    GearShiftText(gGear);
    $Gear = gGear;
  }
}

on key '-'
{
  gGear = $Gear;

  if ( ((gGear > 1) && (gGear <= 6)) || ((gGear == 1) && ($CarSpeed <= 5)) )
  { 
    gGear--;
    GearShiftText(gGear);
    $Gear = gGear;
  }
}
*/
