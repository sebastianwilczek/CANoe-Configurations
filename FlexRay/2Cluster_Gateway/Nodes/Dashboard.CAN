/*@!Encoding:1252*/
variables
{
  msTimer tConsoleElementsDsp2;
}

on start
{
  // set to 2 to get more information into write-window 
  setWriteDbgLevel(1);
  writeDbgLevel(2,"Dashboard");
}

on timer tConsoleElementsDsp2
{
  // Shows the elements "Oil", "Water" & "Battery" in the Dashboard for a few seconds.
  // When the devices are ok the lights will disappear! 
  @PowerTrain::Display::DashboardEngOil     = 0;
  @PowerTrain::Display::DashboardEngWater   = 0;
  @PowerTrain::Display::DashboardEngBaterry = 0;
}

on FRFrame BrakeControl
{
  //Write("ESP warning lamp = %f", $BrakeControl::ESPWarningLamp);
  //Write("ASR Mode = %f", $BrakeControl::ASRMode);

  @PowerTrain::Display::ABSWarningLamp   = $ABSWarningLamp;
  @PowerTrain::Display::ASRMode          = $ASRMode;  
  @PowerTrain::Display::BrakeWarningLamp = $BrakeWarningLamp; 
  @PowerTrain::Display::ESPWarningLamp   = $ESPWarningLamp;
  @PowerTrain::BrakePedalPressure   = $BrakePressure;   
}

on FRFrame ABSInfo
{
  @PowerTrain::Display::CarSpeed   = $CarSpeed;
  @PowerTrain::Display::CarSpeedUS = $CarSpeed;
}

on FRFrame EngineData
{
  @PowerTrain::Display::EngSpeed    = $EngSpeed;
  @PowerTrain::Display::EngTemp     = $EngTemp;
  @PowerTrain::Display::PetrolLevel = $PetrolLevel;
}

on signal (OilWarningLamp, WaterWarningLamp, BatteryWarningLamp)
{
  @PowerTrain::Display::DashboardEngOil     = $OilWarningLamp;
  @PowerTrain::Display::DashboardEngWater   = $WaterWarningLamp;
  @PowerTrain::Display::DashboardEngBaterry = $BatteryWarningLamp;
}

GearShiftText (int gear)
{
  switch(gear)
  {
    case 0: sysSetVariableString(sysVar::PowerTrain::Display::Gear, "R");  break;
    case 1: sysSetVariableString(sysVar::PowerTrain::Display::Gear, "N");  break; 
    case 2: sysSetVariableString(sysVar::PowerTrain::Display::Gear, "D1");  break;
    case 3: sysSetVariableString(sysVar::PowerTrain::Display::Gear, "D2");  break;
    case 4: sysSetVariableString(sysVar::PowerTrain::Display::Gear, "D3");  break;
    case 5: sysSetVariableString(sysVar::PowerTrain::Display::Gear, "D4");  break;
    case 6: sysSetVariableString(sysVar::PowerTrain::Display::Gear, "D5");  break; 
  }
}

on signal CurGear
{
  GearShiftText(this);
}

