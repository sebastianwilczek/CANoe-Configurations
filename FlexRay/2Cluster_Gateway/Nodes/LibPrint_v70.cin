/*@@var:*/
variables
{
  char gTxtStr[254];
  const int gTxtSize = 254;

  int writeSink_Trace           = -3;
  int writeSink_Logging         = -2;
  int writeSeverity_Information = 1;
}
/*@@end*/

/*@@caplFunc:myprint(int,char[]):*///function
void myprint(int level, char text[])
{
  if (level >= 1)
    write("%s", text);
  if (level >= 2)
    writeLineEx(writeSink_Trace,   writeSeverity_Information, "%s", text);
  if (level >= 3)
    writeLineEx(writeSink_Logging, writeSeverity_Information, "%s", text);
}
/*@@end*/

