/*@!Encoding:1252*/

variables
{
  ScopeAnalyseHandle scopeAnlyzHandle = {Handle = 999};
  ScopeBitMaskPolygon bitMaskPolygon;
  int scopeConnected = 0;
}

int CheckStatusInternal(long status, char text[])
{
 if(status <= 0)
 {
   testStepFail(testStepName, " Internal error in %s, return code = %d", text, status);
   return 0;
 }
 return 1;
}

int DoScopeConnect()
{
  long res;
  
  res = scopeConnect();
  if(!CheckStatusInternal(res, "scopeConnect"))return 0; 
  if(res!=2)  //already connected
  {
    res =testWaitForScopeEvent(eScopeConnected, 8000);
    if(!CheckStatusInternal(res, "scopeConnect"))return 0; 
  }
  scopeConnected = 1;
  return 1;
}

int DoScopeTrigger()
{
  long res;
  
  if(!scopeConnected) return 0;
  
  res = scopeTriggerNow();
  if(!CheckStatusInternal(res, "scopeTriggerNow")) return 0;

  // wait till action done
  res =(testWaitForScopeEvent(eScopeTriggered, 50000));
  if(!CheckStatusInternal(res, "scopeTriggerNow")) return 0;

  return 1; 
}

void AddSetupInfo(ScopeBitMaskPolygon bitmask, char name[])
{
  int i;
  const long bufLength = 512;
  char buffer[bufLength], buffer1[bufLength];
  
  TestReportAddMiscInfo("Position", "Data0, Data1");
  for(i=0;i< bitmask.maskPointCount; ++i)
  {
    snprintf(buffer, bufLength, "%2.2f%%", bitmask.timeOffset[i]);
    snprintf(buffer1, bufLength, "%+4d mV, %+4d mV", bitmask.data_0_Mask[i], bitmask.data_1_Mask[i]);
    TestReportAddMiscInfo(buffer, buffer1);
  }
}
    
void GetFrBitFieldName(long bitFieldType, char name[], long nameLength)
{	
  switch(bitFieldType)
  {
    case eCAPLScopeDataField_FR_BSS_FIELD: strncpy(name, "FR_BSS_FIELD", nameLength); return;
    case eCAPLScopeDataField_FR_RESERVE_BIT_FIELD: strncpy(name, "RESERVE_BIT_FIELD", nameLength); return;
    case eCAPLScopeDataField_FR_PAYLOAD_PREAMBLE_INDICATOR_BIT_FIELD:strncpy(name, "PAYLOAD_PREAMBLE_INDICATOR_BIT_FIELD", nameLength); return;
    case eCAPLScopeDataField_FR_NULL_FRAME_BIT_FIELD:strncpy(name, "NULL_FRAME_BIT_FIELD", nameLength); return;
    case eCAPLScopeDataField_FR_SYNC_FRAME_BIT_FIELD:strncpy(name, "SYNC_FRAME_BIT_FIELD", nameLength); return;
    case eCAPLScopeDataField_FR_START_UP_FRAME_BIT_FIELD:strncpy(name, "START_UP_FRAME_BIT_FIELD", nameLength); return;
    case eCAPLScopeDataField_FR_FRAME_ID_FIELD:strncpy(name, "FRAME_ID_FIELD", nameLength); return;
    case eCAPLScopeDataField_FR_PAYLOAD_LENGTH_FIELD:strncpy(name, "PAYLOAD_LENGTH_FIELD", nameLength); return;
    case eCAPLScopeDataField_FR_CRC_HEADER_FIELD:strncpy(name, "CRC_HEADER_FIELD", nameLength); return;
    case eCAPLScopeDataField_FR_CYCLE_COUNT_FIELD:strncpy(name, "CYCLE_COUNT_FIELD", nameLength); return;
    case eCAPLScopeDataField_FR_DATAFIELD_BYTE_1:strncpy(name, "DATAFIELD_BYTE_1", nameLength); return;
    case eCAPLScopeDataField_FR_DATAFIELD_BYTE_2:strncpy(name, "DATAFIELD_BYTE_2", nameLength); return;
    case eCAPLScopeDataField_FR_DATAFIELD_BYTE_3:strncpy(name, "DATAFIELD_BYTE_3", nameLength); return;
    case eCAPLScopeDataField_FR_DATAFIELD_BYTE_4:strncpy(name, "DATAFIELD_BYTE_4", nameLength); return;
    case eCAPLScopeDataField_FR_DATAFIELD_BYTE_5:strncpy(name, "DATAFIELD_BYTE_5", nameLength); return;
    case eCAPLScopeDataField_FR_DATAFIELD_BYTE_6:strncpy(name, "DATAFIELD_BYTE_6", nameLength); return;
    case eCAPLScopeDataField_FR_DATAFIELD_BYTE_7:strncpy(name, "DATAFIELD_BYTE_7", nameLength); return;
    case eCAPLScopeDataField_FR_DATAFIELD_BYTE_8:strncpy(name, "DATAFIELD_BYTE_8", nameLength); return;
    case eCAPLScopeDataField_FR_DATAFIELD_BYTE_9:strncpy(name, "DATAFIELD_BYTE_9", nameLength); return;
    case eCAPLScopeDataField_FR_DATAFIELD_BYTE_10:strncpy(name, "DATAFIELD_BYTE_10", nameLength); return;
    case eCAPLScopeDataField_FR_DATAFIELD_BYTE_11:strncpy(name, "DATAFIELD_BYTE_11", nameLength); return;
    case eCAPLScopeDataField_FR_DATAFIELD_BYTE_12:strncpy(name, "DATAFIELD_BYTE_12", nameLength); return;
    case eCAPLScopeDataField_FR_DATAFIELD_BYTE_13:strncpy(name, "DATAFIELD_BYTE_13", nameLength); return;
    case eCAPLScopeDataField_FR_DATAFIELD_BYTE_14:strncpy(name, "DATAFIELD_BYTE_14", nameLength); return;
    case eCAPLScopeDataField_FR_DATAFIELD_BYTE_15:strncpy(name, "DATAFIELD_BYTE_15", nameLength); return;
    case eCAPLScopeDataField_FR_DATAFIELD_BYTE_16:strncpy(name, "DATAFIELD_BYTE_16", nameLength); return;
    case eCAPLScopeDataField_FR_DATAFIELD_BYTE_17:strncpy(name, "DATAFIELD_BYTE_17", nameLength); return;
    case eCAPLScopeDataField_FR_DATAFIELD_BYTE_18:strncpy(name, "DATAFIELD_BYTE_18", nameLength); return;
    case eCAPLScopeDataField_FR_DATAFIELD_BYTE_19:strncpy(name, "DATAFIELD_BYTE_19", nameLength); return;
    case eCAPLScopeDataField_FR_DATAFIELD_BYTE_20:strncpy(name, "DATAFIELD_BYTE_20", nameLength); return;
    case eCAPLScopeDataField_FR_DATAFIELD_BYTE_21:strncpy(name, "DATAFIELD_BYTE_21", nameLength); return;
    case eCAPLScopeDataField_FR_DATAFIELD_BYTE_22:strncpy(name, "DATAFIELD_BYTE_22", nameLength); return;
    case eCAPLScopeDataField_FR_DATAFIELD_BYTE_23:strncpy(name, "DATAFIELD_BYTE_23", nameLength); return;
    case eCAPLScopeDataField_FR_DATAFIELD_BYTE_24:strncpy(name, "DATAFIELD_BYTE_24", nameLength); return;
    case eCAPLScopeDataField_FR_DATAFIELD_BYTE_25:strncpy(name, "DATAFIELD_BYTE_25", nameLength); return;
    case eCAPLScopeDataField_FR_DATAFIELD_BYTE_26:strncpy(name, "DATAFIELD_BYTE_26", nameLength); return;
    case eCAPLScopeDataField_FR_DATAFIELD_BYTE_27:strncpy(name, "DATAFIELD_BYTE_27", nameLength); return;
    case eCAPLScopeDataField_FR_DATAFIELD_BYTE_28:strncpy(name, "DATAFIELD_BYTE_28", nameLength); return;
    case eCAPLScopeDataField_FR_DATAFIELD_BYTE_29:strncpy(name, "DATAFIELD_BYTE_29", nameLength); return;
    case eCAPLScopeDataField_FR_DATAFIELD_BYTE_30:strncpy(name, "DATAFIELD_BYTE_30", nameLength); return;
    case eCAPLScopeDataField_FR_DATAFIELD_BYTE_31:strncpy(name, "DATAFIELD_BYTE_31", nameLength); return;
    case eCAPLScopeDataField_FR_DATAFIELD_BYTE_32:strncpy(name, "DATAFIELD_BYTE_32", nameLength); return;
    case eCAPLScopeDataField_FR_DATAFIELD_BYTE_33:strncpy(name, "DATAFIELD_BYTE_33", nameLength); return;
    case eCAPLScopeDataField_FR_DATAFIELD_BYTE_34:strncpy(name, "DATAFIELD_BYTE_34", nameLength); return;
    case eCAPLScopeDataField_FR_DATAFIELD_BYTE_35:strncpy(name, "DATAFIELD_BYTE_35", nameLength); return;
    case eCAPLScopeDataField_FR_DATAFIELD_BYTE_36:strncpy(name, "DATAFIELD_BYTE_36", nameLength); return;
    case eCAPLScopeDataField_FR_DATAFIELD_BYTE_37:strncpy(name, "DATAFIELD_BYTE_37", nameLength); return;
    case eCAPLScopeDataField_FR_DATAFIELD_BYTE_38:strncpy(name, "DATAFIELD_BYTE_38", nameLength); return;
    case eCAPLScopeDataField_FR_DATAFIELD_BYTE_39:strncpy(name, "DATAFIELD_BYTE_39", nameLength); return;
    case eCAPLScopeDataField_FR_DATAFIELD_BYTE_40:strncpy(name, "DATAFIELD_BYTE_40", nameLength); return;
    case eCAPLScopeDataField_FR_DATAFIELD_BYTE_41:strncpy(name, "DATAFIELD_BYTE_41", nameLength); return;
    case eCAPLScopeDataField_FR_DATAFIELD_BYTE_42:strncpy(name, "DATAFIELD_BYTE_42", nameLength); return;
    case eCAPLScopeDataField_FR_DATAFIELD_BYTE_43:strncpy(name, "DATAFIELD_BYTE_43", nameLength); return;
    case eCAPLScopeDataField_FR_DATAFIELD_BYTE_44:strncpy(name, "DATAFIELD_BYTE_44", nameLength); return;
    case eCAPLScopeDataField_FR_DATAFIELD_BYTE_45:strncpy(name, "DATAFIELD_BYTE_45", nameLength); return;
    case eCAPLScopeDataField_FR_DATAFIELD_BYTE_46:strncpy(name, "DATAFIELD_BYTE_46", nameLength); return;
    case eCAPLScopeDataField_FR_DATAFIELD_BYTE_47:strncpy(name, "DATAFIELD_BYTE_47", nameLength); return;
    case eCAPLScopeDataField_FR_DATAFIELD_BYTE_48:strncpy(name, "DATAFIELD_BYTE_48", nameLength); return;
    case eCAPLScopeDataField_FR_DATAFIELD_BYTE_49:strncpy(name, "DATAFIELD_BYTE_49", nameLength); return;
    case eCAPLScopeDataField_FR_DATAFIELD_BYTE_50:strncpy(name, "DATAFIELD_BYTE_50", nameLength); return;
    case eCAPLScopeDataField_FR_DATAFIELD_BYTE_51:strncpy(name, "DATAFIELD_BYTE_51", nameLength); return;
    case eCAPLScopeDataField_FR_DATAFIELD_BYTE_52:strncpy(name, "DATAFIELD_BYTE_52", nameLength); return;
    case eCAPLScopeDataField_FR_DATAFIELD_BYTE_53:strncpy(name, "DATAFIELD_BYTE_53", nameLength); return;
    case eCAPLScopeDataField_FR_DATAFIELD_BYTE_54:strncpy(name, "DATAFIELD_BYTE_54", nameLength); return;
    case eCAPLScopeDataField_FR_DATAFIELD_BYTE_55:strncpy(name, "DATAFIELD_BYTE_55", nameLength); return;
    case eCAPLScopeDataField_FR_DATAFIELD_BYTE_56:strncpy(name, "DATAFIELD_BYTE_56", nameLength); return;
    case eCAPLScopeDataField_FR_DATAFIELD_BYTE_57:strncpy(name, "DATAFIELD_BYTE_57", nameLength); return;
    case eCAPLScopeDataField_FR_DATAFIELD_BYTE_58:strncpy(name, "DATAFIELD_BYTE_58", nameLength); return;
    case eCAPLScopeDataField_FR_DATAFIELD_BYTE_59:strncpy(name, "DATAFIELD_BYTE_59", nameLength); return;
    case eCAPLScopeDataField_FR_DATAFIELD_BYTE_60:strncpy(name, "DATAFIELD_BYTE_60", nameLength); return;
    case eCAPLScopeDataField_FR_DATAFIELD_BYTE_61:strncpy(name, "DATAFIELD_BYTE_61", nameLength); return;
    case eCAPLScopeDataField_FR_DATAFIELD_BYTE_62:strncpy(name, "DATAFIELD_BYTE_62", nameLength); return;
    case eCAPLScopeDataField_FR_DATAFIELD_BYTE_63:strncpy(name, "DATAFIELD_BYTE_63", nameLength); return;
    case eCAPLScopeDataField_FR_DATAFIELD_BYTE_64:strncpy(name, "DATAFIELD_BYTE_64", nameLength); return;
    case eCAPLScopeDataField_FR_DATAFIELD_BYTE_65:strncpy(name, "DATAFIELD_BYTE_65", nameLength); return;
    case eCAPLScopeDataField_FR_DATAFIELD_BYTE_66:strncpy(name, "DATAFIELD_BYTE_66", nameLength); return;
    case eCAPLScopeDataField_FR_DATAFIELD_BYTE_67:strncpy(name, "DATAFIELD_BYTE_67", nameLength); return;
    case eCAPLScopeDataField_FR_DATAFIELD_BYTE_68:strncpy(name, "DATAFIELD_BYTE_68", nameLength); return;
    case eCAPLScopeDataField_FR_DATAFIELD_BYTE_69:strncpy(name, "DATAFIELD_BYTE_69", nameLength); return;
    case eCAPLScopeDataField_FR_DATAFIELD_BYTE_70:strncpy(name, "DATAFIELD_BYTE_70", nameLength); return;
    case eCAPLScopeDataField_FR_DATAFIELD_BYTE_71:strncpy(name, "DATAFIELD_BYTE_71", nameLength); return;
    case eCAPLScopeDataField_FR_DATAFIELD_BYTE_72:strncpy(name, "DATAFIELD_BYTE_72", nameLength); return;
    case eCAPLScopeDataField_FR_DATAFIELD_BYTE_73:strncpy(name, "DATAFIELD_BYTE_73", nameLength); return;
    case eCAPLScopeDataField_FR_DATAFIELD_BYTE_74:strncpy(name, "DATAFIELD_BYTE_74", nameLength); return;
    case eCAPLScopeDataField_FR_DATAFIELD_BYTE_75:strncpy(name, "DATAFIELD_BYTE_75", nameLength); return;
    case eCAPLScopeDataField_FR_DATAFIELD_BYTE_76:strncpy(name, "DATAFIELD_BYTE_76", nameLength); return;
    case eCAPLScopeDataField_FR_DATAFIELD_BYTE_77:strncpy(name, "DATAFIELD_BYTE_77", nameLength); return;
    case eCAPLScopeDataField_FR_DATAFIELD_BYTE_78:strncpy(name, "DATAFIELD_BYTE_78", nameLength); return;
    case eCAPLScopeDataField_FR_DATAFIELD_BYTE_79:strncpy(name, "DATAFIELD_BYTE_79", nameLength); return;
    case eCAPLScopeDataField_FR_DATAFIELD_BYTE_80:strncpy(name, "DATAFIELD_BYTE_80", nameLength); return;
    case eCAPLScopeDataField_FR_DATAFIELD_BYTE_81:strncpy(name, "DATAFIELD_BYTE_81", nameLength); return;
    case eCAPLScopeDataField_FR_DATAFIELD_BYTE_82:strncpy(name, "DATAFIELD_BYTE_82", nameLength); return;
    case eCAPLScopeDataField_FR_DATAFIELD_BYTE_83:strncpy(name, "DATAFIELD_BYTE_83", nameLength); return;
    case eCAPLScopeDataField_FR_DATAFIELD_BYTE_84:strncpy(name, "DATAFIELD_BYTE_84", nameLength); return;
    case eCAPLScopeDataField_FR_DATAFIELD_BYTE_85:strncpy(name, "DATAFIELD_BYTE_85", nameLength); return;
    case eCAPLScopeDataField_FR_DATAFIELD_BYTE_86:strncpy(name, "DATAFIELD_BYTE_86", nameLength); return;
    case eCAPLScopeDataField_FR_DATAFIELD_BYTE_87:strncpy(name, "DATAFIELD_BYTE_87", nameLength); return;
    case eCAPLScopeDataField_FR_DATAFIELD_BYTE_88:strncpy(name, "DATAFIELD_BYTE_88", nameLength); return;
    case eCAPLScopeDataField_FR_DATAFIELD_BYTE_89:strncpy(name, "DATAFIELD_BYTE_89", nameLength); return;
    case eCAPLScopeDataField_FR_DATAFIELD_BYTE_90:strncpy(name, "DATAFIELD_BYTE_90", nameLength); return;
    case eCAPLScopeDataField_FR_DATAFIELD_BYTE_91:strncpy(name, "DATAFIELD_BYTE_91", nameLength); return;
    case eCAPLScopeDataField_FR_DATAFIELD_BYTE_92:strncpy(name, "DATAFIELD_BYTE_92", nameLength); return;
    case eCAPLScopeDataField_FR_DATAFIELD_BYTE_93:strncpy(name, "DATAFIELD_BYTE_93", nameLength); return;
    case eCAPLScopeDataField_FR_DATAFIELD_BYTE_94:strncpy(name, "DATAFIELD_BYTE_94", nameLength); return;
    case eCAPLScopeDataField_FR_DATAFIELD_BYTE_95:strncpy(name, "DATAFIELD_BYTE_95", nameLength); return;
    case eCAPLScopeDataField_FR_DATAFIELD_BYTE_96:strncpy(name, "DATAFIELD_BYTE_96", nameLength); return;
    case eCAPLScopeDataField_FR_DATAFIELD_BYTE_97:strncpy(name, "DATAFIELD_BYTE_97", nameLength); return;
    case eCAPLScopeDataField_FR_DATAFIELD_BYTE_98:strncpy(name, "DATAFIELD_BYTE_98", nameLength); return;
    case eCAPLScopeDataField_FR_DATAFIELD_BYTE_99:strncpy(name, "DATAFIELD_BYTE_99", nameLength); return;
    case eCAPLScopeDataField_FR_DATAFIELD_BYTE_100:strncpy(name, "DATAFIELD_BYTE_100", nameLength); return;
    case eCAPLScopeDataField_FR_DATAFIELD_BYTE_101:strncpy(name, "DATAFIELD_BYTE_101", nameLength); return;
    case eCAPLScopeDataField_FR_DATAFIELD_BYTE_102:strncpy(name, "DATAFIELD_BYTE_102", nameLength); return;
    case eCAPLScopeDataField_FR_DATAFIELD_BYTE_103:strncpy(name, "DATAFIELD_BYTE_103", nameLength); return;
    case eCAPLScopeDataField_FR_DATAFIELD_BYTE_104:strncpy(name, "DATAFIELD_BYTE_104", nameLength); return;
    case eCAPLScopeDataField_FR_DATAFIELD_BYTE_105:strncpy(name, "DATAFIELD_BYTE_105", nameLength); return;
    case eCAPLScopeDataField_FR_DATAFIELD_BYTE_106:strncpy(name, "DATAFIELD_BYTE_106", nameLength); return;
    case eCAPLScopeDataField_FR_DATAFIELD_BYTE_107:strncpy(name, "DATAFIELD_BYTE_107", nameLength); return;
    case eCAPLScopeDataField_FR_DATAFIELD_BYTE_108:strncpy(name, "DATAFIELD_BYTE_108", nameLength); return;
    case eCAPLScopeDataField_FR_DATAFIELD_BYTE_109:strncpy(name, "DATAFIELD_BYTE_109", nameLength); return;
    case eCAPLScopeDataField_FR_DATAFIELD_BYTE_110:strncpy(name, "DATAFIELD_BYTE_110", nameLength); return;
    case eCAPLScopeDataField_FR_DATAFIELD_BYTE_111:strncpy(name, "DATAFIELD_BYTE_111", nameLength); return;
    case eCAPLScopeDataField_FR_DATAFIELD_BYTE_112:strncpy(name, "DATAFIELD_BYTE_112", nameLength); return;
    case eCAPLScopeDataField_FR_DATAFIELD_BYTE_113:strncpy(name, "DATAFIELD_BYTE_113", nameLength); return;
    case eCAPLScopeDataField_FR_DATAFIELD_BYTE_114:strncpy(name, "DATAFIELD_BYTE_114", nameLength); return;
    case eCAPLScopeDataField_FR_DATAFIELD_BYTE_115:strncpy(name, "DATAFIELD_BYTE_115", nameLength); return;
    case eCAPLScopeDataField_FR_DATAFIELD_BYTE_116:strncpy(name, "DATAFIELD_BYTE_116", nameLength); return;
    case eCAPLScopeDataField_FR_DATAFIELD_BYTE_117:strncpy(name, "DATAFIELD_BYTE_117", nameLength); return;
    case eCAPLScopeDataField_FR_DATAFIELD_BYTE_118:strncpy(name, "DATAFIELD_BYTE_118", nameLength); return;
    case eCAPLScopeDataField_FR_DATAFIELD_BYTE_119:strncpy(name, "DATAFIELD_BYTE_119", nameLength); return;
    case eCAPLScopeDataField_FR_DATAFIELD_BYTE_120:strncpy(name, "DATAFIELD_BYTE_120", nameLength); return;
    case eCAPLScopeDataField_FR_DATAFIELD_BYTE_121:strncpy(name, "DATAFIELD_BYTE_121", nameLength); return;
    case eCAPLScopeDataField_FR_DATAFIELD_BYTE_122:strncpy(name, "DATAFIELD_BYTE_122", nameLength); return;
    case eCAPLScopeDataField_FR_DATAFIELD_BYTE_123:strncpy(name, "DATAFIELD_BYTE_123", nameLength); return;
    case eCAPLScopeDataField_FR_DATAFIELD_BYTE_124:strncpy(name, "DATAFIELD_BYTE_124", nameLength); return;
    case eCAPLScopeDataField_FR_DATAFIELD_BYTE_125:strncpy(name, "DATAFIELD_BYTE_125", nameLength); return;
    case eCAPLScopeDataField_FR_DATAFIELD_BYTE_126:strncpy(name, "DATAFIELD_BYTE_126", nameLength); return;
    case eCAPLScopeDataField_FR_DATAFIELD_BYTE_127:strncpy(name, "DATAFIELD_BYTE_127", nameLength); return;
    case eCAPLScopeDataField_FR_DATAFIELD_BYTE_128:strncpy(name, "DATAFIELD_BYTE_128", nameLength); return;
    case eCAPLScopeDataField_FR_DATAFIELD_BYTE_129:strncpy(name, "DATAFIELD_BYTE_129", nameLength); return;
    case eCAPLScopeDataField_FR_DATAFIELD_BYTE_130:strncpy(name, "DATAFIELD_BYTE_130", nameLength); return;
    case eCAPLScopeDataField_FR_DATAFIELD_BYTE_131:strncpy(name, "DATAFIELD_BYTE_131", nameLength); return;
    case eCAPLScopeDataField_FR_DATAFIELD_BYTE_132:strncpy(name, "DATAFIELD_BYTE_132", nameLength); return;
    case eCAPLScopeDataField_FR_DATAFIELD_BYTE_133:strncpy(name, "DATAFIELD_BYTE_133", nameLength); return;
    case eCAPLScopeDataField_FR_DATAFIELD_BYTE_134:strncpy(name, "DATAFIELD_BYTE_134", nameLength); return;
    case eCAPLScopeDataField_FR_DATAFIELD_BYTE_135:strncpy(name, "DATAFIELD_BYTE_135", nameLength); return;
    case eCAPLScopeDataField_FR_DATAFIELD_BYTE_136:strncpy(name, "DATAFIELD_BYTE_136", nameLength); return;
    case eCAPLScopeDataField_FR_DATAFIELD_BYTE_137:strncpy(name, "DATAFIELD_BYTE_137", nameLength); return;
    case eCAPLScopeDataField_FR_DATAFIELD_BYTE_138:strncpy(name, "DATAFIELD_BYTE_138", nameLength); return;
    case eCAPLScopeDataField_FR_DATAFIELD_BYTE_139:strncpy(name, "DATAFIELD_BYTE_139", nameLength); return;
    case eCAPLScopeDataField_FR_DATAFIELD_BYTE_140:strncpy(name, "DATAFIELD_BYTE_140", nameLength); return;
    case eCAPLScopeDataField_FR_DATAFIELD_BYTE_141:strncpy(name, "DATAFIELD_BYTE_141", nameLength); return;
    case eCAPLScopeDataField_FR_DATAFIELD_BYTE_142:strncpy(name, "DATAFIELD_BYTE_142", nameLength); return;
    case eCAPLScopeDataField_FR_DATAFIELD_BYTE_143:strncpy(name, "DATAFIELD_BYTE_143", nameLength); return;
    case eCAPLScopeDataField_FR_DATAFIELD_BYTE_144:strncpy(name, "DATAFIELD_BYTE_144", nameLength); return;
    case eCAPLScopeDataField_FR_DATAFIELD_BYTE_145:strncpy(name, "DATAFIELD_BYTE_145", nameLength); return;
    case eCAPLScopeDataField_FR_DATAFIELD_BYTE_146:strncpy(name, "DATAFIELD_BYTE_146", nameLength); return;
    case eCAPLScopeDataField_FR_DATAFIELD_BYTE_147:strncpy(name, "DATAFIELD_BYTE_147", nameLength); return;
    case eCAPLScopeDataField_FR_DATAFIELD_BYTE_148:strncpy(name, "DATAFIELD_BYTE_148", nameLength); return;
    case eCAPLScopeDataField_FR_DATAFIELD_BYTE_149:strncpy(name, "DATAFIELD_BYTE_149", nameLength); return;
    case eCAPLScopeDataField_FR_DATAFIELD_BYTE_150:strncpy(name, "DATAFIELD_BYTE_150", nameLength); return;
    case eCAPLScopeDataField_FR_DATAFIELD_BYTE_151:strncpy(name, "DATAFIELD_BYTE_151", nameLength); return;
    case eCAPLScopeDataField_FR_DATAFIELD_BYTE_152:strncpy(name, "DATAFIELD_BYTE_152", nameLength); return;
    case eCAPLScopeDataField_FR_DATAFIELD_BYTE_153:strncpy(name, "DATAFIELD_BYTE_153", nameLength); return;
    case eCAPLScopeDataField_FR_DATAFIELD_BYTE_154:strncpy(name, "DATAFIELD_BYTE_154", nameLength); return;
    case eCAPLScopeDataField_FR_DATAFIELD_BYTE_155:strncpy(name, "DATAFIELD_BYTE_155", nameLength); return;
    case eCAPLScopeDataField_FR_DATAFIELD_BYTE_156:strncpy(name, "DATAFIELD_BYTE_156", nameLength); return;
    case eCAPLScopeDataField_FR_DATAFIELD_BYTE_157:strncpy(name, "DATAFIELD_BYTE_157", nameLength); return;
    case eCAPLScopeDataField_FR_DATAFIELD_BYTE_158:strncpy(name, "DATAFIELD_BYTE_158", nameLength); return;
    case eCAPLScopeDataField_FR_DATAFIELD_BYTE_159:strncpy(name, "DATAFIELD_BYTE_159", nameLength); return;
    case eCAPLScopeDataField_FR_DATAFIELD_BYTE_160:strncpy(name, "DATAFIELD_BYTE_160", nameLength); return;
    case eCAPLScopeDataField_FR_DATAFIELD_BYTE_161:strncpy(name, "DATAFIELD_BYTE_161", nameLength); return;
    case eCAPLScopeDataField_FR_DATAFIELD_BYTE_162:strncpy(name, "DATAFIELD_BYTE_162", nameLength); return;
    case eCAPLScopeDataField_FR_DATAFIELD_BYTE_163:strncpy(name, "DATAFIELD_BYTE_163", nameLength); return;
    case eCAPLScopeDataField_FR_DATAFIELD_BYTE_164:strncpy(name, "DATAFIELD_BYTE_164", nameLength); return;
    case eCAPLScopeDataField_FR_DATAFIELD_BYTE_165:strncpy(name, "DATAFIELD_BYTE_165", nameLength); return;
    case eCAPLScopeDataField_FR_DATAFIELD_BYTE_166:strncpy(name, "DATAFIELD_BYTE_166", nameLength); return;
    case eCAPLScopeDataField_FR_DATAFIELD_BYTE_167:strncpy(name, "DATAFIELD_BYTE_167", nameLength); return;
    case eCAPLScopeDataField_FR_DATAFIELD_BYTE_168:strncpy(name, "DATAFIELD_BYTE_168", nameLength); return;
    case eCAPLScopeDataField_FR_DATAFIELD_BYTE_169:strncpy(name, "DATAFIELD_BYTE_169", nameLength); return;
    case eCAPLScopeDataField_FR_DATAFIELD_BYTE_170:strncpy(name, "DATAFIELD_BYTE_170", nameLength); return;
    case eCAPLScopeDataField_FR_DATAFIELD_BYTE_171:strncpy(name, "DATAFIELD_BYTE_171", nameLength); return;
    case eCAPLScopeDataField_FR_DATAFIELD_BYTE_172:strncpy(name, "DATAFIELD_BYTE_172", nameLength); return;
    case eCAPLScopeDataField_FR_DATAFIELD_BYTE_173:strncpy(name, "DATAFIELD_BYTE_173", nameLength); return;
    case eCAPLScopeDataField_FR_DATAFIELD_BYTE_174:strncpy(name, "DATAFIELD_BYTE_174", nameLength); return;
    case eCAPLScopeDataField_FR_DATAFIELD_BYTE_175:strncpy(name, "DATAFIELD_BYTE_175", nameLength); return;
    case eCAPLScopeDataField_FR_DATAFIELD_BYTE_176:strncpy(name, "DATAFIELD_BYTE_176", nameLength); return;
    case eCAPLScopeDataField_FR_DATAFIELD_BYTE_177:strncpy(name, "DATAFIELD_BYTE_177", nameLength); return;
    case eCAPLScopeDataField_FR_DATAFIELD_BYTE_178:strncpy(name, "DATAFIELD_BYTE_178", nameLength); return;
    case eCAPLScopeDataField_FR_DATAFIELD_BYTE_179:strncpy(name, "DATAFIELD_BYTE_179", nameLength); return;
    case eCAPLScopeDataField_FR_DATAFIELD_BYTE_180:strncpy(name, "DATAFIELD_BYTE_180", nameLength); return;
    case eCAPLScopeDataField_FR_DATAFIELD_BYTE_181:strncpy(name, "DATAFIELD_BYTE_181", nameLength); return;
    case eCAPLScopeDataField_FR_DATAFIELD_BYTE_182:strncpy(name, "DATAFIELD_BYTE_182", nameLength); return;
    case eCAPLScopeDataField_FR_DATAFIELD_BYTE_183:strncpy(name, "DATAFIELD_BYTE_183", nameLength); return;
    case eCAPLScopeDataField_FR_DATAFIELD_BYTE_184:strncpy(name, "DATAFIELD_BYTE_184", nameLength); return;
    case eCAPLScopeDataField_FR_DATAFIELD_BYTE_185:strncpy(name, "DATAFIELD_BYTE_185", nameLength); return;
    case eCAPLScopeDataField_FR_DATAFIELD_BYTE_186:strncpy(name, "DATAFIELD_BYTE_186", nameLength); return;
    case eCAPLScopeDataField_FR_DATAFIELD_BYTE_187:strncpy(name, "DATAFIELD_BYTE_187", nameLength); return;
    case eCAPLScopeDataField_FR_DATAFIELD_BYTE_188:strncpy(name, "DATAFIELD_BYTE_188", nameLength); return;
    case eCAPLScopeDataField_FR_DATAFIELD_BYTE_189:strncpy(name, "DATAFIELD_BYTE_189", nameLength); return;
    case eCAPLScopeDataField_FR_DATAFIELD_BYTE_190:strncpy(name, "DATAFIELD_BYTE_190", nameLength); return;
    case eCAPLScopeDataField_FR_DATAFIELD_BYTE_191:strncpy(name, "DATAFIELD_BYTE_191", nameLength); return;
    case eCAPLScopeDataField_FR_DATAFIELD_BYTE_192:strncpy(name, "DATAFIELD_BYTE_192", nameLength); return;
    case eCAPLScopeDataField_FR_DATAFIELD_BYTE_193:strncpy(name, "DATAFIELD_BYTE_193", nameLength); return;
    case eCAPLScopeDataField_FR_DATAFIELD_BYTE_194:strncpy(name, "DATAFIELD_BYTE_194", nameLength); return;
    case eCAPLScopeDataField_FR_DATAFIELD_BYTE_195:strncpy(name, "DATAFIELD_BYTE_195", nameLength); return;
    case eCAPLScopeDataField_FR_DATAFIELD_BYTE_196:strncpy(name, "DATAFIELD_BYTE_196", nameLength); return;
    case eCAPLScopeDataField_FR_DATAFIELD_BYTE_197:strncpy(name, "DATAFIELD_BYTE_197", nameLength); return;
    case eCAPLScopeDataField_FR_DATAFIELD_BYTE_198:strncpy(name, "DATAFIELD_BYTE_198", nameLength); return;
    case eCAPLScopeDataField_FR_DATAFIELD_BYTE_199:strncpy(name, "DATAFIELD_BYTE_199", nameLength); return;
    case eCAPLScopeDataField_FR_DATAFIELD_BYTE_200:strncpy(name, "DATAFIELD_BYTE_200", nameLength); return;
    case eCAPLScopeDataField_FR_DATAFIELD_BYTE_201:strncpy(name, "DATAFIELD_BYTE_201", nameLength); return;
    case eCAPLScopeDataField_FR_DATAFIELD_BYTE_202:strncpy(name, "DATAFIELD_BYTE_202", nameLength); return;
    case eCAPLScopeDataField_FR_DATAFIELD_BYTE_203:strncpy(name, "DATAFIELD_BYTE_203", nameLength); return;
    case eCAPLScopeDataField_FR_DATAFIELD_BYTE_204:strncpy(name, "DATAFIELD_BYTE_204", nameLength); return;
    case eCAPLScopeDataField_FR_DATAFIELD_BYTE_205:strncpy(name, "DATAFIELD_BYTE_205", nameLength); return;
    case eCAPLScopeDataField_FR_DATAFIELD_BYTE_206:strncpy(name, "DATAFIELD_BYTE_206", nameLength); return;
    case eCAPLScopeDataField_FR_DATAFIELD_BYTE_207:strncpy(name, "DATAFIELD_BYTE_207", nameLength); return;
    case eCAPLScopeDataField_FR_DATAFIELD_BYTE_208:strncpy(name, "DATAFIELD_BYTE_208", nameLength); return;
    case eCAPLScopeDataField_FR_DATAFIELD_BYTE_209:strncpy(name, "DATAFIELD_BYTE_209", nameLength); return;
    case eCAPLScopeDataField_FR_DATAFIELD_BYTE_210:strncpy(name, "DATAFIELD_BYTE_210", nameLength); return;
    case eCAPLScopeDataField_FR_DATAFIELD_BYTE_211:strncpy(name, "DATAFIELD_BYTE_211", nameLength); return;
    case eCAPLScopeDataField_FR_DATAFIELD_BYTE_212:strncpy(name, "DATAFIELD_BYTE_212", nameLength); return;
    case eCAPLScopeDataField_FR_DATAFIELD_BYTE_213:strncpy(name, "DATAFIELD_BYTE_213", nameLength); return;
    case eCAPLScopeDataField_FR_DATAFIELD_BYTE_214:strncpy(name, "DATAFIELD_BYTE_214", nameLength); return;
    case eCAPLScopeDataField_FR_DATAFIELD_BYTE_215:strncpy(name, "DATAFIELD_BYTE_215", nameLength); return;
    case eCAPLScopeDataField_FR_DATAFIELD_BYTE_216:strncpy(name, "DATAFIELD_BYTE_216", nameLength); return;
    case eCAPLScopeDataField_FR_DATAFIELD_BYTE_217:strncpy(name, "DATAFIELD_BYTE_217", nameLength); return;
    case eCAPLScopeDataField_FR_DATAFIELD_BYTE_218:strncpy(name, "DATAFIELD_BYTE_218", nameLength); return;
    case eCAPLScopeDataField_FR_DATAFIELD_BYTE_219:strncpy(name, "DATAFIELD_BYTE_219", nameLength); return;
    case eCAPLScopeDataField_FR_DATAFIELD_BYTE_220:strncpy(name, "DATAFIELD_BYTE_220", nameLength); return;
    case eCAPLScopeDataField_FR_DATAFIELD_BYTE_221:strncpy(name, "DATAFIELD_BYTE_221", nameLength); return;
    case eCAPLScopeDataField_FR_DATAFIELD_BYTE_222:strncpy(name, "DATAFIELD_BYTE_222", nameLength); return;
    case eCAPLScopeDataField_FR_DATAFIELD_BYTE_223:strncpy(name, "DATAFIELD_BYTE_223", nameLength); return;
    case eCAPLScopeDataField_FR_DATAFIELD_BYTE_224:strncpy(name, "DATAFIELD_BYTE_224", nameLength); return;
    case eCAPLScopeDataField_FR_DATAFIELD_BYTE_225:strncpy(name, "DATAFIELD_BYTE_225", nameLength); return;
    case eCAPLScopeDataField_FR_DATAFIELD_BYTE_226:strncpy(name, "DATAFIELD_BYTE_226", nameLength); return;
    case eCAPLScopeDataField_FR_DATAFIELD_BYTE_227:strncpy(name, "DATAFIELD_BYTE_227", nameLength); return;
    case eCAPLScopeDataField_FR_DATAFIELD_BYTE_228:strncpy(name, "DATAFIELD_BYTE_228", nameLength); return;
    case eCAPLScopeDataField_FR_DATAFIELD_BYTE_229:strncpy(name, "DATAFIELD_BYTE_229", nameLength); return;
    case eCAPLScopeDataField_FR_DATAFIELD_BYTE_230:strncpy(name, "DATAFIELD_BYTE_230", nameLength); return;
    case eCAPLScopeDataField_FR_DATAFIELD_BYTE_231:strncpy(name, "DATAFIELD_BYTE_231", nameLength); return;
    case eCAPLScopeDataField_FR_DATAFIELD_BYTE_232:strncpy(name, "DATAFIELD_BYTE_232", nameLength); return;
    case eCAPLScopeDataField_FR_DATAFIELD_BYTE_233:strncpy(name, "DATAFIELD_BYTE_233", nameLength); return;
    case eCAPLScopeDataField_FR_DATAFIELD_BYTE_234:strncpy(name, "DATAFIELD_BYTE_234", nameLength); return;
    case eCAPLScopeDataField_FR_DATAFIELD_BYTE_235:strncpy(name, "DATAFIELD_BYTE_235", nameLength); return;
    case eCAPLScopeDataField_FR_DATAFIELD_BYTE_236:strncpy(name, "DATAFIELD_BYTE_236", nameLength); return;
    case eCAPLScopeDataField_FR_DATAFIELD_BYTE_237:strncpy(name, "DATAFIELD_BYTE_237", nameLength); return;
    case eCAPLScopeDataField_FR_DATAFIELD_BYTE_238:strncpy(name, "DATAFIELD_BYTE_238", nameLength); return;
    case eCAPLScopeDataField_FR_DATAFIELD_BYTE_239:strncpy(name, "DATAFIELD_BYTE_239", nameLength); return;
    case eCAPLScopeDataField_FR_DATAFIELD_BYTE_240:strncpy(name, "DATAFIELD_BYTE_240", nameLength); return;
    case eCAPLScopeDataField_FR_DATAFIELD_BYTE_241:strncpy(name, "DATAFIELD_BYTE_241", nameLength); return;
    case eCAPLScopeDataField_FR_DATAFIELD_BYTE_242:strncpy(name, "DATAFIELD_BYTE_242", nameLength); return;
    case eCAPLScopeDataField_FR_DATAFIELD_BYTE_243:strncpy(name, "DATAFIELD_BYTE_243", nameLength); return;
    case eCAPLScopeDataField_FR_DATAFIELD_BYTE_244:strncpy(name, "DATAFIELD_BYTE_244", nameLength); return;
    case eCAPLScopeDataField_FR_DATAFIELD_BYTE_245:strncpy(name, "DATAFIELD_BYTE_245", nameLength); return;
    case eCAPLScopeDataField_FR_DATAFIELD_BYTE_246:strncpy(name, "DATAFIELD_BYTE_246", nameLength); return;
    case eCAPLScopeDataField_FR_DATAFIELD_BYTE_247:strncpy(name, "DATAFIELD_BYTE_247", nameLength); return;
    case eCAPLScopeDataField_FR_DATAFIELD_BYTE_248:strncpy(name, "DATAFIELD_BYTE_248", nameLength); return;
    case eCAPLScopeDataField_FR_DATAFIELD_BYTE_249:strncpy(name, "DATAFIELD_BYTE_249", nameLength); return;
    case eCAPLScopeDataField_FR_DATAFIELD_BYTE_250:strncpy(name, "DATAFIELD_BYTE_250", nameLength); return;
    case eCAPLScopeDataField_FR_DATAFIELD_BYTE_251:strncpy(name, "DATAFIELD_BYTE_251", nameLength); return;
    case eCAPLScopeDataField_FR_DATAFIELD_BYTE_252:strncpy(name, "DATAFIELD_BYTE_252", nameLength); return;
    case eCAPLScopeDataField_FR_DATAFIELD_BYTE_253:strncpy(name, "DATAFIELD_BYTE_253", nameLength); return;
    case eCAPLScopeDataField_FR_DATAFIELD_BYTE_254:strncpy(name, "DATAFIELD_BYTE_254", nameLength); return;
    case eCAPLScopeDataField_FR_CRC_TRAILERFIELD_1:strncpy(name, "CRC_TRAILERFIELD_1", nameLength); return;
    case eCAPLScopeDataField_FR_CRC_TRAILERFIELD_2:strncpy(name, "CRC_TRAILERFIELD_2", nameLength); return;
    case eCAPLScopeDataField_FR_CRC_TRAILERFIELD_3:strncpy(name, "CRC_TRAILERFIELD_3", nameLength); return;
    case eCAPLScopeDataField_FR_FES_TRAILER_FIELD:strncpy(name, "FES_TRAILER_FIELD", nameLength); return;
    case eCAPLScopeDataField_FR_RECEIVE_MESSAGE:strncpy(name, "RECEIVE_MESSAGE", nameLength); return;
	}
}
