/*@!Encoding:1252*/
variables
{
  const byte cMaxCount = 99; // 0 - 99 = 100 steps

  mstimer resetStartCycleEnvVar;
  const int cResetStartCycleEnvVarTimeout = 1; // ms
}

on signal_update Switch_AB_5_0_ms
{
  $Switch_AB_5_0_ms = 1 - $Switch_AB_5_0_ms;
}

on signal_update Switch_AB_2_5_ms
{
  $Switch_AB_2_5_ms = 1 - $Switch_AB_2_5_ms;
}

on signal_update Switch_AB_1_25_ms
{
  $Switch_AB_1_25_ms = 1 - $Switch_AB_1_25_ms;
}

on start
{
  $Switch_AB_1_25_ms = 1;
  $Switch_AB_2_5_ms  = 1;
  $Switch_AB_5_0_ms  = 1;
}

on signal_update Counter_AB_5_0_ms
{
  $Counter_AB_5_0_ms = $Counter_AB_5_0_ms + 1;
  if ($Counter_AB_5_0_ms > cMaxCount) $Counter_AB_5_0_ms = 0;
}

on signal_update Counter_AB_2_5_ms
{
  $Counter_AB_2_5_ms = $Counter_AB_2_5_ms + 1;
  if ($Counter_AB_2_5_ms > cMaxCount) $Counter_AB_2_5_ms = 0;
}

on signal_update Counter_AB_1_25_ms
{
  $Counter_AB_1_25_ms = $Counter_AB_1_25_ms + 1;
  if ($Counter_AB_1_25_ms > cMaxCount) $Counter_AB_1_25_ms = 0;
}

on FRStartCycle *
{
  @StartOfCycle = 1;
  cancelTimer(resetStartCycleEnvVar);
  setTimer(resetStartCycleEnvVar, cResetStartCycleEnvVarTimeout);
}

on timer resetStartCycleEnvVar
{
  @StartOfCycle = 0;
}

