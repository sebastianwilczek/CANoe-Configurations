/*@@var:*/
variables
{
}
/*@@end*/

/*@@updateSignal:Counter_AB_2_5_ms:*/
on signal_update Counter_AB_2_5_ms
{
  $Counter_BA_2_5_ms = $Counter_AB_2_5_ms;
}
/*@@end*/

/*@@updateSignal:Counter_AB_5_0_ms:*/
on signal_update Counter_AB_5_0_ms
{
  $Counter_BA_5_0_ms = $Counter_AB_5_0_ms;
}
/*@@end*/

/*@@updateSignal:Counter_AB_1_25_ms:*/
on signal_update Counter_AB_1_25_ms
{
  $Counter_BA_1_25_ms = $Counter_AB_1_25_ms;
}
/*@@end*/

/*@@updateSignal:Switch_AB_5_0_ms:*/
on signal_update Switch_AB_5_0_ms
{
  $Switch_BA_5_0_ms = $Switch_AB_5_0_ms;
}
/*@@end*/

/*@@updateSignal:Switch_AB_2_5_ms:*/
on signal_update Switch_AB_2_5_ms
{
  $Switch_BA_2_5_ms = $Switch_AB_2_5_ms;
}
/*@@end*/

/*@@updateSignal:Switch_AB_1_25_ms:*/
on signal_update Switch_AB_1_25_ms
{
  $Switch_BA_1_25_ms = $Switch_AB_1_25_ms;
}
/*@@end*/

