/*@@var:*/
variables {

  // Handle of Connection A2:
  long gConnectionHandle_A2 = 0;
}
/*@@end*/

/*@@caplFunc:InitConnSysTPVars_A2():*///function
void InitConnSysTPVars_A2 ()
{
  @sysvar::TP_A2::DLLVersionNoMajor = FrTP_GetDLLInfo(1);
  @sysvar::TP_A2::DLLVersionNoMinor = FrTP_GetDLLInfo(2);
  @sysvar::TP_A2::DLLVersionNoBuild = FrTP_GetDLLInfo(3);

  CreateTPConnection_A2(@sysvar::TP_A2::VerbosityLevel);
}
/*@@end*/

/*@@sysvarChange:TP_A2::AbortRxOnNewTxStart:*/
on sysvar sysvar::TP_A2::AbortRxOnNewTxStart
{
  SetTPAbortRxOnNewTxStart(gConnectionHandle_A2, @this, @sysvar::TP_A2::VerbosityLevel);
}
/*@@end*/

/*@@sysvarChange:TP_A2::AddrType:*/
on sysvar sysvar::TP_A2::AddrType
{
  SetTPAddresses(gConnectionHandle_A2, @sysvar::TP_A2::AddrType, @sysvar::TP_A2::LocalAddr, @sysvar::TP_A2::RemoteAddr, @sysvar::TP_A2::VerbosityLevel);
}
/*@@end*/

/*@@sysvarChange:TP_A2::BlockSize:*/
on sysvar sysvar::TP_A2::BlockSize
{
  SetTPBlockSize(gConnectionHandle_A2, @this, @sysvar::TP_A2::VerbosityLevel);
}
/*@@end*/

/*@@sysvarChange:TP_A2::ConnModeRx:*/
on sysvar sysvar::TP_A2::ConnModeRx
{
  SetTPConnectionModeRX(gConnectionHandle_A2, @this, @sysvar::TP_A2::VerbosityLevel);
}
/*@@end*/

/*@@sysvarChange:TP_A2::ConnModeTx:*/
on sysvar sysvar::TP_A2::ConnModeTx
{
  SetTPConnectionModeTX(gConnectionHandle_A2, @this, @sysvar::TP_A2::VerbosityLevel);
}
/*@@end*/

/*@@sysvarChange:TP_A2::EnablePadding:*/
on sysvar sysvar::TP_A2::EnablePadding
{
  SetTPPadding(gConnectionHandle_A2, @sysvar::TP_A2::EnablePadding, @sysvar::TP_A2::FillByte, @sysvar::TP_A2::VerbosityLevel);
}
/*@@end*/

/*@@sysvarChange:TP_A2::FillByte:*/
on sysvar sysvar::TP_A2::FillByte
{
  SetTPPadding(gConnectionHandle_A2, @sysvar::TP_A2::EnablePadding, @sysvar::TP_A2::FillByte, @sysvar::TP_A2::VerbosityLevel);
}
/*@@end*/

/*@@sysvarChange:TP_A2::LengthModeRx:*/
on sysvar sysvar::TP_A2::LengthModeRx
{
  SetTPLengthModeRX(gConnectionHandle_A2, @this, @sysvar::TP_A2::VerbosityLevel);
}
/*@@end*/

/*@@sysvarChange:TP_A2::LengthModeTx:*/
on sysvar sysvar::TP_A2::LengthModeTx
{
  SetTPLengthModeTX(gConnectionHandle_A2, @this, @sysvar::TP_A2::VerbosityLevel);
}
/*@@end*/

/*@@sysvarChange:TP_A2::LocalAddr:*/
on sysvar sysvar::TP_A2::LocalAddr
{
  SetTPAddresses(gConnectionHandle_A2, @sysvar::TP_A2::AddrType, @sysvar::TP_A2::LocalAddr, @sysvar::TP_A2::RemoteAddr, @sysvar::TP_A2::VerbosityLevel);
}
/*@@end*/

/*@@sysvarChange:TP_A2::RemoteAddr:*/
on sysvar sysvar::TP_A2::RemoteAddr
{
  SetTPAddresses(gConnectionHandle_A2, @sysvar::TP_A2::AddrType, @sysvar::TP_A2::LocalAddr, @sysvar::TP_A2::RemoteAddr, @sysvar::TP_A2::VerbosityLevel);
}
/*@@end*/

/*@@sysvarChange:TP_A2::MaxPDULength:*/
on sysvar sysvar::TP_A2::MaxPDULength
{
  SetTPMaxPduLength(gConnectionHandle_A2, @this, @sysvar::TP_A2::VerbosityLevel);
}
/*@@end*/

/*@@sysvarChange:TP_A2::MaxTxPrioPDUs:*/
on sysvar sysvar::TP_A2::MaxTxPrioPDUs
{
  SetTPMaxTXPrioPDUs(gConnectionHandle_A2, @this, @sysvar::TP_A2::VerbosityLevel);
}
/*@@end*/

/*@@sysvarChange:TP_A2::StMin:*/
on sysvar sysvar::TP_A2::StMin
{
  SetTPSTmin(gConnectionHandle_A2, @this, @sysvar::TP_A2::VerbosityLevel);
}
/*@@end*/

/*@@sysvarChange:TP_A2::VerbosityLevel:*/
on sysvar sysvar::TP_A2::VerbosityLevel
{
  FrTP_SetVerbosity (@this);

  SetTPPrefixString(gConnectionHandle_A2);
  write("%sVerbosity Level set: %d", gTPPrefix, @this); 
}
/*@@end*/

/*@@caplFunc:CreateTPConnection_PDUs_A2(int,char[][],int,char[][],int,ASRTPParameter,int):*///function
CreateTPConnection_PDUs_A2 (int numTxPDUs, char aTxPDUPool[][], int numRxPDUs, char aRxPDUPool[][], int aPDUNameLen, struct ASRTPParameter params, int verbosityLevel)
{
  params.mConnectionHandle = gConnectionHandle_A2;

  gConnectionHandle_A2 = CreateTPConnection( numTxPDUs, aTxPDUPool, numRxPDUs, aRxPDUPool, aPDUNameLen, params, verbosityLevel);

  @sysvar::TP_A2::ConnModeTx      = params.mConnectionModeTx;
  @sysvar::TP_A2::ConnModeRx      = params.mConnectionModeRx;
  @sysvar::TP_A2::LengthModeTx    = params.mLengthModeTx;
  @sysvar::TP_A2::LengthModeRx    = params.mLengthModeRx;
  @sysvar::TP_A2::AddrType        = params.mAddrType;
  @sysvar::TP_A2::LocalAddr       = params.mLocalAddr;
  @sysvar::TP_A2::RemoteAddr      = params.mRemoteAddr;
  @sysvar::TP_A2::EnablePadding   = params.mPadding;
  @sysvar::TP_A2::FillByte        = params.mFillByte;;
  @sysvar::TP_A2::MaxTxPrioPDUs   = params.mMaxTxPrioPDUs;
  @sysvar::TP_A2::BlockSize       = params.mBlockSize;
  @sysvar::TP_A2::StMin           = params.mStMin;
  @sysvar::TP_A2::MaxPDULength    = params.mMaxPDULength;

  @sysvar::TP_A2::TimeoutAs       = params.mTimeoutAs;
  @sysvar::TP_A2::TimeoutAr       = params.mTimeoutAr;
  @sysvar::TP_A2::TimeoutBs       = params.mTimeoutBs;
  @sysvar::TP_A2::TimeBr          = params.mTimeBr;
  @sysvar::TP_A2::TimeCs          = params.mTimeCs;
  @sysvar::TP_A2::TimeoutCr       = params.mTimeoutCr;

  //@sysvar::Panel_A2::ConnectionHandle = gConnectionHandle_A2; // show connection reference of A2 in panel A2
}
/*@@end*/

/*@@sysvarChange:TP_A2::TxPriority:*/
on sysvar sysvar::TP_A2::TxPriority
{
  SetTPTxPriority(gConnectionHandle_A2, @this, @sysvar::TP_A2::VerbosityLevel);
}
/*@@end*/

/*@@sysvarChange:TP_A2::ExclusiveTxUsage:*/
on sysvar sysvar::TP_A2::ExclusiveTxUsage
{
  SetTPExclusiveTxUsage(gConnectionHandle_A2, @this, @sysvar::TP_A2::VerbosityLevel);
}
/*@@end*/

