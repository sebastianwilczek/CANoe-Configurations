/*@@var:*/
variables {

  // Handle of Connection B1:
  long gConnectionHandle_B1 = 0;
}
/*@@end*/

/*@@caplFunc:InitConnSysTPVars_B1():*///function
void InitConnSysTPVars_B1 ()
{
  @sysvar::TP_B1::DLLVersionNoMajor = FrTP_GetDLLInfo(1);
  @sysvar::TP_B1::DLLVersionNoMinor = FrTP_GetDLLInfo(2);
  @sysvar::TP_B1::DLLVersionNoBuild = FrTP_GetDLLInfo(3);

  CreateTPConnection_B1(@sysvar::TP_B1::VerbosityLevel);
}
/*@@end*/

/*@@sysvarChange:TP_B1::AbortRxOnNewTxStart:*/
on sysvar sysvar::TP_B1::AbortRxOnNewTxStart
{
  SetTPAbortRxOnNewTxStart(gConnectionHandle_B1, @this, @sysvar::TP_B1::VerbosityLevel);
}
/*@@end*/

/*@@sysvarChange:TP_B1::AddrType:*/
on sysvar sysvar::TP_B1::AddrType
{
  SetTPAddresses(gConnectionHandle_B1, @sysvar::TP_B1::AddrType, @sysvar::TP_B1::LocalAddr, @sysvar::TP_B1::RemoteAddr, @sysvar::TP_B1::VerbosityLevel);
}
/*@@end*/

/*@@sysvarChange:TP_B1::BlockSize:*/
on sysvar sysvar::TP_B1::BlockSize
{
  SetTPBlockSize(gConnectionHandle_B1, @this, @sysvar::TP_B1::VerbosityLevel);
}
/*@@end*/

/*@@sysvarChange:TP_B1::ConnModeRx:*/
on sysvar sysvar::TP_B1::ConnModeRx
{
  SetTPConnectionModeRX(gConnectionHandle_B1, @this, @sysvar::TP_B1::VerbosityLevel);
}
/*@@end*/

/*@@sysvarChange:TP_B1::ConnModeTx:*/
on sysvar sysvar::TP_B1::ConnModeTx
{
  SetTPConnectionModeTX(gConnectionHandle_B1, @this, @sysvar::TP_B1::VerbosityLevel);
}
/*@@end*/

/*@@sysvarChange:TP_B1::EnablePadding:*/
on sysvar sysvar::TP_B1::EnablePadding
{
  SetTPPadding(gConnectionHandle_B1, @sysvar::TP_B1::EnablePadding, @sysvar::TP_B1::FillByte, @sysvar::TP_B1::VerbosityLevel);
}
/*@@end*/

/*@@sysvarChange:TP_B1::FillByte:*/
on sysvar sysvar::TP_B1::FillByte
{
  SetTPPadding(gConnectionHandle_B1, @sysvar::TP_B1::EnablePadding, @sysvar::TP_B1::FillByte, @sysvar::TP_B1::VerbosityLevel);
}
/*@@end*/

/*@@sysvarChange:TP_B1::LengthModeRx:*/
on sysvar sysvar::TP_B1::LengthModeRx
{
  SetTPLengthModeRX(gConnectionHandle_B1, @this, @sysvar::TP_B1::VerbosityLevel);
}
/*@@end*/

/*@@sysvarChange:TP_B1::LengthModeTx:*/
on sysvar sysvar::TP_B1::LengthModeTx
{
  SetTPLengthModeTX(gConnectionHandle_B1, @this, @sysvar::TP_B1::VerbosityLevel);
}
/*@@end*/

/*@@sysvarChange:TP_B1::LocalAddr:*/
on sysvar sysvar::TP_B1::LocalAddr
{
  SetTPAddresses(gConnectionHandle_B1, @sysvar::TP_B1::AddrType, @sysvar::TP_B1::LocalAddr, @sysvar::TP_B1::RemoteAddr, @sysvar::TP_B1::VerbosityLevel);
}
/*@@end*/

/*@@sysvarChange:TP_B1::RemoteAddr:*/
on sysvar sysvar::TP_B1::RemoteAddr
{
  SetTPAddresses(gConnectionHandle_B1, @sysvar::TP_B1::AddrType, @sysvar::TP_B1::LocalAddr, @sysvar::TP_B1::RemoteAddr, @sysvar::TP_B1::VerbosityLevel);
}
/*@@end*/

/*@@sysvarChange:TP_B1::MaxPDULength:*/
on sysvar sysvar::TP_B1::MaxPDULength
{
  SetTPMaxPduLength(gConnectionHandle_B1, @this, @sysvar::TP_B1::VerbosityLevel);
}
/*@@end*/

/*@@sysvarChange:TP_B1::MaxTxPrioPDUs:*/
on sysvar sysvar::TP_B1::MaxTxPrioPDUs
{
  SetTPMaxTXPrioPDUs(gConnectionHandle_B1, @this, @sysvar::TP_B1::VerbosityLevel);
}
/*@@end*/

/*@@sysvarChange:TP_B1::StMin:*/
on sysvar sysvar::TP_B1::StMin
{
  SetTPSTmin(gConnectionHandle_B1, @this, @sysvar::TP_B1::VerbosityLevel);
}
/*@@end*/

/*@@sysvarChange:TP_B1::VerbosityLevel:*/
on sysvar sysvar::TP_B1::VerbosityLevel
{
  FrTP_SetVerbosity (@this);

  SetTPPrefixString(gConnectionHandle_B1);
  write("%sVerbosity Level set: %d", gTPPrefix, @this); 
}
/*@@end*/

/*@@caplFunc:CreateTPConnection_PDUs_B1(int,char[][],int,char[][],int,ASRTPParameter,int):*///function
CreateTPConnection_PDUs_B1 (int numTxPDUs, char aTxPDUPool[][], int numRxPDUs, char aRxPDUPool[][], int aPDUNameLen, struct ASRTPParameter params, int verbosityLevel)
{
  params.mConnectionHandle = gConnectionHandle_B1;

  gConnectionHandle_B1 = CreateTPConnection( numTxPDUs, aTxPDUPool, numRxPDUs, aRxPDUPool, aPDUNameLen, params, verbosityLevel);

  @sysvar::TP_B1::ConnModeTx      = params.mConnectionModeTx;
  @sysvar::TP_B1::ConnModeRx      = params.mConnectionModeRx;
  @sysvar::TP_B1::LengthModeTx    = params.mLengthModeTx;
  @sysvar::TP_B1::LengthModeRx    = params.mLengthModeRx;
  @sysvar::TP_B1::AddrType        = params.mAddrType;
  @sysvar::TP_B1::LocalAddr       = params.mLocalAddr;
  @sysvar::TP_B1::RemoteAddr      = params.mRemoteAddr;
  @sysvar::TP_B1::EnablePadding   = params.mPadding;
  @sysvar::TP_B1::FillByte        = params.mFillByte;;
  @sysvar::TP_B1::MaxTxPrioPDUs   = params.mMaxTxPrioPDUs;
  @sysvar::TP_B1::BlockSize       = params.mBlockSize;
  @sysvar::TP_B1::StMin           = params.mStMin;
  @sysvar::TP_B1::MaxPDULength    = params.mMaxPDULength;

  @sysvar::TP_B1::TimeoutAs       = params.mTimeoutAs;
  @sysvar::TP_B1::TimeoutAr       = params.mTimeoutAr;
  @sysvar::TP_B1::TimeoutBs       = params.mTimeoutBs;
  @sysvar::TP_B1::TimeBr          = params.mTimeBr;
  @sysvar::TP_B1::TimeCs          = params.mTimeCs;
  @sysvar::TP_B1::TimeoutCr       = params.mTimeoutCr;

  @sysvar::Panel_B1::ConnectionHandle = gConnectionHandle_B1; // show connection reference of B1 in panel B1
}
/*@@end*/

/*@@sysvarChange:TP_B1::ExclusiveTxUsage:*/
on sysvar sysvar::TP_B1::ExclusiveTxUsage
{
  SetTPExclusiveTxUsage(gConnectionHandle_B1, @this, @sysvar::TP_B1::VerbosityLevel);
}
/*@@end*/

/*@@sysvarChange:TP_B1::TxPriority:*/
on sysvar sysvar::TP_B1::TxPriority
{
  SetTPTxPriority(gConnectionHandle_B1, @this, @sysvar::TP_B1::VerbosityLevel);
}
/*@@end*/

