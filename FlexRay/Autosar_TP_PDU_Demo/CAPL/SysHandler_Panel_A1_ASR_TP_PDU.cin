/*@@var:*/
variables {

  byte gTxDataBuffer_A1[kTxSize];

  msTimer tSignalRcvdData_A1; // Signal Received Data
}
/*@@end*/

/*@@timer:tSignalRcvdData_A1:*/
on timer tSignalRcvdData_A1
{
  // Switch off led for RcvdData
  @sysvar::Panel_A1::RxIndication = 0;
}
/*@@end*/

/*@@caplFunc:InitConnSysPanelVars_A1():*///function
void InitConnSysPanelVars_A1 ()
{
  SysSetVariableString(sysvar::Panel_A1::NodeName, gECU);
}
/*@@end*/

/*@@caplFunc:FrTP_ErrorInd_A1(long,dword):*///callback
FrTP_ErrorInd_A1(long connectionHdl, DWORD error)
{
  char errorStrings[13][200] =
  {
    /*   0 */ "unknown error",
    /*   1 */ "Some mandatory settings are missing, e.g. the addresses to use",
    /*   2 */ "The value given contradicts another setting made earlier, e.g. payload length is larger than maximum",
    /*   3 */ "The request to send some data was rejected since another transmission is in progress",
    /*   4 */ "A reception was active when FF or SF was received",
    /*   5 */ "A negative ACK was received for acknowledged connections",
    /*   6 */ "The bus did not confirm transmission of a frame in time",
    /*   7 */ "The transmitter did not receive a FC (or AF) in time",
    /*   8 */ "The receiver did not receive the next CF in time",
    /*   9 */ "unknown error",
    /*  10 */ "unknown error",
    /*  11 */ "The peer rejected the data since it is too long",
    /*  12 */ "Peer sent an undefined Ack"
  };

  SetTPPrefixString(connectionHdl);

  if ((error > 0) && (error < 13))
  {
    write("%sError (%d): %s", gTPPrefix, error, errorStrings[error]);
  }
  else
  {
    write("%sError (%d): %s", gTPPrefix, error, errorStrings[0]);
  }
}
/*@@end*/

/*@@caplFunc:FrTP_FirstFrameInd_A1(long,dword):*///callback
FrTP_FirstFrameInd_A1 (long connectionHdl, dword dataLength)
{
  if (@sysvar::TP_A1::VerbosityLevel > 1)
  {
    SetTPPrefixString(connectionHdl);
    write("%sCALLBACK: FF indication, peer has started transfer of %d byte.", gTPPrefix, dataLength);
  }
}
/*@@end*/

/*@@caplFunc:FrTP_TxConfirmationInd_A1(long):*///callback
FrTP_TxConfirmationInd_A1 (long connectionHdl)
{
  @sysvar::TP_A1::ExclusiveTxUsage = 0; // set again to default

  if (@sysvar::TP_A1::VerbosityLevel > 1)
  {
    SetTPPrefixString(connectionHdl);
    write("%sCALLBACK: Tx confirmation received", gTPPrefix);
  }
}
/*@@end*/

/*@@caplFunc:FrTP_ReceptionInd_A1(long,byte[]):*///callback
FrTP_ReceptionInd_A1 (long connectionHdl, BYTE data[])
{
  if (@sysvar::TP_A1::VerbosityLevel > 1)
  {
    SetTPPrefixString(connectionHdl);
    write("%sCALLBACK: ReceptionInd called, received = %ld Bytes", gTPPrefix, elcount(data)); 
  }

  SysSetVariableData(sysvar::Panel_A1::DataBuffer, data, elcount(data));
  @sysvar::Panel_A1::RxDataLength = elcount(data);

  /* Signal received Data */
  @sysvar::Panel_A1::RxIndication = 1;
  cancelTimer(tSignalRcvdData_A1); setTimer(tSignalRcvdData_A1, 500);
}
/*@@end*/

/*@@sysvarChange:Panel_A1::ClearData:*/
on sysvar sysvar::Panel_A1::ClearData
{
  if (@this >= 1)
  {
    SysSetVariableData(sysvar::Panel_A1::DataBuffer, gClearData, 0);
    @sysvar::Panel_A1::RxIndication = 0;
    if (@sysvar::TP_A1::VerbosityLevel > 1)
    {
      SetTPPrefixString(gConnectionHandle_A1);
      write("%sData cleared!", gTPPrefix);
    }
  }
}
/*@@end*/

/*@@sysvarChange:Panel_A1::SendData:*/
on sysvar sysvar::Panel_A1::SendData
{
  long txCount, txArraySize;

  // Prevent from sending when button is released
  if (@this == 0)
    return;

  SysGetVariableData(sysvar::Panel_A1::DataBuffer, gTxDataBuffer_A1, txArraySize);
  txCount = @sysvar::Panel_A1::TxDataLength;

  // FlexRay Demo TP supports only up to kTxSize bytes per transmission
  if (txArraySize>=kTxSize) txArraySize=kTxSize; // don't write over array limits

  TPTransmit_A1(gTxDataBuffer_A1, txArraySize);
}
/*@@end*/

/*@@sysvarChange:Panel_A1::FillSendData:*/
on sysvar sysvar::Panel_A1::FillSendData
{
  long txCount,i;

  // No action if button is released
  if (@this==0)
    return;
    
  txCount = @sysvar::Panel_A1::TxDataLength;

  // don't write over array limits
  // use maximum capacity of protocol
  if (txCount>=kTxSize) txCount=kTxSize; 

  for( i=0; i<txCount; i++ ) 
  {
    gTxDataBuffer_A1[i] = 0x30+i;
  }
  
  // show data in panel
    
  SysSetVariableData(sysvar::Panel_A1::DataBuffer, gTxDataBuffer_A1, txCount);

  // send data

  TPTransmit_A1(gTxDataBuffer_A1, txCount);
}
/*@@end*/

