/*@@var:*/
variables {

  // Handle of Connection A3:
  long gConnectionHandle_A3 = 0;
}
/*@@end*/

/*@@caplFunc:InitConnSysTPVars_A3():*///function
void InitConnSysTPVars_A3 ()
{
  @sysvar::TP_A3::DLLVersionNoMajor = FrTP_GetDLLInfo(1);
  @sysvar::TP_A3::DLLVersionNoMinor = FrTP_GetDLLInfo(2);
  @sysvar::TP_A3::DLLVersionNoBuild = FrTP_GetDLLInfo(3);

  CreateTPConnection_A3(@sysvar::TP_A3::VerbosityLevel);
}
/*@@end*/

/*@@sysvarChange:TP_A3::AbortRxOnNewTxStart:*/
on sysvar sysvar::TP_A3::AbortRxOnNewTxStart
{
  SetTPAbortRxOnNewTxStart(gConnectionHandle_A3, @this, @sysvar::TP_A3::VerbosityLevel);
}
/*@@end*/

/*@@sysvarChange:TP_A3::AddrType:*/
on sysvar sysvar::TP_A3::AddrType
{
  SetTPAddresses(gConnectionHandle_A3, @sysvar::TP_A3::AddrType, @sysvar::TP_A3::LocalAddr, @sysvar::TP_A3::RemoteAddr, @sysvar::TP_A3::VerbosityLevel);
}
/*@@end*/

/*@@sysvarChange:TP_A3::BlockSize:*/
on sysvar sysvar::TP_A3::BlockSize
{
  SetTPBlockSize(gConnectionHandle_A3, @this, @sysvar::TP_A3::VerbosityLevel);
}
/*@@end*/

/*@@sysvarChange:TP_A3::ConnModeRx:*/
on sysvar sysvar::TP_A3::ConnModeRx
{
  SetTPConnectionModeRX(gConnectionHandle_A3, @this, @sysvar::TP_A3::VerbosityLevel);
}
/*@@end*/

/*@@sysvarChange:TP_A3::ConnModeTx:*/
on sysvar sysvar::TP_A3::ConnModeTx
{
  SetTPConnectionModeTX(gConnectionHandle_A3, @this, @sysvar::TP_A3::VerbosityLevel);
}
/*@@end*/

/*@@sysvarChange:TP_A3::EnablePadding:*/
on sysvar sysvar::TP_A3::EnablePadding
{
  SetTPPadding(gConnectionHandle_A3, @sysvar::TP_A3::EnablePadding, @sysvar::TP_A3::FillByte, @sysvar::TP_A3::VerbosityLevel);
}
/*@@end*/

/*@@sysvarChange:TP_A3::FillByte:*/
on sysvar sysvar::TP_A3::FillByte
{
  SetTPPadding(gConnectionHandle_A3, @sysvar::TP_A3::EnablePadding, @sysvar::TP_A3::FillByte, @sysvar::TP_A3::VerbosityLevel);
}
/*@@end*/

/*@@sysvarChange:TP_A3::LengthModeRx:*/
on sysvar sysvar::TP_A3::LengthModeRx
{
  SetTPLengthModeRX(gConnectionHandle_A3, @this, @sysvar::TP_A3::VerbosityLevel);
}
/*@@end*/

/*@@sysvarChange:TP_A3::LengthModeTx:*/
on sysvar sysvar::TP_A3::LengthModeTx
{
  SetTPLengthModeTX(gConnectionHandle_A3, @this, @sysvar::TP_A3::VerbosityLevel);
}
/*@@end*/

/*@@sysvarChange:TP_A3::LocalAddr:*/
on sysvar sysvar::TP_A3::LocalAddr
{
  SetTPAddresses(gConnectionHandle_A3, @sysvar::TP_A3::AddrType, @sysvar::TP_A3::LocalAddr, @sysvar::TP_A3::RemoteAddr, @sysvar::TP_A3::VerbosityLevel);
}
/*@@end*/

/*@@sysvarChange:TP_A3::RemoteAddr:*/
on sysvar sysvar::TP_A3::RemoteAddr
{
  SetTPAddresses(gConnectionHandle_A3, @sysvar::TP_A3::AddrType, @sysvar::TP_A3::LocalAddr, @sysvar::TP_A3::RemoteAddr, @sysvar::TP_A3::VerbosityLevel);
}
/*@@end*/

/*@@sysvarChange:TP_A3::MaxPDULength:*/
on sysvar sysvar::TP_A3::MaxPDULength
{
  SetTPMaxPduLength(gConnectionHandle_A3, @this, @sysvar::TP_A3::VerbosityLevel);
}
/*@@end*/

/*@@sysvarChange:TP_A3::MaxTxPrioPDUs:*/
on sysvar sysvar::TP_A3::MaxTxPrioPDUs
{
  SetTPMaxTXPrioPDUs(gConnectionHandle_A3, @this, @sysvar::TP_A3::VerbosityLevel);
}
/*@@end*/

/*@@sysvarChange:TP_A3::StMin:*/
on sysvar sysvar::TP_A3::StMin
{
  SetTPSTmin(gConnectionHandle_A3, @this, @sysvar::TP_A3::VerbosityLevel);
}
/*@@end*/

/*@@sysvarChange:TP_A3::VerbosityLevel:*/
on sysvar sysvar::TP_A3::VerbosityLevel
{
  FrTP_SetVerbosity (@this);

  SetTPPrefixString(gConnectionHandle_A3);
  write("%sVerbosity Level set: %d", gTPPrefix, @this); 
}
/*@@end*/

/*@@caplFunc:CreateTPConnection_PDUs_A3(int,char[][],int,char[][],int,ASRTPParameter,int):*///function
CreateTPConnection_PDUs_A3 (int numTxPDUs, char aTxPDUPool[][], int numRxPDUs, char aRxPDUPool[][], int aPDUNameLen, struct ASRTPParameter params, int verbosityLevel)
{
  params.mConnectionHandle = gConnectionHandle_A3;

  gConnectionHandle_A3 = CreateTPConnection( numTxPDUs, aTxPDUPool, numRxPDUs, aRxPDUPool, aPDUNameLen, params, verbosityLevel);

  @sysvar::TP_A3::ConnModeTx      = params.mConnectionModeTx;
  @sysvar::TP_A3::ConnModeRx      = params.mConnectionModeRx;
  @sysvar::TP_A3::LengthModeTx    = params.mLengthModeTx;
  @sysvar::TP_A3::LengthModeRx    = params.mLengthModeRx;
  @sysvar::TP_A3::AddrType        = params.mAddrType;
  @sysvar::TP_A3::LocalAddr       = params.mLocalAddr;
  @sysvar::TP_A3::RemoteAddr      = params.mRemoteAddr;
  @sysvar::TP_A3::EnablePadding   = params.mPadding;
  @sysvar::TP_A3::FillByte        = params.mFillByte;;
  @sysvar::TP_A3::MaxTxPrioPDUs   = params.mMaxTxPrioPDUs;
  @sysvar::TP_A3::BlockSize       = params.mBlockSize;
  @sysvar::TP_A3::StMin           = params.mStMin;
  @sysvar::TP_A3::MaxPDULength    = params.mMaxPDULength;

  @sysvar::TP_A3::TimeoutAs       = params.mTimeoutAs;
  @sysvar::TP_A3::TimeoutAr       = params.mTimeoutAr;
  @sysvar::TP_A3::TimeoutBs       = params.mTimeoutBs;
  @sysvar::TP_A3::TimeBr          = params.mTimeBr;
  @sysvar::TP_A3::TimeCs          = params.mTimeCs;
  @sysvar::TP_A3::TimeoutCr       = params.mTimeoutCr;

  @sysvar::Panel_A3::ConnectionHandle = gConnectionHandle_A3; // show connection reference of A3 in panel A3
}
/*@@end*/

/*@@sysvarChange:TP_A3::TxPriority:*/
on sysvar sysvar::TP_A3::TxPriority
{
  SetTPTxPriority(gConnectionHandle_A3, @this, @sysvar::TP_A3::VerbosityLevel);
}
/*@@end*/

/*@@sysvarChange:TP_A3::ExclusiveTxUsage:*/
on sysvar sysvar::TP_A3::ExclusiveTxUsage
{
  SetTPExclusiveTxUsage(gConnectionHandle_A3, @this, @sysvar::TP_A3::VerbosityLevel);
}
/*@@end*/

