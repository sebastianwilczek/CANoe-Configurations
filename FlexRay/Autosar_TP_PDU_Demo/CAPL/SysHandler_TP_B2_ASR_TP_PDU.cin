/*@@var:*/
variables {

  // Handle of Connection B2:
  long gConnectionHandle_B2 = 0;
}
/*@@end*/

/*@@caplFunc:InitConnSysTPVars_B2():*///function
void InitConnSysTPVars_B2 ()
{
  @sysvar::TP_B2::DLLVersionNoMajor = FrTP_GetDLLInfo(1);
  @sysvar::TP_B2::DLLVersionNoMinor = FrTP_GetDLLInfo(2);
  @sysvar::TP_B2::DLLVersionNoBuild = FrTP_GetDLLInfo(3);

  CreateTPConnection_B2(@sysvar::TP_B2::VerbosityLevel);
}
/*@@end*/

/*@@sysvarChange:TP_B2::AbortRxOnNewTxStart:*/
on sysvar sysvar::TP_B2::AbortRxOnNewTxStart
{
  SetTPAbortRxOnNewTxStart(gConnectionHandle_B2, @this, @sysvar::TP_B2::VerbosityLevel);
}
/*@@end*/

/*@@sysvarChange:TP_B2::AddrType:*/
on sysvar sysvar::TP_B2::AddrType
{
  SetTPAddresses(gConnectionHandle_B2, @sysvar::TP_B2::AddrType, @sysvar::TP_B2::LocalAddr, @sysvar::TP_B2::RemoteAddr, @sysvar::TP_B2::VerbosityLevel);
}
/*@@end*/

/*@@sysvarChange:TP_B2::BlockSize:*/
on sysvar sysvar::TP_B2::BlockSize
{
  SetTPBlockSize(gConnectionHandle_B2, @this, @sysvar::TP_B2::VerbosityLevel);
}
/*@@end*/

/*@@sysvarChange:TP_B2::ConnModeRx:*/
on sysvar sysvar::TP_B2::ConnModeRx
{
  SetTPConnectionModeRX(gConnectionHandle_B2, @this, @sysvar::TP_B2::VerbosityLevel);
}
/*@@end*/

/*@@sysvarChange:TP_B2::ConnModeTx:*/
on sysvar sysvar::TP_B2::ConnModeTx
{
  SetTPConnectionModeTX(gConnectionHandle_B2, @this, @sysvar::TP_B2::VerbosityLevel);
}
/*@@end*/

/*@@sysvarChange:TP_B2::EnablePadding:*/
on sysvar sysvar::TP_B2::EnablePadding
{
  SetTPPadding(gConnectionHandle_B2, @sysvar::TP_B2::EnablePadding, @sysvar::TP_B2::FillByte, @sysvar::TP_B2::VerbosityLevel);
}
/*@@end*/

/*@@sysvarChange:TP_B2::FillByte:*/
on sysvar sysvar::TP_B2::FillByte
{
  SetTPPadding(gConnectionHandle_B2, @sysvar::TP_B2::EnablePadding, @sysvar::TP_B2::FillByte, @sysvar::TP_B2::VerbosityLevel);
}
/*@@end*/

/*@@sysvarChange:TP_B2::LengthModeRx:*/
on sysvar sysvar::TP_B2::LengthModeRx
{
  SetTPLengthModeRX(gConnectionHandle_B2, @this, @sysvar::TP_B2::VerbosityLevel);
}
/*@@end*/

/*@@sysvarChange:TP_B2::LengthModeTx:*/
on sysvar sysvar::TP_B2::LengthModeTx
{
  SetTPLengthModeTX(gConnectionHandle_B2, @this, @sysvar::TP_B2::VerbosityLevel);
}
/*@@end*/

/*@@sysvarChange:TP_B2::LocalAddr:*/
on sysvar sysvar::TP_B2::LocalAddr
{
  SetTPAddresses(gConnectionHandle_B2, @sysvar::TP_B2::AddrType, @sysvar::TP_B2::LocalAddr, @sysvar::TP_B2::RemoteAddr, @sysvar::TP_B2::VerbosityLevel);
}
/*@@end*/

/*@@sysvarChange:TP_B2::RemoteAddr:*/
on sysvar sysvar::TP_B2::RemoteAddr
{
  SetTPAddresses(gConnectionHandle_B2, @sysvar::TP_B2::AddrType, @sysvar::TP_B2::LocalAddr, @sysvar::TP_B2::RemoteAddr, @sysvar::TP_B2::VerbosityLevel);
}
/*@@end*/

/*@@sysvarChange:TP_B2::MaxPDULength:*/
on sysvar sysvar::TP_B2::MaxPDULength
{
  SetTPMaxPduLength(gConnectionHandle_B2, @this, @sysvar::TP_B2::VerbosityLevel);
}
/*@@end*/

/*@@sysvarChange:TP_B2::MaxTxPrioPDUs:*/
on sysvar sysvar::TP_B2::MaxTxPrioPDUs
{
  SetTPMaxTXPrioPDUs(gConnectionHandle_B2, @this, @sysvar::TP_B2::VerbosityLevel);
}
/*@@end*/

/*@@sysvarChange:TP_B2::StMin:*/
on sysvar sysvar::TP_B2::StMin
{
  SetTPSTmin(gConnectionHandle_B2, @this, @sysvar::TP_B2::VerbosityLevel);
}
/*@@end*/

/*@@sysvarChange:TP_B2::VerbosityLevel:*/
on sysvar sysvar::TP_B2::VerbosityLevel
{
  FrTP_SetVerbosity (@this);

  SetTPPrefixString(gConnectionHandle_B2);
  write("%sVerbosity Level set: %d", gTPPrefix, @this); 
}
/*@@end*/

/*@@caplFunc:CreateTPConnection_PDUs_B2(int,char[][],int,char[][],int,ASRTPParameter,int):*///function
CreateTPConnection_PDUs_B2 (int numTxPDUs, char aTxPDUPool[][], int numRxPDUs, char aRxPDUPool[][], int aPDUNameLen, struct ASRTPParameter params, int verbosityLevel)
{
  params.mConnectionHandle = gConnectionHandle_B2;

  gConnectionHandle_B2 = CreateTPConnection( numTxPDUs, aTxPDUPool, numRxPDUs, aRxPDUPool, aPDUNameLen, params, verbosityLevel);

  @sysvar::TP_B2::ConnModeTx      = params.mConnectionModeTx;
  @sysvar::TP_B2::ConnModeRx      = params.mConnectionModeRx;
  @sysvar::TP_B2::LengthModeTx    = params.mLengthModeTx;
  @sysvar::TP_B2::LengthModeRx    = params.mLengthModeRx;
  @sysvar::TP_B2::AddrType        = params.mAddrType;
  @sysvar::TP_B2::LocalAddr       = params.mLocalAddr;
  @sysvar::TP_B2::RemoteAddr      = params.mRemoteAddr;
  @sysvar::TP_B2::EnablePadding   = params.mPadding;
  @sysvar::TP_B2::FillByte        = params.mFillByte;;
  @sysvar::TP_B2::MaxTxPrioPDUs   = params.mMaxTxPrioPDUs;
  @sysvar::TP_B2::BlockSize       = params.mBlockSize;
  @sysvar::TP_B2::StMin           = params.mStMin;
  @sysvar::TP_B2::MaxPDULength    = params.mMaxPDULength;

  @sysvar::TP_B2::TimeoutAs       = params.mTimeoutAs;
  @sysvar::TP_B2::TimeoutAr       = params.mTimeoutAr;
  @sysvar::TP_B2::TimeoutBs       = params.mTimeoutBs;
  @sysvar::TP_B2::TimeBr          = params.mTimeBr;
  @sysvar::TP_B2::TimeCs          = params.mTimeCs;
  @sysvar::TP_B2::TimeoutCr       = params.mTimeoutCr;

  //@sysvar::Panel_B2::ConnectionHandle = gConnectionHandle_B2; // show connection reference of B2 in panel B2
}
/*@@end*/

/*@@sysvarChange:TP_B2::ExclusiveTxUsage:*/
on sysvar sysvar::TP_B2::ExclusiveTxUsage
{
  SetTPExclusiveTxUsage(gConnectionHandle_B2, @this, @sysvar::TP_B2::VerbosityLevel);
}
/*@@end*/

/*@@sysvarChange:TP_B2::TxPriority:*/
on sysvar sysvar::TP_B2::TxPriority
{
  SetTPTxPriority(gConnectionHandle_B2, @this, @sysvar::TP_B2::VerbosityLevel);
}
/*@@end*/

