/*@@var:*/
variables {

  // Handle of Connection C1:
  long gConnectionHandle_C1 = 0;
}
/*@@end*/

/*@@caplFunc:InitConnSysTPVars_C1():*///function
void InitConnSysTPVars_C1 ()
{
  @sysvar::TP_C1::DLLVersionNoMajor = FrTP_GetDLLInfo(1);
  @sysvar::TP_C1::DLLVersionNoMinor = FrTP_GetDLLInfo(2);
  @sysvar::TP_C1::DLLVersionNoBuild = FrTP_GetDLLInfo(3);

  CreateTPConnection_C1(@sysvar::TP_C1::VerbosityLevel);
}
/*@@end*/

/*@@sysvarChange:TP_C1::AbortRxOnNewTxStart:*/
on sysvar sysvar::TP_C1::AbortRxOnNewTxStart
{
  SetTPAbortRxOnNewTxStart(gConnectionHandle_C1, @this, @sysvar::TP_C1::VerbosityLevel);
}
/*@@end*/

/*@@sysvarChange:TP_C1::AddrType:*/
on sysvar sysvar::TP_C1::AddrType
{
  SetTPAddresses(gConnectionHandle_C1, @sysvar::TP_C1::AddrType, @sysvar::TP_C1::LocalAddr, @sysvar::TP_C1::RemoteAddr, @sysvar::TP_C1::VerbosityLevel);
}
/*@@end*/

/*@@sysvarChange:TP_C1::BlockSize:*/
on sysvar sysvar::TP_C1::BlockSize
{
  SetTPBlockSize(gConnectionHandle_C1, @this, @sysvar::TP_C1::VerbosityLevel);
}
/*@@end*/

/*@@sysvarChange:TP_C1::ConnModeRx:*/
on sysvar sysvar::TP_C1::ConnModeRx
{
  SetTPConnectionModeRX(gConnectionHandle_C1, @this, @sysvar::TP_C1::VerbosityLevel);
}
/*@@end*/

/*@@sysvarChange:TP_C1::ConnModeTx:*/
on sysvar sysvar::TP_C1::ConnModeTx
{
  SetTPConnectionModeTX(gConnectionHandle_C1, @this, @sysvar::TP_C1::VerbosityLevel);
}
/*@@end*/

/*@@sysvarChange:TP_C1::EnablePadding:*/
on sysvar sysvar::TP_C1::EnablePadding
{
  SetTPPadding(gConnectionHandle_C1, @sysvar::TP_C1::EnablePadding, @sysvar::TP_C1::FillByte, @sysvar::TP_C1::VerbosityLevel);
}
/*@@end*/

/*@@sysvarChange:TP_C1::FillByte:*/
on sysvar sysvar::TP_C1::FillByte
{
  SetTPPadding(gConnectionHandle_C1, @sysvar::TP_C1::EnablePadding, @sysvar::TP_C1::FillByte, @sysvar::TP_C1::VerbosityLevel);
}
/*@@end*/

/*@@sysvarChange:TP_C1::LengthModeRx:*/
on sysvar sysvar::TP_C1::LengthModeRx
{
  SetTPLengthModeRX(gConnectionHandle_C1, @this, @sysvar::TP_C1::VerbosityLevel);
}
/*@@end*/

/*@@sysvarChange:TP_C1::LengthModeTx:*/
on sysvar sysvar::TP_C1::LengthModeTx
{
  SetTPLengthModeTX(gConnectionHandle_C1, @this, @sysvar::TP_C1::VerbosityLevel);
}
/*@@end*/

/*@@sysvarChange:TP_C1::LocalAddr:*/
on sysvar sysvar::TP_C1::LocalAddr
{
  SetTPAddresses(gConnectionHandle_C1, @sysvar::TP_C1::AddrType, @sysvar::TP_C1::LocalAddr, @sysvar::TP_C1::RemoteAddr, @sysvar::TP_C1::VerbosityLevel);
}
/*@@end*/

/*@@sysvarChange:TP_C1::RemoteAddr:*/
on sysvar sysvar::TP_C1::RemoteAddr
{
  SetTPAddresses(gConnectionHandle_C1, @sysvar::TP_C1::AddrType, @sysvar::TP_C1::LocalAddr, @sysvar::TP_C1::RemoteAddr, @sysvar::TP_C1::VerbosityLevel);
}
/*@@end*/

/*@@sysvarChange:TP_C1::MaxPDULength:*/
on sysvar sysvar::TP_C1::MaxPDULength
{
  SetTPMaxPduLength(gConnectionHandle_C1, @this, @sysvar::TP_C1::VerbosityLevel);
}
/*@@end*/

/*@@sysvarChange:TP_C1::MaxTxPrioPDUs:*/
on sysvar sysvar::TP_C1::MaxTxPrioPDUs
{
  SetTPMaxTXPrioPDUs(gConnectionHandle_C1, @this, @sysvar::TP_C1::VerbosityLevel);
}
/*@@end*/

/*@@sysvarChange:TP_C1::StMin:*/
on sysvar sysvar::TP_C1::StMin
{
  SetTPSTmin(gConnectionHandle_C1, @this, @sysvar::TP_C1::VerbosityLevel);
}
/*@@end*/

/*@@sysvarChange:TP_C1::VerbosityLevel:*/
on sysvar sysvar::TP_C1::VerbosityLevel
{
  FrTP_SetVerbosity (@this);

  SetTPPrefixString(gConnectionHandle_C1);
  write("%sVerbosity Level set: %d", gTPPrefix, @this); 
}
/*@@end*/

/*@@caplFunc:CreateTPConnection_PDUs_C1(int,char[][],int,char[][],int,ASRTPParameter,int):*///function
CreateTPConnection_PDUs_C1 (int numTxPDUs, char aTxPDUPool[][], int numRxPDUs, char aRxPDUPool[][], int aPDUNameLen, struct ASRTPParameter params, int verbosityLevel)
{
  params.mConnectionHandle = gConnectionHandle_C1;

  gConnectionHandle_C1 = CreateTPConnection( numTxPDUs, aTxPDUPool, numRxPDUs, aRxPDUPool, aPDUNameLen, params, verbosityLevel);

  @sysvar::TP_C1::ConnModeTx      = params.mConnectionModeTx;
  @sysvar::TP_C1::ConnModeRx      = params.mConnectionModeRx;
  @sysvar::TP_C1::LengthModeTx    = params.mLengthModeTx;
  @sysvar::TP_C1::LengthModeRx    = params.mLengthModeRx;
  @sysvar::TP_C1::AddrType        = params.mAddrType;
  @sysvar::TP_C1::LocalAddr       = params.mLocalAddr;
  @sysvar::TP_C1::RemoteAddr      = params.mRemoteAddr;
  @sysvar::TP_C1::EnablePadding   = params.mPadding;
  @sysvar::TP_C1::FillByte        = params.mFillByte;;
  @sysvar::TP_C1::MaxTxPrioPDUs   = params.mMaxTxPrioPDUs;
  @sysvar::TP_C1::BlockSize       = params.mBlockSize;
  @sysvar::TP_C1::StMin           = params.mStMin;
  @sysvar::TP_C1::MaxPDULength    = params.mMaxPDULength;

  @sysvar::TP_C1::TimeoutAs       = params.mTimeoutAs;
  @sysvar::TP_C1::TimeoutAr       = params.mTimeoutAr;
  @sysvar::TP_C1::TimeoutBs       = params.mTimeoutBs;
  @sysvar::TP_C1::TimeBr          = params.mTimeBr;
  @sysvar::TP_C1::TimeCs          = params.mTimeCs;
  @sysvar::TP_C1::TimeoutCr       = params.mTimeoutCr;

  @sysvar::Panel_C1::ConnectionHandle = gConnectionHandle_C1; // show connection reference of C1 in panel C1
}
/*@@end*/

/*@@sysvarChange:TP_C1::ExclusiveTxUsage:*/
on sysvar sysvar::TP_C1::ExclusiveTxUsage
{
  SetTPExclusiveTxUsage(gConnectionHandle_C1, @this, @sysvar::TP_C1::VerbosityLevel);
}
/*@@end*/

/*@@sysvarChange:TP_C1::TxPriority:*/
on sysvar sysvar::TP_C1::TxPriority
{
  SetTPTxPriority(gConnectionHandle_C1, @this, @sysvar::TP_C1::VerbosityLevel);
}
/*@@end*/

