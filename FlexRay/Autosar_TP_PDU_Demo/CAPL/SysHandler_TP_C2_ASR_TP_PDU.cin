/*@@var:*/
variables {

  // Handle of Connection C2:
  long gConnectionHandle_C2 = 0;
}
/*@@end*/

/*@@caplFunc:InitConnSysTPVars_C2():*///function
void InitConnSysTPVars_C2 ()
{
  @sysvar::TP_C2::DLLVersionNoMajor = FrTP_GetDLLInfo(1);
  @sysvar::TP_C2::DLLVersionNoMinor = FrTP_GetDLLInfo(2);
  @sysvar::TP_C2::DLLVersionNoBuild = FrTP_GetDLLInfo(3);

  CreateTPConnection_C2(@sysvar::TP_C2::VerbosityLevel);
}
/*@@end*/

/*@@sysvarChange:TP_C2::AbortRxOnNewTxStart:*/
on sysvar sysvar::TP_C2::AbortRxOnNewTxStart
{
  SetTPAbortRxOnNewTxStart(gConnectionHandle_C2, @this, @sysvar::TP_C2::VerbosityLevel);
}
/*@@end*/

/*@@sysvarChange:TP_C2::AddrType:*/
on sysvar sysvar::TP_C2::AddrType
{
  SetTPAddresses(gConnectionHandle_C2, @sysvar::TP_C2::AddrType, @sysvar::TP_C2::LocalAddr, @sysvar::TP_C2::RemoteAddr, @sysvar::TP_C2::VerbosityLevel);
}
/*@@end*/

/*@@sysvarChange:TP_C2::BlockSize:*/
on sysvar sysvar::TP_C2::BlockSize
{
  SetTPBlockSize(gConnectionHandle_C2, @this, @sysvar::TP_C2::VerbosityLevel);
}
/*@@end*/

/*@@sysvarChange:TP_C2::ConnModeRx:*/
on sysvar sysvar::TP_C2::ConnModeRx
{
  SetTPConnectionModeRX(gConnectionHandle_C2, @this, @sysvar::TP_C2::VerbosityLevel);
}
/*@@end*/

/*@@sysvarChange:TP_C2::ConnModeTx:*/
on sysvar sysvar::TP_C2::ConnModeTx
{
  SetTPConnectionModeTX(gConnectionHandle_C2, @this, @sysvar::TP_C2::VerbosityLevel);
}
/*@@end*/

/*@@sysvarChange:TP_C2::EnablePadding:*/
on sysvar sysvar::TP_C2::EnablePadding
{
  SetTPPadding(gConnectionHandle_C2, @sysvar::TP_C2::EnablePadding, @sysvar::TP_C2::FillByte, @sysvar::TP_C2::VerbosityLevel);
}
/*@@end*/

/*@@sysvarChange:TP_C2::FillByte:*/
on sysvar sysvar::TP_C2::FillByte
{
  SetTPPadding(gConnectionHandle_C2, @sysvar::TP_C2::EnablePadding, @sysvar::TP_C2::FillByte, @sysvar::TP_C2::VerbosityLevel);
}
/*@@end*/

/*@@sysvarChange:TP_C2::LengthModeRx:*/
on sysvar sysvar::TP_C2::LengthModeRx
{
  SetTPLengthModeRX(gConnectionHandle_C2, @this, @sysvar::TP_C2::VerbosityLevel);
}
/*@@end*/

/*@@sysvarChange:TP_C2::LengthModeTx:*/
on sysvar sysvar::TP_C2::LengthModeTx
{
  SetTPLengthModeTX(gConnectionHandle_C2, @this, @sysvar::TP_C2::VerbosityLevel);
}
/*@@end*/

/*@@sysvarChange:TP_C2::LocalAddr:*/
on sysvar sysvar::TP_C2::LocalAddr
{
  SetTPAddresses(gConnectionHandle_C2, @sysvar::TP_C2::AddrType, @sysvar::TP_C2::LocalAddr, @sysvar::TP_C2::RemoteAddr, @sysvar::TP_C2::VerbosityLevel);
}
/*@@end*/

/*@@sysvarChange:TP_C2::RemoteAddr:*/
on sysvar sysvar::TP_C2::RemoteAddr
{
  SetTPAddresses(gConnectionHandle_C2, @sysvar::TP_C2::AddrType, @sysvar::TP_C2::LocalAddr, @sysvar::TP_C2::RemoteAddr, @sysvar::TP_C2::VerbosityLevel);
}
/*@@end*/

/*@@sysvarChange:TP_C2::MaxPDULength:*/
on sysvar sysvar::TP_C2::MaxPDULength
{
  SetTPMaxPduLength(gConnectionHandle_C2, @this, @sysvar::TP_C2::VerbosityLevel);
}
/*@@end*/

/*@@sysvarChange:TP_C2::MaxTxPrioPDUs:*/
on sysvar sysvar::TP_C2::MaxTxPrioPDUs
{
  SetTPMaxTXPrioPDUs(gConnectionHandle_C2, @this, @sysvar::TP_C2::VerbosityLevel);
}
/*@@end*/

/*@@sysvarChange:TP_C2::StMin:*/
on sysvar sysvar::TP_C2::StMin
{
  SetTPSTmin(gConnectionHandle_C2, @this, @sysvar::TP_C2::VerbosityLevel);
}
/*@@end*/

/*@@sysvarChange:TP_C2::VerbosityLevel:*/
on sysvar sysvar::TP_C2::VerbosityLevel
{
  FrTP_SetVerbosity (@this);

  SetTPPrefixString(gConnectionHandle_C2);
  write("%sVerbosity Level set: %d", gTPPrefix, @this); 
}
/*@@end*/

/*@@caplFunc:CreateTPConnection_PDUs_C2(int,char[][],int,char[][],int,ASRTPParameter,int):*///function
CreateTPConnection_PDUs_C2 (int numTxPDUs, char aTxPDUPool[][], int numRxPDUs, char aRxPDUPool[][], int aPDUNameLen, struct ASRTPParameter params, int verbosityLevel)
{
  params.mConnectionHandle = gConnectionHandle_C2;

  gConnectionHandle_C2 = CreateTPConnection( numTxPDUs, aTxPDUPool, numRxPDUs, aRxPDUPool, aPDUNameLen, params, verbosityLevel);

  @sysvar::TP_C2::ConnModeTx      = params.mConnectionModeTx;
  @sysvar::TP_C2::ConnModeRx      = params.mConnectionModeRx;
  @sysvar::TP_C2::LengthModeTx    = params.mLengthModeTx;
  @sysvar::TP_C2::LengthModeRx    = params.mLengthModeRx;
  @sysvar::TP_C2::AddrType        = params.mAddrType;
  @sysvar::TP_C2::LocalAddr       = params.mLocalAddr;
  @sysvar::TP_C2::RemoteAddr      = params.mRemoteAddr;
  @sysvar::TP_C2::EnablePadding   = params.mPadding;
  @sysvar::TP_C2::FillByte        = params.mFillByte;;
  @sysvar::TP_C2::MaxTxPrioPDUs   = params.mMaxTxPrioPDUs;
  @sysvar::TP_C2::BlockSize       = params.mBlockSize;
  @sysvar::TP_C2::StMin           = params.mStMin;
  @sysvar::TP_C2::MaxPDULength    = params.mMaxPDULength;

  @sysvar::TP_C2::TimeoutAs       = params.mTimeoutAs;
  @sysvar::TP_C2::TimeoutAr       = params.mTimeoutAr;
  @sysvar::TP_C2::TimeoutBs       = params.mTimeoutBs;
  @sysvar::TP_C2::TimeBr          = params.mTimeBr;
  @sysvar::TP_C2::TimeCs          = params.mTimeCs;
  @sysvar::TP_C2::TimeoutCr       = params.mTimeoutCr;

  //@sysvar::Panel_C2::ConnectionHandle = gConnectionHandle_C2; // show connection reference of C2 in panel C2
}
/*@@end*/

/*@@sysvarChange:TP_C2::ExclusiveTxUsage:*/
on sysvar sysvar::TP_C2::ExclusiveTxUsage
{
  SetTPExclusiveTxUsage(gConnectionHandle_C2, @this, @sysvar::TP_C2::VerbosityLevel);
}
/*@@end*/

/*@@sysvarChange:TP_C2::TxPriority:*/
on sysvar sysvar::TP_C2::TxPriority
{
  SetTPTxPriority(gConnectionHandle_C2, @this, @sysvar::TP_C2::VerbosityLevel);
}
/*@@end*/

