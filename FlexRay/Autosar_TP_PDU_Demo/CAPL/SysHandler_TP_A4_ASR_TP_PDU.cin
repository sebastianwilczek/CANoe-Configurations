/*@@var:*/
variables {

  // Handle of Connection A4:
  long gConnectionHandle_A4 = 0;
}
/*@@end*/

/*@@caplFunc:InitConnSysTPVars_A4():*///function
void InitConnSysTPVars_A4 ()
{
  @sysvar::TP_A4::DLLVersionNoMajor = FrTP_GetDLLInfo(1);
  @sysvar::TP_A4::DLLVersionNoMinor = FrTP_GetDLLInfo(2);
  @sysvar::TP_A4::DLLVersionNoBuild = FrTP_GetDLLInfo(3);

  CreateTPConnection_A4(@sysvar::TP_A4::VerbosityLevel);
}
/*@@end*/

/*@@sysvarChange:TP_A4::AbortRxOnNewTxStart:*/
on sysvar sysvar::TP_A4::AbortRxOnNewTxStart
{
  SetTPAbortRxOnNewTxStart(gConnectionHandle_A4, @this, @sysvar::TP_A4::VerbosityLevel);
}
/*@@end*/

/*@@sysvarChange:TP_A4::AddrType:*/
on sysvar sysvar::TP_A4::AddrType
{
  SetTPAddresses(gConnectionHandle_A4, @sysvar::TP_A4::AddrType, @sysvar::TP_A4::LocalAddr, @sysvar::TP_A4::RemoteAddr, @sysvar::TP_A4::VerbosityLevel);
}
/*@@end*/

/*@@sysvarChange:TP_A4::BlockSize:*/
on sysvar sysvar::TP_A4::BlockSize
{
  SetTPBlockSize(gConnectionHandle_A4, @this, @sysvar::TP_A4::VerbosityLevel);
}
/*@@end*/

/*@@sysvarChange:TP_A4::ConnModeRx:*/
on sysvar sysvar::TP_A4::ConnModeRx
{
  SetTPConnectionModeRX(gConnectionHandle_A4, @this, @sysvar::TP_A4::VerbosityLevel);
}
/*@@end*/

/*@@sysvarChange:TP_A4::ConnModeTx:*/
on sysvar sysvar::TP_A4::ConnModeTx
{
  SetTPConnectionModeTX(gConnectionHandle_A4, @this, @sysvar::TP_A4::VerbosityLevel);
}
/*@@end*/

/*@@sysvarChange:TP_A4::EnablePadding:*/
on sysvar sysvar::TP_A4::EnablePadding
{
  SetTPPadding(gConnectionHandle_A4, @sysvar::TP_A4::EnablePadding, @sysvar::TP_A4::FillByte, @sysvar::TP_A4::VerbosityLevel);
}
/*@@end*/

/*@@sysvarChange:TP_A4::FillByte:*/
on sysvar sysvar::TP_A4::FillByte
{
  SetTPPadding(gConnectionHandle_A4, @sysvar::TP_A4::EnablePadding, @sysvar::TP_A4::FillByte, @sysvar::TP_A4::VerbosityLevel);
}
/*@@end*/

/*@@sysvarChange:TP_A4::LengthModeRx:*/
on sysvar sysvar::TP_A4::LengthModeRx
{
  SetTPLengthModeRX(gConnectionHandle_A4, @this, @sysvar::TP_A4::VerbosityLevel);
}
/*@@end*/

/*@@sysvarChange:TP_A4::LengthModeTx:*/
on sysvar sysvar::TP_A4::LengthModeTx
{
  SetTPLengthModeTX(gConnectionHandle_A4, @this, @sysvar::TP_A4::VerbosityLevel);
}
/*@@end*/

/*@@sysvarChange:TP_A4::LocalAddr:*/
on sysvar sysvar::TP_A4::LocalAddr
{
  SetTPAddresses(gConnectionHandle_A4, @sysvar::TP_A4::AddrType, @sysvar::TP_A4::LocalAddr, @sysvar::TP_A4::RemoteAddr, @sysvar::TP_A4::VerbosityLevel);
}
/*@@end*/

/*@@sysvarChange:TP_A4::RemoteAddr:*/
on sysvar sysvar::TP_A4::RemoteAddr
{
  SetTPAddresses(gConnectionHandle_A4, @sysvar::TP_A4::AddrType, @sysvar::TP_A4::LocalAddr, @sysvar::TP_A4::RemoteAddr, @sysvar::TP_A4::VerbosityLevel);
}
/*@@end*/

/*@@sysvarChange:TP_A4::MaxPDULength:*/
on sysvar sysvar::TP_A4::MaxPDULength
{
  SetTPMaxPduLength(gConnectionHandle_A4, @this, @sysvar::TP_A4::VerbosityLevel);
}
/*@@end*/

/*@@sysvarChange:TP_A4::MaxTxPrioPDUs:*/
on sysvar sysvar::TP_A4::MaxTxPrioPDUs
{
  SetTPMaxTXPrioPDUs(gConnectionHandle_A4, @this, @sysvar::TP_A4::VerbosityLevel);
}
/*@@end*/

/*@@sysvarChange:TP_A4::StMin:*/
on sysvar sysvar::TP_A4::StMin
{
  SetTPSTmin(gConnectionHandle_A4, @this, @sysvar::TP_A4::VerbosityLevel);
}
/*@@end*/

/*@@sysvarChange:TP_A4::VerbosityLevel:*/
on sysvar sysvar::TP_A4::VerbosityLevel
{
  FrTP_SetVerbosity (@this);

  SetTPPrefixString(gConnectionHandle_A4);
  write("%sVerbosity Level set: %d", gTPPrefix, @this); 
}
/*@@end*/

/*@@caplFunc:CreateTPConnection_PDUs_A4(int,char[][],int,char[][],int,ASRTPParameter,int):*///function
CreateTPConnection_PDUs_A4 (int numTxPDUs, char aTxPDUPool[][], int numRxPDUs, char aRxPDUPool[][], int aPDUNameLen, struct ASRTPParameter params, int verbosityLevel)
{
  params.mConnectionHandle = gConnectionHandle_A4;

  gConnectionHandle_A4 = CreateTPConnection( numTxPDUs, aTxPDUPool, numRxPDUs, aRxPDUPool, aPDUNameLen, params, verbosityLevel);

  @sysvar::TP_A4::ConnModeTx      = params.mConnectionModeTx;
  @sysvar::TP_A4::ConnModeRx      = params.mConnectionModeRx;
  @sysvar::TP_A4::LengthModeTx    = params.mLengthModeTx;
  @sysvar::TP_A4::LengthModeRx    = params.mLengthModeRx;
  @sysvar::TP_A4::AddrType        = params.mAddrType;
  @sysvar::TP_A4::LocalAddr       = params.mLocalAddr;
  @sysvar::TP_A4::RemoteAddr      = params.mRemoteAddr;
  @sysvar::TP_A4::EnablePadding   = params.mPadding;
  @sysvar::TP_A4::FillByte        = params.mFillByte;;
  @sysvar::TP_A4::MaxTxPrioPDUs   = params.mMaxTxPrioPDUs;
  @sysvar::TP_A4::BlockSize       = params.mBlockSize;
  @sysvar::TP_A4::StMin           = params.mStMin;
  @sysvar::TP_A4::MaxPDULength    = params.mMaxPDULength;

  @sysvar::TP_A4::TimeoutAs       = params.mTimeoutAs;
  @sysvar::TP_A4::TimeoutAr       = params.mTimeoutAr;
  @sysvar::TP_A4::TimeoutBs       = params.mTimeoutBs;
  @sysvar::TP_A4::TimeBr          = params.mTimeBr;
  @sysvar::TP_A4::TimeCs          = params.mTimeCs;
  @sysvar::TP_A4::TimeoutCr       = params.mTimeoutCr;

  //@sysvar::Panel_A4::ConnectionHandle = gConnectionHandle_A4; // show connection reference of A4 in panel A4
}
/*@@end*/

/*@@sysvarChange:TP_A4::TxPriority:*/
on sysvar sysvar::TP_A4::TxPriority
{
  SetTPTxPriority(gConnectionHandle_A4, @this, @sysvar::TP_A4::VerbosityLevel);
}
/*@@end*/

/*@@sysvarChange:TP_A4::ExclusiveTxUsage:*/
on sysvar sysvar::TP_A4::ExclusiveTxUsage
{
  SetTPExclusiveTxUsage(gConnectionHandle_A4, @this, @sysvar::TP_A4::VerbosityLevel);
}
/*@@end*/

