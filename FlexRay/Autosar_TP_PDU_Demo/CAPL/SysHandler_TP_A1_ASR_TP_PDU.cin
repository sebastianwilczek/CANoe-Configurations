/*@@var:*/
variables {

  // Handle of Connection A1:
  long gConnectionHandle_A1 = 0;
}
/*@@end*/

/*@@caplFunc:InitConnSysTPVars_A1():*///function
void InitConnSysTPVars_A1 ()
{
  @sysvar::TP_A1::DLLVersionNoMajor = FrTP_GetDLLInfo(1);
  @sysvar::TP_A1::DLLVersionNoMinor = FrTP_GetDLLInfo(2);
  @sysvar::TP_A1::DLLVersionNoBuild = FrTP_GetDLLInfo(3);

  CreateTPConnection_A1(@sysvar::TP_A1::VerbosityLevel);
}
/*@@end*/

/*@@sysvarChange:TP_A1::AbortRxOnNewTxStart:*/
on sysvar sysvar::TP_A1::AbortRxOnNewTxStart
{
  SetTPAbortRxOnNewTxStart(gConnectionHandle_A1, @this, @sysvar::TP_A1::VerbosityLevel);
}
/*@@end*/

/*@@sysvarChange:TP_A1::AddrType:*/
on sysvar sysvar::TP_A1::AddrType
{
  SetTPAddresses(gConnectionHandle_A1, @sysvar::TP_A1::AddrType, @sysvar::TP_A1::LocalAddr, @sysvar::TP_A1::RemoteAddr, @sysvar::TP_A1::VerbosityLevel);
}
/*@@end*/

/*@@sysvarChange:TP_A1::BlockSize:*/
on sysvar sysvar::TP_A1::BlockSize
{
  SetTPBlockSize(gConnectionHandle_A1, @this, @sysvar::TP_A1::VerbosityLevel);
}
/*@@end*/

/*@@sysvarChange:TP_A1::ConnModeRx:*/
on sysvar sysvar::TP_A1::ConnModeRx
{
  SetTPConnectionModeRX(gConnectionHandle_A1, @this, @sysvar::TP_A1::VerbosityLevel);
}
/*@@end*/

/*@@sysvarChange:TP_A1::ConnModeTx:*/
on sysvar sysvar::TP_A1::ConnModeTx
{
  SetTPConnectionModeTX(gConnectionHandle_A1, @this, @sysvar::TP_A1::VerbosityLevel);
}
/*@@end*/

/*@@sysvarChange:TP_A1::EnablePadding:*/
on sysvar sysvar::TP_A1::EnablePadding
{
  SetTPPadding(gConnectionHandle_A1, @sysvar::TP_A1::EnablePadding, @sysvar::TP_A1::FillByte, @sysvar::TP_A1::VerbosityLevel);
}
/*@@end*/

/*@@sysvarChange:TP_A1::FillByte:*/
on sysvar sysvar::TP_A1::FillByte
{
  SetTPPadding(gConnectionHandle_A1, @sysvar::TP_A1::EnablePadding, @sysvar::TP_A1::FillByte, @sysvar::TP_A1::VerbosityLevel);
}
/*@@end*/

/*@@sysvarChange:TP_A1::LengthModeRx:*/
on sysvar sysvar::TP_A1::LengthModeRx
{
  SetTPLengthModeRX(gConnectionHandle_A1, @this, @sysvar::TP_A1::VerbosityLevel);
}
/*@@end*/

/*@@sysvarChange:TP_A1::LengthModeTx:*/
on sysvar sysvar::TP_A1::LengthModeTx
{
  SetTPLengthModeTX(gConnectionHandle_A1, @this, @sysvar::TP_A1::VerbosityLevel);
}
/*@@end*/

/*@@sysvarChange:TP_A1::LocalAddr:*/
on sysvar sysvar::TP_A1::LocalAddr
{
  SetTPAddresses(gConnectionHandle_A1, @sysvar::TP_A1::AddrType, @sysvar::TP_A1::LocalAddr, @sysvar::TP_A1::RemoteAddr, @sysvar::TP_A1::VerbosityLevel);
}
/*@@end*/

/*@@sysvarChange:TP_A1::RemoteAddr:*/
on sysvar sysvar::TP_A1::RemoteAddr
{
  SetTPAddresses(gConnectionHandle_A1, @sysvar::TP_A1::AddrType, @sysvar::TP_A1::LocalAddr, @sysvar::TP_A1::RemoteAddr, @sysvar::TP_A1::VerbosityLevel);
}
/*@@end*/

/*@@sysvarChange:TP_A1::MaxPDULength:*/
on sysvar sysvar::TP_A1::MaxPDULength
{
  SetTPMaxPduLength(gConnectionHandle_A1, @this, @sysvar::TP_A1::VerbosityLevel);
}
/*@@end*/

/*@@sysvarChange:TP_A1::MaxTxPrioPDUs:*/
on sysvar sysvar::TP_A1::MaxTxPrioPDUs
{
  SetTPMaxTXPrioPDUs(gConnectionHandle_A1, @this, @sysvar::TP_A1::VerbosityLevel);
}
/*@@end*/

/*@@sysvarChange:TP_A1::StMin:*/
on sysvar sysvar::TP_A1::StMin
{
  SetTPSTmin(gConnectionHandle_A1, @this, @sysvar::TP_A1::VerbosityLevel);
}
/*@@end*/

/*@@sysvarChange:TP_A1::VerbosityLevel:*/
on sysvar sysvar::TP_A1::VerbosityLevel
{
  FrTP_SetVerbosity (@this);

  SetTPPrefixString(gConnectionHandle_A1);
  write("%sVerbosity Level set: %d", gTPPrefix, @this); 
}
/*@@end*/

/*@@caplFunc:CreateTPConnection_PDUs_A1(int,char[][],int,char[][],int,ASRTPParameter,int):*///function
CreateTPConnection_PDUs_A1 (int numTxPDUs, char aTxPDUPool[][], int numRxPDUs, char aRxPDUPool[][], int aPDUNameLen, struct ASRTPParameter params, int verbosityLevel)
{
  params.mConnectionHandle = gConnectionHandle_A1;

  gConnectionHandle_A1 = CreateTPConnection( numTxPDUs, aTxPDUPool, numRxPDUs, aRxPDUPool, aPDUNameLen, params, verbosityLevel);

  @sysvar::TP_A1::ConnModeTx      = params.mConnectionModeTx;
  @sysvar::TP_A1::ConnModeRx      = params.mConnectionModeRx;
  @sysvar::TP_A1::LengthModeTx    = params.mLengthModeTx;
  @sysvar::TP_A1::LengthModeRx    = params.mLengthModeRx;
  @sysvar::TP_A1::AddrType        = params.mAddrType;
  @sysvar::TP_A1::LocalAddr       = params.mLocalAddr;
  @sysvar::TP_A1::RemoteAddr      = params.mRemoteAddr;
  @sysvar::TP_A1::EnablePadding   = params.mPadding;
  @sysvar::TP_A1::FillByte        = params.mFillByte;;
  @sysvar::TP_A1::MaxTxPrioPDUs   = params.mMaxTxPrioPDUs;
  @sysvar::TP_A1::BlockSize       = params.mBlockSize;
  @sysvar::TP_A1::StMin           = params.mStMin;
  @sysvar::TP_A1::MaxPDULength    = params.mMaxPDULength;

  @sysvar::TP_A1::TimeoutAs       = params.mTimeoutAs;
  @sysvar::TP_A1::TimeoutAr       = params.mTimeoutAr;
  @sysvar::TP_A1::TimeoutBs       = params.mTimeoutBs;
  @sysvar::TP_A1::TimeBr          = params.mTimeBr;
  @sysvar::TP_A1::TimeCs          = params.mTimeCs;
  @sysvar::TP_A1::TimeoutCr       = params.mTimeoutCr;

  @sysvar::Panel_A1::ConnectionHandle = gConnectionHandle_A1; // show connection reference of A1 in panel A1
}
/*@@end*/

/*@@sysvarChange:TP_A1::TxPriority:*/
on sysvar sysvar::TP_A1::TxPriority
{
  SetTPTxPriority(gConnectionHandle_A1, @this, @sysvar::TP_A1::VerbosityLevel);
}
/*@@end*/

/*@@sysvarChange:TP_A1::ExclusiveTxUsage:*/
on sysvar sysvar::TP_A1::ExclusiveTxUsage
{
  SetTPExclusiveTxUsage(gConnectionHandle_A1, @this, @sysvar::TP_A1::VerbosityLevel);
}
/*@@end*/

