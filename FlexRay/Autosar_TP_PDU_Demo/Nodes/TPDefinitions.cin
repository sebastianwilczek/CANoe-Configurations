/*@@var:*/
variables
{
  // ==============================================================================
  // TP addresses to be assigned to the Tester and to the ECUs:

  const word cTPAddressTester  = 0xAAA1;
  const word cTPAddressECM     = 0xBBB1;
  const word cTPAddressESP     = 0xCCC1;

  // ==============================================================================
  // Pool1 PDUs to be used for diagnostics requests from Tester to all ECUs:

  const int cNumPool1PDUs = 2;
  char  gPool1PDUArray[cNumPool1PDUs][cPDUNameLength] =
    {
      "PDU_TP_Tester_1", // Length = 253 Bytes, UB, Slot 100,0,1
      "PDU_TP_Tester_2"  // Length = 253 Bytes, UB, Slot 101,0,1
    };
  int   gPool1PDULength = 253; // [Bytes]

  // ==============================================================================
  // Pool 2 PDUs to be used for diagnostics/flashing responses from ESP:

  const int cNumPool2PDUs = 2;
  char  gPool2PDUArray[cNumPool2PDUs][cPDUNameLength] =
    {
      "PDU_TP_ESP_1", // Length = 253 Bytes, UB, Slot 156,0,1
      "PDU_TP_ESP_2"  // Length = 253 Bytes, UB, Slot 157,0,1
    };
  int   gPool2PDULength = 253; // [Bytes]

  // ==============================================================================
  // Pool 3 PDUs to be used for flashing requests from Tester to all ECUs:

  const int cNumPool3PDUs = 2;
  char  gPool3PDUArray[cNumPool3PDUs][cPDUNameLength] =
    {
      "PDU_TP2_Tester_1", // Length = 41 Bytes, UB, Slot  2,0,1
      "PDU_TP2_Tester_2"  // Length = 41 Bytes, UB, Slot  4,0,1
    };
  int   gPool3PDULength = 41; // [Bytes]

  // ==============================================================================
  // Pool 4 PDUs to be used for diagnostics/flashing responses from ECM:

  const int cNumPool4PDUs = 2;
  char  gPool4PDUArray[cNumPool4PDUs][cPDUNameLength] =
    {
      "PDU_TP_ECM_1", // Length = 32 Bytes, UB, Slot 150,0,1
      "PDU_TP_ECM_2"  // Length = 32 Bytes, UB, Slot 151,0,1
    };
  int   gPool4PDULength = 32; // [Bytes]

  // ==============================================================================
  // Pool 5 PDUs to be used for diagnostics/flashing responses from ESP:

  const int cNumPool5PDUs = 2;
  char  gPool5PDUArray[cNumPool5PDUs][cPDUNameLength] =
    {
      "PDU_TP2_ESP_1", // Length = 41 Bytes, UB, Slot  26,0,1
      "PDU_TP2_ESP_2"  // Length = 41 Bytes, UB, Slot  27,0,1
    };
  int   gPool5PDULength = 41; // [Bytes]

  // ==============================================================================
  // Pool 6 PDUs to be used for diagnostics/flashing responses from ECM:

  const int cNumPool6PDUs = 2;
  char  gPool6PDUArray[cNumPool6PDUs][cPDUNameLength] =
    {
      "PDU_TP2_ECM_1", // Length = 41 Bytes, UB, Slot  20,0,1
      "PDU_TP2_ECM_2"  // Length = 41 Bytes, UB, Slot  21,0,1
    };
  int   gPool6PDULength = 41; // [Bytes]

  // ==============================================================================
}
/*@@end*/

