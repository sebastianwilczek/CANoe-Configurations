/*@!Encoding:1252*/
variables
{
}

on signal_update BackUpLight
{
  // The signal will switch the BackUp light on/off
  @sysvar::Panel::BackUpLight = this;
}

on signal_update BrakeLight
{
  // The signal will switch the Brake light on/off
  @sysvar::Panel::BackLightStatus = this; 
}

