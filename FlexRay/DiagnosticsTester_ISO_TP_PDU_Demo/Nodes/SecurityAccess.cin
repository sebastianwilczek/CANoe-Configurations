/*@!Encoding:1252*/
includes
{
}

variables
{
  byte  gSeedArray[2];
  int   gSeedArraySize      = 2;
  int   gSecurityLevel      = 0x20;
  char  gVariant[200]       = "";
  char  gOption[200]        = "";
  byte  gKeyArray[2];
  int   gMaxKeyArraySize    = 2;  
  DWORD gActualSize         = 0; 
  char  gDebugBuffer[2000];

  // ------- Security Access --------
  const DWORD cSecurityAccessMaxNumberOfTries = 3; // Allow only 3 tries when sending key
  WORD gSecurityAccessTries;
  DWORD gSecurityAccessSeed;
}

DWORD ComputeKey( DWORD seed)
{
  dword genKey;
  int   ret;
  // Note: in order to make the entering of the key in the console
  //       easier, this function uses only 16 bit of the value.
  gSeedArray[0] = seed >> 8;
  gSeedArray[1] = seed & 0xff;


  /* Calculation of the SecurityKey via SeednKey.Dll */ 
  /* _Diag_GetError will be called with details if there is an error */
  ret = DiagGenerateKeyFromSeed (gSeedArray, gSeedArraySize, gSecurityLevel, gVariant, gOption, gKeyArray, gMaxKeyArraySize, gActualSize);

  /* Check if the KeyGeneration result == okay */ 
  genKey = 0;

  if(ret == 0)
  { 
    /* Put into the correct value */  
    genKey = gKeyArray[0] << 8;       // High Byte 
    genKey = genKey | gKeyArray[1];   // Low  Byte 
    genKey = genKey & 0x0000FFFF;
  }
  return genKey;
}

_Diag_GetError (char buffer[])
{
  //called if error in DiagGenerateKeyFromSeed occurs
  snprintf(gDebugBuffer,elcount(gDebugBuffer),"%s", buffer);
  write("Diagnostic Error %s", gDebugBuffer);
}
