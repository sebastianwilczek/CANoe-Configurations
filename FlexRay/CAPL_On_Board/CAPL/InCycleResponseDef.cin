variables
{
  // For In-Cycle Repetition demo define slots to be used:
  const int channelMask        = 1;
  const int cStaticPayloadLen  = 42;
  const int cycleStart         = 0;
  const int cycleRepetition    = 1;
  const int sendCycleRep       = 2;
  const int flags              = 0x10; // event-triggered
  const int channel            = 1;

  const int triggerSlot        = 2;

  const int pcSlotCount        = 8;
  int pcSlots[pcSlotCount]     = {20, 25, 30, 35, 40, 45, 50, 55};

  const int cobSlotCount       = 2;
  int cobSlots[cobSlotCount]   = {7, 9};

 
  byte dataBytes[cStaticPayloadLen];
  int index                    = 0;

  const int numOfVals          = 101;
  int rampTable[numOfVals]     = { 0, 1, 2, 3, 4, 5, 6, 7, 8, 9, 10, 11, 12, 13, 14, 15, 16, 17, 18, 19, 20, 21, 22, 23, 24, 25, 26, 27, 28, 29, 30, 31, 32, 33, 34, 35, 36, 37, 38, 39, 40, 41, 42, 43, 44, 45, 46, 47, 48, 49, 50, 51, 52, 53, 54, 55, 56, 57, 58, 59, 60, 61, 62, 63, 64, 65, 66, 67, 68, 69, 70, 71, 72, 73, 74, 75, 76, 77, 78, 79, 80, 81, 82, 83, 84, 85, 86, 87, 88, 89, 90, 91, 92, 93, 94, 95, 96, 97, 98, 99, 100 };
}

void sendPcResponses (BYTE cycle)
{
  int i;
  int j;
  
  FrFrame MsgChannel1.(20,0,1)  msg1 = {MsgChannel = channel,FR_ChannelMask = channelMask,FR_Flags = flags};
  msg1.FR_PayloadLength = cStaticPayloadLen/2;

  if ((cycle % sendCycleRep) == cycleStart)
  {
    dataBytes[0] = cycle;
    dataBytes[3] = rampTable[index++];
    if (index == numOfVals) index = 0;

    for(i = 0; i < pcSlotCount; ++i)
    {
      msg1.FR_SlotID = pcSlots[i];
      for(j=0;j<cStaticPayloadLen;j++)
      {
        msg1.byte(j) = dataBytes[j];
      }
      frUpdateStatFrame(msg1);
    }
  }
}

void sendCOBResponses (BYTE cycle)
{
  int i;
  int j;
  FrFrame msgchannel1.(20,cycleStart,cycleRepetition) msg1 = {MsgChannel = channel,FR_ChannelMask = channelMask,FR_Flags = flags};
  msg1.FR_PayloadLength = cStaticPayloadLen/2;
  
  if ((cycle % sendCycleRep) == cycleStart)
  {
    dataBytes[0] = cycle;
    dataBytes[3] = rampTable[index++];
    if (index == numOfVals) index = 0;

    for(i = 0; i < cobSlotCount; ++i)
    {
      msg1.FR_SlotID = pcSlots[i];
      for(j=0;j<cStaticPayloadLen;j++)
      {
        msg1.byte(j) = dataBytes[j];
      }
      frUpdateStatFrame(msg1);
    }
  }
}

