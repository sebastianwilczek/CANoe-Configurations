/*@@includes:*/
includes
{
#include "InCycleResponseDef.cin"
}
/*@@end*/

/*@@var:*/
variables
{
  // Simulated node for PC

  // For demo of indeterminism :
  FrFrame Cyclic_Frame_PC frm;

  // For slot definitions of In-Cycle Repetition demo see include file
}
/*@@end*/

/*@@frSlot:MsgChannel1.2:*///SortKey=0x2
on FRSlot MsgChannel1.2
{
  // For demo of determinism :
  frm.Counter_PC = this.FR_Cycle;
  FROutputDynFrame(frm);

  // For In-Cycle Repetition demo:
  sendPcResponses(this.FR_Cycle);
}
/*@@end*/

/*@@startStart:Start:*/
on start
{
  frm.FR_Flags = 0x10; // send frame event-triggered
}
/*@@end*/

