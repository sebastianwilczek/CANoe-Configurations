/*@@includes:*/
includes
{
#include "InCycleResponseDef.cin"
}
/*@@end*/

/*@@var:*/
variables
{
  // Simulated node for CAPL on Board

  // For demo of determinism :
  FrFrame Cyclic_Frame_COB frm;

  // For slot definitions of In-Cycle Repetition demo see include file
}
/*@@end*/

/*@@frStartCycle:MsgChannel1.(0,1):*///SortKey=0x41
on FRStartCycle MsgChannel1.(0,1)
{
  // For demo of determinism :
  frm.Counter_COB = this.FR_Cycle;
  FROutputDynFrame(frm);
}
/*@@end*/

/*@@startStart:Start:*/
on start
{
  // For demo of determinism :
  frm.FR_Flags = 0x10; // send frame event-triggered
}
/*@@end*/

/*@@frSlot:MsgChannel1.2:*///SortKey=0x2
on FRSlot MsgChannel1.2
{
  BYTE cycle;
  // For In-Cycle Repetition demo:
  cycle = this.FR_Cycle;
  sendCOBResponses(cycle);
}
/*@@end*/

