/*@!Encoding:1252*/
variables 
{
  FrFrame BrakeState frm_BrakeState;
}

on preStart
{
  //frm_BrakeState.fr_channelMask=1;
  //frm_BrakeState.msgChannel = 1;
  frm_BrakeState.fr_flags=0x10;
}

on start
{
  //$BrakeControl.BrakeWarningLamp = 1;
  //frm_BrakeState.fr_flags = 0x80;
  //FrUpdateStatFrame(frm_BrakeState);
}

on sysvar sysvar::Brakes::BrakePressure
{
  write("ENGINE: Brake pressure applied");
  //frm_BrakeState.byte(0) = 0x10; // Target Address
  //frm_BrakeState.byte(1) = 0x11;
  //frm_BrakeState.byte(2) = 0x12; // Source Addres
  //frm_BrakeState.byte(7) = 0x10;
  //frUpdateStatFrame(frm_BrakeState);
  write("ENGINE: Updated bytes");
  //$BrakePressure = 1;
  //msg_BrakeState.BrakePressure = @this;
  //output(msg_BrakeState);
}