/*@!Encoding:1252*/
variables 
{
  //message BrakeState msg_BrakeState;
}

on preStart
{
}

on start
{
  $BrakePressure = 0;
}

on sysvar sysvar::Brakes::BrakePressure
{
  write("ENGINE: Brake pressure applied");
  $BrakePressure = 1;
  //msg_BrakeState.BrakePressure = @this;
  //output(msg_BrakeState);
}