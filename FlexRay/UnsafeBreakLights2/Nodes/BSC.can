/*@!Encoding:1252*/
variables
{
  int gBrakePedalStatus       = 0;
  int SystemCheck             = 0;
  const int PRESS             = 1;
  const Int NOPRESS           = 0;
}

on sysvar sysvar::Panel::BrakeActive
{
  if(@this)  
    gBrakePedalStatus = PRESS;
  else  
    gBrakePedalStatus = NOPRESS;

  $BrakeLight = @this;
}

on start
{
  $BrakeLight = 0;
}