/*@!Encoding:1252*/
on start
{
  write("HACKER: Hello, I'm a compromised ECU.");
}

on key 'h'
{
  write("HACKER: Sending Brake Light Signal");
  $BrakeLight = 1;
}