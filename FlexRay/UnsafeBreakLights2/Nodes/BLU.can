/*@!Encoding:1252*/
on signal_update BrakeLight
{
  @sysvar::Panel::BackLightStatus = this; 
}