/*@!Encoding:1252*/
/**
 * This ECU is responsible to show the effects of messages on the CAN bus.
 * It represents the lights on the back of a car.
 * It's only purpose is to showcase effects for this simulation.
**/

/**
 * When this ECU receives a FlexRay PDU for BackLightInfo, it sets the brake light to the BrakeLight signal inside the PDU.
**/
on frPDU BackLightInfo
{
  write("BLU: Received BrakeControl PDU, %d", this.BrakeLight);
  @sysvar::Panel::BackLightStatus = this.BrakeLight;
}