/*@!Encoding:1252*/
includes
{
  
}

variables
{
  const word pgnBCL = 0x1000;
  const word pgnBCP =  0x600;
  const word pgnBCS = 0x1100;
  const word pgnBEM = 0x1E00;
  const word pgnBHM = 0x2700;
  const word pgnBMT = 0x1600;
  const word pgnBMV = 0x1500;
  const word pgnBRM =  0x200;
  const word pgnBRO =  0x900;
  const word pgnBSD = 0x1C00;
  const word pgnBSM = 0x1300;
  const word pgnBSP = 0x1700;
  const word pgnBST = 0x1900;
  const word pgnCCS = 0x1200;
  const word pgnCEM = 0x1F00;
  const word pgnCHM = 0x2600;
  const word pgnCML =  0x800;
  const word pgnCRM =  0x100;
  const word pgnCRO =  0xA00;
  const word pgnCSD = 0x1D00;
  const word pgnCST = 0x1A00;
  const word pgnCTS =  0x700;
}


on pg *
{
  dword id, id2;
  
  id = this.id;
  id2 = id & 0x80000000;
  if(id2 != 0x80000000)
    return;

  switch(this.pgn)
  {
    //Handshake initiation
    case pgnCHM:
    case pgnBHM:
      traceSetEventColors(this, makeRGB(0, 0, 0), makeRGB(226, 225, 240));
      break;

    //Handshake recognition
    case pgnBRM:
    case pgnCRM:
      traceSetEventColors(this, makeRGB(0, 0, 0), makeRGB(251, 222, 221));
      break;

      //Parameter configuration
    case pgnBCP:
    case pgnBRO:
    case pgnCML:
    case pgnCRO:
    case pgnCTS:
      traceSetEventColors(this, makeRGB(0, 0, 0), makeRGB(191, 236, 250));
      break;

      //Charging
    case pgnBCL:
    case pgnBCS:
    case pgnBMT:
    case pgnBMV:
    case pgnBSM:
    case pgnBSP:
    case pgnCCS:
      traceSetEventColors(this, makeRGB(0, 0, 0), makeRGB(191, 233, 216));
      break; 
    
      //Suspension of charging
    case pgnBST:
    case pgnCST:
      traceSetEventColors(this, makeRGB(0, 0, 0), makeRGB(222, 199, 222));
      break;

      //End of charging
    case pgnBSD:
    case pgnCSD:
      traceSetEventColors(this, makeRGB(0, 0, 0), makeRGB(254, 237, 191));
      break;

      //Error
    case pgnBEM:
    case pgnCEM:
      traceSetEventColors(this, makeRGB(255, 0, 0), makeRGB(255, 255, 255));
      break;
  }
  
  output(this);
}