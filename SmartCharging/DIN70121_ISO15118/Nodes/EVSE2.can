/*@!Encoding:1252*/

/* ----------------------------------------------
   Second EVSE to demonstrate SLAC functionality   
 ---------------------------------------------- */
  
/*
  This EVSE is only active for SLAC, the EV will never actually connect to it.
  It provides higher attenuation values than the EVSE node.  
*/

on preStart
{	
  SCC_SetVerbosity(2);
}

on start
{
  SCC_LoadCommunicationConfig(1);

	SCC_StartPassive(1);   // Start as passive but allow automatic SLAC
  
  /*  
  Background:
    In a real environment, SLAC would cause the EV and the nearest EVSE to form an individual network,
    thus this one would not receive the Discovery Req. In the simulation, the EV cannot tell which
    EVSE was accepted by SLAC, thus we just switch this one off.    
  */
  
  SCC_SLAC_SetChipPresent(0);   // Always simulate attenuation
  
  SCC_SLAC_SetAttenuation(15.0, 1.5);
}