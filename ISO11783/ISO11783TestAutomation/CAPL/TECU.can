/*@!Encoding:1252*/
includes
{
  
}

variables
{
  msTimer timerUpdateDist;
}

on start
{
  setTimer(timerUpdateDist, 1000);
}

on timer timerUpdateDist
{
  $GBSD_TECU::GroundBasedMachineDistance += $GBSD_TECU::GroundBasedMachineSpeed;
  setTimer(timerUpdateDist, 1000);
}

on sysvar sysvar::ISO11783::svSpeed
{
  $GBSD_TECU::GroundBasedMachineSpeed = @sysvar::ISO11783::svSpeed;
  
}
