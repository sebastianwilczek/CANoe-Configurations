/*@!Encoding:1252*/
includes
{
  
}

variables
{
  
}

//on sysvar sysvar::ISO11783::svSetpointApplicationRate
//{
//  TCIL_ValueCommandPhysical(Sprayer, 6, 2, @sysvar::ISO11783::svSetpointApplicationRate);
//}

