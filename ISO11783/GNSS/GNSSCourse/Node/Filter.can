/*@!Encoding:1252*/
includes
{
  
}

variables
{
  
}

on message GNSSPositionData_RC
{
  return;
}

on pg GNSSPositionData_RC
{
  if(this.dlc == 8)
    return;
  output(this);
}

on message *
{
  output(this);
}
