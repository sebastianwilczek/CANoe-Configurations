/*@!Encoding:1252*/
variables
{
  //
  // GNSSReceiver
  //
  // You can use this CAPL programm to set GNSS model positions
  // which are connected and transmitted
  //
  // (c) 2002 Vector Informatik GmbH
  //

  // Constants
  char kNodeLabel[32] = "GNSSReceiver";   // label of the node (for output to write window)  
  int  kStateStopped  = 0; // simulation is started
  int  kStateStarted  = 1; // simulation is stopped

  // Error constants
  int kNoWaypointSet = 105;

  // Global varibals
  int  gECUState  = 0;                    // 0=Offline, 1=Online 2=ShutingDown
  long gNodeAddress= 3;                   // global address of this node
  char gNodeName[8];                      // global name of this node

  // Definition of debugging constants
  const int kDbgInfo    = 10;
  const int kDbgWarning = 5;
  const int kDbgError   = 1;
  const int kDbgQuiet   = 0;

  // Error constants
  int kErrorNo       = 0;

  // General global variables
  int   gDbgLevel    = kDbgInfo; // Set debug level for output to write window}
}

on start
{
  StartUp();
}

on stopMeasurement
{
  ShutDown();
}

on envVar evCmdPauseSpeed
{
  if( getValue( evCmdPauseSpeed ) == 1 ) {
    GNSSPauseSpeed();
  }
}

on envVar evCmdStartSimulation
{
  if( getValue( evCmdStartSimulation ) == 1 ) {
    StartSimulation();
  }
}

on envVar evCmdStopSimulation
{
  if( getValue( evCmdStopSimulation ) == 1 ) {
    StopSimulation();
  }
}

on envVar evSpeed
{
  GNSSSetSpeed( getValue( evSpeed ) );
}

on preStart
{
  setWriteDbgLevel( gDbgLevel );
}

void StartUp()
{
  writeDbgLevel( kDbgInfo, "<%s> StartUp", kNodeLabel );

  // init address of this node
  gNodeAddress = GNSSReceiver.NmStationAddress; /* get node address */

  // init deviece name
  GNSSMakeName( gNodeName, 
                GNSSReceiver.NmJ1939AAC,
                GNSSReceiver.NmJ1939IndustryGroup,
                GNSSReceiver.NmJ1939SystemInstance,
                GNSSReceiver.NmJ1939System,
                GNSSReceiver.NmJ1939Function,
                GNSSReceiver.NmJ1939FunctionInstance,
                GNSSReceiver.NmJ1939ECUInstance,
                GNSSReceiver.NmJ1939ManufacturerCode,
                GNSSReceiver.NmJ1939IdentityNumber );

  GNSSStartUp( gNodeName, gNodeAddress );

  // set speed
  putValue( evSpeed, 65 );

  // set course
  putValue( evCourse, 90 );

  // set start position
  putValue( evLatitude, 48.46 );
  putValue( evLongitude, 9.11E );
  putValue( evAltitude, 225 );
  

  InitializePGs();

  // start simulation
  StartSimulation();
}

void ShutDown()
{
  GNSSShutDown();
}

void StartSimulation()
{
  dword res;
  double lat, lon, alt;

  // get start position
  lat = getValue( evLatitude );
  lon = getValue( evLongitude );
  alt = getValue( evAltitude );
  writeDbgLevel( kDbgInfo, "<%s> Add waypoint (lat = %f, lon = %f, alt = %f", kNodeLabel, lat, lon, alt );
  GNSSAddWp( lat, lon, alt);

  // get start course and gradient  
  SetCourse();
  
  res = GNSSStartSimulation( 1 );
  if (res == 0) {
    putValue( evSimulationState, kStateStarted );
  } 
  else if (res == kNoWaypointSet) {
    writeDbgLevel( kDbgWarning, "<%s> StartUp failed, because no waypoint is set", kNodeLabel ); 
  }
}

void StopSimulation()
{
  if( GNSSStopSimulation() == 0 ) {
    putValue( evSimulationState, kStateStopped );
  }
}

on envVar evCmdContinueSpeed
{
  if( getValue( evCmdContinueSpeed ) == 1 ) {
    GNSSContinueSpeed();
  }
}

//
// Adress Claimed
//
void GNSSAppAddrClaimed()
{
}

//
// Commanded address indication
//
void GNSSAppCmdAddrIndication( long dataLen )
{
}

//
// Error indication
//
void GNSSAppErrorIndication( long errorClass, long errorNumber, long addCode)
{
  char strErrClass[32];
  char strErrInfo[64];

  switch(errorClass) {
    case 1: snprintf( strErrClass, elCount(strErrClass), "TimeOut" ); break;
    case 2: snprintf( strErrClass, elCount(strErrClass), "AddressClaiming" ); break;
    case 3: snprintf( strErrClass, elCount(strErrClass), "CAN Error" ); break;
    case 4: snprintf( strErrClass, elCount(strErrClass), "System Error" ); break;
	case 5: snprintf( strErrClass, elCount(strErrClass), "Transport Protocol Error Error" ); break;
  }

  switch( errorNumber ) {
    case 0x1: snprintf( strErrInfo, elCount(strErrInfo), "cts error" ); break;
    case 0x2: snprintf( strErrInfo, elCount(strErrInfo), "peer to peer data timeout" ); break;
    case 0x3: snprintf( strErrInfo, elCount(strErrInfo), "BAM data timeout" ); break;
    case 0x4: snprintf( strErrInfo, elCount(strErrInfo), "acknowledge timeout" ); break;
	case 0x10: snprintf( strErrInfo, elCount(strErrInfo), "lost address claiming or received address claim with higher priority" ); break;
    case 0x15: snprintf( strErrInfo, elCount(strErrInfo), "init error: node name detected two times" ); break;
    case 0x17: snprintf( strErrInfo, elCount(strErrInfo), "init error: node address detected two times" ); break;
    case 0x30: snprintf( strErrInfo, elCount(strErrInfo), "exeption while choosing protokoll BAM or CMDT" ); break;
    case 0x40: snprintf( strErrInfo, elCount(strErrInfo), "internal data buffer full" ); break;
    case 0x60: snprintf( strErrInfo, elCount(strErrInfo), "user sends system pg " ); break;
    case 0x71: snprintf( strErrInfo, elCount(strErrInfo), "transmission abort by receiver" ); break;
    case 0x72: snprintf( strErrInfo, elCount(strErrInfo), "transmission abort by sender" ); break;
  }

  writeDbgLevel( kDbgInfo, "<%s> ERROR(0x%x) %s, %s", kNodeLabel, errorNumber, strErrClass, strErrInfo );
}

on envVar evCourse
{
  SetCourse();
}

on envVar evGradient
{
  SetCourse();
}

void SetCourse()
{
  float course, gradient;

  course = getValue( evCourse );
  gradient = getValue( evGradient ); 
  //writeDbgLevel( kDbgInfo, "<%s> Course = %f, Gradient = %f", kNodeLabel, course, gradient );
  GNSSSetCourse( course, gradient );
}

int InitializePGs()
{
  int res;
  DWORD enable, disable;
  enable  = 1;
  disable = 0;


  // GNSS Position Data
  res = GNSSSetPGSettings( 129029, enable, 255, 6, 1000 );
  if (res != kErrorNo) return res;
  
  // Position Rapid Update
  res = GNSSSetPGSettings( 129025, disable, 255, 2, 100 );
  if (res != kErrorNo) return res;

  // COG&SOG RapidUpdate
  res = GNSSSetPGSettings( 129026, disable, 255, 2, 250 );
  if (res != kErrorNo) return res;

  // Position delta, high precision rapid update
  res = GNSSSetPGSettings( 129027, enable, 255, 2, 250 );
  if (res != kErrorNo) return res;

  // Vehcile Position (J1939)
  res = GNSSSetPGSettings( 65267, disable, 255, 2, 250 );
  if (res != kErrorNo) return res;

  // Vehcile Direction Speed (J1939)
  res = GNSSSetPGSettings( 65256, disable, 255, 2, 250 );
  if (res != kErrorNo) return res;

  return kErrorNo;
}

