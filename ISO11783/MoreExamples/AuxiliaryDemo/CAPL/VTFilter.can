/*@!Encoding:1252*/
variables
{
  qword lastWSMaintenance[255];
  qword lastVTStatus[255];
  qword lastAuxInputMaintenance[255];
  dword lastAuxInputStatus[long];
}

on start
{
  int pos;
  for(pos = 0; pos < 255; pos++)
  {
    lastWSMaintenance[pos] = 0;
    lastVTStatus[pos] = 0;
    lastAuxInputMaintenance[pos] = 0;
  }
}

on pg *
{
//  output(this);
}

on pg 0xe700x
{
  switch (this.byte(0)) 
  {
    case 0x23: // Maintenance message
    {
      if(lastAuxInputMaintenance[this.sa] != this.qword(0))
      {
        lastAuxInputMaintenance[this.sa] = this.qword(0);
        output(this);
      }
    }
    break;

    case 0xff: // Maintenance message
    {
      if(lastWSMaintenance[this.sa] != this.qword(0))
      {
        lastWSMaintenance[this.sa] = this.qword(0);
        output(this);
      }
    }
    break;
    
    default:
      output(this);
      break;
  }
}

on pg 0xe600x
{
  dword auxInputObjId;
  int byteWithErrorFlags = -1;
  int vtCommand;
  
  byteWithErrorFlags = -1;

  vtCommand = this.byte(0);
  switch (vtCommand) 
  {
    case 0xfe:  //VT Status  message
    if(lastVTStatus[this.sa] != this.qword(0))
    {
      lastVTStatus[this.sa] = this.qword(0);
      output(this);
    }
    break;
    
    case 0x26: // Aux Input Status
    {
      auxInputObjId =  this.word(1) << 0 | this.sa << 16;
      if((lastAuxInputStatus.containsKey(auxInputObjId) == 0) ||
        (lastAuxInputStatus[auxInputObjId] != this.dword(3)))
      {
        lastAuxInputStatus[auxInputObjId] = this.dword(3);
        output(this);
      }
    }
    break;
    
    //trivial response: don't path through
    default:
      if(vtCommand == 0xa0)
        byteWithErrorFlags = 4;
      else if(vtCommand == 0xa1)
        byteWithErrorFlags = 4;
      else if(vtCommand == 0xa2)
        byteWithErrorFlags = 4;
      else if(vtCommand == 0xa3)
        byteWithErrorFlags = 1;
      else if(vtCommand == 0xa4)
        byteWithErrorFlags = 1;
      else if(vtCommand == 0xa5)
        byteWithErrorFlags = 5;
      else if(vtCommand == 0xa6)
        byteWithErrorFlags = 3;
      else if(vtCommand == 0xa7)
        byteWithErrorFlags = 4;
      else if(vtCommand == 0xa8)
        byteWithErrorFlags = 3;
      else if(vtCommand == 0xa9)
        byteWithErrorFlags = 3;
      else if(vtCommand == 0xaa)
        byteWithErrorFlags = 3;
      else if(vtCommand == 0xab)
        byteWithErrorFlags = 3;
      else if(vtCommand == 0xac)
        byteWithErrorFlags = 3;
      else if(vtCommand == 0xad)
        byteWithErrorFlags = 3;
      else if(vtCommand == 0xae)
        byteWithErrorFlags = 5;
      else if(vtCommand == 0xaf)
        byteWithErrorFlags = 4;
      else if(vtCommand == 0xb0)
        byteWithErrorFlags = 4;
      else if(vtCommand == 0xb1)
        byteWithErrorFlags = 6;
      else if(vtCommand == 0xb2)
        byteWithErrorFlags = 1;
      else if(vtCommand == 0xb3)
        byteWithErrorFlags = 5;
      else if(vtCommand == 0xb4)
        byteWithErrorFlags = 5;
      else if(vtCommand == 0xb5)
        byteWithErrorFlags = 1;
      else if(vtCommand == 0xb6)
        byteWithErrorFlags = 3;
      else if(vtCommand == 0xb7)
        byteWithErrorFlags = 7;
      else if(vtCommand == 0xb8)
        byteWithErrorFlags = 4;
      else if(vtCommand == 0xba)
        byteWithErrorFlags = 3;
      else if(vtCommand == 0xbd)
        byteWithErrorFlags = 2;
      else if(vtCommand == 0xbe)
        byteWithErrorFlags = 2;
      else if(vtCommand == 0xd0)
        byteWithErrorFlags = 5;
      else if(vtCommand == 0xd1)
        byteWithErrorFlags = 5;
      else if(vtCommand == 0xd2)
        byteWithErrorFlags = 5;
      if((byteWithErrorFlags == -1) ||
        (byteWithErrorFlags > 0 && this.byte(byteWithErrorFlags) != 0))
      {
        output(this);
      }
      break;
  }
}

