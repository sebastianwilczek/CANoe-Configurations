/*@@var:*/
variables
{
}
/*@@end*/

/*@@pg:CAN1.ISO11783Bus::VT21 (0xE7FEFEX):*/
on pg VT21
{
  switch (this.byte(0)) {
    case 255: // Maintenance message
      break;
    case 34: // Preferred assignment
    case 35: // Auxiliary input maintenace message
    case 36: // Auxiliary assignment type 2
      output(this);
      break;
    default:
      break;
  }
}
/*@@end*/

/*@@pg:CAN1.ISO11783Bus::VT12 (0xE6FEFEX):*/
on pg VT12
{
  switch (this.byte(0)) {
    case 254: // VT status message
      break;
    case 34: // Preferred assignment
    case 36: // Auxiliary assignment type 2
    case 38: // Auxiliary input status type 2:
      output(this);
    default:
      break;
  }
}
/*@@end*/

