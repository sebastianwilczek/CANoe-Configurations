/*@!Encoding:1252*/
includes
{

}

variables
{
  const int cVerbosityNoMessages        = 0;
  const int cVerbosityErrors            = 1;
  const int cVerbosityErrorsAndWarnings = 2;
  const int cVerbosityAll               = 3;
    
  // Constants for Certificate Type
  const int cCertificateType_AEFRoot            = 0;
  const int cCertificateType_Testlab            = 1;
  const int cCertificateType_Manufacturer       = 2;
  const int cCertificateType_ManufacturerSeries = 3;
  const int cCertificateType_Device             = 4;
  const int cCertificateType_CRLSigning         = 5;
  
  // Constants for CRL Type
  const int cCRLType_CRL        = 0;
  const int cCRLType_CRLSignCA  = 1;
 
  // Facility Suport
  const int cFacilityNotSupported = 0;
  const int cFacilitySupported    = 1;
  
  // Functions
  const int cAuxValve01           = 01;
  const int cAuxValve02           = 02;
  const int cAuxValve03           = 03;
  const int cAuxValve04           = 04;
  const int cAuxValve05           = 05;
  const int cAuxValve06           = 06;
  const int cAuxValve07           = 07;
  const int cAuxValve08           = 08;
  const int cAuxValve09           = 09;
  const int cAuxValve10           = 10;
  const int cAuxValve11           = 11;
  const int cAuxValve12           = 12;
  const int cAuxValve13           = 13;
  const int cAuxValve14           = 14;
  const int cAuxValve15           = 15;
  const int cAuxValve16           = 16;
  const int cAuxValve17           = 17;
  const int cAuxValve18           = 18;
  const int cAuxValve19           = 19;
  const int cAuxValve20           = 20;
  const int cAuxValve21           = 21;
  const int cAuxValve22           = 22;
  const int cAuxValve23           = 23;
  const int cAuxValve24           = 24;
  const int cAuxValve25           = 25;
  const int cAuxValve26           = 26;
  const int cAuxValve27           = 27;
  const int cAuxValve28           = 28;
  const int cAuxValve29           = 29;
  const int cAuxValve30           = 30;
  const int cAuxValve31           = 31;
  const int cAuxValve32           = 32;
  const int cFrontPTO             = 64;
  const int cRearPTO              = 65;
  const int cFrontHitch           = 66;
  const int cRearHitch            = 67;
  const int cVehicleSpeed         = 68;
  const int cExternalGuidance     = 70;
  
  // TIM function automation status
  const int cAutomationUnavailable    = 0;
  const int cAutomationNotReady       = 1;
  const int cAutomationReadyToEnable  = 2;
  const int cAutomationEnabled        = 3;
  const int cAutomationPending        = 4;
  const int cActiveNotLimited         = 5;
  const int cActiveLimitedHigh        = 6;
  const int cActiveLimitedLow         = 7;
  const int cNonRecoverableFault      = 14;
  const int cNotAvailable             = 15;
  
  // TIM function 
  const int cNoReasonAllClear                               = 0x00;
  const int cReasonRquiredLevelOfOperatorPresencNotDetected = 0x01;
  const int cReasonImplementReleasedControlOfFunction       = 0x02;
  const int cReasonOperatorOverrideOfFunction               = 0x03;
  const int cOperatorControlNotInValidPosition              = 0x04;
  const int cReasonRemoteCommandTimeout                     = 0x05;
  const int cReasonRemoteCommandOutOfRange                  = 0x06;
  const int cReasonFunctionNotCalibrated                    = 0x07;
  const int cReasonOperatorControlFault                     = 0x08;
  const int cReasonFunctionFault                            = 0x09;
  const int cError                                          = 0x1E;
  const int cReasonNotAvailable                             = 0x1F;

  // TIM function request value
  const word cReleasedControlRequestingOperator             = 0xFBFD;
  const word cReleasedControlAndAcceptFunctionValueIncrease = 0xFBFE;
  const word cReadyToControl                                = 0xFBFF;
  
  enum VTIM12MsgCode // byte 0 of TIM12 message
  {
    TIMFunctionsAssignmentStatusResponse = 0xF3,
    TIMFunctionsSupportResponse          = 0xF4,
    TIMFunctionsAssignmentResponse       = 0xF5,
    TIMConnectionVersionResponse         = 0xF6,
    TIMClientVersionRequest              = 0xF7,
    TIMServerVersionResponse             = 0xF8,
    TIMServerStatus_Msg                  = 0xFA
  };

  enum VTIM21MsgCode // byte 0 of TIM21 message
  {
    TIMFunctionsAssignmentStatusRequest  = 0xF3,
    TIMFunctionsSupportRequest           = 0xF4,
    TIMFunctionsAssignmentRequest        = 0xF5,
    TIMConnectionVersionRequest          = 0xF6,
    TIMClientVersionResponse             = 0xF7,
    TIMServerVersionRequest              = 0xF8,
    TIMClientStatus_Msg                  = 0xF9
  };

  enum VAUTH12MsgCode // byte 0 of AUTH12 message
  {
    AUTHServerStoredCertificateTypesResponse = 0,
    AUTHClientStoredCertificateTypesRequest  = 1,
    AUTHServerCertificateResponse            = 2,
    AUTHClientCertificateRequest             = 3,
    AUTHServerRandomChallengeResponse        = 4,
    AUTHClientRandomChallengeRequest         = 5,
    AUTHServerSignedChallengeResponse        = 6,
    AUTHClientSignedChallengeRequest         = 7,
    AUTHServerAuthenticationStatus           = 249
  };

  enum VAUTH21MsgCode // byte 0 of AUTH21 message
  {
    AUTHServerStoredCertificateTypeRequest   = 0,
    AUTHClientStoredCertificateTypesResponse = 1,
    AUTHServerCertificateRequest             = 2,
    AUTHClientCertificateResponse            = 3,
    AUTHServerRandomChallengeRequest         = 4,
    AUTHClientRandomChallengeResponse        = 5,
    AUTHServerSignedChallengeRequest         = 6,
    AUTHClientSignedChallengeResponse        = 7,
    AUTHClientAuthenticationStatus           = 250
  };
  
  enum VTIMPGN
  {
    TIM21_PGN = 0x2400,
    TIM12_PGN = 0x2300,
    AUTH21_PGN = 0x6f00,
    AUTH12_PGN = 0x7000
  };
  
  enum VTIMSystemOperationState
  {
    RequirementsForTIMOperationNotFulfilled     = 0,
    RequirementsForNormalOperationFulfilled     = 1,
    RequirementsForStandstillOperationFulfilled = 2,
    RequirementsForStationaryOperationFulfilled = 3 
  };
  
  const dword cAUTHStatusTimeout= 3000;
  const dword cTIMStatusTimeout = 300;
  
  // PGN
  const word PGN_ServerToClient 		= 0x2300;
  const word PGN_ClientToServer 		= 0x2400;
  const word PGN_AuthServerToClient = 0x7000;
  const word PGN_AuthClientToServer = 0x6F00;
  
  // Message codes
  const byte MSGC_FUNCTION_SUPPORT_REQ_RES 		= 0xF4;
  const byte MSGC_CONNECTION_VERSION_REQ_RES 	= 0xF6;
  const byte MSGC_SERVER_STATUS_MESSAGE 			= 0xFA;
  
  // Message codes - authentication
  const byte MSGC_CERT_REQ = 0x00;
  const byte MSGC_AUTHENTICATION_STATUS  = 0x05;
  const byte MSGC_CERTIFICATE = 0x01;
  const byte MSGC_CHALLENGE = 0x03;
  const byte MSGC_CHALLENGE_RESPONSE = 0x04;
  const byte MSGC_SERVER_CERTIFICATE_REQ_RESP = 0x02;
  const byte MSGC_CLIENT_CERTIFICATE_REQ_RESP = 0x03;
  const byte MSGC_SERVER_RANDOM_CHALLENGE_REQ_RESP = 0x04;
  const byte MSGC_CLIENT_RANDOM_CHALLENGE_REQ_RESP = 0x05;
  const byte MSGC_SERVER_SIGNED_CHALLENGE_REQ_RESP = 0x06;
  const byte MSGC_CLIENT_SIGNED_CHALLENGE_REQ_RESP = 0x07;
  const byte MSGC_CLIENT_AUTH_STATUS = 0xFA;
  const byte MSGC_SERVER_AUTH_STATUS = 0xF9;
  
  // Requested Certificate values
  const byte MSGC_CERT_REQ_RESP_TESTLAB = 0x01;
  const byte MSGC_CERT_REQ_RESP_MANUFACTURER = 0x02;
  const byte MSGC_CERT_REQ_RESP_MANUFACTURER_SERIES = 0x03;
  const byte MSGC_CERT_REQ_RESP_MANUFACTURER_DEVICE = 0x04;
  
  // Status Message - Authentication State
  const byte AUTHENTICATION_STATE_NOT_AUTHENTCATED = 0x00;
  const byte AUTHENTICATION_STATE_AUTHENTCATED = 0x01;
  
  // Bitmask - Authentication Sub Status
  const byte AUTH_SUB_STAT_TESTLAB_VALIDATED_BITMASK = 0x20;
  const byte AUTH_SUB_STAT_MANU_VALIDATED_BITMASK = 0x10;
  const byte AUTH_SUB_STAT_MANU_SERIES_VALIDATED_BITMASK = 0x08;
  const byte AUTH_SUB_STAT_MANU_DEVICE_VALIDATED_BITMASK = 0x04;
  const byte AUTH_SUB_STAT_CHALLENGE_SIGNED_BITMASK = 0x02;
  const byte AUTH_STATUS_BITMASK_LEAST_SIGN_4BITS = 0x0F;
  
  // MESSAGE DATA
  const byte MSG_CERT_TYPE_TESTLAB = 0x00;
  const byte MSG_CERT_TYPE_PERSERIES = 0x01;
  
  
  // writeLineEx constants
  
  const long cWriteTargetSystemPage  = 0;
  const long cWriteTargetCaplPage    = 1;
  const long cWriteTargetTestPage    = 2;
  const long cWriteTargetLoggingFile = -2;
  const long cWriteTragetTraceWindow = -3;
  
  const dword cWriteSeveritySuccess     = 0;
  const dword cWriteSeverityInformation = 1;
  const dword cWriteSeverityWarning     = 2;
  const dword cWriteSeverityError       = 3;
}
