/*@!Encoding:1252*/

///////////////////////////////////////
// v. 2.0
///////////////////////////////////////
includes
{
  
}

variables
{
  byte ActualClientAddress = 0xff;
  byte ActualServerAddress = 0xff;
  
  char OutputString[513];
  
  char TempString1[257];
  char TempString2[129];
  char TempString3[129];
  char TempString4[129];
  char TempString5[129];
  char TempString6[129];
   
  const byte LogAlignNothing = 0;
  const byte LogAlignServer = 1;
  const byte LogAlignClient = 2;  
  
  const long TIM_AuthStatus_Client_Timeoutval = 3000;
  const long TIM_AuthStatus_Server_Timeoutval = 3000;
  
  byte HideResetOfStartAuth = 0;
       
  msTimer Timer_ClientStatusMessage;
  msTimer Timer_ServerStatusMessage;
  const long TIM_ClientStatusMsg_Timeoutval = 3000;
  const long TIM_ServerStatusMsg_Timeoutval = 3000;
  
  
  msTimer DummyTimer;
  
  /* TIM function codes */
  const byte kMsgCodeS2_FuncID_FrontPto = 0x40;
  const byte kMsgCodeS2_FuncID_RearPto = 0x41;
  const byte kMsgCodeS2_FuncID_FrontHitch = 0x42;
  const byte kMsgCodeS2_FuncID_RearHitch = 0x43;
  const byte kMsgCodeS2_FuncID_Speed = 0x44;
  


//  /* TIM client state*/
//  const byte kClientState_AutomationUnavailable = 0;
//  const byte kClientState_AutomationNotReady = 1;
//  const byte kClientState_AutomationReadyToEnable = 2;
//  const byte kClientState_AutomationEnabled = 3;
//  const byte kClientState_AutomationActive = 5;
//  const byte kClientState_error = 14;
//  const byte kClientState_notAvailable = 15;
//  
//  /* TIM server master indication*/
//  const byte kServerMasterInd_ActingAsTimServerMaster = 1;
//  const byte kServerMasterInd_Error = 2;
//  const byte kServerMasterInd_NotAvailable = 3;
//
//   /* TIM server operator acknowledge */
//  const byte kServerOpAck_NotAcknowledged = 0;
//  const byte kServerOpAck_Acknowledged = 1;
//  const byte kServerOpAck_Error = 2;
//  const byte kServerOpAck_NotAvailable = 3;
//  
//  /* TIM system state  */
//  const byte kSystemState_NoAutomationActive = 0;
//  const byte kSystemState_AutomationActive = 1;
//  const byte kSystemStateOpAck_Error = 0xE;
//  const byte kSystemState_NotAvailable = 0xF;
  
  
//  /* TIM server state*/
//  const byte kServerState_AutomationUnavailable = 0;
//  const byte kServerState_AutomationNotReady = 1;
//  const byte kServerState_AutomationEnabled = 3;
//  const byte kServerState_AutomationActive = 5;
//  const byte kServerState_error = 14;
//  const byte kServerState_notAvailable = 15;
//  
//  /* TIM system standstill state */
//  const byte kSystemStandStillstate_NotStandstill = 0;
//  const byte kSystemStandStillstate_Standstill = 1;
//  const byte kSystemStandStillstate_Error = 2;
//  const byte kSystemStandStillstate_NotAvailable = 3;
//  
//  /* TIM system stationary operation state */
//  const byte kSystemStationaryOpstate_NotStandstill = 0;
//  const byte kSystemStationaryOpstate_Standstill = 1;
//  const byte kSystemStationaryOpstate_Error = 2;
//  const byte kSystemStationaryOpstate_NotAvailable = 3;
  
 
//  /* general exit reason codes */
//  const byte kExitReason_NoReasonAllClear = 0;
//  const byte kExitReason_OperatorAwarenessNotDetected = 1;
//  const byte kExitReason_ImplementRelease = 2;
//  const byte kExitReason_OperatorOverride = 3;
//  const byte kExitReason_OperatorControlNotValid = 4;
//  const byte kExitReason_RemoteCommandTimeout = 5;
//  const byte kExitReason_RemonteCommandOutOfRange = 6;
//  const byte kExitReason_FunctionNotCalibrated = 7;
//  const byte kExitReason_OperatorControlFault = 8;
//  const byte kExitReason_FunctionFault = 9;
//  
//  const byte kExitReason_Error = 0x1E;
//  const byte kExitReason_NotAvailable = 0x1F;
//  
//  /* exit reason code PTO shaft speed */
//  const byte kExitReason_PTO_InvalidGear = 0x0F;
//  
//  /* exit reason code vehicle speed */
//  const byte kExitReason_VehicleTransmissionGear = 15;
//  
//  
//  /* SLOT info see D2.2 ; for all functions*/
//  const byte kAutomationState_unavailable = 0;
//  const byte kAutomationState_notReady = 1;
//  const byte kAutomationState_readyToEnable = 2;
//  const byte kAutomationState_enabled = 3;
//  const byte kAutomationState_pending = 4;
//  const byte kAutomationState_activeNotLimited = 5;
//  const byte kAutomationState_activeLimitedHigh = 6;
//  const byte kAutomationState_activeLimitedLow = 7;
//  const byte kAutomationState_error = 14;
//  const byte kAutomationState_notAvailable = 15;
//  
//  /* SLOT info see D4.2.1 ; PTO output shaft speed request  */
//  const byte kPtoSpeedReq_ReverseSpeed = 0;
//  const byte kPtoSpeedReq_Stop = 0x7D80;
//  const byte kPtoSpeedReq_ForwardSpeed = 0xFB00;
//  const byte kPtoSpeedReq_ReleaseControl_OpAwareness = 0xFBFD;
//  const byte kPtoSpeedReq_ReleaseControl_AcceptFuncValIncr = 0xFBFE;
//  const byte kPtoSpeedReq_ReadyToControl = 0xFBFF;
//    
//  /* SLOT info see D4.2.3 ; PTO shaft speed */
//  
//  
//  /* SLOT info see D6.2.1 ; vehicle speed request  */
//  const byte kVehicleSpeedReq_ReverseSpeed = 0;
//  const byte kVehicleSpeedReq_Stop = 0x7D80;
//  const byte kVehicleSpeedReq_ForwardSpeed = 0xFB00;
//  const byte kVehicleSpeedReq_ReleaseControl_OpAwareness = 0xFBFD;
//  const byte kVehicleSpeedReq_ReleaseControl_AcceptFuncValIncr = 0xFBFE;
//  const byte kVehicleSpeedReq_ReadyToControl = 0xFBFF;
//  
//  /* SLOT info see D6.2.3 ; vehicle speed */
  
}

on pg AUTH21
{

  if(0x2 == this.MessageCode)  //server cert request
  {
//    write("check peer %x", CheckPeerValidity(this.sa, this.da, ActualClientAddress, ActualServerAddress));
    if( 1 == CheckPeerValidity(this.sa, this.da, ActualClientAddress, ActualServerAddress))
    {
      ProcessServerCertReq(this);
    }
  }
  else if(0x3 == this.MessageCode)  //client cert response
  {
//    write("check peer %x", CheckPeerValidity(this.sa, this.da, ActualClientAddress, ActualServerAddress));
    if( 1 == CheckPeerValidity(this.sa, this.da, ActualClientAddress, ActualServerAddress))
    {
      ProcessClientCertResp(this);
    }
  }
  else if(0x4 == this.MessageCode)  //server random challenge request
  {
//    write("check peer %x", CheckPeerValidity(this.sa, this.da, ActualClientAddress, ActualServerAddress));
    if( 1 == CheckPeerValidity(this.sa, this.da, ActualClientAddress, ActualServerAddress))
    {
      ProcessServerRandomChallengeReq(this);
    }
  }
  else if(0x5 == this.MessageCode)  //client random challenge response
  {
//    write("check peer %x", CheckPeerValidity(this.sa, this.da, ActualClientAddress, ActualServerAddress));
    if( 1 == CheckPeerValidity(this.sa, this.da, ActualClientAddress, ActualServerAddress))
    {
      ProcessClientRandomChallengeResp(this);
    }
  }
  else if(0x6 == this.MessageCode)  //server signed challenge request
  {
//    write("check peer %x", CheckPeerValidity(this.sa, this.da, ActualClientAddress, ActualServerAddress));
    if( 1 == CheckPeerValidity(this.sa, this.da, ActualClientAddress, ActualServerAddress))
    {
      ProcessServerSignedChallengeReq(this);
    }
  }
  else if(0x7 == this.MessageCode)  //client signed challenge response
  {
//    write("check peer %x", CheckPeerValidity(this.sa, this.da, ActualClientAddress, ActualServerAddress));
    if( 1 == CheckPeerValidity(this.sa, this.da, ActualClientAddress, ActualServerAddress))
    {
      ProcessClientSignedChallengeResp(this);
    }
  }  
  
  
  else if(0x9 == this.MessageCode)  //client authentication info
  {
//    write("check peer %x", CheckPeerValidity(this.sa, this.da, ActualClientAddress, ActualServerAddress));
    if( 1 == CheckPeerValidity(this.sa, this.da, ActualClientAddress, ActualServerAddress))
    {
      ProcessClientAuthenticationInfo(this);
    }
  }
  
  else if(0xFA == this.MessageCode)  //client authentication status
  {
//    write("check peer %x", CheckPeerValidity(this.sa, this.da, ActualClientAddress, ActualServerAddress));
    if( 1 == CheckPeerValidity(this.sa, this.da, ActualClientAddress, ActualServerAddress))
    {
      ProcessClientAuthenticationStatus(this);
    }
  }
  
  
  else //not defined --> error
  {
    
  }
}



// on Server2Client Authentication
on pg AUTH12
{
  if(0x2 == this.MessageCode)  //server cert response
  {
//    write("check peer %x", CheckPeerValidity(this.da, this.sa, ActualClientAddress, ActualServerAddress));
    if( 1 == CheckPeerValidity(this.da, this.sa, ActualClientAddress, ActualServerAddress))
    {
      ProcessServerCertResp(this);
    }
  }
  else if(0x3 == this.MessageCode)  //client cert request
  {
//    write("check peer %x", CheckPeerValidity(this.da, this.sa, ActualClientAddress, ActualServerAddress));
    if( 1 == CheckPeerValidity(this.da, this.sa, ActualClientAddress, ActualServerAddress))
    {
      ProcessClientCertReq(this);
    }
  }
  else if(0x4 == this.MessageCode)  //server random challenge response
  {
//    write("check peer %x", CheckPeerValidity(this.da, this.sa, ActualClientAddress, ActualServerAddress));
    if( 1 == CheckPeerValidity(this.da, this.sa, ActualClientAddress, ActualServerAddress))
    {
      ProcessServerRandomChallengeResp(this);
    }
  }
  else if(0x5 == this.MessageCode)  //client random challenge request
  {
//    write("check peer %x", CheckPeerValidity(this.da, this.sa, ActualClientAddress, ActualServerAddress));
    if( 1 == CheckPeerValidity(this.da, this.sa, ActualClientAddress, ActualServerAddress))
    {
      ProcessClientRandomChallengeReq(this);
    }
  }  
  else if(0x6 == this.MessageCode)  //server signed challenge response
  {
//    write("check peer %x", CheckPeerValidity(this.da, this.sa, ActualClientAddress, ActualServerAddress));
    if( 1 == CheckPeerValidity(this.da, this.sa, ActualClientAddress, ActualServerAddress))
    {
      ProcessServerSignedChallengeResp(this);
    }
  }
  else if(0x7 == this.MessageCode)  //client signed challenge request
  {
//    write("check peer %x", CheckPeerValidity(this.da, this.sa, ActualClientAddress, ActualServerAddress));
    if( 1 == CheckPeerValidity(this.da, this.sa, ActualClientAddress, ActualServerAddress))
    {
      ProcessClientSignedChallengeReq(this);
    }
  }
  else if(0x8 == this.MessageCode)  //server authentication info
  {
//    write("check peer %x", CheckPeerValidity(this.da, this.sa, ActualClientAddress, ActualServerAddress));
    if( 1 == CheckPeerValidity(this.da, this.sa, ActualClientAddress, ActualServerAddress))
    {
      ProcessServerAuthenticationInfo(this);
    }
  }
  
  else if(0xF9 == this.MessageCode)  //server authentication status
  {
//    write("check peer %x", CheckPeerValidity(this.da, this.sa, ActualClientAddress, ActualServerAddress));
    if( 1 == CheckPeerValidity(this.da, this.sa, ActualClientAddress, ActualServerAddress))
    {
      ProcessServerAuthenticationStatus(this);
    }
  }
  
  else //not defined --> error
  {
    
  }
}

on pg TIM21
{  
  if(0xF6 == this.GroupFunctionValue) //connection version request
  {
    if( /*(0x01 == this.TIMClientVersionNbrRequest)*/ 1 && (0x01 == this.MinimumTIMVersionNr) )
    {
      ActualClientAddress = this.sa;
      @Authentication::Client::Address = ActualClientAddress;
    
      //reset all 
      InitDisplayData();  
    }
  }
  else if(0xF9 == this.GroupFunctionValue)  //client status
  {
//    write("check peer %x", CheckPeerValidity(this.sa, this.da, ActualClientAddress, ActualServerAddress));
    if( 1 == CheckPeerValidity(this.sa, this.da, ActualClientAddress, ActualServerAddress))    
    {
      ProcessClientStatusMsg(this);
    }
  }   
  else if(  ( kMsgCodeS2_FuncID_FrontPto == this.GroupFunctionValue)     //front pto req
          ||( kMsgCodeS2_FuncID_RearPto == this.GroupFunctionValue)  )  //rear pto req
  {
//    write("check peer %x", CheckPeerValidity(this.sa, this.da, ActualClientAddress, ActualServerAddress));
    if( 1 == CheckPeerValidity(this.sa, this.da, ActualClientAddress, ActualServerAddress))    
    {
      PtoSpeedReqMsg(this);
    }
  }
  else if( kMsgCodeS2_FuncID_Speed == this.GroupFunctionValue)  //speed control req.
  {
//    write("check peer %x", CheckPeerValidity(this.sa, this.da, ActualClientAddress, ActualServerAddress));
    if( 1 == CheckPeerValidity(this.sa, this.da, ActualClientAddress, ActualServerAddress))    
    {
      ProcessSpeedReqMsg(this);
    }
  }
  else
  {
  }
}

  
on pg TIM12
{
  message * m;
  int i, mx;
  signal * testSig;
    
  if(0xFA == this.GroupFunctionValue)  //server status
  {
    //write("check peer %x", CheckPeerValidity(/*this.da*/ ActualClientAddress, this.sa, ActualClientAddress, ActualServerAddress));//broadcast message
    if( 1 == CheckPeerValidity(/*this.da*/ ActualClientAddress, this.sa, ActualClientAddress, ActualServerAddress))//broadcast message
    {
      ProcessServerStatusMsg(this);
    }
  }

  if(  (kMsgCodeS2_FuncID_FrontPto == this.GroupFunctionValue)     //front pto status
     ||(kMsgCodeS2_FuncID_RearPto == this.GroupFunctionValue)  )  //rear pto status
  {
    //write("check peer %x", CheckPeerValidity(/*this.da*/ ActualClientAddress, this.sa, ActualClientAddress, ActualServerAddress));  //broadcast message
    if( 1 == CheckPeerValidity(/*this.da*/ ActualClientAddress, this.sa, ActualClientAddress, ActualServerAddress))//broadcast message
    {
      ProcessPtoStatusMsg(this);
    }
  }
  
  if(kMsgCodeS2_FuncID_Speed == this.GroupFunctionValue)     //speed control status
  {
    //write("check peer %x", CheckPeerValidity(/*this.da*/ ActualClientAddress, this.sa, ActualClientAddress, ActualServerAddress));  //broadcast message
    if( 1 == CheckPeerValidity(/*this.da*/ ActualClientAddress, this.sa, ActualClientAddress, ActualServerAddress))//broadcast message
    {
      ProcessSpeedStatusMsg(this);
    }
  } 
}

on pg ACL
{
  //determine actual server
  if(  (this.IndustryGroup == 2) && ( this.Function == 142) )
  {
    //TODO check if server master!
    
    ActualServerAddress = this.sa;
    @Authentication::Server::Address = ActualServerAddress;
  }
}


on start
{
  dword Err = 0;
  pg RQST ReqADC;
  
  InitDisplayData();
    
  // request address claimed
//  ReqADC.sa = 0xFF;
//  ReqADC.da = 0xFF;
//  ReqADC.ParameterGroupNumber = 0xee00;  
//  output(ReqADC);
}


/*
  *Call this function to init the PG message
  */
void InitPg (pg *_pg)
{
    int i;
    for( i = 0; i< _pg.dlc; i++ ) {
       _pg.byte(i)= 0xFF;             // fill empty bytes wit "0xFF"
    }
}

byte DisplayLogString(char ActPanel[], char ActControl[], long ActTime, byte Side, char MainText[], char DetailText[])
{  
  char tabs[9];
  
  if(Side == 0)  //no alignment
  {
    //nothing
    snprintf(tabs,elcount(tabs),"\t     \t\0");
  }
  else if(Side == 1)
  {
    snprintf(tabs,elcount(tabs),"\tS-->C\t\0");
  }
  else if(Side == 2)
  {
    snprintf(tabs,elcount(tabs),"\tC-->S\t\0");
  }
    
  snprintf(OutputString, elcount(OutputString), "\n%6d.%05d: %s%s:  %s", ActTime/100000, ActTime%100000, tabs, MainText, DetailText);
  putValueToControl(ActPanel, ActControl, OutputString);
  
  return 1;
}
byte DetermineCertType(char ActString[], byte ActCertType, sysvarInt *AuthDetail_ActCert_Testlab,
                                                           sysvarInt *AuthDetail_ActCert_Manu,
                                                           sysvarInt *AuthDetail_ActCert_ManuSeries,
                                                           sysvarInt *AuthDetail_ActCert_Device)
{
  if(0x00 == ActCertType) //AEF root
  {
    snprintf(ActString, elcount(ActString), "AEF root cert");
  }
  else if(0x01 == ActCertType) //test lab
  {
    snprintf(ActString, elcount(ActString), "test lab cert");
    
    @AuthDetail_ActCert_Testlab = 1;
  }
  else if(0x02 == ActCertType) //manufacturer
  {
    snprintf(ActString, elcount(ActString), "manufacturer cert");
    
    @AuthDetail_ActCert_Manu = 1;
  }
  else if(0x03 == ActCertType) //manufacturer series
  {
    snprintf(ActString, elcount(ActString), "manufacturer series cert");
    
    @AuthDetail_ActCert_ManuSeries = 1;
  }
  else if(0x04 == ActCertType) //device
  {
    snprintf(ActString, elcount(ActString), "device cert");
    
    @AuthDetail_ActCert_Device = 1;
  }
  else if(0x05 == ActCertType) //CRL signing
  {
    snprintf(ActString, elcount(ActString), "CRL signing cert");
  }
  else if(0x06 == ActCertType) //CRL
  {
    snprintf(ActString, elcount(ActString), "CRL cert");
  }
  
  return 1;
}

byte DetermineErrorCode(char ActString[], byte ActErrorCode)
{
  if(ActErrorCode == 0x00)
  {
    snprintf(ActString, elcount(ActString), "no error");
  }
  else if(ActErrorCode == 0x01)
  {
    snprintf(ActString, elcount(ActString), "participant busy");
  }
  else if(ActErrorCode == 0x02)
  {
    snprintf(ActString, elcount(ActString), "certificate format not supported");
  }
  else if(ActErrorCode == 0x03)
  {
    snprintf(ActString, elcount(ActString), "not an authentication server/client");
  }
  else if(ActErrorCode == 0x04)
  {
    snprintf(ActString, elcount(ActString), "Root cert. sign. invalid");
  }
  else if(ActErrorCode == 0x05)
  {
    snprintf(ActString, elcount(ActString), "Test lab cert. sign. invalid");
  }
  else if(ActErrorCode == 0x06)
  {
    snprintf(ActString, elcount(ActString), "Manufacturer cert. sign. invalid");
  }
  else if(ActErrorCode == 0x07)
  {
    snprintf(ActString, elcount(ActString), "Manufacturer Series cert. sign. invalid  ");
  }
  else if(ActErrorCode == 0x08)
  {
    snprintf(ActString, elcount(ActString), "Device cert. sign. invalid");
  }
  else if(ActErrorCode == 0x09)
  {
    snprintf(ActString, elcount(ActString), "challenges don't match");    
  }
  else if(ActErrorCode == 0x0A)
  {
    snprintf(ActString, elcount(ActString), "internal error");
  }
  else if(ActErrorCode == 0x0B)
  {
    snprintf(ActString, elcount(ActString), "Root cert. data corrupt");
  }
  else if(ActErrorCode == 0x0C)
  {
    snprintf(ActString, elcount(ActString), "Test lab cert. data corrupt");
  }
  else if(ActErrorCode == 0x0D)
  {
    snprintf(ActString, elcount(ActString), "Manufacturer cert. data corrupt");
  }
  else if(ActErrorCode == 0x0E)
  {
    snprintf(ActString, elcount(ActString), "Manufacturer Series cert. data corrupt");
  }
  else if(ActErrorCode == 0x0F)
  {
    snprintf(ActString, elcount(ActString), "Device cert. data corrupt");
  }
 
  else if(ActErrorCode == 0x10)
  {
    snprintf(ActString, elcount(ActString), "Authentication status lost");
  }
  else if(ActErrorCode == 0x11)
  {
    snprintf(ActString, elcount(ActString), "Authentication type not supported");
  }
  else if(ActErrorCode == 0x12)
  {
    snprintf(ActString, elcount(ActString), "Server detected error");
  }
  
  else if(ActErrorCode == 0x13)
  {
    snprintf(ActString, elcount(ActString), "Unexpected re-start authentication bit set");
  }
  else if(ActErrorCode == 0x14)
  {
    snprintf(ActString, elcount(ActString), "ECC public key validation failed");
  }
  else if(ActErrorCode == 0x15)
  {
    snprintf(ActString, elcount(ActString), "NAME mismatch");
  }
  else if(ActErrorCode == 0x16)
  {
    snprintf(ActString, elcount(ActString), "ECU version mismatch");
  }
  else if(ActErrorCode == 0x17)
  {
    snprintf(ActString, elcount(ActString), "Certificate chain invalid");
  }
  else if(ActErrorCode == 0x18)
  {
    snprintf(ActString, elcount(ActString), "CRL signature invalid");
  }
  else if(ActErrorCode == 0x19)
  {
    snprintf(ActString, elcount(ActString), "Root cert. revoked");
  }
  else if(ActErrorCode == 0x1A)
  {
    snprintf(ActString, elcount(ActString), "Lab cert. revoked");
  }
  else if(ActErrorCode == 0x1B)
  {
    snprintf(ActString, elcount(ActString), "Manufacturer cert. revoked");
  }
  else if(ActErrorCode == 0x1C)
  {
    snprintf(ActString, elcount(ActString), "Manufacturer series cert. revoked");
  }
  else if(ActErrorCode == 0x1D)
  {
    snprintf(ActString, elcount(ActString), "Device cert. revoked");
  }
  else if(ActErrorCode == 0x1E)
  {
    snprintf(ActString, elcount(ActString), "Cert. type invalid");
  }
  else if(ActErrorCode == 0x1F)
  {
    snprintf(ActString, elcount(ActString), "Authentication timeout");
  }
  else if(ActErrorCode == 0x20)
  {
    snprintf(ActString, elcount(ActString), "Challenge type invalid");
  }
  else
  {
    snprintf(ActString, elcount(ActString), "-");
  } 
  
  return 1;
}

byte DetermineAuthStatus(char ActString[], byte ActAuthStatus, sysvarInt *AuthDetail_CertResp_Testlab, 
  sysvarInt *AuthDetail_CertResp_Manu,
  sysvarInt *AuthDetail_CertResp_ManuSeries,
  sysvarInt *AuthDetail_CertResp_Device,
  sysvarInt *AuthDetail_Status, sysvarInt *AuthDetail_AuthStatus,
  sysvarInt *AuthDetail_PeerStoredCerts,
  msTimer ActTimer_StatusMessage)
{
  if(ActAuthStatus == 0x00)
  {
    snprintf(ActString, elcount(ActString), "not authenticated");
    
    // test if all required certs are here
    if(  (  (@AuthDetail_CertResp_Testlab == 1) || (@AuthDetail_PeerStoredCerts&0x40 == 0)  )
       &&(  (@AuthDetail_CertResp_Manu == 1) || (@AuthDetail_PeerStoredCerts&0x20 == 0)  )
       &&(  (@AuthDetail_CertResp_ManuSeries == 1) || (@AuthDetail_PeerStoredCerts&0x10 == 0)  )
       &&(  (@AuthDetail_CertResp_Device == 1) || (@AuthDetail_PeerStoredCerts&0x08 == 0)  )  
      )
    {
      @AuthDetail_Status = 1;
    }
  }
  else if(ActAuthStatus == 0x01)
  {
    snprintf(ActString, elcount(ActString), "authenticated");
    
    @AuthDetail_AuthStatus = 1;
    
    cancelTimer(ActTimer_StatusMessage);
  }
  else if(ActAuthStatus == 0x0E)
  {
    snprintf(ActString, elcount(ActString), "error");
  }
  else if(ActAuthStatus == 0x0F)
  {
    snprintf(ActString, elcount(ActString), "error");
  }
  else
  {
    snprintf(ActString, elcount(ActString), "-");
  } 
  
  
  return 1;
}

byte DetermineAuthSubStatus(char ActString[], byte AuthStatus, byte reStartAuth, byte lwaPossible, 
                            byte testLabCertValid, byte manufacturerCertValid, byte manufacturerSeriesValid, byte deviceCertValid, 
                            byte challengeSigned, 
                            sysvarInt *Testlab_valid,
                            sysvarInt *Manufacturer_valid,
                            sysvarInt *ManufacturerSeries_valid,
                            sysvarInt *Device_valid,
                            sysvarInt *SignedChallenge_valid,

                            sysvarInt *AuthDetail_SetRestart,
                            sysvarInt *AuthDetail_LwA_Possible,
                            sysvarInt *AuthDetail_ResetRestart,
                            sysvarInt *AuthDetail_AuthCallSignedStatus,
                            msTimer ActTimer_StatusMessage,
                            long AuthStatus_Timeoutval)
{
  ActString.byte(0) = 0x00;
  
  //write("Stored certs %X: str: %S", ActAuthSubStatus, ActString );
  if (reStartAuth)
  {
    strncat(ActString, "(re)start auth&", elcount(ActString));
    
    setTimer(ActTimer_StatusMessage, AuthStatus_Timeoutval);
    @AuthDetail_SetRestart = 1;
    
    //evaluate LwA possible bit when (Re)Start bit is set
    if(lwaPossible)
    {
      @AuthDetail_LwA_Possible = 1;
    }
    else
    {
      @AuthDetail_LwA_Possible = 0;
    }
  }
  else //TODO: other condition neccessary?
  {
    if(  (@AuthDetail_SetRestart == 1) && (HideResetOfStartAuth == 0) && (@AuthDetail_ResetRestart != 1) )
    {
      @AuthDetail_ResetRestart = 1;
    }
  }
  
  if(lwaPossible)
  {
    strncat(ActString, "lwA poss.&", elcount(ActString));
  }
  if(testLabCertValid)
  {
    strncat(ActString, "TestlabCertValid&", elcount(ActString));
    @Testlab_valid = 1;
  }
  else
  {
    @Testlab_valid = 0;
  }    
  if(manufacturerCertValid)
  {
    strncat(ActString, "ManuCertValid&", elcount(ActString));
    @Manufacturer_valid = 1;
  }
  else
  {
    @Manufacturer_valid = 0;
  }
  if (manufacturerSeriesValid)
  {
    strncat(ActString, "ManuSeriesCertValid&", elcount(ActString));
    @ManufacturerSeries_valid = 1;
  }
  else
  {
    @ManufacturerSeries_valid = 0;
  }
  if (deviceCertValid)
  {
    strncat(ActString, "DeviceCertValid&", elcount(ActString));
    @Device_valid = 1;
  }
  else
  {
    @Device_valid = 0;
  }
  if (challengeSigned)
  {
    strncat(ActString, "Chall.signed&", elcount(ActString));
    
    @AuthDetail_AuthCallSignedStatus = 1;
    
    if(AuthStatus == 0x01) //authenticated
    {      
      @SignedChallenge_valid = 1;
    }
    else
    {
      @SignedChallenge_valid = 0;
    }
  }
  else
  {
    @SignedChallenge_valid = 0;
  }
  
  //delete last "&"
  if(  (strlen(ActString) != 0)
    &&(ActString[strlen(ActString)-1] == '&')  )
  {
    ActString[strlen(ActString)-1] = 0x00;
  }
  
  if( strlen(ActString) == 0)
  {
    strncat(ActString, "-", elcount(ActString));
  }
  
  return 1;
}

byte DetermineCoupleStatus(char ActString[], byte ActCoupleStatus)
{
  if(ActCoupleStatus == 0x00)
  {
    snprintf(ActString, elcount(ActString), "not authenticated");
  }
  else if(ActCoupleStatus == 0x01)
  {
    snprintf(ActString, elcount(ActString), "authenticated");
  }
  else if(ActCoupleStatus == 0x02)
  {
    snprintf(ActString, elcount(ActString), "error");
  }
  else if(ActCoupleStatus == 0x03)
  {
    snprintf(ActString, elcount(ActString), "n.a.");
  }
  else
  {
    snprintf(ActString, elcount(ActString), "-");
  }  
  return 1;
}
    

void InitDisplayData(void)
{
  @Authentication::Client::ReqServerStoredCerts = 0;
  @Authentication::Client::Testlab_valid = 0;
  @Authentication::Client::Manufacturer_valid = 0;
  @Authentication::Client::ManufacturerSeries_valid = 0;
  @Authentication::Client::Device_valid = 0;
  @Authentication::Client::SignedChallenge_valid = 0;
  @Authentication::Client::Random_received = 0;

  @Authentication::Client::StatusMsgTimeout = 0;
  
  @Authentication::Client::ServerStoredCertsErrorCode = 0;
  @Authentication::Client::ServerStoredCerts= 0;
  
  
  @Authentication::Server::ReqClientStoredCerts = 0;
  @Authentication::Server::Testlab_valid = 0;
  @Authentication::Server::Manufacturer_valid = 0;
  @Authentication::Server::ManufacturerSeries_valid = 0;
  @Authentication::Server::Device_valid = 0;
  @Authentication::Server::SignedChallenge_valid = 0;
  @Authentication::Server::Random_received = 0;
  
  @Authentication::Server::StatusMsgTimeout = 0;
  
  @Authentication::Server::ClientStoredCertsErrorCode = 0;
  @Authentication::Server::ClientStoredCerts= 0;
  
  //AuthDetail Data
  @Authentication::AuthDetail::StartAuthReq = 0;
  @Authentication::AuthDetail::Client_LwA_Possible = 0;
  @Authentication::AuthDetail::StartAuthResp = 0;
  @Authentication::AuthDetail::Server_LwA_Possible = 0;
  @Authentication::AuthDetail::LwA = 0;
  @Authentication::AuthDetail::RestartAuthReq = 0;
  @Authentication::AuthDetail::RestartAuthResp = 0;
  @Authentication::AuthDetail::ServerStoredCertsReq = 0;
  @Authentication::AuthDetail::ServerStoredCertsResp = 0;
  @Authentication::AuthDetail::ClientStoredCertsReq = 0;
  @Authentication::AuthDetail::ClientStoredCertsResp = 0;
  @Authentication::AuthDetail::ServerCertReq_Testlab = 0;
  @Authentication::AuthDetail::ServerCertReq_Manu = 0;
  @Authentication::AuthDetail::ServerCertReq_ManuSeries = 0;
  @Authentication::AuthDetail::ServerCertReq_Device = 0;
  @Authentication::AuthDetail::ServerCertResp_Testlab = 0;
  @Authentication::AuthDetail::ServerCertResp_Manu = 0;
  @Authentication::AuthDetail::ServerCertResp_ManuSeries = 0;
  @Authentication::AuthDetail::ServerCertResp_Device = 0;
  @Authentication::AuthDetail::ClientCertReq_Testlab = 0;
  @Authentication::AuthDetail::ClientCertReq_Manu = 0;
  @Authentication::AuthDetail::ClientCertReq_ManuSeries = 0;
  @Authentication::AuthDetail::ClientCertReq_Device= 0;
  @Authentication::AuthDetail::ClientCertResp_Testlab = 0;
  @Authentication::AuthDetail::ClientCertResp_Manu = 0;
  @Authentication::AuthDetail::ClientCertResp_ManuSeries = 0;
  @Authentication::AuthDetail::ClientCertResp_Device = 0;
  @Authentication::AuthDetail::ClientAcknowledgeStatus = 0;
  @Authentication::AuthDetail::ServerAcknowledgeStatus = 0;
  @Authentication::AuthDetail::ClientRandomChallReq = 0;
  @Authentication::AuthDetail::ClientRandomChallResp = 0;
  @Authentication::AuthDetail::ServerRandomChallReq = 0;
  @Authentication::AuthDetail::ServerRandomChallResp = 0;
  @Authentication::AuthDetail::ClientAcknowledgeChallSigned = 0;
  @Authentication::AuthDetail::ServerAcknowledgeChallSigned = 0;
  @Authentication::AuthDetail::ClientSignedChallReq = 0;
  @Authentication::AuthDetail::ClientSignedChallResp = 0;
  @Authentication::AuthDetail::ServerSignedChallReq = 0;
  @Authentication::AuthDetail::ServerSignedChallResp = 0;
  @Authentication::AuthDetail::ClientAcknowledgeAuthStatus = 0;
  @Authentication::AuthDetail::ServerAcknowledgeAuthStatus = 0;
}
 

byte CheckPeerValidity(byte ClientAdr, byte ServerAdr, byte ActClientAdr, byte ActServerAdr)
{
  if( (ClientAdr == ActClientAdr) && (ServerAdr == ActServerAdr) ) 
  {
    return 1;
  }
  else
  {
    //other peer or error!
    
    return 0;
  }  
}

/****************************************************************************
 * begin: CLIENT sent PGNs
*****************************************************************************/

void ProcessServerCertReq(pg AUTH21 AuthClient2ServerPGN)
{
  if(0x00 == AuthClient2ServerPGN.AuthenticationType) //TIM authentication
  {
    if(0x00 == AuthClient2ServerPGN.CertificateFormat)  //DER
    {
      DetermineCertType(TempString1, AuthClient2ServerPGN.CertType, sysvar::Authentication::AuthDetail::ServerCertReq_Testlab,
                                                                            sysvar::Authentication::AuthDetail::ServerCertReq_Manu,
                                                                            sysvar::Authentication::AuthDetail::ServerCertReq_ManuSeries,
                                                                            sysvar::Authentication::AuthDetail::ServerCertReq_Device );
      DisplayLogString("Display", "TIMoutputwindow", AuthClient2ServerPGN.time, LogAlignClient, "ServerCertReq", TempString1);      
    }
  }
  else if(0x0E == AuthClient2ServerPGN.AuthenticationType) //error
  {
    DisplayLogString("Display", "TIMoutputwindow", AuthClient2ServerPGN.time, LogAlignClient, "ServerCertReq", "error");
  }
  else if(0x0F == AuthClient2ServerPGN.AuthenticationType) //n.a.
  {
    DisplayLogString("Display", "TIMoutputwindow", AuthClient2ServerPGN.time, LogAlignClient, "ServerCertReq", "n.a.");
  }
}

void ProcessClientCertResp(pg AUTH21 AuthClient2ServerPGN)
{
  if(0x00 == AuthClient2ServerPGN.AuthenticationType) //TIM authentication
  {
    DetermineCertType(TempString2, AuthClient2ServerPGN.CertType, sysvar::Authentication::AuthDetail::ClientCertResp_Testlab,
                                                                  sysvar::Authentication::AuthDetail::ClientCertResp_Manu,
                                                                  sysvar::Authentication::AuthDetail::ClientCertResp_ManuSeries,
                                                                  sysvar::Authentication::AuthDetail::ClientCertResp_Device);
    DetermineErrorCode(TempString3, AuthClient2ServerPGN.ErrorCode);
    snprintf(TempString1, elcount(TempString1), "certType: %s; error code: %s", TempString2, TempString3);
    DisplayLogString("Display", "TIMoutputwindow", AuthClient2ServerPGN.time, LogAlignClient, "ClientCertResp", TempString1);
    
  }
  else if(0x0E == AuthClient2ServerPGN.AuthenticationType) //error
  {
    DisplayLogString("Display", "TIMoutputwindow", AuthClient2ServerPGN.time, LogAlignClient, "ClientCertResp", "error");
  }
  else if(0x0F == AuthClient2ServerPGN.AuthenticationType) //n.a.
  {
    DisplayLogString("Display", "TIMoutputwindow", AuthClient2ServerPGN.time, LogAlignClient, "ClientCertResp", "n.a.");
  }
}

void ProcessServerRandomChallengeReq(pg AUTH21 AuthClient2ServerPGN)
{
  if(0x00 == AuthClient2ServerPGN.AuthenticationType) //TIM authentication
  {
    DisplayLogString("Display", "TIMoutputwindow", AuthClient2ServerPGN.time, LogAlignClient, "ServerRandomChallengeReq", TempString1);
    
    @Authentication::AuthDetail::ServerRandomChallReq = 1;
    
  }
  else if(0x0E == AuthClient2ServerPGN.AuthenticationType) //error
  {
    DisplayLogString("Display", "TIMoutputwindow", AuthClient2ServerPGN.time, LogAlignClient, "ServerRandomChallengeReq", "error");
  }
  else if(0x0F == AuthClient2ServerPGN.AuthenticationType) //n.a.
  {
    DisplayLogString("Display", "TIMoutputwindow", AuthClient2ServerPGN.time, LogAlignClient, "ServerRandomChallengeReq", "n.a.");
  }
}

void ProcessClientRandomChallengeResp(pg AUTH21 AuthClient2ServerPGN)
{
  if(0x00 == AuthClient2ServerPGN.AuthenticationType) //TIM authentication
  {
    DetermineErrorCode(TempString3, AuthClient2ServerPGN.ErrorCode);
    snprintf(TempString1, elcount(TempString1), "error code: %s", TempString3);
    DisplayLogString("Display", "TIMoutputwindow", AuthClient2ServerPGN.time, LogAlignClient, "ClientRandomChallengeResp", TempString1);
    
    @Authentication::Client::Random_received = 1;
    
    @Authentication::AuthDetail::ClientRandomChallResp = 1;
    
  }
  else if(0x0E == AuthClient2ServerPGN.AuthenticationType) //error
  {
    DisplayLogString("Display", "TIMoutputwindow", AuthClient2ServerPGN.time, LogAlignClient, "ClientRandomChallengeResp", "error");
  }
  else if(0x0F == AuthClient2ServerPGN.AuthenticationType) //n.a.
  {
    DisplayLogString("Display", "TIMoutputwindow", AuthClient2ServerPGN.time, LogAlignClient, "ClientRandomChallengeResp", "n.a.");
  }
}

void ProcessServerSignedChallengeReq(pg AUTH21 AuthClient2ServerPGN)
{
  if(0x00 == AuthClient2ServerPGN.AuthenticationType) //TIM authentication
  {
    DisplayLogString("Display", "TIMoutputwindow", AuthClient2ServerPGN.time, LogAlignClient, "ServerSignedChallengeReq", "");
    
    @Authentication::AuthDetail::ServerSignedChallReq = 1;

  }
  else if(0x0E == AuthClient2ServerPGN.AuthenticationType) //error
  {
    DisplayLogString("Display", "TIMoutputwindow", AuthClient2ServerPGN.time, LogAlignClient, "ServerSignedChallengeReq", "error");
  }
  else if(0x0F == AuthClient2ServerPGN.AuthenticationType) //n.a.
  {
    DisplayLogString("Display", "TIMoutputwindow", AuthClient2ServerPGN.time, LogAlignClient, "ServerSignedChallengeReq", "n.a.");
  }
}

void ProcessClientSignedChallengeResp(pg AUTH21 AuthClient2ServerPGN)
{
  if(0x00 == AuthClient2ServerPGN.AuthenticationType) //TIM authentication
  {
    DetermineErrorCode(TempString3, AuthClient2ServerPGN.ErrorCode);
    snprintf(TempString1, elcount(TempString1), " error code: %s", TempString3);
    DisplayLogString("Display", "TIMoutputwindow", AuthClient2ServerPGN.time, LogAlignClient, "ClientSignedChallengeResp", TempString1);
    
    @Authentication::AuthDetail::ClientSignedChallResp = 1;

  }
  else if(0x0E == AuthClient2ServerPGN.AuthenticationType) //error
  {
    DisplayLogString("Display", "TIMoutputwindow", AuthClient2ServerPGN.time, LogAlignClient, "ClientSignedChallengeResp", "error");
  }
  else if(0x0F == AuthClient2ServerPGN.AuthenticationType) //n.a.
  {
    DisplayLogString("Display", "TIMoutputwindow", AuthClient2ServerPGN.time, LogAlignClient, "ClientSignedChallengeResp", "n.a.");
  }
}

void ProcessClientAuthenticationInfo(pg AUTH21 AuthClient2ServerPGN)
{
  //hack: this values are not in DB: due to different position like in other mux values
  
  byte AuthType;
  byte AuthStatus;
  byte AuthSubstatus;
  byte CertType;
  byte CoupleStatus;
  byte TestLabValid;
  
  AuthType = ( (AuthClient2ServerPGN.byte(3) & 0xf0) >> 4);
  AuthStatus =  (AuthClient2ServerPGN.byte(3) & 0xf);
  AuthSubstatus = AuthClient2ServerPGN.byte(4);
  CertType = ( (AuthClient2ServerPGN.byte(5) & 0xf0) >> 4);
  CoupleStatus = (AuthClient2ServerPGN.byte(5) & 0xf);
  
  if(0x00 == AuthType) //TIM authentication
  {
    DetermineErrorCode(TempString2, AuthClient2ServerPGN.byte(2));
    DetermineAuthStatus(TempString3, AuthStatus,  sysvar::Authentication::AuthDetail::ClientCertResp_Testlab,
                                                  sysvar::Authentication::AuthDetail::ClientCertResp_Manu,
                                                  sysvar::Authentication::AuthDetail::ClientCertResp_ManuSeries,
                                                  sysvar::Authentication::AuthDetail::ClientCertResp_Device,
      
                                                  sysvar::Authentication::AuthDetail::ClientAcknowledgeStatus,
                                                  sysvar::Authentication::AuthDetail::ClientAcknowledgeAuthStatus,
      
                                                  sysvar::Authentication::Client::ServerStoredCerts,
                                                  DummyTimer);
    
    DetermineAuthSubStatus(TempString4, AuthStatus, AuthClient2ServerPGN.ReStartAuth, AuthClient2ServerPGN.LwAPossible, 
                           AuthClient2ServerPGN.TestlabCertIsValid,AuthClient2ServerPGN.ManufactCertIsValid, AuthClient2ServerPGN.ManufactSeriesCertIsValid, 
                           AuthClient2ServerPGN.DeviceCertIsValid, AuthClient2ServerPGN.ChallengeSigned,
                           
                           sysvar::Authentication::Client::Testlab_valid, 
                           sysvar::Authentication::Client::Manufacturer_valid,
                           sysvar::Authentication::Client::ManufacturerSeries_valid, 
                           sysvar::Authentication::Client::Device_valid,
                           sysvar::Authentication::Client::SignedChallenge_valid,    

                           sysvar::Authentication::AuthDetail::StartAuthReq,
                           sysvar::Authentication::AuthDetail::Client_LwA_Possible,
                           sysvar::Authentication::AuthDetail::RestartAuthReq,
                           sysvar::Authentication::AuthDetail::ClientAcknowledgeChallSigned,
                           DummyTimer, TIM_AuthStatus_Client_Timeoutval);
    
    DetermineCoupleStatus(TempString6, CoupleStatus);
    
    snprintf(TempString1, elcount(TempString1), "MsgCode: %X; errorCode: %s; authStatus: %s; authSubStatus: %s; certType: %s; coupleStatus: %s", 
                         AuthClient2ServerPGN.byte(0), TempString2, TempString3, TempString4, TempString5, TempString6);    
    DisplayLogString("Display", "TIMoutputwindow", AuthClient2ServerPGN.time, LogAlignClient, "ClientAuthenticationInfo", TempString1);
  }
  else if(0x0E == AuthType) //error
  {
    DisplayLogString("Display", "TIMoutputwindow", AuthClient2ServerPGN.time, LogAlignClient, "ClientAuthenticationInfo", "error");
  }
  else if(0x0F == AuthType) //n.a.
  {
    DisplayLogString("Display", "TIMoutputwindow", AuthClient2ServerPGN.time, LogAlignClient, "ClientAuthenticationInfo", "n.a.");
  }
}

void ProcessClientAuthenticationStatus(pg AUTH21 AuthClient2ServerPGN)
{
  byte TestlabValid;
  
  if(0x00 == AuthClient2ServerPGN.AuthenticationType) //TIM authentication
  {
    setTimer(Timer_ClientStatusMessage, TIM_AuthStatus_Client_Timeoutval);
    @Authentication::Client::StatusMsgTimeout = 0;
    
    DetermineErrorCode(TempString2, AuthClient2ServerPGN.ErrorCode);
    DetermineAuthStatus(TempString3, AuthClient2ServerPGN.AuthenticationStatus,
                                                  sysvar::Authentication::AuthDetail::ClientCertResp_Testlab,
                                                  sysvar::Authentication::AuthDetail::ClientCertResp_Manu,
                                                  sysvar::Authentication::AuthDetail::ClientCertResp_ManuSeries,
                                                  sysvar::Authentication::AuthDetail::ClientCertResp_Device,
      
                                                  sysvar::Authentication::AuthDetail::ClientAcknowledgeStatus,
                                                  sysvar::Authentication::AuthDetail::ClientAcknowledgeAuthStatus,
                                                  sysvar::Authentication::Client::ServerStoredCerts,
                                                  Timer_ClientStatusMessage);
    
    DetermineAuthSubStatus(TempString4, AuthClient2ServerPGN.AuthenticationStatus, AuthClient2ServerPGN.ReStartAuth, AuthClient2ServerPGN.LwAPossible, 
                           AuthClient2ServerPGN.TestlabCertIsValid,AuthClient2ServerPGN.ManufactCertIsValid, AuthClient2ServerPGN.ManufactSeriesCertIsValid, 
                           AuthClient2ServerPGN.DeviceCertIsValid, AuthClient2ServerPGN.ChallengeSigned,
                                                       sysvar::Authentication::Client::Testlab_valid, 
                                                       sysvar::Authentication::Client::Manufacturer_valid,
                                                       sysvar::Authentication::Client::ManufacturerSeries_valid,
                                                       sysvar::Authentication::Client::Device_valid,
                                                       sysvar::Authentication::Client::SignedChallenge_valid,
                                                      sysvar::Authentication::AuthDetail::StartAuthReq,
                                                      sysvar::Authentication::AuthDetail::Client_LwA_Possible,
                                                      sysvar::Authentication::AuthDetail::RestartAuthReq,
                                                      sysvar::Authentication::AuthDetail::ClientAcknowledgeChallSigned,
                                                      Timer_ClientStatusMessage, TIM_AuthStatus_Client_Timeoutval);
    
    // write("ErrorCode: %s; AuthStatus: %s; SubStatus %s", TempString2, TempString3, TempString4);
    snprintf(TempString1, elcount(TempString1), "MsgCode: %X; errorCode: %s; authStatus: %s; authSubStatus: %s", 
                         AuthClient2ServerPGN.byte(0), TempString2, TempString3, TempString4);    
    DisplayLogString("Display", "TIMoutputwindow", AuthClient2ServerPGN.time, LogAlignClient, "ClientAuthenticationStatus", TempString1);
  }
  else if(0x0E == AuthClient2ServerPGN.AuthenticationType) //error
  {
    DisplayLogString("Display", "TIMoutputwindow", AuthClient2ServerPGN.time, LogAlignClient, "ClientAuthenticationStatus", "error");
  }
  else if(0x0F == AuthClient2ServerPGN.AuthenticationType) //n.a.
  {
    DisplayLogString("Display", "TIMoutputwindow", AuthClient2ServerPGN.time, LogAlignClient, "ClientAuthenticationStatus", "n.a.");
  }
  
}

void ProcessClientStatusMsg(pg TIM21 Client2ServerPGN)
{
  byte LastClientStatus = 0xF;
  
  if( LastClientStatus != Client2ServerPGN.TIMClientState)
  {  
    LastClientStatus = Client2ServerPGN.TIMClientState;
       
    if( 0 == getSignalDescriptionForValue(TIM21::TIMClientState, Client2ServerPGN.TIMClientState, TempString1, elcount(TempString1)) )
    {
      ;
    }
    else
    {
      snprintf(TempString1, elcount(TempString1), "-");
    }
      
    DisplayLogString("Display", "TIMoutputwindow", Client2ServerPGN.time, LogAlignClient, "ClientState", TempString1);
  }

}

void PtoSpeedReqMsg(pg TIM21 Client2ServerPGN)
{
  word LastFrontPtoRequestedSpeed = 0x7D80;
  word LastRearPtoRequestedSpeed = 0x7D80;
  
  
  if(kMsgCodeS2_FuncID_FrontPto == Client2ServerPGN.GroupFunctionValue)     //front pto req.
  {
    if( LastFrontPtoRequestedSpeed != Client2ServerPGN.PTOSpeedRequest)
    {  
      LastFrontPtoRequestedSpeed = Client2ServerPGN.PTOSpeedRequest;
    
      if( 0 == getSignalDescriptionForValue(TIM21::PTOSpeedRequest, Client2ServerPGN.PTOSpeedRequest, TempString1, elcount(TempString1)) )
      {
        ;
      }
      else
      {
        snprintf(TempString1, elcount(TempString1), "-");
      }
         
      DisplayLogString("Display", "TIMoutputwindow", Client2ServerPGN.time, LogAlignServer, "FrontPtoRequest", TempString1);
    }
  }
  if(kMsgCodeS2_FuncID_RearPto == Client2ServerPGN.GroupFunctionValue)     //rear pto req.
  {
    if( LastRearPtoRequestedSpeed != Client2ServerPGN.PTOSpeedRequest)
    {  
      LastRearPtoRequestedSpeed = Client2ServerPGN.PTOSpeedRequest;
    
      if( 0 == getSignalDescriptionForValue(TIM21::PTOSpeedRequest, Client2ServerPGN.PTOSpeedRequest, TempString1, elcount(TempString1)) )
      {
        ;
      }
      else
      {
        snprintf(TempString1, elcount(TempString1), "-");
      }
      
      DisplayLogString("Display", "TIMoutputwindow", Client2ServerPGN.time, LogAlignServer, "RearPtoRequest", TempString1);
    }
  }
}


void ProcessSpeedReqMsg(pg TIM21 Client2ServerPGN)
{
  word LastSpeedRequestedSpeed = 0x7D80;
  
  if(kMsgCodeS2_FuncID_Speed == Client2ServerPGN.GroupFunctionValue)     //speeed control req.
  {
    if( LastSpeedRequestedSpeed != Client2ServerPGN.VehicleSpeedRequest)
    {  
      LastSpeedRequestedSpeed = Client2ServerPGN.VehicleSpeedRequest;
    
      if( 0 == getSignalDescriptionForValue(TIM21::VehicleSpeedRequest, Client2ServerPGN.VehicleSpeedRequest, TempString1, elcount(TempString1)) )
      {
        ;
      }
      else
      {
        snprintf(TempString1, elcount(TempString1), "-");
      }
         
      DisplayLogString("Display", "TIMoutputwindow", Client2ServerPGN.time, LogAlignServer, "SpeedRequest", TempString1);
    }
  }
}

/****************************************************************************
 * end: CLIENT sent PGNs
*****************************************************************************/



/****************************************************************************
 * begin: SERVER sent PGNs
*****************************************************************************/

void ProcessServerCertResp(pg AUTH12 AuthServer2ClientPGN)
{
  if(0x00 == AuthServer2ClientPGN.AuthenticationType) //TIM authentication
  {
    DetermineCertType(TempString2, AuthServer2ClientPGN.CertType, sysvar::Authentication::AuthDetail::ServerCertResp_Testlab,
                                                                          sysvar::Authentication::AuthDetail::ServerCertResp_Manu,
                                                                          sysvar::Authentication::AuthDetail::ServerCertResp_ManuSeries,
                                                                          sysvar::Authentication::AuthDetail::ServerCertResp_Device);
    DetermineErrorCode(TempString3, AuthServer2ClientPGN.ErrorCode);
    snprintf(TempString1, elcount(TempString1), "certType: %s; error code: %s", TempString2, TempString3);
    DisplayLogString("Display", "TIMoutputwindow", AuthServer2ClientPGN.time, LogAlignServer, "ServerCertResp", TempString1);
  }
  else if(0x0E == AuthServer2ClientPGN.AuthenticationType) //error
  {
    DisplayLogString("Display", "TIMoutputwindow", AuthServer2ClientPGN.time, LogAlignServer, "ServerCertResp", "error");
  }
  else if(0x0F == AuthServer2ClientPGN.AuthenticationType) //n.a.
  {
    DisplayLogString("Display", "TIMoutputwindow", AuthServer2ClientPGN.time, LogAlignServer, "ServerCertResp", "n.a.");
  }
}
 
void ProcessClientCertReq(pg AUTH12 AuthServer2ClientPGN)
{
  if(0x00 == AuthServer2ClientPGN.AuthenticationType) //TIM authentication
  {
    if(0x00 == AuthServer2ClientPGN.CertificateFormat)  //DER
    {
      DetermineCertType(TempString1, AuthServer2ClientPGN.CertType, sysvar::Authentication::AuthDetail::ClientCertReq_Testlab,
                                                                            sysvar::Authentication::AuthDetail::ClientCertReq_Manu,
                                                                            sysvar::Authentication::AuthDetail::ClientCertReq_ManuSeries,
                                                                            sysvar::Authentication::AuthDetail::ClientCertReq_Device);
      DisplayLogString("Display", "TIMoutputwindow", AuthServer2ClientPGN.time, LogAlignServer, "ClientCertReq", TempString1);
    }
  }
  else if(0x0E == AuthServer2ClientPGN.AuthenticationType) //error
  {
    DisplayLogString("Display", "TIMoutputwindow", AuthServer2ClientPGN.time, LogAlignServer, "ClientCertReq", "error");
  }
  else if(0x0F == AuthServer2ClientPGN.AuthenticationType) //n.a.
  {
    DisplayLogString("Display", "TIMoutputwindow", AuthServer2ClientPGN.time, LogAlignServer, "ClientCertReq", "n.a.");
  } 
}

void ProcessServerRandomChallengeResp(pg AUTH12 AuthServer2ClientPGN)
{
  if(0x00 == AuthServer2ClientPGN.AuthenticationType) //TIM authentication
  {
    DetermineErrorCode(TempString3, AuthServer2ClientPGN.ErrorCode);
    snprintf(TempString1, elcount(TempString1), "error code: %s", TempString3);
    DisplayLogString("Display", "TIMoutputwindow", AuthServer2ClientPGN.time, LogAlignServer, "ServerRandomChallengeResp", TempString1);
    
    @Authentication::Server::Random_received = 1;
    
    @Authentication::AuthDetail::ServerRandomChallResp = 1;

  }
  else if(0x0E == AuthServer2ClientPGN.AuthenticationType) //error
  {
    DisplayLogString("Display", "TIMoutputwindow", AuthServer2ClientPGN.time, LogAlignServer, "ServerRandomChallengeResp", "error");
  }
  else if(0x0F == AuthServer2ClientPGN.AuthenticationType) //n.a.
  {
    DisplayLogString("Display", "TIMoutputwindow", AuthServer2ClientPGN.time, LogAlignServer, "ServerRandomChallengeResp", "n.a.");
  }
}

void ProcessClientRandomChallengeReq(pg AUTH12 AuthServer2ClientPGN)
{
  if(0x00 == AuthServer2ClientPGN.AuthenticationType) //TIM authentication
  {
    DisplayLogString("Display", "TIMoutputwindow", AuthServer2ClientPGN.time, LogAlignServer, "ClientRandomChallengeReq", TempString1);
    
    @Authentication::AuthDetail::ClientRandomChallReq = 1;

  }
  else if(0x0E == AuthServer2ClientPGN.AuthenticationType) //error
  {
    DisplayLogString("Display", "TIMoutputwindow", AuthServer2ClientPGN.time, LogAlignServer, "ClientRandomChallengeReq", "error");
  }
  else if(0x0F == AuthServer2ClientPGN.AuthenticationType) //n.a.
  {
    DisplayLogString("Display", "TIMoutputwindow", AuthServer2ClientPGN.time, LogAlignServer, "ClientRandomChallengeReq", "n.a.");
  }
}

void ProcessServerSignedChallengeResp(pg AUTH12 AuthServer2ClientPGN)
{
  if(0x00 == AuthServer2ClientPGN.AuthenticationType) //TIM authentication
  {
    DetermineErrorCode(TempString3, AuthServer2ClientPGN.ErrorCode);
    snprintf(TempString1, elcount(TempString1), " error code: %s",  TempString3);
    DisplayLogString("Display", "TIMoutputwindow", AuthServer2ClientPGN.time, LogAlignServer, "ServerSignedChallengeResp", TempString1);
    
    @Authentication::AuthDetail::ServerSignedChallResp = 1;
        
  }
  else if(0x0E == AuthServer2ClientPGN.AuthenticationType) //error
  {
    DisplayLogString("Display", "TIMoutputwindow", AuthServer2ClientPGN.time, LogAlignServer, "ServerSignedChallengeResp", "error");
  }
  else if(0x0F == AuthServer2ClientPGN.AuthenticationType) //n.a.
  {
    DisplayLogString("Display", "TIMoutputwindow", AuthServer2ClientPGN.time, LogAlignServer, "ServerSignedChallengeResp", "n.a.");
  }
}

void ProcessClientSignedChallengeReq(pg AUTH12 AuthServer2ClientPGN)
{
  if(0x00 == AuthServer2ClientPGN.AuthenticationType) //TIM authentication
  {
    DisplayLogString("Display", "TIMoutputwindow", AuthServer2ClientPGN.time, LogAlignServer, "ClientSignedChallengeReq", "");
    
    @Authentication::AuthDetail::ClientSignedChallReq = 1;

  }
  else if(0x0E == AuthServer2ClientPGN.AuthenticationType) //error
  {
    DisplayLogString("Display", "TIMoutputwindow", AuthServer2ClientPGN.time, LogAlignServer, "ClientSignedChallengeReq", "error");
  }
  else if(0x0F == AuthServer2ClientPGN.AuthenticationType) //n.a.
  {
    DisplayLogString("Display", "TIMoutputwindow", AuthServer2ClientPGN.time, LogAlignServer, "ClientSignedChallengeReq", "n.a.");
  }
}

void ProcessServerAuthenticationInfo(pg AUTH12 AuthServer2ClientPGN)
{
  //hack: this values are not in DB: due to different position like in other mux values
  
  byte AuthType;
  byte AuthStatus;
  byte AuthSubstatus;
  byte CertType;
  byte CoupleStatus;
    
  AuthType = ( (AuthServer2ClientPGN.byte(3) & 0xf0) >> 4);
  AuthStatus =  (AuthServer2ClientPGN.byte(3) & 0xf);
  AuthSubstatus = AuthServer2ClientPGN.byte(4);
  CertType = ( (AuthServer2ClientPGN.byte(5) & 0xf0) >> 4);
  CoupleStatus = (AuthServer2ClientPGN.byte(5) & 0xf);
  
  
  if(0x00 == AuthType) //TIM authentication
  {
    DetermineErrorCode(TempString2, AuthServer2ClientPGN.byte(2));
    DetermineAuthStatus(TempString3, AuthStatus,  sysvar::Authentication::AuthDetail::ServerCertResp_Testlab,
                                                  sysvar::Authentication::AuthDetail::ServerCertResp_Manu,
                                                  sysvar::Authentication::AuthDetail::ServerCertResp_ManuSeries,
                                                  sysvar::Authentication::AuthDetail::ServerCertResp_Device,
      
                                                  sysvar::Authentication::AuthDetail::ServerAcknowledgeStatus,
                                                  sysvar::Authentication::AuthDetail::ServerAcknowledgeAuthStatus,
      
                                                  sysvar::Authentication::Server::ClientStoredCerts,
                                                  DummyTimer);
    
    DetermineAuthSubStatus(TempString4, AuthStatus, AuthServer2ClientPGN.ReStartAuth, AuthServer2ClientPGN.LwAPossible, 
                           AuthServer2ClientPGN.TestlabCertIsValid,AuthServer2ClientPGN.ManufactCertIsValid, AuthServer2ClientPGN.ManufactSeriesCertIsValid, 
                           AuthServer2ClientPGN.DeviceCertIsValid, AuthServer2ClientPGN.ChallengeSigned, 
                                                      sysvar::Authentication::Server::Testlab_valid, 
                                                      sysvar::Authentication::Server::Manufacturer_valid,
                                                      sysvar::Authentication::Server::ManufacturerSeries_valid, 
                                                      sysvar::Authentication::Server::Device_valid,
                                                      sysvar::Authentication::Server::SignedChallenge_valid,
                                                      sysvar::Authentication::AuthDetail::StartAuthResp,
                                                      sysvar::Authentication::AuthDetail::Server_LwA_Possible,
                                                      sysvar::Authentication::AuthDetail::RestartAuthResp,
                                                      sysvar::Authentication::AuthDetail::ServerAcknowledgeChallSigned,
                                                      DummyTimer, TIM_AuthStatus_Client_Timeoutval);

    //DetermineAuthCertType(TempString5, CertType);
    DetermineCoupleStatus(TempString6, CoupleStatus);
    
    snprintf(TempString1, elcount(TempString1), "MsgCode: %X; errorCode: %s; authStatus: %s; authSubStatus: %s; certType: %s; coupleStatus: %s", 
                         AuthServer2ClientPGN.byte(0), TempString2, TempString3, TempString4, TempString5, TempString6);    
    DisplayLogString("Display", "TIMoutputwindow", AuthServer2ClientPGN.time, LogAlignServer, "ServerAuthenticationInfo", TempString1);
  }
  else if(0x0E == AuthType) //error
  {
    DisplayLogString("Display", "TIMoutputwindow", AuthServer2ClientPGN.time, LogAlignServer, "ServerAuthenticationInfo", "error");
  }
  else if(0x0F == AuthType) //n.a.
  {
    DisplayLogString("Display", "TIMoutputwindow", AuthServer2ClientPGN.time, LogAlignServer, "ServerAuthenticationInfo", "n.a.");
  }
  
  //TODO: next authenticated clients not processed
}

void ProcessServerAuthenticationStatus(pg AUTH12 AuthServer2ClientPGN)
{
  if(0x00 == AuthServer2ClientPGN.AuthenticationType) //TIM authentication
  {
    setTimer(Timer_ServerStatusMessage, TIM_AuthStatus_Server_Timeoutval);
    @Authentication::Server::StatusMsgTimeout = 0;
    
    DetermineErrorCode(TempString2, AuthServer2ClientPGN.ErrorCode);
    DetermineAuthStatus(TempString3, AuthServer2ClientPGN.AuthenticationStatus,
                                                  sysvar::Authentication::AuthDetail::ServerCertResp_Testlab,
                                                  sysvar::Authentication::AuthDetail::ServerCertResp_Manu,
                                                  sysvar::Authentication::AuthDetail::ServerCertResp_ManuSeries,
                                                  sysvar::Authentication::AuthDetail::ServerCertResp_Device,
      
                                                  sysvar::Authentication::AuthDetail::ServerAcknowledgeStatus,
                                                  sysvar::Authentication::AuthDetail::ServerAcknowledgeAuthStatus,
      
                                                  sysvar::Authentication::Server::ClientStoredCerts,
                                                  Timer_ServerStatusMessage);
    
    DetermineAuthSubStatus(TempString4, AuthServer2ClientPGN.AuthenticationStatus, AuthServer2ClientPGN.ReStartAuth, AuthServer2ClientPGN.LwAPossible, 
                           AuthServer2ClientPGN.TestlabCertIsValid,AuthServer2ClientPGN.ManufactCertIsValid, AuthServer2ClientPGN.ManufactSeriesCertIsValid, 
                           AuthServer2ClientPGN.DeviceCertIsValid, AuthServer2ClientPGN.ChallengeSigned,
                                                       sysvar::Authentication::Server::Testlab_valid, 
                                                       sysvar::Authentication::Server::Manufacturer_valid,
                                                       sysvar::Authentication::Server::ManufacturerSeries_valid,
                                                       sysvar::Authentication::Server::Device_valid,
                                                       sysvar::Authentication::Server::SignedChallenge_valid,
                                                      sysvar::Authentication::AuthDetail::StartAuthResp,
                                                      sysvar::Authentication::AuthDetail::Server_LwA_Possible,
                                                      sysvar::Authentication::AuthDetail::RestartAuthResp,
                                                      sysvar::Authentication::AuthDetail::ServerAcknowledgeChallSigned,
                                                      Timer_ServerStatusMessage, TIM_AuthStatus_Server_Timeoutval);
    
    snprintf(TempString1, elcount(TempString1), "MsgCode: %X; errorCode: %s; authStatus: %s; authSubStatus: %s", 
                         AuthServer2ClientPGN.byte(0), TempString2, TempString3, TempString4);    
    DisplayLogString("Display", "TIMoutputwindow", AuthServer2ClientPGN.time, LogAlignServer, "ServerAuthenticationStatus", TempString1);
    
    if(@sysvar::Authentication::AuthDetail::StartAuthReq == 1 &&
       @sysvar::Authentication::AuthDetail::StartAuthResp == 1 &&
       @sysvar::Authentication::AuthDetail::RestartAuthReq == 0 &&
       @sysvar::Authentication::AuthDetail::RestartAuthResp == 0)
    {
      // Both Client and Server set (Re)Start Authentication bit
      // Determine whether LwA or FwA will be performed
      if(@sysvar::Authentication::AuthDetail::Client_LwA_Possible == 1 &&
         @sysvar::Authentication::AuthDetail::Server_LwA_Possible == 1)
      {
        @sysvar::Authentication::AuthDetail::LwA = 1;
        DisplayLogString("Display", "TIMoutputwindow", AuthServer2ClientPGN.time, LogAlignServer, "ServerAuthenticationStatus", "Authentication type: LwA");
      }
      else
      {
        @sysvar::Authentication::AuthDetail::LwA = 0;
        DisplayLogString("Display", "TIMoutputwindow", AuthServer2ClientPGN.time, LogAlignServer, "ServerAuthenticationStatus", "Authentication type: FwA");
      }
    }
  }
  else if(0x0E == AuthServer2ClientPGN.AuthenticationType) //error
  {
    DisplayLogString("Display", "TIMoutputwindow", AuthServer2ClientPGN.time, LogAlignServer, "ServerAuthenticationStatus", "error");
  }
  else if(0x0F == AuthServer2ClientPGN.AuthenticationType) //n.a.
  {
    DisplayLogString("Display", "TIMoutputwindow", AuthServer2ClientPGN.time, LogAlignServer, "ServerAuthenticationStatus", "n.a.");
  }
  
}


void ProcessServerStatusMsg(pg TIM12 Server2ClientPGN)
{
  byte LastServerState = 0xF;  
  byte LastSystemState  = 0xF;
  byte LastSystemOperationState  = 0xF;
  
  if( LastServerState != Server2ClientPGN.TIMServerState)
  {  
    LastServerState = Server2ClientPGN.TIMServerState;
    //State// @Server::State = Server2ClientPGN.TIMServerState;
    
    if( 0 == getSignalDescriptionForValue(TIM12::TIMServerState, Server2ClientPGN.TIMServerState, TempString1, elcount(TempString1)) )
    {
      ;
    }
    else
    {
      snprintf(TempString1, elcount(TempString1), "-");
    }
    //State// sysSetVariableString(sysvar::Server::StateString, TempString1);
       
    DisplayLogString("Display", "TIMoutputwindow", Server2ClientPGN.time, LogAlignServer, "ServerState", TempString1);
  } 
  
  if( LastSystemState != Server2ClientPGN.TIMSystemState)
  {  
    LastSystemState = Server2ClientPGN.TIMSystemState;
    //State// @System::State = Server2ClientPGN.TIMSystemState;
    
    if( 0 == getSignalDescriptionForValue(TIM12::TIMSystemState, Server2ClientPGN.TIMSystemState, TempString1, elcount(TempString1)) )
    {
      ;
    }
    else
    {
      snprintf(TempString1, elcount(TempString1), "-");
    }
    //State// sysSetVariableString(sysvar::System::StateString, TempString1);
       
    DisplayLogString("Display", "TIMoutputwindow", Server2ClientPGN.time, LogAlignServer, "SystemState", TempString1);
  } 
  
  
  if( LastSystemOperationState != Server2ClientPGN.TIMSystemOperationState)
  {  
    LastSystemOperationState = Server2ClientPGN.TIMSystemOperationState;
    //State// @System::StationaryOpState = Server2ClientPGN.TIMSystemStationaryOpState;
    
    if( 0 == getSignalDescriptionForValue(TIM12::TIMSystemOperationState, Server2ClientPGN.TIMSystemOperationState, TempString1, elcount(TempString1)) )
    {
      ;
    }
    else
    {
      snprintf(TempString1, elcount(TempString1), "-");
    }
    //State// sysSetVariableString(sysvar::System::StationaryOpStateString, TempString1);
       
    DisplayLogString("Display", "TIMoutputwindow", Server2ClientPGN.time, LogAlignServer, "SystemOperationState", TempString1);
  } 
}


void ProcessPtoStatusMsg(pg TIM12 Server2ClientPGN)
{
  byte LastFrontPtoState = 0xF;
  byte LastRearPtoState = 0xF;
  word LastFrontPtoExitReasonCode = 0x1F;
  word LastRearPtoExitReasonCode = 0x1F;
  word LastFrontPtoActSpeed = 0x7D80;
  word LastRearPtoActSpeed = 0x7D80;
  
  if(kMsgCodeS2_FuncID_FrontPto == Server2ClientPGN.GroupFunctionValue)     //front pto status
  {
    if( LastFrontPtoState != Server2ClientPGN.AutomationStatus)
    {  
      LastFrontPtoState = Server2ClientPGN.AutomationStatus;
      //Function// @Function::FrontPtoControl::AutomationState = Server2ClientPGN.AutomationStatus;
    
      if( 0 == getSignalDescriptionForValue(TIM12::AutomationStatus, Server2ClientPGN.AutomationStatus, TempString1, elcount(TempString1)) )
      {
        ;
      }
      else
      {
        snprintf(TempString1, elcount(TempString1), "-");
      }
      //Function//sysSetVariableString(sysvar::Function::FrontPtoControl::AutomationStateString, TempString1);
         
      DisplayLogString("Display", "TIMoutputwindow", Server2ClientPGN.time, LogAlignServer, "FrontPtoAutomationState", TempString1);
    } 
    
    if( LastFrontPtoExitReasonCode != Server2ClientPGN.PTOExitReasonCode)
    {  
      LastFrontPtoExitReasonCode = Server2ClientPGN.PTOExitReasonCode;
      //Function//@Function::FrontPtoControl::ExitReasonCode = Server2ClientPGN.PTOExitReasonCode;
    
      if( 0 == getSignalDescriptionForValue(TIM12::PTOExitReasonCode, Server2ClientPGN.PTOExitReasonCode, TempString1, elcount(TempString1)) )
      {
        ;
      }
      else
      {
        snprintf(TempString1, elcount(TempString1), "-");
      }
      //Function//sysSetVariableString(sysvar::Function::FrontPtoControl::ExitReasonCodeString, TempString1);
         
      DisplayLogString("Display", "TIMoutputwindow", Server2ClientPGN.time, LogAlignServer, "FrontPtoExitReasonCode", TempString1);
    }
    
    if( LastFrontPtoActSpeed != Server2ClientPGN.PTOSpeed)
    {  
      LastFrontPtoActSpeed = Server2ClientPGN.PTOSpeed;
      //Function//@Function::FrontPtoControl::Speed = Server2ClientPGN.PTOSpeed;
    
      if( 0 == getSignalDescriptionForValue(TIM12::PTOSpeed, Server2ClientPGN.PTOSpeed, TempString1, elcount(TempString1)) )
      {
        ;
      }
      else
      {
        snprintf(TempString1, elcount(TempString1), "-");
      }
      //Function//sysSetVariableString(sysvar::Function::FrontPtoControl::SpeedString, TempString1);
         
      DisplayLogString("Display", "TIMoutputwindow", Server2ClientPGN.time, LogAlignServer, "FrontPtoSpeed", TempString1);
    }
    
  }
  else if(kMsgCodeS2_FuncID_RearPto == Server2ClientPGN.GroupFunctionValue)  //rear pto status
  {
    if( LastRearPtoState != Server2ClientPGN.AutomationStatus)
    {  
      LastRearPtoState = Server2ClientPGN.AutomationStatus;
      //Function//@Function::RearPtoControl::AutomationState = Server2ClientPGN.AutomationStatus;
    
      if( 0 == getSignalDescriptionForValue(TIM12::AutomationStatus, Server2ClientPGN.AutomationStatus, TempString1, elcount(TempString1)) )
      {
        ;
      }
      else
      {
        snprintf(TempString1, elcount(TempString1), "-");
      }
      //Function//sysSetVariableString(sysvar::Function::RearPtoControl::AutomationStateString, TempString1);
         
      DisplayLogString("Display", "TIMoutputwindow", Server2ClientPGN.time, LogAlignServer, "RearPtoAutomationState", TempString1);
    }
    
    if( LastRearPtoExitReasonCode != Server2ClientPGN.PTOExitReasonCode)
    {  
      LastRearPtoExitReasonCode = Server2ClientPGN.PTOExitReasonCode;
      //Function//@Function::RearPtoControl::ExitReasonCode = Server2ClientPGN.PTOExitReasonCode;
    
      if( 0 == getSignalDescriptionForValue(TIM12::PTOExitReasonCode, Server2ClientPGN.PTOExitReasonCode, TempString1, elcount(TempString1)) )
      {
        ;
      }
      else
      {
        snprintf(TempString1, elcount(TempString1), "-");
      }
      //Function//sysSetVariableString(sysvar::Function::RearPtoControl::ExitReasonCodeString, TempString1);
         
      DisplayLogString("Display", "TIMoutputwindow", Server2ClientPGN.time, LogAlignServer, "RearPtoExitReasonCode", TempString1);
    }
    
    if( LastRearPtoActSpeed != Server2ClientPGN.PTOSpeed)
    {  
      LastRearPtoActSpeed = Server2ClientPGN.PTOSpeed;
      //Function//@Function::RearPtoControl::Speed = Server2ClientPGN.PTOSpeed;
    
      if( 0 == getSignalDescriptionForValue(TIM12::PTOSpeed, Server2ClientPGN.PTOSpeed, TempString1, elcount(TempString1)) )
      {
        ;
      }
      else
      {
        snprintf(TempString1, elcount(TempString1), "-");
      }
      //Function//sysSetVariableString(sysvar::Function::RearPtoControl::SpeedString, TempString1);
         
      DisplayLogString("Display", "TIMoutputwindow", Server2ClientPGN.time, LogAlignServer, "RearPtoSpeed", TempString1);
    }
  }
}


void ProcessSpeedStatusMsg(pg TIM12 Server2ClientPGN)
{
  byte LastSpeedState = 0xF;
  word LastSpeedExitReasonCode = 0x1F;
  word LastSpeedActSpeed = 0x7D80;
  
  if(kMsgCodeS2_FuncID_Speed == Server2ClientPGN.GroupFunctionValue)     //speeed control status
  {
    if( LastSpeedState != Server2ClientPGN.AutomationStatus)
    {  
      LastSpeedState = Server2ClientPGN.AutomationStatus;
      //Function// @Function::SpeedControl::AutomationState = Server2ClientPGN.TIMVehicleSpeedAutomationStatus;
    
      if( 0 == getSignalDescriptionForValue(TIM12::AutomationStatus, Server2ClientPGN.AutomationStatus, TempString1, elcount(TempString1)) )
      {
        ;
      }
      else
      {
        snprintf(TempString1, elcount(TempString1), "-");
      }
      //Function// sysSetVariableString(sysvar::Function::SpeedControl::AutomationStateString, TempString1);
         
      DisplayLogString("Display", "TIMoutputwindow", Server2ClientPGN.time, LogAlignServer, "SpeedAutomationState", TempString1);
    }
    
    if( LastSpeedExitReasonCode != Server2ClientPGN.SpeedExitReasonCode)
    {  
      LastSpeedExitReasonCode = Server2ClientPGN.SpeedExitReasonCode;
      //Function// @Function::SpeedControl::ExitReasonCode = Server2ClientPGN.TIMVehicleSpeedExitReasonCode;
    
      if( 0 == getSignalDescriptionForValue(TIM12::SpeedExitReasonCode, Server2ClientPGN.SpeedExitReasonCode, TempString1, elcount(TempString1)) )
      {
        ;
      }
      else
      {
        snprintf(TempString1, elcount(TempString1), "-");
      }
      //Function// sysSetVariableString(sysvar::Function::SpeedControl::ExitReasonCodeString, TempString1);
         
      DisplayLogString("Display", "TIMoutputwindow", Server2ClientPGN.time, LogAlignServer, "SpeedExitReasonCode", TempString1);
    }
    
    if( LastSpeedActSpeed != Server2ClientPGN.VehicleSpeed)
    {  
      LastSpeedActSpeed = Server2ClientPGN.VehicleSpeed;
      //Function// @Function::SpeedControl::Speed = Server2ClientPGN.TIMVehicleSpeedSpeed;
    
      if( 0 == getSignalDescriptionForValue(TIM12::VehicleSpeed, Server2ClientPGN.VehicleSpeed, TempString1, elcount(TempString1)) )
      {
        ;
      }
      else
      {
        snprintf(TempString1, elcount(TempString1), "-");
      }
      //Function// sysSetVariableString(sysvar::Function::SpeedControl::SpeedString, TempString1);
         
      DisplayLogString("Display", "TIMoutputwindow", Server2ClientPGN.time, LogAlignServer, "Speed", TempString1);
    }
    
  }
}


/****************************************************************************
 * end: SERVER sent PGNs
*****************************************************************************/


on timer Timer_ClientStatusMessage
{
  DisplayLogString("Display", "TIMoutputwindow", timeNow(), LogAlignClient, "ClientStatusMessageTimeout", " occured");
  @Authentication::Client::StatusMsgTimeout = 1;
}

on timer Timer_ServerStatusMessage
{
  DisplayLogString("Display", "TIMoutputwindow", timeNow(), LogAlignServer, "ServerStatusMessageTimeout", " occured");
  @Authentication::Server::StatusMsgTimeout = 1;
}

on timer DummyTimer
{
  //do nothing
}


//dword Iso11783AppRxIndication( LONG ecuHdl, LONG srcAddr, LONG dstAddr, LONG len, LONG pgNumber)
//{
//  return 0;
//}
//
//dword Iso11783AppErrorIndication( LONG ecuHdl, LONG errClass, LONG errNum, LONG addCode )
//{
//  return 0;
//}
//
//dword Iso11783AppRequestIndication( LONG ecuHdl, LONG source, LONG dest, LONG page, LONG pgNum )
//{
//  return 0;
//}
//
//dword Iso11783AppAddrClaimed( LONG ecuHandle )
//{
//  return 0;
//}
//
//dword Iso11783AppCmdAddrIndication( LONG ecuHandle, LONG length)
//{
//  return 0;
//}
//
//dword Iso11783AppTxIndication( LONG ecuHdl, LONG txPG, LONG source, LONG dest )
//{
//  return 0;
//}
//
//dword Iso11783AppNmtIndication( LONG busHandle, LONG address, LONG flag )
//{
//  return 0;
//}


