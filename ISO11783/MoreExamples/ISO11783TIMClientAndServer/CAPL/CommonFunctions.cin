/*@!Encoding:1252*/
includes
{

}

variables
{
}

void UpdateTextColor(char panel[], char control[], int facilityRequired)
{
  long green, red, black;
  green = MakeRGB(0, 150, 0);
  red = MakeRGB(255, 0, 0);
  black = MakeRGB(0, 0, 0);
  
  if(facilityRequired == 1)
    setControlForeColor(panel, control, green);
  else
    setControlForeColor(panel, control, black);
}

void UpdateTextColor2(char panel1[], char panel2[], char control[], int facilityRequired)
{
  long green, red, black;
  green = MakeRGB(0, 150, 0);
  red = MakeRGB(255, 0, 0);
  black = MakeRGB(0, 0, 0);
  
  if(facilityRequired == 1)
  {
    setControlForeColor(panel1, control, green);
    setControlForeColor(panel2, control, green);
  }
  else
  {
    setControlForeColor(panel1, control, black);
    setControlForeColor(panel1, control, black);
  }
}

void ResetTextColor(char panel[], char control[])
{
  setDefaultControlColors(panel, control);
}

void ResetTextColor(char panel1[], char panel2[], char control[])
{
  setDefaultControlColors(panel1, control);
  setDefaultControlColors(panel2, control);
}

void ActivateControlColors(char panel[], char control[])
{
  long green, white;
  green = MakeRGB(0, 150, 0);
  white = MakeRGB(255, 255, 255);
  
  setControlColors(panel, control, green, white);
}

void ActivateControlColors2(char panel1[], char panel2[], char control[])
{
  long green, white;
  green = MakeRGB(0, 150, 0);
  white = MakeRGB(255, 255, 255);
  
  setControlColors(panel1, control, green, white);
  setControlColors(panel1, control, green, white);
}

void ResetControlColors(char panel[], char control[])
{
  setDefaultControlColors(panel, control);
}

void ResetControlColors2(char panel1[], char panel2[], char control[])
{
  setDefaultControlColors(panel1, control);
  setDefaultControlColors(panel2, control);
}



