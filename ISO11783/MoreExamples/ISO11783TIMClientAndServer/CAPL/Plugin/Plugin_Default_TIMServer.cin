/*@!Encoding:1252*/
includes
{
  
}

variables
{
 
}

////////////////////////////////////////////////////////
//            Iso Callbacks                           //
////////////////////////////////////////////////////////

// callback
void Iso11783IL_OnError( long errorCode, long param )
{

}

// callback
void Iso11783IL_TIMOnError(long errorCode, dword param ) 
{
   
}

////////////////////////////////////////////////////////
//            Plugin Functions                        //
////////////////////////////////////////////////////////

byte Plugin_ServerIsConfiguredFromCT() 
{
  
  return 0;
}

void Plugin_OnStart()
{
  
}

void Plugin_StartServer()
{
 
}

void Plugin_StopServer()
{

}

void Plugin_DefaultPreparationSequence()
{

}



long Plugin_TxPrepareForTests(pg * txPG)
{
  
  return 1;
  
}

long Plugin_RxReceiveForTests(pg * rxPG) 
{ 
  
  return 1;
}



