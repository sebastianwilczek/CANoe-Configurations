/*@!Encoding:1252*/
includes
{
}

variables
{
}

////////////////////////////////////////////////////////
//            ISO11783 IL Callbacks                   //
////////////////////////////////////////////////////////

// callback
void Iso11783IL_OnError( long errorCode, long param )
{
}

// callback
void Iso11783IL_TIMOnError(long errorCode, dword param ) 
{
}

////////////////////////////////////////////////////////
//              Plugin Functions                      //
////////////////////////////////////////////////////////

void Plugin_OnStart()
{
  // called if the measurement is started 
}

void Plugin_StartClient()
{
  // called if TIM client is started 
}

void Plugin_StopClient()
{
  // called if TIM client is stopped 
}

long Plugin_OnTxPrepare(pg * txPG)
{  
  // called before the TIM client sends a message (see Iso11783IL_OnTxPrepare).
  
  return 1; // 1: send message
}

long Plugin_OnRxMessage(pg * rxPG) 
{
  // called if TIM client receives a message (see Iso11783IL_OnRxMessage).

  return 1; // 1: Received message will be processed by the TIM client
}

