/*@!Encoding:1252*/
includes
{
}

variables
{
}

////////////////////////////////////////////////////////
//            ISO11783 IL Callbacks                   //
////////////////////////////////////////////////////////

// callback
void Iso11783IL_OnError( long errorCode, long param )
{
}

// callback
void Iso11783IL_TIMOnError(long errorCode, dword param ) 
{
}

////////////////////////////////////////////////////////
//              Plugin Functions                      //
////////////////////////////////////////////////////////

byte Plugin_ServerIsConfiguredByPlugin() 
{
  // here you can if configure the supported TIM functions
  
  return 0; // 0: if plugin does not configure the supported functions
}

void Plugin_OnStart()
{ 
  // called if the measurement is started 
}

void Plugin_StartServer()
{
  // called if TIM server is started 
}

void Plugin_StopServer()
{
  // called if TIM server is stopped 
}

void Plugin_DefaultPreparationSequence()
{
}

long Plugin_OnTxPrepare(pg * txPG)
{
  // called before the TIM server sends a message (see Iso11783IL_OnTxPrepare).
  
  return 1; // 1: send message
}

long Plugin_OnRxMessage(pg * rxPG) 
{
  // called if TIM server receives a message (see Iso11783IL_OnRxMessage).

  return 1; // 1: Received message will be processed by the TIM server
}

