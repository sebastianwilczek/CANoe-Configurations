/*@@var:*/
variables
{
}
/*@@end*/

/*@@pg:*:*/
on pg *
{
  // block all messages
}
/*@@end*/

/*@@pg:CAN1.ISO11783::VT21 (0xE7FEFEX):*/
on pg VT21
{
  switch (this.byte(0)) {
    case 0x23: // block Auxiliary Input Maintenance message
      break;   
    case 0xff: // block Maintenance message
      break;
    default:
      output(this); // transmit all other messages
      break;
  }
}
/*@@end*/

/*@@pg:CAN1.ISO11783::VT12 (0xE6FEFEX):*/
on pg VT12
{
  switch (this.byte(0)) {
    case 0xfe: // block VT status message
      break;
    default:
      output(this); // transmit all other messages
      break;
  }
}
/*@@end*/

