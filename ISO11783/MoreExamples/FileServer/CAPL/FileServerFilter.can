/*@!Encoding:1252*/
/*
 * Version 2.0
 *
 * Copyright 2019 - Vector Informatik GmbH
 *
 * This CAPL programm filters the File Server maintenance and status messages
 *
 */
variables
{
  qword gLastServerStatus[256];       // Stores the content of the last File Server Status messages
  qword gLastClientMaintenance[256];  // Stores the content of the last File Server Client Connecton Maintenance messages

}

on pg *
{
  output( this );
}

on preStart
{
  int number;
  for (number=0; number<256; ++number)
  {
    gLastServerStatus[number] = 0xFFFFFFFFFFFFFFFFLL;
    gLastClientMaintenance[number] = 0xFFFFFFFFFFFFFFFFLL;
  }
}

on pg FSC
{
  if (this.FSServerCommand == FSC.FSServerCommand::FileServerStatus) 
  {
    if(this.qword(0) == gLastServerStatus[this.sa])
    {
      return;
    }
    gLastServerStatus[this.sa] = this.qword(0);
  }
  
  output( this );
}

on pg CFS
{
  if (this.FSClientCommand == CFS.FSClientCommand::ConnectionMaintenance) 
  {
    if(this.qword(0) == gLastClientMaintenance[this.sa])
    {
      return;
    }
    gLastClientMaintenance[this.sa] = this.qword(0);
  }

  output( this );
}

