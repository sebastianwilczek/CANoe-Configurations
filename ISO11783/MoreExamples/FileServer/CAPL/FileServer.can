/*@!Encoding:1252*/
/*
 * Version 2.0
 *
 * Copyright 2019 - Vector Informatik GmbH
 *
 * This CAPL model simulates a File Server (ISO11783 Part 13)
 *
 */

includes
{
  #include "..\CAPL\FileServerCommon.cin"
}

variables
{
  const int kMaxClient = 5; // Max. number of clients

  int gClientAddresses[long, kMaxClient]; // Address of the client
  int gDbgLevel = kDbgWarning;            // Set debug level for output to write window
}

on preStart
{
  setWriteDbgLevel( gDbgLevel );
  
  FSIL_ControlInit(); // prevents automatic start of File Server
  
  // set File Server properties
  FSIL_SetNodeProperty("fsVersion", kVersionSecondIS);
  FSIL_SetNodeProperty("rootDirectory", "FSRoot");  
  FSIL_SetNodeProperty("primaryVolume", "VOLUME");
  FSIL_SetNodeProperty("supportsLongFilenames", 1);
  FSIL_SetNodeProperty("autoDeleteRoot", 0);
  
  InitializeClientIndizies();
  ResetPanel();
}

on start
{
  FSIL_ControlStart();
}

on stopMeasurement
{
  FSIL_ControlStop();
}

///////////////////////////////////////////////////////////////
// Callbacks
///////////////////////////////////////////////////////////////

// called if a client opened or closed a file or directory
void FSIL_OnNumberOfOpenFilesChanged(dword clientAddress, dword numberOfOpenFiles)
{
  int index;
   
  index = GetClientIndex(clientAddress);
  switch (index)
  {
    case 0:
      @FileServer::Client1OpenFileCount = numberOfOpenFiles;
      break;
    case 1:
      @FileServer::Client2OpenFileCount = numberOfOpenFiles;
      break;
    case 2:
      @FileServer::Client3OpenFileCount = numberOfOpenFiles;
      break;
    case 3:
      @FileServer::Client4OpenFileCount = numberOfOpenFiles;
      break;
    case 4:
      @FileServer::Client5OpenFileCount = numberOfOpenFiles;
      break;
    default:
      break;
  }   
}

// called if a client changed the current directory
void FSIL_OnCurrentDirectoryChanged(dword clientAddress, char currentDirectory[])
{
  int index;
  index = GetClientIndex(clientAddress);
  switch (index)
  {
    case 0:
      @FileServer::Client1Address = clientAddress;
      sysSetVariableString(sysvar::FileServer::Client1CurrentDirectory, currentDirectory);
      break;
    case 1:
      @FileServer::Client2Address = clientAddress;
      sysSetVariableString(sysvar::FileServer::Client2CurrentDirectory, currentDirectory);
      break;
    case 2:
      @FileServer::Client3Address = clientAddress;
      sysSetVariableString(sysvar::FileServer::Client3CurrentDirectory, currentDirectory);
      break;
    case 3:
      @FileServer::Client4Address = clientAddress;
      sysSetVariableString(sysvar::FileServer::Client4CurrentDirectory, currentDirectory);
      break;
    case 4:
      @FileServer::Client5Address = clientAddress;
      sysSetVariableString(sysvar::FileServer::Client5CurrentDirectory, currentDirectory);
      break;
    default:
      break;
  }   
}

///////////////////////////////////////////////////////////////
// Functions
///////////////////////////////////////////////////////////////

void InitializeClientIndizies()
{
  int index;
  for (index = 0; index < kMaxClient; ++index)
  {
    gClientAddresses[index] = kNullAddr;
  } 
}

int GetClientIndex(byte clientAddress)
{
  int index;
  int nextIndex;
  long address;
  
  nextIndex = -1;
  for (index = 0; index < kMaxClient; ++index)
  {
    address = gClientAddresses[index];
    if (address == clientAddress)
    {
      // ok, address is already in the associative field
      return index;
    }
    else if ((address == kNullAddr) && (nextIndex < 0))
    {
      nextIndex = index;
    }
  } 
  
  // add new address
  if (nextIndex >= 0)
  {
    gClientAddresses[nextIndex] = clientAddress;
  }
  return nextIndex; // return either a free index or -1 if no index is free
}

void ResetPanel()
{
  @FileServer::Client1Address = kNullAddr;
  @FileServer::Client1OpenFileCount = 0;
  sysSetVariableString(sysvar::FileServer::Client1CurrentDirectory, "");

  @FileServer::Client2Address = kNullAddr;
  @FileServer::Client2OpenFileCount = 0;
  sysSetVariableString(sysvar::FileServer::Client2CurrentDirectory, "");

  @FileServer::Client3Address = kNullAddr;
  @FileServer::Client3OpenFileCount = 0;
  sysSetVariableString(sysvar::FileServer::Client3CurrentDirectory, "");

  @FileServer::Client4Address = kNullAddr;
  @FileServer::Client4OpenFileCount = 0;
  sysSetVariableString(sysvar::FileServer::Client4CurrentDirectory, "");

  @FileServer::Client5Address = kNullAddr;
  @FileServer::Client5OpenFileCount = 0;
  sysSetVariableString(sysvar::FileServer::Client5CurrentDirectory, "");
}


