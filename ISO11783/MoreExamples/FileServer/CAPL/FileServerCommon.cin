/*@!Encoding:1252*/

variables
{
  // ISO11783 address constants
  const BYTE kNullAddr           = 0xfe;   // Null address
  const BYTE kGlobalAddr         = 0xff;   // Global address
  
  // CAPL function constants
  const LONG kSuccess            = 0;      // Function was executed successfully
  
  // File path constants
  const int kMaxPath             = 256;    // Max. size of a path

  // Debugging constants
  enum Severity
  {
    kDbgQuiet   = 0,
    kDbgError   = 1,
    kDbgWarning = 5,
    kDbgInfo    = 10
  };
  
  // File Server version
  enum FSVersion
  {
    kVersionFirstIS  = 2,
    kVersionSecondIS = 3
  };

  // ISO11783 IL constants
  enum ClientState
  {
    kInitialized     = 0,      // State: not connected
    kClaiming        = 1,      // State: ECU is claiming an address
    kActive          = 2,      // State: operational
    kStopped         = 3,      // State: operational
    kSuspended       = 4       // State: operational
  };

  // FS Client specific constants
  enum RequestState
  {
    kNoRequestInProcess = 0,
    kRequestSending     = 1,
    kWaitingForResponse = 2
  };  
  
  // File Server Functions
  enum VFSFunction
  {
    kServerStatusOrClientMaintenance = 0,
    kGetFileServerProperties = 1,
    kVolumeStatus = 2,
    kGetCurrentDirectory = 16,
    kChangeCurrentDirectory = 17,
    kOpenFile = 32,
    kSeekFile = 33,
    kReadFile = 34,
    kWriteFile = 35,
    kCloseFile = 36,
    kMoveFile = 48,
    kDeleteFile = 49,
    kGetFileAttributes = 50,
    kSetFileAttributes = 51,
    kGetFileDateTime = 52,
    kInitializeVolume = 64
  };

}