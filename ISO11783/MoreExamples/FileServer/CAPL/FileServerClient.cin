/*@!Encoding:1252*/
/*
 * Version 2.0
 *
 * Copyright 2019 - Vector Informatik GmbH
 *
 * This CAPL model contains functions which can be used by a File Server Client ECU (ISO11783 Part 13)
 *
*/

