/*@!Encoding:1252*/
includes
{
}

variables
{
  msTimer mMoveTimer;
  int mVTFunctionInstance;
}

on start
{
  // transfer object pool to the preferred Virtual Terminal (default: function instance 0)
  mVTFunctionInstance = getProfileInt("PreferredVT", "VTFunctionInstance", 0, "Implement.ini");
  Iso11783IL_OPSetProperty("version", 5);
  Iso11783IL_OPLoad( "IOP\\MoveToAnotherVT.iop" );
  Iso11783IL_OPSetProperty( "VTFunctionInstance", mVTFunctionInstance );
}

on timer mMoveTimer
{
  // transfer object pool to the next Virtual Terminal
  mVTFunctionInstance = (mVTFunctionInstance < 2) ? ++mVTFunctionInstance : 0;
  Iso11783IL_OPSetProperty( "VTFunctionInstance", mVTFunctionInstance );
  Iso11783IL_OPActivate();
  
  // save the new Virtual Terminal as the preferred VT for a next power cycle
  writeProfileInt ("PreferredVT", "VTFunctionInstance", mVTFunctionInstance, "Implement.ini"); 
}

void Iso11783IL_OPOnKeyActivation( dword objectID, dword parentID, dword keyCode, dword activation )
{ 
  // if button 'Next VT' is pressed the object pool is moved to the next VT
  if (objectID == 6000 && keyCode == 1 && activation == 1) 
  {
    MoveToNextVT();
  }  
}

void MoveToNextVT()
{
  Iso11783IL_OPDeactivate();
  
  // After one second the object pool is transferred to the next Virtual Terminal
  SetTimer( mMoveTimer, 100 );
}

