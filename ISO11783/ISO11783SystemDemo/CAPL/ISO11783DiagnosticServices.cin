/*@!Encoding:1252*/
variables
{

/*
 * ISO11783 Diagnostics Services (ISO11783-12)              Version 1.0
 * 
 * Copyright Vector Informatik GmbH - All rights reserved
 * 
 * This CAPL Library provides function for ISO11783-12 Diagnostics
 * Services. The acronym ids is used as prefix for types/variables/
 * functions defined in this module. It needs the ISO11783 Node Layer.
 * 
 * History:
 * 1.0   (amr)  First public version
 */

  struct IdsDTC
  {
    dword spn ;     // Suspect Parameter Number (19bit)
    word  fmi ;     // Fault Mode Identifier (5bit)
    byte  oc ;      // occurence counter (7bit)
    byte  active ;  // DTC is active (bool)
  } ;

  struct IdsDTC gIdsDtcActive[long] ;   // key is spn<<8 | fmi
  struct IdsDTC gIdsDtcPrevious[long] ; // key is spn<<8 | fmi

  struct // parameter for ECUID PG (ISO11783-12 B.1)
  {
    char EcuPartNumber[100] ;
    char EcuSerialNumber[100] ;
    char EcuLocation[100] ;
    char EcuType[100] ;
    char EcuManufacturerName[100] ;
    char EcuHardwareID[100] ;
  } gIdsEcuidParam ;

  struct // paramter for SOFT PG (ISO11783-12 B.2)
  {
    int  SoftwareIdentFields ; // max 7
    char SoftwareIdent[7][100] ;
  } gIdsSoftParam ;

  struct // parameter for ICC PG (ISO11783-12 B.3)
  {
    byte CertificationYear            ; //  6bit
    byte CertificateRevision          ; //  3bit
    byte CertificateLaboratoryType    ; //  3bit
    word CertificationLaboratoryID    ; // 11bit
    byte CertTypeMinimumECU           ; //  1bit
    byte CertTypeTECUClass1           ; //  1bit
    byte CertTypeTECUClass2           ; //  1bit
    byte CertTypeTECUClass3           ; //  1bit
    byte CertTypeClass3ECU            ; //  1bit
    byte CertTypeVirtualTerminal      ; //  1bit
    byte CertTypeVTWorkingSetMaster   ; //  1bit
    byte CertTypeVTWorkingSetMember   ; //  1bit
    byte CertTypeTaskController       ; //  1bit
    byte CertTypeTCWorkingSetMaster   ; //  1bit
    byte CertTypeTCWorkingSetMember   ; //  1bit
    byte CertTypeFileServer           ; //  1bit
    byte CertTypeGPSReceiver          ; //  1bit
    word CertificationReferenceNumber ; // 16bit
  } gIdsIccParam ;

  struct // parameter for DP PG (ISO11783-12 B.5)
  {
    byte J1939_73       ; // 1bit
    byte ISO14230       ; // 1bit
    byte ISO15765_3     ; // 1bit
  } gIdsDpParam ;

  struct // parameter for VI PG (J1939-71)
  {
    char VehicleIdentificationNumber[200] ;
  } gIdsVehicleIdentificationParam ;
  
  struct // parameter for PPI PG (ISO11783-12 B.10)
  {
    char ProductIdentificationCode[100] ;
    char ProductIdentificationBrand[100] ;
    char ProductIdentificationModel[100] ;
  } gIdsProductIdentificationParam ;

  enum IdsFMI // failure mode identification codes (ISO11783-12 E.3)
  {
    kIdsFMI_DataAboveNormal_MostSevereLevel                  =  0,
    kIdsFMI_DataBelowNormal_MostSevereLevel                  =  1,
    kIdsFMI_DataErraticIntermittentOrIncorrect               =  2,
    kIdsFMI_VoltageAboveNormalOrShortedToHighSource          =  3,
    kIdsFMI_VoltageBelowNormalOrShortedToLowSource           =  4,
    kIdsFMI_CurrentBelowNormalOrOpenCircuit                  =  5,
    kIdsFMI_CurrentAboveNormalOrGroundedCircuit              =  6,
    kIdsFMI_MechanicalSystemNotRespondingOrOutOfAdjustment   =  7,
    kIdsFMI_AbnormalFrequencyOrPulseWidthOrPeriod            =  8,
    kIdsFMI_AbnormalUpdateRate                               =  9,
    kIdsFMI_AbnormalRateOfChange                             = 10,
    kIdsFMI_RootCauseNotKnown                                = 11,
    kIdsFMI_BadIntelligentDeviceOrComponent                  = 12,
    kIdsFMI_OutOfCalibration                                 = 13,
    kIdsFMI_SpecialInstructions                              = 14,
    kIdsFMI_DataAboveNormal_LeastSevereLevel                 = 15,
    kIdsFMI_DataAboveNormal_ModeratelySevereLevel            = 16,
    kIdsFMI_DataBelowNormal_LeastSevereLevel                 = 17,
    kIdsFMI_DataBelowNormal_ModeratelySevereLevel            = 18,
    kIdsFMI_ReceivedNetworkDataInError                       = 19,
    kIdsFMI_DataDriftedHigh                                  = 20,
    kIdsFMI_DataDriftedLow                                   = 21,
    kIdsFMI_ConditionExists                                  = 31
  } ;
}

// workaround

void idsMemcpy(struct IdsDTC dst, struct IdsDTC src)
{
  memcpy(dst, src) ;
}

// activate an "spn"/"fmi" in the "dtcs" table
// if DTC already present increase OC if not already active and less than 126

void idsDtcActivate(struct IdsDTC dtcs[long], word spn, word fmi)
{
  struct IdsDTC dtc ;
  long keySpnFmi ;

  keySpnFmi = spn<<8 | fmi ;

  if (!dtcs.containsKey(keySpnFmi))
  {
    dtc.spn    = spn ;
    dtc.fmi    = fmi ;
    dtc.oc     = 0 ;
    dtc.active = 0 ;
  }
  else
    idsMemcpy(dtc, dtcs[keySpnFmi]) ;

  if (!dtc.active)
  {
    if (dtc.oc < 126)
      dtc.oc += 1 ;
    dtc.active = 1 ;

    idsMemcpy(dtcs[keySpnFmi], dtc) ;
  }
}

// deactivate an "spn"/"fmi" in the "dtcs" table

void idsDtcDeactivate(struct IdsDTC dtcs[long], word spn, word fmi)
{
  dtcs[spn<<8|fmi].active = 0 ;
}

// activate an "spn"/"fmi" in Active (DM1) and Previous (DM2) DTC tables

void idsDtcActivate(word spn, word fmi)
{
  idsDtcActivate(gIdsDtcActive,   spn, fmi) ;
  idsDtcActivate(gIdsDtcPrevious, spn, fmi) ;
}

// deactivate an "spn"/"fmi" in Active (DM1) and Previous (DM2) DTC tables

void idsDtcDeactivate(word spn, word fmi)
{
  idsDtcDeactivate(gIdsDtcActive,   spn, fmi) ;
  idsDtcDeactivate(gIdsDtcPrevious, spn, fmi) ;
}

// remove all entries in Active (DM1) DTC table

void idsDtcDeactivateActive()
{
  gIdsDtcActive.clear() ;
}

// remove all entries in Previous (DM2) DTC table

void idsDtcDeactivatePrevious()
{
  gIdsDtcPrevious.clear() ;
}

// build a "dm" PG with DTCs from the "dtcs" table
// if "all" is false only add active DTCs 
// ISO11783-12 B.6 (DM1)
// ISO11783-12 B.7 (DM2)

void idsFillDM1withDTCs(pg DM1 dm, struct IdsDTC dtcs[long], byte all)
{
  long spn ;
  word fmi ;
  byte oc ;
  word offset ;

  offset = 0 ;
  dm.word(offset) = 0xffff ;
  offset += 2 ;

  for (long keySpnFmi: dtcs)
  {
    if (all || dtcs[keySpnFmi].active)
    {
      spn = dtcs[keySpnFmi].spn ;
      fmi = dtcs[keySpnFmi].fmi ;
      oc  = dtcs[keySpnFmi].oc ;

      dm.dword(offset) = (spn & 0x3ffff) <<  0 |
                         (fmi &    0x1f) << 16 |
                         (oc  &    0x7f) << 24 ;
      offset += 4 ;
    }
  }

  switch (offset)
  {
  case 2: // no active
    dm.dlc      = 8 ;
    dm.dword(2) = 0 ;
    dm.word(6)  = 0xffff ;
    break ;
  case 6: // one active
    dm.dlc      = 8 ;
    dm.word(6)  = 0xffff ;
    break ;
  default: // more active
    dm.dlc      = offset ;
    break ;
  }
}

// append string "src" to PG "dstPg" data at "dstOffset"
// returns length of "dstPg" data
int idsConcat(pg CAPL_IDS dstPg, int dstOffset, char src[])
{
  int len ;
  int i ;

  if ((dstOffset < 0) || (dstOffset >= dstPg.dlc))
    return -1 ;

  len = strlen(src) ;
  for (i = 0 ; (i < len) && (dstOffset < dstPg.dlc) ; ++i)
    dstPg.byte(dstOffset++) = src[i] ;
  if (dstOffset < dstPg.dlc)
    dstPg.byte(dstOffset++) = '*' ;

  return dstOffset ;
}

// ISO11783-12 B.1
void idsPrepareECUID(pg ECUID ecuid)
{
  long offset;
  ecuid.dlc = 1785 ;
  offset = 0 ;
  offset = idsConcat((pg CAPL_IDS) ecuid, offset, gIdsEcuidParam.EcuPartNumber) ;
  offset = idsConcat((pg CAPL_IDS) ecuid, offset, gIdsEcuidParam.EcuSerialNumber) ;
  offset = idsConcat((pg CAPL_IDS) ecuid, offset, gIdsEcuidParam.EcuLocation) ;
  offset = idsConcat((pg CAPL_IDS) ecuid, offset, gIdsEcuidParam.EcuType) ;
  offset = idsConcat((pg CAPL_IDS) ecuid, offset, gIdsEcuidParam.EcuManufacturerName) ;
  offset = idsConcat((pg CAPL_IDS) ecuid, offset, gIdsEcuidParam.EcuHardwareID) ;

  while ((offset > 0) && (offset < 8))
    ecuid.byte(offset++) = 0xff ;

  ecuid.dlc = offset ;
}

// ISO11783-12 B.2
void idsPrepareSOFT(pg SOFT soft)
{
  int offset ;
  int iIdent ;

  soft.dlc = 1785 ;
  offset = 0 ;

  soft.byte(offset++) = gIdsSoftParam.SoftwareIdentFields ;
  for (iIdent = 0 ; iIdent < gIdsSoftParam.SoftwareIdentFields ; ++iIdent)
  {
    char param[100] ;

    //offset = idsConcat((pg CAPL_IDS) soft, offset, gIdsSoftParam[iIdent]) ;

    strncpy(param, gIdsSoftParam.SoftwareIdent[iIdent], 100) ;
    offset = idsConcat((pg CAPL_IDS) soft, offset, param) ;
  }

  while ((offset > 0) && (offset < 8))
    soft.byte(offset++) = 0xff ;

  soft.dlc = offset ;
}

// ISO11783-12 B.3
void idsPrepareICC(pg ICC icc)
{
  icc.qword(0) = 0xffffffffffffffffLL ;

  icc.TestProtocolPublicationYear  = gIdsIccParam.CertificationYear            ;
  icc.TestProtocolRevision         = gIdsIccParam.CertificateRevision          ;
  icc.CertLaboratoryType_SecondDef = gIdsIccParam.CertificateLaboratoryType    ;
  icc.CertificationLaboratoryID    = gIdsIccParam.CertificationLaboratoryID    ;
  icc.MessageRevision              = 1;
  icc.CertificationReferenceNumber = gIdsIccParam.CertificationReferenceNumber ;

  icc.dlc = 8 ;
}


// ISO11783-12 B.4
// send ECUNAME PG --- not implemented

void idsEcuNameSend()
{
  write("ECU ISO 11783 NAME (ISO11783-12 B.4) not implemented") ;
}

// ISO11783-12 B.5
void idsPrepareDP(pg DP dp)
{
  dp.qword(0) = 0xffffffffffffffffLL ;
  dp.J1939_73       = gIdsDpParam.J1939_73       ;
  dp.ISO14230       = gIdsDpParam.ISO14230       ;
  dp.ISO15765_3     = gIdsDpParam.ISO15765_3     ;

  dp.dlc = 8 ;
}


// J1939-71 (VI PG)
void idsPrepareVI(pg VI vi)
{
  int  offset ;

  vi.dlc = 1785 ;
  offset = 0 ;
  offset = idsConcat((pg CAPL_IDS) vi, offset, gIdsVehicleIdentificationParam.VehicleIdentificationNumber) ;

  while ((offset > 0) && (offset < 8))
    vi.byte(offset++) = 0xff ;

  vi.dlc = offset ;
}

// ISO11783-12 B.10
void idsPreparePII(pg PII pii)
{
  long offset;
  pii.dlc = 1785 ;
  offset = 0 ;
  offset = idsConcat((pg CAPL_IDS) pii, offset, gIdsProductIdentificationParam.ProductIdentificationCode) ;
  offset = idsConcat((pg CAPL_IDS) pii, offset, gIdsProductIdentificationParam.ProductIdentificationBrand) ;
  offset = idsConcat((pg CAPL_IDS) pii, offset, gIdsProductIdentificationParam.ProductIdentificationModel) ;

  while ((offset > 0) && (offset < 8))
    pii.byte(offset++) = 0xff ;

  pii.dlc = offset ;
}


