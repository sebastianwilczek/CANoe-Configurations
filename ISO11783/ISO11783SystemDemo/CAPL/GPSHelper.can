/*@!Encoding:1252*/
includes
{
  
}

variables
{
  
}

on sysvar sysvar::GPS::GPS1.Speed
{
  @GPS::GPS1_Color.Track = GetColourFrom_WhiteToBlue(@this, 10);
  //@GPS::GPS1_Color.Track = GetColourFrom_Rainbow(@this, 10);
}

on *
{
  output(this);
}

/*
Colour is between the white (curSpeed == 0) and blue (curSpeed == maxSpeed)
*/
long GetColourFrom_WhiteToBlue(double curSpeed, double maxSpeed)
{
  int otherPart;
  if(curSpeed < maxSpeed)
    otherPart = 255 - 255 * (curSpeed / maxSpeed);
  else
    otherPart = 0;
  return makeRGB(otherPart, otherPart, 255);
}
/*
Colour gradient is a rainbow: 
blue:   curSpeed == 0;
green:  curSpeed == maxSpeed * 0.4;
yellow: curSpeed == maxSpeed * 0.5;
orange: curSpeed == maxSpeed * 0.6;
red:    curSpeed == maxSpeed.
*/

long GetColourFrom_Rainbow(double curSpeed, double maxSpeed)
{
  int red, green, blue;
  
  if(curSpeed < maxSpeed * 0.4)
  {
    red = 0;
    green = (curSpeed * 2.0 / maxSpeed) * 255;
    blue = (1.0 - curSpeed * 2.0 / maxSpeed) * 255; 
  }
  else if(curSpeed < maxSpeed * 0.6)
  {
    red = (0.2 - (maxSpeed * 0.6 - curSpeed)/maxSpeed)* 5 * 255;
    green = 255;
    blue = 0;
  }
  else if(curSpeed < maxSpeed)
  {
    red = 255;
    green = (2.0 - curSpeed * 2.0 / maxSpeed) * 255;
    blue = 0;
  }
  else
  {
    red = 255;
    green = 0;
    blue = 0;                                       
  }
  return makeRGB(red, green, blue);
}
