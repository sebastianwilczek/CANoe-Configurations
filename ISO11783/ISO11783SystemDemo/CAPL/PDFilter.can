/*@!Encoding:1252*/
variables
{
  qword lastTCStatus[255];
  qword lastClientTaskMsg[255];
}

on start
{
  int pos;
  for(pos = 0; pos < 255; pos++)
  {
    lastTCStatus[pos] = 0;
    lastClientTaskMsg[pos] = 0;
  }
}

on pg *
{
//  output(this);
}

/**
Lets pass the PD messages only.
In case of "Task Controller status" message or "Client Task" message: lets it pass if the content has changed.
*/
on pg 0xCB00
{
  switch (this.byte(0) & 0x0f) 
  {
    case 0xe: // Task Controller status
    {
      if(lastTCStatus[this.SA] != this.QWord(0))
      {
        lastTCStatus[this.SA] = this.QWord(0);
        output(this);
      }
    }
    break;
    
    case 0xf: // Client Task message
    {
      if(lastClientTaskMsg[this.SA] != this.QWord(0))
      {
        lastClientTaskMsg[this.SA] = this.QWord(0);
        output(this);
      }
    }
    break;

    default:
	  output(this);
	  break;
  }
}

on pg TPCM, TPDT,ETP_CM, ETP_DT
{
//  output( this );
}

