/*@!Encoding:1252*/
/**************************************************************************************************
 Description: This file is part of the examples in the option CANaero.
              It feeds a small aircraft model with environment date.
 -------------------------------------------------------------------------------------------------
      C O P Y R I G H T 
 ------------------------------------------------------------------------------------------------- 
  Copyright (c) 2014 by Vector Informatik GmbH. All rights reserved. 
  
  This software is copyright protected and proprietary to Vector Informatik GmbH. 
  Vector Informatik GmbH grants to you only those rights as set out in the license conditions. 
  All other rights remain with Vector Informatik GmbH. 
  
  REMOVAL OF THESE COMMENTS IS A VIOLATION OF THE COPYRIGHT AGREEMENT. 
 *************************************************************************************************/

variables
{
  mstimer oFlightControlCycleTimer;
  int     nFlightControlCycleTime = 50;
  float   varLeftAileronPosition = 0;
  float   varRightAileronPosition = 0;
  float   varElevatorPosition = 0;
  char    bAutoPilotActivated = 0;
}



on timer oFlightControlCycleTimer
{
  if( bAutoPilotActivated )
  {
    HandleAutoPilot();
  }

  SetTimer( oFlightControlCycleTimer, nFlightControlCycleTime );
}



on start
{
    SetTimer( oFlightControlCycleTimer, nFlightControlCycleTime );
}



on key 'a'
{
  bAutoPilotActivated = (~bAutoPilotActivated) & 0x01;
  @evAutopilot = bAutoPilotActivated;
}



on envVar evBank
{
  float nBank;
  nBank = Deg2Rad( @this ); //getting degrees; convert to rad

  $LeftAileronPosition   = -nBank;
  $RightAileronPosition  =  nBank;
}



on envVar evAutopilot
{
  bAutoPilotActivated = @evAutopilot;
}



on envVar evPitch
{
  $ElevatorPosition = Deg2Rad( @this ); //getting degrees; convert to rad
}



float Deg2Rad( float nDeg )
{
  return (2*pi*nDeg)/360;
}



HandleAutopilot ()
{
  @evBank  = (sin( timeNow() / 400000.0 ) * 19.5 + (double)random( 9 ) * 0.125 - 0.5 );
  @evPitch = (sin( timeNow() / 600000.0 ) * 24.5 + (double)random( 9 ) * 0.125 - 0.5 );
}