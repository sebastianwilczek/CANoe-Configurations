

on message
  NodeServiceRequestFID0SID0,   // group: all
  NodeServiceRequestFID4SID0,   // group: FID = 4
  NodeServiceRequestFID8SID0,   // group: FID = 8
  NodeServiceRequestFID16SID0,  // group: FID = 16
  NodeServiceRequestFID20SID0,  // group: FID = 20
  NodeServiceRequestFID4SID1,   // Flight state
  NodeServiceRequestFID4SID2,   // Aileron left
  NodeServiceRequestFID4SID3,   // Aileron right
  NodeServiceRequestFID4SID4,   // Rudder
  NodeServiceRequestFID4SID5,   // Elevator
  NodeServiceRequestFID8SID1,   // Indicating/Recording Systems
  NodeServiceRequestFID16SID1,  // Engine Fuel and Control
  NodeServiceRequestFID20SID1   // Stabilizers
{
  if (
       (this.dlc == 8)
    && (this.word(0) == 0) ) {
    switch (this.id) {
      // Generic: Node Service Handling
      case NodeServiceRequestFID0SID0.id:
        GenerateResponseFID4SID1 ();
        GenerateResponseFID4SID2 ();
        GenerateResponseFID4SID3 ();
        GenerateResponseFID4SID4 ();
        GenerateResponseFID4SID5 ();
        GenerateResponseFID8SID1 ();
        GenerateResponseFID16SID1 ();
        GenerateResponseFID20SID1 ();
        break;
      // Function Group 4:  Node Service Handling
      case NodeServiceRequestFID4SID0.id:
        GenerateResponseFID4SID1 ();
        GenerateResponseFID4SID2 ();
        GenerateResponseFID4SID3 ();
        GenerateResponseFID4SID4 ();
        GenerateResponseFID4SID5 ();
        break;
      // Flight state: specific Node Service Handling
      case NodeServiceRequestFID4SID1.id:
        GenerateResponseFID4SID1 ();
        break;
      // AileronLeft: specific Node Service Handling
      case NodeServiceRequestFID4SID2.id:
        GenerateResponseFID4SID2 ();
        break;
      // AileronRight: specific Node Service Handling
      case NodeServiceRequestFID4SID3.id:
        GenerateResponseFID4SID3 ();
        break;
      // Rudder: specific Node Service Handling
      case NodeServiceRequestFID4SID4.id:
        GenerateResponseFID4SID4 ();
        break;
      // Elevator: specific Node Service Handling
      case NodeServiceRequestFID4SID5.id:
        GenerateResponseFID4SID5 ();
        break;
      // Function Group 8: specific Node Service Handling
      case NodeServiceRequestFID8SID0.id:
        GenerateResponseFID8SID1 ();
        break;
      // Indicating/Recording Systems: specific Node Service Handling
      case NodeServiceRequestFID8SID1.id:
        GenerateResponseFID8SID1 ();
        break;
      // Function Group 16: specific Node Service Handling
      case NodeServiceRequestFID16SID0.id:
        GenerateResponseFID16SID1 ();
        break;
      // Engine Fuel and Control: specific Node Service Handling
      case NodeServiceRequestFID16SID1.id:
        GenerateResponseFID16SID1 ();
        break;
      // Function Group 20: specific Node Service Handling
      case NodeServiceRequestFID20SID0.id:
        GenerateResponseFID20SID1 ();
        break;
      // Stabilizers: specific Node Service Handling
      case NodeServiceRequestFID20SID1.id:
        GenerateResponseFID20SID1 ();
        break;
    }
  }
}



// Flight State: Create Service Response Message
GenerateResponseFID4SID1 ()
{
  message NodeServiceResponseFID4SID1 myMsg;
  myMsg.NodeServiceResponseFID4SID1 = 0x0000;
  myMsg.ProfileIDFID4SID1           = 2;
  myMsg.ProfileSubIDFID4SID1        = 5;
  myMsg.LRUcodeFID4SID1             = 0x0401;
  output( myMsg );
}



// AileronLeft: Create Service Response Message
GenerateResponseFID4SID2 ()
{
  message NodeServiceResponseFID4SID2 myMsg;
  myMsg.NodeServiceResponseFID4SID2 = 0x0000;
  myMsg.ProfileIDFID4SID2           = 2;
  myMsg.ProfileSubIDFID4SID2        = 5;
  myMsg.LRUcodeFID4SID2             = 0x0402;
  output( myMsg );
}



// AileronRight: Create Service Response Message
GenerateResponseFID4SID3 ()
{
  message NodeServiceResponseFID4SID3 myMsg;
  myMsg.NodeServiceResponseFID4SID3 = 0x0000;
  myMsg.ProfileIDFID4SID3           = 2;
  myMsg.ProfileSubIDFID4SID3        = 5;
  myMsg.LRUcodeFID4SID3             = 0x0403;
  output( myMsg );
}



// Rudder: Create Service Response Message
GenerateResponseFID4SID4 ()
{
  message NodeServiceResponseFID4SID4 myMsg;
  myMsg.NodeServiceResponseFID4SID4 = 0x0000;
  myMsg.ProfileIDFID4SID4           = 2;
  myMsg.ProfileSubIDFID4SID4        = 5;
  myMsg.LRUcodeFID4SID4             = 0x0404;
  output( myMsg );
}



// Elevator: Create Service Response Message
GenerateResponseFID4SID5 ()
{
  message NodeServiceResponseFID4SID5 myMsg;
  myMsg.NodeServiceResponseFID4SID5 = 0x0000;
  myMsg.ProfileIDFID4SID5           = 2;
  myMsg.ProfileSubIDFID4SID5        = 5;
  myMsg.LRUcodeFID4SID5             = 0x0405;
  output( myMsg );
}



// Indicating/Recording Systems: Create Service Response Message
GenerateResponseFID8SID1 ()
{
  message NodeServiceResponseFID8SID1 myMsg;
  myMsg.NodeServiceResponseFID8SID1 = 0x0000;
  myMsg.ProfileIDFID8SID1           = 2;
  myMsg.ProfileSubIDFID8SID1        = 5;
  myMsg.LRUcodeFID8SID1             = 0x0801;
  output( myMsg );
}



// Engine Fuel and Control: Create Service Response Message
GenerateResponseFID16SID1 ()
{
  message NodeServiceResponseFID16SID1 myMsg;
  myMsg.NodeServiceResponseFID16SID1 = 0x0000;
  myMsg.ProfileIDFID16SID1           = 2;
  myMsg.ProfileSubIDFID16SID1        = 5;
  myMsg.LRUcodeFID16SID1             = 0x1001;
  output( myMsg );
}



// Stabilizers: Create Service Response Message
GenerateResponseFID20SID1 ()
{
  message NodeServiceResponseFID20SID1 myMsg;
  myMsg.NodeServiceResponseFID20SID1 = 0x0000;
  myMsg.ProfileIDFID20SID1           = 2;
  myMsg.ProfileSubIDFID20SID1        = 5;
  myMsg.LRUcodeFID20SID1             = 0x1401;
  output( myMsg );
}