variables
{
}

on key 'i'
{
    message NodeServiceRequestFID4SID1 oNodeServiceRequestFID4SID1;
    message NodeServiceRequestFID8SID1 oNodeServiceRequestFID8SID1;
    message NodeServiceRequestFID16SID1 oNodeServiceRequestFID16SID1;
    message NodeServiceRequestFID20SID1 oNodeServiceRequestFID20SID1;

    oNodeServiceRequestFID4SID1.NodeServiceRequestFID4SID1 = 0x0000;//Node Identification Service (IDS)
    output( oNodeServiceRequestFID4SID1 );

    oNodeServiceRequestFID8SID1.NodeServiceRequestFID8SID1 = 0x0000;//Node Identification Service (IDS)
    output( oNodeServiceRequestFID8SID1 );

    oNodeServiceRequestFID16SID1.NodeServiceRequestFID16SID1 = 0x0000;//Node Identification Service (IDS)
    output( oNodeServiceRequestFID16SID1 );

    oNodeServiceRequestFID20SID1.NodeServiceRequestFID20SID1 = 0x0000;//Node Identification Service (IDS)
    output( oNodeServiceRequestFID20SID1 );
}

on key 'I'
{
     message NodeServiceRequestFID0SID0 oNodeServiceRequestFID0SID0;

    oNodeServiceRequestFID0SID0.NodeServiceRequestFID0SID0 = 0x0000;//Node Identification Service (IDS)
    output( oNodeServiceRequestFID0SID0 );
}

on key 'S'
{
    message NodeServiceRequestFID0SID0 oNodeServiceRequestFID0SID0;
    oNodeServiceRequestFID0SID0.NodeServiceRequestFID0SID0 = 0x0001;//Node Synchronisation Service (NSS)
    output( oNodeServiceRequestFID0SID0 );
}

on key 's'
{
    message NodeServiceRequestFID4SID1 oNodeServiceRequestFID4SID1;
    message NodeServiceRequestFID8SID1 oNodeServiceRequestFID8SID1;
    message NodeServiceRequestFID16SID1 oNodeServiceRequestFID16SID1;
    message NodeServiceRequestFID20SID1 oNodeServiceRequestFID20SID1;

    oNodeServiceRequestFID4SID1.NodeServiceRequestFID4SID1 = 0x0001;//Node Synchronisation Service (NSS)
    output( oNodeServiceRequestFID4SID1 );

    oNodeServiceRequestFID8SID1.NodeServiceRequestFID8SID1 = 0x0001;//Node Synchronisation Service (NSS)
    output( oNodeServiceRequestFID8SID1 );

    oNodeServiceRequestFID16SID1.NodeServiceRequestFID16SID1 = 0x0001;//Node Synchronisation Service (NSS)
    output( oNodeServiceRequestFID16SID1 );

    oNodeServiceRequestFID20SID1.NodeServiceRequestFID20SID1 = 0x0001;//Node Synchronisation Service (NSS)
    output( oNodeServiceRequestFID20SID1 );
}

