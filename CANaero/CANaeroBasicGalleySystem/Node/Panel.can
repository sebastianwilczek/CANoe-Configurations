/*@@var:*/
variables
{
  const int kPanel_MaxMenuEntries = 6;
  const int kPanel_MaxScreens     = 2;

  const int kPanel_ScreenMain = 0;
  const int kPanel_ScreenNodes = 1;

  const int kPanel_MenuNodes = 0;

  int  gPanel_Width;
  int  gPanel_Height;

  char gPanel_OutString[10000];

  int  gPanel_CurrentScreen;
  int  gPanel_CurrentSelection[kPanel_MaxScreens];

  int  gPanel_MenuCount;
  int  gPanel_MenuPos[kPanel_MaxMenuEntries];
}
/*@@end*/

/*@@caplFunc:Panel_AddMenu(char[]):*///function
void Panel_AddMenu (char text[])
{
  int i, maxlen;

  if (kPanel_MaxMenuEntries > gPanel_MenuCount) {
    maxlen = strlen(text);

    for (i = gPanel_MenuPos[gPanel_MenuCount]; i < gPanel_MenuPos[gPanel_MenuCount] + 3; i++) {
      gPanel_OutString[i] = ' ';
    }
    for (i = gPanel_MenuPos[gPanel_MenuCount] + 3; i < gPanel_MenuPos[gPanel_MenuCount] + 3 + maxlen; i++) {
      gPanel_OutString[i] = text[i-gPanel_MenuPos[gPanel_MenuCount]-3];
    }
    gPanel_OutString[i]   = '\r';
    gPanel_OutString[i+1] = '\n';

    gPanel_MenuPos[++gPanel_MenuCount] = i+2;
  }
}
/*@@end*/

/*@@caplFunc:Panel_FlushScreen():*///function
void Panel_FlushScreen ()
{
  int i;
  write(gPanel_OutString);

  for (i = 0; i < gPanel_MenuCount; i++) {
    if (i == gPanel_CurrentSelection[gPanel_CurrentScreen]) {
      gPanel_OutString[gPanel_MenuPos[gPanel_CurrentSelection[gPanel_CurrentScreen]]] = '>';
    }
    else {
      gPanel_OutString[gPanel_MenuPos[i]] = ' ';
    }
  }
  putValue(Panel_Out, gPanel_OutString);
}
/*@@end*/

/*@@caplFunc:Panel_SetCaption(char[]):*///function
void Panel_SetCaption (char text[]) // returns next free line index
{
  int i, maxlen;

  maxlen = strlen(text);
  strncpy(gPanel_OutString, text, maxlen+1);

  gPanel_OutString[maxlen]   = '\r';
  gPanel_OutString[maxlen+1] = '\n';

  for (i = maxlen+2; i < 2 * maxlen + 2; i++) {
    gPanel_OutString[i] = '=';
  }

  gPanel_OutString[i] = '\r';
  gPanel_OutString[++i] = '\n';

  gPanel_MenuPos[0] = ++i;
}
/*@@end*/

