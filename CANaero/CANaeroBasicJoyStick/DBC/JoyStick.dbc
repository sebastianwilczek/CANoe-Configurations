VERSION "HIPFNNYYYYYYYYYYYYYYYYYYYYYYYYYYNNNNNNNNNN/4/%%%/4/'%**4NNN///"

NS_ :

BS_:

BU_: Joystick

BO_ 2147485188 JOYSTICK_LAT: 8 Joystick
 SG_ JOYSTICK_LAT_high m13 : 55|16@0+ (1,0) [0|0] "" Vector__XXX
 SG_ JOYSTICK_LAT_float m2 : 39|32@0- (1,0) [0|0] "" Vector__XXX
 SG_ JOYSTICK_LAT_ushort m13 : 39|16@0+ (1,0) [0|0] "" Vector__XXX
 SG_ MsgCode : 31|8@0+ (1,0) [0|0] "" Vector__XXX
 SG_ ServiceCode : 23|8@0+ (1,0) [0|0] "" Vector__XXX
 SG_ DataType M : 15|8@0+ (1,0) [0|0] "" Vector__XXX
 SG_ TxNodeID : 7|8@0+ (1,0) [0|0] "" Vector__XXX

BO_ 2147485189 JOYSTICK_LONG: 8 Joystick
 SG_ JOYSTICK_LONG_high m13 : 55|16@0+ (1,0) [0|0] "" Vector__XXX
 SG_ JOYSTICK_LONG_float m2 : 39|32@0- (1,0) [0|0] "" Vector__XXX
 SG_ JOYSTICK_LONG_ushort m13 : 39|16@0+ (1,0) [0|0] "" Vector__XXX
 SG_ MsgCode : 31|8@0+ (1,0) [0|0] "" Vector__XXX
 SG_ ServiceCode : 23|8@0+ (1,0) [0|0] "" Vector__XXX
 SG_ DataType M : 15|8@0+ (1,0) [0|0] "" Vector__XXX
 SG_ TxNodeID : 7|8@0+ (1,0) [0|0] "" Vector__XXX

BO_ 1542 JOYSTICK_SWITCH: 8 Joystick
 SG_ JOYSTICK_SWITCH_blong m5 : 39|32@0- (1,0) [0|0] "" Vector__XXX
 SG_ MsgCode : 31|8@0+ (1,0) [0|0] "" Vector__XXX
 SG_ ServiceCode : 23|8@0+ (1,0) [0|0] "" Vector__XXX
 SG_ DataType M : 15|8@0+ (1,0) [0|0] "" Vector__XXX
 SG_ TxNodeID : 7|8@0+ (1,0) [0|0] "" Vector__XXX

EV_ evJoyStick_Long: 1 [0|5000] "" 0 1 DUMMY_NODE_VECTOR0 Vector__XXX;

EV_ evJoyStick_Lat: 1 [0|5000] "" 0 2 DUMMY_NODE_VECTOR0 Vector__XXX;

BA_DEF_ SG_  "GenSigSendType" ENUM  "Cyclic","OnWrite","OnWriteWithRepetition","OnChange","OnChangeWithRepetition","IfActive","IfActiveWithRepetition","NoSigSendType","NotUsed","NotUsed","NotUsed","NotUsed","NotUsed";
BA_DEF_ SG_  "A825SignalType" ENUM  "noPVS","PVSassigned","PVSvalue";
BA_DEF_ BO_  "GenMsgILSupport" ENUM  "No","Yes";
BA_DEF_ BO_  "GenMsgSendType" ENUM  "Cyclic","NotUsed","NotUsed","NotUsed","NotUsed","Cyclic","NotUsed","IfActive","NoMsgSendType","NotUsed","vector_leerstring";
BA_DEF_ BO_  "A825MsgType" ENUM  "unspecific","PeriodicHealth","HighIntegrity";
BA_DEF_ BU_  "CanEquipment" STRING ;
BA_DEF_ BU_  "NodeLayerModules" STRING ;
BA_DEF_  "BusType" STRING ;
BA_DEF_  "DBName" STRING ;
BA_DEF_  "ProtocolType" STRING ;
BA_DEF_  "VersionMonth" INT 0 12;
BA_DEF_  "VersionWeek" INT 0 52;
BA_DEF_  "VersionDay" INT 0 31;
BA_DEF_  "ToolVersion" STRING ;
BA_DEF_  "ToolName" STRING ;
BA_DEF_  "TemplateVersion" STRING ;
BA_DEF_  "A825RCIBitSize" INT 0 2;
BA_DEF_  "IsCANaerospace" INT 0 1;
BA_DEF_DEF_  "GenSigSendType" "Cyclic";
BA_DEF_DEF_  "A825SignalType" "noPVS";
BA_DEF_DEF_  "GenMsgILSupport" "Yes";
BA_DEF_DEF_  "GenMsgSendType" "NoMsgSendType";
BA_DEF_DEF_  "A825MsgType" "unspecific";
BA_DEF_DEF_  "CanEquipment" "<unknown>";
BA_DEF_DEF_  "NodeLayerModules" "CANoeILNLVector.dll";
BA_DEF_DEF_  "BusType" "CAN";
BA_DEF_DEF_  "DBName" "";
BA_DEF_DEF_  "ProtocolType" "ARINC825V3";
BA_DEF_DEF_  "VersionMonth" 1;
BA_DEF_DEF_  "VersionWeek" 1;
BA_DEF_DEF_  "VersionDay" 1;
BA_DEF_DEF_  "ToolVersion" "2.0.0.0";
BA_DEF_DEF_  "ToolName" "manually";
BA_DEF_DEF_  "TemplateVersion" "1.1.0.0";
BA_DEF_DEF_  "A825RCIBitSize" 2;
BA_DEF_DEF_  "IsCANaerospace" 1;
BA_ "DBName" "JoyStick";
VAL_ 2147485188 DataType 25 "ACHAR4" 24 "ACHAR2" 23 "ACHAR" 22 "CHKSUM" 21 "MEMID" 20 "BCHAR2" 19 "UCHAR2" 18 "CHAR2" 17 "BCHAR4" 16 "UCHAR4" 15 "CHAR4" 14 "BSHORT2" 13 "USHORT2" 12 "SHORT2" 11 "BCHAR" 10 "UCHAR" 9 "CHAR" 8 "BSHORT" 7 "USHORT" 6 "SHORT" 5 "BLONG" 4 "ULONG" 3 "LONG" 2 "FLOAT" 1 "ERROR" 0 "NODATA" ;
VAL_ 2147485189 DataType 25 "ACHAR4" 24 "ACHAR2" 23 "ACHAR" 22 "CHKSUM" 21 "MEMID" 20 "BCHAR2" 19 "UCHAR2" 18 "CHAR2" 17 "BCHAR4" 16 "UCHAR4" 15 "CHAR4" 14 "BSHORT2" 13 "USHORT2" 12 "SHORT2" 11 "BCHAR" 10 "UCHAR" 9 "CHAR" 8 "BSHORT" 7 "USHORT" 6 "SHORT" 5 "BLONG" 4 "ULONG" 3 "LONG" 2 "FLOAT" 1 "ERROR" 0 "NODATA" ;
VAL_ 1542 DataType 25 "ACHAR4" 24 "ACHAR2" 23 "ACHAR" 22 "CHKSUM" 21 "MEMID" 20 "BCHAR2" 19 "UCHAR2" 18 "CHAR2" 17 "BCHAR4" 16 "UCHAR4" 15 "CHAR4" 14 "BSHORT2" 13 "USHORT2" 12 "SHORT2" 11 "BCHAR" 10 "UCHAR" 9 "CHAR" 8 "BSHORT" 7 "USHORT" 6 "SHORT" 5 "BLONG" 4 "ULONG" 3 "LONG" 2 "FLOAT" 1 "ERROR" 0 "NODATA" ;
SIG_VALTYPE_ 2147485188 JOYSTICK_LAT_float : 1;
SIG_VALTYPE_ 2147485189 JOYSTICK_LONG_float : 1;
