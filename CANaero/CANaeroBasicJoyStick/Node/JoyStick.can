/*@!Encoding:1252*/
/**************************************************************************************************
 Description: This file is part of the examples in the option CANaero.
              The example simultaes a joy stick and generates CAN messages with the
              joy stick's position data.
 -------------------------------------------------------------------------------------------------
      C O P Y R I G H T 
 ------------------------------------------------------------------------------------------------- 
  Copyright (c) 2014 by Vector Informatik GmbH. All rights reserved. 
  
  This software is copyright protected and proprietary to Vector Informatik GmbH. 
  Vector Informatik GmbH grants to you only those rights as set out in the license conditions. 
  All other rights remain with Vector Informatik GmbH. 
  
  REMOVAL OF THESE COMMENTS IS A VIOLATION OF THE COPYRIGHT AGREEMENT. 
 *************************************************************************************************/

variables
{
  /* The messages are defined in the assigned database JoyStick.dbc */
  message JOYSTICK_LONG msgLongitude;
  message JOYSTICK_LAT  msgLatitude;
  
  /* The messages are triggered cyclically via the defined timer handler. */
  msTimer tLongitude;
  msTimer tLatitude;
  const long cLongitudeTime = 100;
  const long cLatitudeTime  = 100;
}

on preStart
{
  /* init static message contents */
  msgLongitude.MsgCode     = 0;
  msgLongitude.ServiceCode = 0;
  msgLongitude.TxNodeID    = 0;
  msgLongitude.DataType    = 2; /* float */

  msgLatitude.MsgCode      = 0;
  msgLatitude.ServiceCode  = 0;
  msgLatitude.TxNodeID     = 0;
  msgLatitude.DataType     = 2; /* float */
}

on start
{
  callAllOnEnvVar();
  /* start timers immediately */
  setTimer(tLongitude, 0);
  setTimer(tLatitude, 0);
}

on timer tLongitude
{
  /* send message and rearm timer */
  output(msgLongitude);
  setTimer(tLongitude, cLongitudeTime);
}

on timer tLatitude
{
  /* send message and rearm timer */
  output(msgLatitude);
  setTimer(tLatitude, cLatitudeTime);
}

on envVar evJoyStick_Long
{ 
  msgLongitude.JOYSTICK_LONG_float = @evJoyStick_Long;
}

on envVar evJoyStick_Lat
{ 
  msgLatitude.JOYSTICK_LAT_float = @evJoyStick_Lat;
}